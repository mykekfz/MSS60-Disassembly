ASAP2_VERSION 1 60
/begin PROJECT MSS60_V762_INJ "MSS60 (S65) V762 INJ CPU - generated 04.11.2026 from the reverse-engineered XDF"
/begin HEADER "Calibration description (characteristics from the XDF; measurements = V530 RAM names transferred to V762 addresses, confidence in each long identifier). Status tag in every long identifier: verified (checked against the code) / A2L-ref (placed from the V530 A2L) / EST (estimated) / unassigned (UNK placeholder)." VERSION "V762-RE-04112026" /end HEADER
/begin MODULE INJ "MSS60 V762 INJ"
/begin MOD_COMMON "" BYTE_ORDER MSB_FIRST ALIGNMENT_BYTE 1 ALIGNMENT_WORD 2 ALIGNMENT_LONG 4 /end MOD_COMMON
/begin CHARACTERISTIC K_ED_SL_DURCHS_HSTRANG.P_CODE_OPENLOAD "Fault code SL_DURCHS_HSTRANG - OBD P-code reported for open circuit [verified]" VALUE 0x71B3C RL_VAL_UW 0 CM_0000 0 65535 /end CHARACTERISTIC
/begin CHARACTERISTIC K_ED_SL_DURCHS_HSTRANG.P_CODE_SH_TO_GND "Fault code SL_DURCHS_HSTRANG - OBD P-code reported for short to ground [verified]" VALUE 0x71B3A RL_VAL_UW 0 CM_0000 0 65535 /end CHARACTERISTIC
/begin CHARACTERISTIC K_ED_SL_DURCHS_HSTRANG.P_CODE_SH_TO_UB "Fault code SL_DURCHS_HSTRANG - OBD P-code reported for short to battery voltage [verified]" VALUE 0x71B38 RL_VAL_UW 0 CM_0000 0 65535 /end CHARACTERISTIC
/begin CHARACTERISTIC K_ED_SL_DURCHS_HSTRANG.P_CODE_UNPLAUSIBEL "Fault code SL_DURCHS_HSTRANG - OBD P-code reported for implausible signal [verified]" VALUE 0x71B3E RL_VAL_UW 0 CM_0000 0 65535 /end CHARACTERISTIC
/begin CHARACTERISTIC K_ED_SL_ML_HFM.DEC_NACH_EINTRAG "Fault code SL_ML_HFM - debounce filter decrement after fault-memory entry [verified]" VALUE 0x70EFB RL_VAL_UB 0 CM_0000 0 255 /end CHARACTERISTIC
/begin CHARACTERISTIC K_ED_SL_ML_HFM.DEC_VOR_EINTRAG "Fault code SL_ML_HFM - debounce filter decrement before fault-memory entry [verified]" VALUE 0x70EF9 RL_VAL_UB 0 CM_0000 0 255 /end CHARACTERISTIC
/begin CHARACTERISTIC K_ED_SL_ML_HFM.FEHLERSCHWELLE "Fault code SL_ML_HFM - debounce filter threshold for setting the fault [verified]" VALUE 0x70EF6 RL_VAL_UB 0 CM_0000 0 255 /end CHARACTERISTIC
/begin CHARACTERISTIC K_ED_SL_ML_HFM.INC_NACH_EINTRAG "Fault code SL_ML_HFM - debounce filter increment after fault-memory entry [verified]" VALUE 0x70EFA RL_VAL_UB 0 CM_0000 0 255 /end CHARACTERISTIC
/begin CHARACTERISTIC K_ED_SL_ML_HFM.INC_VOR_EINTRAG "Fault code SL_ML_HFM - debounce filter increment before fault-memory entry [verified]" VALUE 0x70EF8 RL_VAL_UB 0 CM_0000 0 255 /end CHARACTERISTIC
/begin CHARACTERISTIC K_ED_SL_ML_HFM.KLASSENINDEX "Fault code SL_ML_HFM - fault class selection (lamp / warning behaviour) [verified]" VALUE 0x70EFC RL_VAL_UB 0 CM_0000 0 255 /end CHARACTERISTIC
/begin CHARACTERISTIC K_ED_SL_ML_HFM.OK_SCHWELLE "Fault code SL_ML_HFM - debounce filter threshold for clearing (healing) the fault [verified]" VALUE 0x70EF7 RL_VAL_UB 0 CM_0000 0 255 /end CHARACTERISTIC
/begin CHARACTERISTIC K_ED_SL_ML_HFM.P_CODE_OPENLOAD "Fault code SL_ML_HFM - OBD P-code reported for open circuit [verified]" VALUE 0x70EF2 RL_VAL_UW 0 CM_0000 0 65535 /end CHARACTERISTIC
/begin CHARACTERISTIC K_ED_SL_ML_HFM.P_CODE_SH_TO_GND "Fault code SL_ML_HFM - OBD P-code reported for short to ground [verified]" VALUE 0x70EF0 RL_VAL_UW 0 CM_0000 0 65535 /end CHARACTERISTIC
/begin CHARACTERISTIC K_ED_SL_ML_HFM.P_CODE_SH_TO_UB "Fault code SL_ML_HFM - OBD P-code reported for short to battery voltage [verified]" VALUE 0x70EEE RL_VAL_UW 0 CM_0000 0 65535 /end CHARACTERISTIC
/begin CHARACTERISTIC K_ED_SL_ML_HFM.P_CODE_UNPLAUSIBEL "Fault code SL_ML_HFM - OBD P-code reported for implausible signal [verified]" VALUE 0x70EF4 RL_VAL_UW 0 CM_0000 0 65535 /end CHARACTERISTIC
/begin CHARACTERISTIC K_ED_SL_ML_HFM_OBD.DEC_NACH_EINTRAG "Fault code SL_ML_HFM_OBD - debounce filter decrement after fault-memory entry [verified]" VALUE 0x71D33 RL_VAL_UB 0 CM_0000 0 255 /end CHARACTERISTIC
/begin CHARACTERISTIC K_ED_SL_ML_HFM_OBD.DEC_VOR_EINTRAG "Fault code SL_ML_HFM_OBD - debounce filter decrement before fault-memory entry [verified]" VALUE 0x71D31 RL_VAL_UB 0 CM_0000 0 255 /end CHARACTERISTIC
/begin CHARACTERISTIC K_ED_SL_ML_HFM_OBD.FEHLERSCHWELLE "Fault code SL_ML_HFM_OBD - debounce filter threshold for setting the fault [verified]" VALUE 0x71D2E RL_VAL_UB 0 CM_0000 0 255 /end CHARACTERISTIC
/begin CHARACTERISTIC K_ED_SL_ML_HFM_OBD.INC_NACH_EINTRAG "Fault code SL_ML_HFM_OBD - debounce filter increment after fault-memory entry [verified]" VALUE 0x71D32 RL_VAL_UB 0 CM_0000 0 255 /end CHARACTERISTIC
/begin CHARACTERISTIC K_ED_SL_ML_HFM_OBD.INC_VOR_EINTRAG "Fault code SL_ML_HFM_OBD - debounce filter increment before fault-memory entry [verified]" VALUE 0x71D30 RL_VAL_UB 0 CM_0000 0 255 /end CHARACTERISTIC
/begin CHARACTERISTIC K_ED_SL_ML_HFM_OBD.KLASSENINDEX "Fault code SL_ML_HFM_OBD - fault class selection (lamp / warning behaviour) [verified]" VALUE 0x71D34 RL_VAL_UB 0 CM_0000 0 255 /end CHARACTERISTIC
/begin CHARACTERISTIC K_ED_SL_ML_HFM_OBD.OK_SCHWELLE "Fault code SL_ML_HFM_OBD - debounce filter threshold for clearing (healing) the fault [verified]" VALUE 0x71D2F RL_VAL_UB 0 CM_0000 0 255 /end CHARACTERISTIC
/begin CHARACTERISTIC K_ED_SL_ML_HFM_OBD.P_CODE_OPENLOAD "Fault code SL_ML_HFM_OBD - OBD P-code reported for open circuit [verified]" VALUE 0x71D2A RL_VAL_UW 0 CM_0000 0 65535 /end CHARACTERISTIC
/begin CHARACTERISTIC K_ED_SL_ML_HFM_OBD.P_CODE_SH_TO_GND "Fault code SL_ML_HFM_OBD - OBD P-code reported for short to ground [verified]" VALUE 0x71D28 RL_VAL_UW 0 CM_0000 0 65535 /end CHARACTERISTIC
/begin CHARACTERISTIC K_ED_SL_ML_HFM_OBD.P_CODE_SH_TO_UB "Fault code SL_ML_HFM_OBD - OBD P-code reported for short to battery voltage [verified]" VALUE 0x71D26 RL_VAL_UW 0 CM_0000 0 65535 /end CHARACTERISTIC
/begin CHARACTERISTIC K_ED_SL_ML_HFM_OBD.P_CODE_UNPLAUSIBEL "Fault code SL_ML_HFM_OBD - OBD P-code reported for implausible signal [verified]" VALUE 0x71D2C RL_VAL_UW 0 CM_0000 0 65535 /end CHARACTERISTIC
/begin CHARACTERISTIC K_ED_S_GETR_HS.DEC_NACH_EINTRAG "Fault code S_GETR_HS - debounce filter decrement after fault-memory entry [verified]" VALUE 0x71B79 RL_VAL_UB 0 CM_0000 0 255 /end CHARACTERISTIC
/begin CHARACTERISTIC K_ED_S_GETR_HS.DEC_VOR_EINTRAG "Fault code S_GETR_HS - debounce filter decrement before fault-memory entry [verified]" VALUE 0x71B77 RL_VAL_UB 0 CM_0000 0 255 /end CHARACTERISTIC
/begin CHARACTERISTIC K_ED_S_GETR_HS.FEHLERSCHWELLE "Fault code S_GETR_HS - debounce filter threshold for setting the fault [verified]" VALUE 0x71B74 RL_VAL_UB 0 CM_0000 0 255 /end CHARACTERISTIC
/begin CHARACTERISTIC K_ED_S_GETR_HS.INC_NACH_EINTRAG "Fault code S_GETR_HS - debounce filter increment after fault-memory entry [verified]" VALUE 0x71B78 RL_VAL_UB 0 CM_0000 0 255 /end CHARACTERISTIC
/begin CHARACTERISTIC K_ED_S_GETR_HS.INC_VOR_EINTRAG "Fault code S_GETR_HS - debounce filter increment before fault-memory entry [verified]" VALUE 0x71B76 RL_VAL_UB 0 CM_0000 0 255 /end CHARACTERISTIC
/begin CHARACTERISTIC K_ED_S_GETR_HS.KLASSENINDEX "Fault code S_GETR_HS - fault class selection (lamp / warning behaviour) [verified]" VALUE 0x71B7A RL_VAL_UB 0 CM_0000 0 255 /end CHARACTERISTIC
/begin CHARACTERISTIC K_ED_S_GETR_HS.OK_SCHWELLE "Fault code S_GETR_HS - debounce filter threshold for clearing (healing) the fault [verified]" VALUE 0x71B75 RL_VAL_UB 0 CM_0000 0 255 /end CHARACTERISTIC
/begin CHARACTERISTIC K_ED_S_GETR_HS.P_CODE_OPENLOAD "Fault code S_GETR_HS - OBD P-code reported for open circuit [verified]" VALUE 0x71B70 RL_VAL_UW 0 CM_0000 0 65535 /end CHARACTERISTIC
/begin CHARACTERISTIC K_ED_S_GETR_HS.P_CODE_SH_TO_GND "Fault code S_GETR_HS - OBD P-code reported for short to ground [verified]" VALUE 0x71B6E RL_VAL_UW 0 CM_0000 0 65535 /end CHARACTERISTIC
/begin CHARACTERISTIC K_ED_S_GETR_HS.P_CODE_SH_TO_UB "Fault code S_GETR_HS - OBD P-code reported for short to battery voltage [verified]" VALUE 0x71B6C RL_VAL_UW 0 CM_0000 0 65535 /end CHARACTERISTIC
/begin CHARACTERISTIC K_ED_S_GETR_HS.P_CODE_UNPLAUSIBEL "Fault code S_GETR_HS - OBD P-code reported for implausible signal [verified]" VALUE 0x71B72 RL_VAL_UW 0 CM_0000 0 65535 /end CHARACTERISTIC
/begin CHARACTERISTIC K_ED_S_KUPP_HS.DEC_NACH_EINTRAG "Fault code S_KUPP_HS - debounce filter decrement after fault-memory entry [verified]" VALUE 0x71B93 RL_VAL_UB 0 CM_0000 0 255 /end CHARACTERISTIC
/begin CHARACTERISTIC K_ED_S_KUPP_HS.DEC_VOR_EINTRAG "Fault code S_KUPP_HS - debounce filter decrement before fault-memory entry [verified]" VALUE 0x71B91 RL_VAL_UB 0 CM_0000 0 255 /end CHARACTERISTIC
/begin CHARACTERISTIC K_ED_S_KUPP_HS.FEHLERSCHWELLE "Fault code S_KUPP_HS - debounce filter threshold for setting the fault [verified]" VALUE 0x71B8E RL_VAL_UB 0 CM_0000 0 255 /end CHARACTERISTIC
/begin CHARACTERISTIC K_ED_S_KUPP_HS.INC_NACH_EINTRAG "Fault code S_KUPP_HS - debounce filter increment after fault-memory entry [verified]" VALUE 0x71B92 RL_VAL_UB 0 CM_0000 0 255 /end CHARACTERISTIC
/begin CHARACTERISTIC K_ED_S_KUPP_HS.INC_VOR_EINTRAG "Fault code S_KUPP_HS - debounce filter increment before fault-memory entry [verified]" VALUE 0x71B90 RL_VAL_UB 0 CM_0000 0 255 /end CHARACTERISTIC
/begin CHARACTERISTIC K_ED_S_KUPP_HS.KLASSENINDEX "Fault code S_KUPP_HS - fault class selection (lamp / warning behaviour) [verified]" VALUE 0x71B94 RL_VAL_UB 0 CM_0000 0 255 /end CHARACTERISTIC
/begin CHARACTERISTIC K_ED_S_KUPP_HS.OK_SCHWELLE "Fault code S_KUPP_HS - debounce filter threshold for clearing (healing) the fault [verified]" VALUE 0x71B8F RL_VAL_UB 0 CM_0000 0 255 /end CHARACTERISTIC
/begin CHARACTERISTIC K_ED_S_KUPP_HS.P_CODE_OPENLOAD "Fault code S_KUPP_HS - OBD P-code reported for open circuit [verified]" VALUE 0x71B8A RL_VAL_UW 0 CM_0000 0 65535 /end CHARACTERISTIC
/begin CHARACTERISTIC K_ED_S_KUPP_HS.P_CODE_SH_TO_GND "Fault code S_KUPP_HS - OBD P-code reported for short to ground [verified]" VALUE 0x71B88 RL_VAL_UW 0 CM_0000 0 65535 /end CHARACTERISTIC
/begin CHARACTERISTIC K_ED_S_KUPP_HS.P_CODE_SH_TO_UB "Fault code S_KUPP_HS - OBD P-code reported for short to battery voltage [verified]" VALUE 0x71B86 RL_VAL_UW 0 CM_0000 0 65535 /end CHARACTERISTIC
/begin CHARACTERISTIC K_ED_S_KUPP_HS.P_CODE_UNPLAUSIBEL "Fault code S_KUPP_HS - OBD P-code reported for implausible signal [verified]" VALUE 0x71B8C RL_VAL_UW 0 CM_0000 0 65535 /end CHARACTERISTIC
/begin CHARACTERISTIC K_ED_S_POEL_DIAG.DEC_NACH_EINTRAG "Fault code S_POEL_DIAG - debounce filter decrement after fault-memory entry [verified]" VALUE 0x719BF RL_VAL_UB 0 CM_0000 0 255 /end CHARACTERISTIC
/begin CHARACTERISTIC K_ED_S_POEL_DIAG.DEC_VOR_EINTRAG "Fault code S_POEL_DIAG - debounce filter decrement before fault-memory entry [verified]" VALUE 0x719BD RL_VAL_UB 0 CM_0000 0 255 /end CHARACTERISTIC
/begin CHARACTERISTIC K_ED_S_POEL_DIAG.FEHLERSCHWELLE "Fault code S_POEL_DIAG - debounce filter threshold for setting the fault [verified]" VALUE 0x719BA RL_VAL_UB 0 CM_0000 0 255 /end CHARACTERISTIC
/begin CHARACTERISTIC K_ED_S_POEL_DIAG.INC_NACH_EINTRAG "Fault code S_POEL_DIAG - debounce filter increment after fault-memory entry [verified]" VALUE 0x719BE RL_VAL_UB 0 CM_0000 0 255 /end CHARACTERISTIC
/begin CHARACTERISTIC K_ED_S_POEL_DIAG.INC_VOR_EINTRAG "Fault code S_POEL_DIAG - debounce filter increment before fault-memory entry [verified]" VALUE 0x719BC RL_VAL_UB 0 CM_0000 0 255 /end CHARACTERISTIC
/begin CHARACTERISTIC K_ED_S_POEL_DIAG.KLASSENINDEX "Fault code S_POEL_DIAG - fault class selection (lamp / warning behaviour) [verified]" VALUE 0x719C0 RL_VAL_UB 0 CM_0000 0 255 /end CHARACTERISTIC
/begin CHARACTERISTIC K_ED_S_POEL_DIAG.OK_SCHWELLE "Fault code S_POEL_DIAG - debounce filter threshold for clearing (healing) the fault [verified]" VALUE 0x719BB RL_VAL_UB 0 CM_0000 0 255 /end CHARACTERISTIC
/begin CHARACTERISTIC K_ED_S_POEL_DIAG.P_CODE_OPENLOAD "Fault code S_POEL_DIAG - OBD P-code reported for open circuit [verified]" VALUE 0x719B6 RL_VAL_UW 0 CM_0000 0 65535 /end CHARACTERISTIC
/begin CHARACTERISTIC K_ED_S_POEL_DIAG.P_CODE_SH_TO_GND "Fault code S_POEL_DIAG - OBD P-code reported for short to ground [verified]" VALUE 0x719B4 RL_VAL_UW 0 CM_0000 0 65535 /end CHARACTERISTIC
/begin CHARACTERISTIC K_ED_S_POEL_DIAG.P_CODE_SH_TO_UB "Fault code S_POEL_DIAG - OBD P-code reported for short to battery voltage [verified]" VALUE 0x719B2 RL_VAL_UW 0 CM_0000 0 65535 /end CHARACTERISTIC
/begin CHARACTERISTIC K_ED_S_POEL_DIAG.P_CODE_UNPLAUSIBEL "Fault code S_POEL_DIAG - OBD P-code reported for implausible signal [verified]" VALUE 0x719B8 RL_VAL_UW 0 CM_0000 0 65535 /end CHARACTERISTIC
/begin CHARACTERISTIC K_ED_TANK_LEER.DEC_NACH_EINTRAG "Fault code TANK_LEER - debounce filter decrement after fault-memory entry [verified]" VALUE 0x71CCB RL_VAL_UB 0 CM_0000 0 255 /end CHARACTERISTIC
/begin CHARACTERISTIC K_ED_TANK_LEER.DEC_VOR_EINTRAG "Fault code TANK_LEER - debounce filter decrement before fault-memory entry [verified]" VALUE 0x71CC9 RL_VAL_UB 0 CM_0000 0 255 /end CHARACTERISTIC
/begin CHARACTERISTIC K_ED_TANK_LEER.FEHLERSCHWELLE "Fault code TANK_LEER - debounce filter threshold for setting the fault [verified]" VALUE 0x71CC6 RL_VAL_UB 0 CM_0000 0 255 /end CHARACTERISTIC
/begin CHARACTERISTIC K_ED_TANK_LEER.INC_NACH_EINTRAG "Fault code TANK_LEER - debounce filter increment after fault-memory entry [verified]" VALUE 0x71CCA RL_VAL_UB 0 CM_0000 0 255 /end CHARACTERISTIC
/begin CHARACTERISTIC K_ED_TANK_LEER.INC_VOR_EINTRAG "Fault code TANK_LEER - debounce filter increment before fault-memory entry [verified]" VALUE 0x71CC8 RL_VAL_UB 0 CM_0000 0 255 /end CHARACTERISTIC
/begin CHARACTERISTIC K_ED_TANK_LEER.KLASSENINDEX "Fault code TANK_LEER - fault class selection (lamp / warning behaviour) [verified]" VALUE 0x71CCC RL_VAL_UB 0 CM_0000 0 255 /end CHARACTERISTIC
/begin CHARACTERISTIC K_ED_TANK_LEER.OK_SCHWELLE "Fault code TANK_LEER - debounce filter threshold for clearing (healing) the fault [verified]" VALUE 0x71CC7 RL_VAL_UB 0 CM_0000 0 255 /end CHARACTERISTIC
/begin CHARACTERISTIC K_ED_TANK_LEER.P_CODE_OPENLOAD "Fault code TANK_LEER - OBD P-code reported for open circuit [verified]" VALUE 0x71CC2 RL_VAL_UW 0 CM_0000 0 65535 /end CHARACTERISTIC
/begin CHARACTERISTIC K_ED_TANK_LEER.P_CODE_SH_TO_GND "Fault code TANK_LEER - OBD P-code reported for short to ground [verified]" VALUE 0x71CC0 RL_VAL_UW 0 CM_0000 0 65535 /end CHARACTERISTIC
/begin CHARACTERISTIC K_ED_TANK_LEER.P_CODE_SH_TO_UB "Fault code TANK_LEER - OBD P-code reported for short to battery voltage [verified]" VALUE 0x71CBE RL_VAL_UW 0 CM_0000 0 65535 /end CHARACTERISTIC
/begin CHARACTERISTIC K_ED_TANK_LEER.P_CODE_UNPLAUSIBEL "Fault code TANK_LEER - OBD P-code reported for implausible signal [verified]" VALUE 0x71CC4 RL_VAL_UW 0 CM_0000 0 65535 /end CHARACTERISTIC
/begin CHARACTERISTIC K_ED_TD.DEC_NACH_EINTRAG "Fault code TD - debounce filter decrement after fault-memory entry [verified]" VALUE 0x7164B RL_VAL_UB 0 CM_0000 0 255 /end CHARACTERISTIC
/begin CHARACTERISTIC K_ED_TD.DEC_VOR_EINTRAG "Fault code TD - debounce filter decrement before fault-memory entry [verified]" VALUE 0x71649 RL_VAL_UB 0 CM_0000 0 255 /end CHARACTERISTIC
/begin CHARACTERISTIC K_ED_TD.FEHLERSCHWELLE "Fault code TD - debounce filter threshold for setting the fault [verified]" VALUE 0x71646 RL_VAL_UB 0 CM_0000 0 255 /end CHARACTERISTIC
/begin CHARACTERISTIC K_ED_TD.INC_NACH_EINTRAG "Fault code TD - debounce filter increment after fault-memory entry [verified]" VALUE 0x7164A RL_VAL_UB 0 CM_0000 0 255 /end CHARACTERISTIC
/begin CHARACTERISTIC K_ED_TD.INC_VOR_EINTRAG "Fault code TD - debounce filter increment before fault-memory entry [verified]" VALUE 0x71648 RL_VAL_UB 0 CM_0000 0 255 /end CHARACTERISTIC
/begin CHARACTERISTIC K_ED_TD.KLASSENINDEX "Fault code TD - fault class selection (lamp / warning behaviour) [verified]" VALUE 0x7164C RL_VAL_UB 0 CM_0000 0 255 /end CHARACTERISTIC
/begin CHARACTERISTIC K_ED_TD.OK_SCHWELLE "Fault code TD - debounce filter threshold for clearing (healing) the fault [verified]" VALUE 0x71647 RL_VAL_UB 0 CM_0000 0 255 /end CHARACTERISTIC
/begin CHARACTERISTIC K_ED_TD.P_CODE_OPENLOAD "Fault code TD - OBD P-code reported for open circuit [verified]" VALUE 0x71642 RL_VAL_UW 0 CM_0000 0 65535 /end CHARACTERISTIC
/begin CHARACTERISTIC K_ED_TD.P_CODE_SH_TO_GND "Fault code TD - OBD P-code reported for short to ground [verified]" VALUE 0x71640 RL_VAL_UW 0 CM_0000 0 65535 /end CHARACTERISTIC
/begin CHARACTERISTIC K_ED_TD.P_CODE_SH_TO_UB "Fault code TD - OBD P-code reported for short to battery voltage [verified]" VALUE 0x7163E RL_VAL_UW 0 CM_0000 0 65535 /end CHARACTERISTIC
/begin CHARACTERISTIC K_ED_TD.P_CODE_UNPLAUSIBEL "Fault code TD - OBD P-code reported for implausible signal [verified]" VALUE 0x71644 RL_VAL_UW 0 CM_0000 0 65535 /end CHARACTERISTIC
/begin CHARACTERISTIC K_ED_TEV1.DEC_NACH_EINTRAG "Fault code TEV1 - debounce filter decrement after fault-memory entry [verified]" VALUE 0x71A0D RL_VAL_UB 0 CM_0000 0 255 /end CHARACTERISTIC
/begin CHARACTERISTIC K_ED_TEV1.DEC_VOR_EINTRAG "Fault code TEV1 - debounce filter decrement before fault-memory entry [verified]" VALUE 0x71A0B RL_VAL_UB 0 CM_0000 0 255 /end CHARACTERISTIC
/begin CHARACTERISTIC K_ED_TEV1.FEHLERSCHWELLE "Fault code TEV1 - debounce filter threshold for setting the fault [verified]" VALUE 0x71A08 RL_VAL_UB 0 CM_0000 0 255 /end CHARACTERISTIC
/begin CHARACTERISTIC K_ED_TEV1.INC_NACH_EINTRAG "Fault code TEV1 - debounce filter increment after fault-memory entry [verified]" VALUE 0x71A0C RL_VAL_UB 0 CM_0000 0 255 /end CHARACTERISTIC
/begin CHARACTERISTIC K_ED_TEV1.INC_VOR_EINTRAG "Fault code TEV1 - debounce filter increment before fault-memory entry [verified]" VALUE 0x71A0A RL_VAL_UB 0 CM_0000 0 255 /end CHARACTERISTIC
/begin CHARACTERISTIC K_ED_TEV1.KLASSENINDEX "Fault code TEV1 - fault class selection (lamp / warning behaviour) [verified]" VALUE 0x71A0E RL_VAL_UB 0 CM_0000 0 255 /end CHARACTERISTIC
/begin CHARACTERISTIC K_ED_TEV1.OK_SCHWELLE "Fault code TEV1 - debounce filter threshold for clearing (healing) the fault [verified]" VALUE 0x71A09 RL_VAL_UB 0 CM_0000 0 255 /end CHARACTERISTIC
/begin CHARACTERISTIC K_ED_TEV1.P_CODE_OPENLOAD "Fault code TEV1 - OBD P-code reported for open circuit [verified]" VALUE 0x71A04 RL_VAL_UW 0 CM_0000 0 65535 /end CHARACTERISTIC
/begin CHARACTERISTIC K_ED_TEV1.P_CODE_SH_TO_GND "Fault code TEV1 - OBD P-code reported for short to ground [verified]" VALUE 0x71A02 RL_VAL_UW 0 CM_0000 0 65535 /end CHARACTERISTIC
/begin CHARACTERISTIC K_ED_TEV1.P_CODE_SH_TO_UB "Fault code TEV1 - OBD P-code reported for short to battery voltage [verified]" VALUE 0x71A00 RL_VAL_UW 0 CM_0000 0 65535 /end CHARACTERISTIC
/begin CHARACTERISTIC K_ED_TEV1.P_CODE_UNPLAUSIBEL "Fault code TEV1 - OBD P-code reported for implausible signal [verified]" VALUE 0x71A06 RL_VAL_UW 0 CM_0000 0 65535 /end CHARACTERISTIC
/begin CHARACTERISTIC K_ED_TEV2.DEC_NACH_EINTRAG "Fault code TEV2 - debounce filter decrement after fault-memory entry [verified]" VALUE 0x71A27 RL_VAL_UB 0 CM_0000 0 255 /end CHARACTERISTIC
/begin CHARACTERISTIC K_ED_TEV2.DEC_VOR_EINTRAG "Fault code TEV2 - debounce filter decrement before fault-memory entry [verified]" VALUE 0x71A25 RL_VAL_UB 0 CM_0000 0 255 /end CHARACTERISTIC
/begin CHARACTERISTIC K_ED_TEV2.FEHLERSCHWELLE "Fault code TEV2 - debounce filter threshold for setting the fault [verified]" VALUE 0x71A22 RL_VAL_UB 0 CM_0000 0 255 /end CHARACTERISTIC
/begin CHARACTERISTIC K_ED_TEV2.INC_NACH_EINTRAG "Fault code TEV2 - debounce filter increment after fault-memory entry [verified]" VALUE 0x71A26 RL_VAL_UB 0 CM_0000 0 255 /end CHARACTERISTIC
/begin CHARACTERISTIC K_ED_TEV2.INC_VOR_EINTRAG "Fault code TEV2 - debounce filter increment before fault-memory entry [verified]" VALUE 0x71A24 RL_VAL_UB 0 CM_0000 0 255 /end CHARACTERISTIC
/begin CHARACTERISTIC K_ED_TEV2.KLASSENINDEX "Fault code TEV2 - fault class selection (lamp / warning behaviour) [verified]" VALUE 0x71A28 RL_VAL_UB 0 CM_0000 0 255 /end CHARACTERISTIC
/begin CHARACTERISTIC K_ED_TEV2.OK_SCHWELLE "Fault code TEV2 - debounce filter threshold for clearing (healing) the fault [verified]" VALUE 0x71A23 RL_VAL_UB 0 CM_0000 0 255 /end CHARACTERISTIC
/begin CHARACTERISTIC K_ED_TEV2.P_CODE_OPENLOAD "Fault code TEV2 - OBD P-code reported for open circuit [verified]" VALUE 0x71A1E RL_VAL_UW 0 CM_0000 0 65535 /end CHARACTERISTIC
/begin CHARACTERISTIC K_ED_TEV2.P_CODE_SH_TO_GND "Fault code TEV2 - OBD P-code reported for short to ground [verified]" VALUE 0x71A1C RL_VAL_UW 0 CM_0000 0 65535 /end CHARACTERISTIC
/begin CHARACTERISTIC K_ED_TEV2.P_CODE_SH_TO_UB "Fault code TEV2 - OBD P-code reported for short to battery voltage [verified]" VALUE 0x71A1A RL_VAL_UW 0 CM_0000 0 65535 /end CHARACTERISTIC
/begin CHARACTERISTIC K_ED_TEV2.P_CODE_UNPLAUSIBEL "Fault code TEV2 - OBD P-code reported for implausible signal [verified]" VALUE 0x71A20 RL_VAL_UW 0 CM_0000 0 65535 /end CHARACTERISTIC
/begin CHARACTERISTIC K_ED_TE_OBD_1.DEC_NACH_EINTRAG "Fault code TE_OBD_1 - debounce filter decrement after fault-memory entry [verified]" VALUE 0x719D9 RL_VAL_UB 0 CM_0000 0 255 /end CHARACTERISTIC
/begin CHARACTERISTIC K_ED_TE_OBD_1.DEC_VOR_EINTRAG "Fault code TE_OBD_1 - debounce filter decrement before fault-memory entry [verified]" VALUE 0x719D7 RL_VAL_UB 0 CM_0000 0 255 /end CHARACTERISTIC
/begin CHARACTERISTIC K_ED_TE_OBD_1.FEHLERSCHWELLE "Fault code TE_OBD_1 - debounce filter threshold for setting the fault [verified]" VALUE 0x719D4 RL_VAL_UB 0 CM_0000 0 255 /end CHARACTERISTIC
/begin CHARACTERISTIC K_ED_TE_OBD_1.INC_NACH_EINTRAG "Fault code TE_OBD_1 - debounce filter increment after fault-memory entry [verified]" VALUE 0x719D8 RL_VAL_UB 0 CM_0000 0 255 /end CHARACTERISTIC
/begin CHARACTERISTIC K_ED_TE_OBD_1.INC_VOR_EINTRAG "Fault code TE_OBD_1 - debounce filter increment before fault-memory entry [verified]" VALUE 0x719D6 RL_VAL_UB 0 CM_0000 0 255 /end CHARACTERISTIC
/begin CHARACTERISTIC K_ED_TE_OBD_1.KLASSENINDEX "Fault code TE_OBD_1 - fault class selection (lamp / warning behaviour) [verified]" VALUE 0x719DA RL_VAL_UB 0 CM_0000 0 255 /end CHARACTERISTIC
/begin CHARACTERISTIC K_ED_TE_OBD_1.OK_SCHWELLE "Fault code TE_OBD_1 - debounce filter threshold for clearing (healing) the fault [verified]" VALUE 0x719D5 RL_VAL_UB 0 CM_0000 0 255 /end CHARACTERISTIC
/begin CHARACTERISTIC K_ED_TE_OBD_1.P_CODE_OPENLOAD "Fault code TE_OBD_1 - OBD P-code reported for open circuit [verified]" VALUE 0x719D0 RL_VAL_UW 0 CM_0000 0 65535 /end CHARACTERISTIC
/begin CHARACTERISTIC K_ED_TE_OBD_1.P_CODE_SH_TO_GND "Fault code TE_OBD_1 - OBD P-code reported for short to ground [verified]" VALUE 0x719CE RL_VAL_UW 0 CM_0000 0 65535 /end CHARACTERISTIC
/begin CHARACTERISTIC K_ED_TE_OBD_1.P_CODE_SH_TO_UB "Fault code TE_OBD_1 - OBD P-code reported for short to battery voltage [verified]" VALUE 0x719CC RL_VAL_UW 0 CM_0000 0 65535 /end CHARACTERISTIC
/begin CHARACTERISTIC K_ED_TE_OBD_1.P_CODE_UNPLAUSIBEL "Fault code TE_OBD_1 - OBD P-code reported for implausible signal [verified]" VALUE 0x719D2 RL_VAL_UW 0 CM_0000 0 65535 /end CHARACTERISTIC
/begin CHARACTERISTIC K_ED_TE_OBD_2.DEC_NACH_EINTRAG "Fault code TE_OBD_2 - debounce filter decrement after fault-memory entry [verified]" VALUE 0x719F3 RL_VAL_UB 0 CM_0000 0 255 /end CHARACTERISTIC
/begin CHARACTERISTIC K_ED_TE_OBD_2.DEC_VOR_EINTRAG "Fault code TE_OBD_2 - debounce filter decrement before fault-memory entry [verified]" VALUE 0x719F1 RL_VAL_UB 0 CM_0000 0 255 /end CHARACTERISTIC
/begin CHARACTERISTIC K_ED_TE_OBD_2.FEHLERSCHWELLE "Fault code TE_OBD_2 - debounce filter threshold for setting the fault [verified]" VALUE 0x719EE RL_VAL_UB 0 CM_0000 0 255 /end CHARACTERISTIC
/begin CHARACTERISTIC K_ED_TE_OBD_2.INC_NACH_EINTRAG "Fault code TE_OBD_2 - debounce filter increment after fault-memory entry [verified]" VALUE 0x719F2 RL_VAL_UB 0 CM_0000 0 255 /end CHARACTERISTIC
/begin CHARACTERISTIC K_ED_TE_OBD_2.INC_VOR_EINTRAG "Fault code TE_OBD_2 - debounce filter increment before fault-memory entry [verified]" VALUE 0x719F0 RL_VAL_UB 0 CM_0000 0 255 /end CHARACTERISTIC
/begin CHARACTERISTIC K_ED_TE_OBD_2.KLASSENINDEX "Fault code TE_OBD_2 - fault class selection (lamp / warning behaviour) [verified]" VALUE 0x719F4 RL_VAL_UB 0 CM_0000 0 255 /end CHARACTERISTIC
/begin CHARACTERISTIC K_ED_TE_OBD_2.OK_SCHWELLE "Fault code TE_OBD_2 - debounce filter threshold for clearing (healing) the fault [verified]" VALUE 0x719EF RL_VAL_UB 0 CM_0000 0 255 /end CHARACTERISTIC
/begin CHARACTERISTIC K_ED_TE_OBD_2.P_CODE_OPENLOAD "Fault code TE_OBD_2 - OBD P-code reported for open circuit [verified]" VALUE 0x719EA RL_VAL_UW 0 CM_0000 0 65535 /end CHARACTERISTIC
/begin CHARACTERISTIC K_ED_TE_OBD_2.P_CODE_SH_TO_GND "Fault code TE_OBD_2 - OBD P-code reported for short to ground [verified]" VALUE 0x719E8 RL_VAL_UW 0 CM_0000 0 65535 /end CHARACTERISTIC
/begin CHARACTERISTIC K_ED_TE_OBD_2.P_CODE_SH_TO_UB "Fault code TE_OBD_2 - OBD P-code reported for short to battery voltage [verified]" VALUE 0x719E6 RL_VAL_UW 0 CM_0000 0 65535 /end CHARACTERISTIC
/begin CHARACTERISTIC K_ED_TE_OBD_2.P_CODE_UNPLAUSIBEL "Fault code TE_OBD_2 - OBD P-code reported for implausible signal [verified]" VALUE 0x719EC RL_VAL_UW 0 CM_0000 0 65535 /end CHARACTERISTIC
/begin CHARACTERISTIC K_ED_TGETR_HS.DEC_NACH_EINTRAG "Fault code TGETR_HS - debounce filter decrement after fault-memory entry [verified]" VALUE 0x71E6B RL_VAL_UB 0 CM_0000 0 255 /end CHARACTERISTIC
/begin CHARACTERISTIC K_ED_TGETR_HS.DEC_VOR_EINTRAG "Fault code TGETR_HS - debounce filter decrement before fault-memory entry [verified]" VALUE 0x71E69 RL_VAL_UB 0 CM_0000 0 255 /end CHARACTERISTIC
/begin CHARACTERISTIC K_ED_TGETR_HS.FEHLERSCHWELLE "Fault code TGETR_HS - debounce filter threshold for setting the fault [verified]" VALUE 0x71E66 RL_VAL_UB 0 CM_0000 0 255 /end CHARACTERISTIC
/begin CHARACTERISTIC K_ED_TGETR_HS.INC_NACH_EINTRAG "Fault code TGETR_HS - debounce filter increment after fault-memory entry [verified]" VALUE 0x71E6A RL_VAL_UB 0 CM_0000 0 255 /end CHARACTERISTIC
/begin CHARACTERISTIC K_ED_TGETR_HS.INC_VOR_EINTRAG "Fault code TGETR_HS - debounce filter increment before fault-memory entry [verified]" VALUE 0x71E68 RL_VAL_UB 0 CM_0000 0 255 /end CHARACTERISTIC
/begin CHARACTERISTIC K_ED_TGETR_HS.KLASSENINDEX "Fault code TGETR_HS - fault class selection (lamp / warning behaviour) [verified]" VALUE 0x71E6C RL_VAL_UB 0 CM_0000 0 255 /end CHARACTERISTIC
/begin CHARACTERISTIC K_ED_TGETR_HS.OK_SCHWELLE "Fault code TGETR_HS - debounce filter threshold for clearing (healing) the fault [verified]" VALUE 0x71E67 RL_VAL_UB 0 CM_0000 0 255 /end CHARACTERISTIC
/begin CHARACTERISTIC K_ED_TGETR_HS.P_CODE_OPENLOAD "Fault code TGETR_HS - OBD P-code reported for open circuit [verified]" VALUE 0x71E62 RL_VAL_UW 0 CM_0000 0 65535 /end CHARACTERISTIC
/begin CHARACTERISTIC K_ED_TGETR_HS.P_CODE_SH_TO_GND "Fault code TGETR_HS - OBD P-code reported for short to ground [verified]" VALUE 0x71E60 RL_VAL_UW 0 CM_0000 0 65535 /end CHARACTERISTIC
/begin CHARACTERISTIC K_ED_TGETR_HS.P_CODE_SH_TO_UB "Fault code TGETR_HS - OBD P-code reported for short to battery voltage [verified]" VALUE 0x71E5E RL_VAL_UW 0 CM_0000 0 65535 /end CHARACTERISTIC
/begin CHARACTERISTIC K_ED_TGETR_HS.P_CODE_UNPLAUSIBEL "Fault code TGETR_HS - OBD P-code reported for implausible signal [verified]" VALUE 0x71E64 RL_VAL_UW 0 CM_0000 0 65535 /end CHARACTERISTIC
/begin CHARACTERISTIC K_ED_TZ1.DEC_NACH_EINTRAG "Fault code TZ1 - debounce filter decrement after fault-memory entry [verified]" VALUE 0x7119F RL_VAL_UB 0 CM_0000 0 255 /end CHARACTERISTIC
/begin CHARACTERISTIC K_ED_TZ1.DEC_VOR_EINTRAG "Fault code TZ1 - debounce filter decrement before fault-memory entry [verified]" VALUE 0x7119D RL_VAL_UB 0 CM_0000 0 255 /end CHARACTERISTIC
/begin CHARACTERISTIC K_ED_TZ1.FEHLERSCHWELLE "Fault code TZ1 - debounce filter threshold for setting the fault [verified]" VALUE 0x7119A RL_VAL_UB 0 CM_0000 0 255 /end CHARACTERISTIC
/begin CHARACTERISTIC K_ED_TZ1.INC_NACH_EINTRAG "Fault code TZ1 - debounce filter increment after fault-memory entry [verified]" VALUE 0x7119E RL_VAL_UB 0 CM_0000 0 255 /end CHARACTERISTIC
/begin CHARACTERISTIC K_ED_TZ1.INC_VOR_EINTRAG "Fault code TZ1 - debounce filter increment before fault-memory entry [verified]" VALUE 0x7119C RL_VAL_UB 0 CM_0000 0 255 /end CHARACTERISTIC
/begin CHARACTERISTIC K_ED_TZ1.KLASSENINDEX "Fault code TZ1 - fault class selection (lamp / warning behaviour) [verified]" VALUE 0x711A0 RL_VAL_UB 0 CM_0000 0 255 /end CHARACTERISTIC
/begin CHARACTERISTIC K_ED_TZ1.OK_SCHWELLE "Fault code TZ1 - debounce filter threshold for clearing (healing) the fault [verified]" VALUE 0x7119B RL_VAL_UB 0 CM_0000 0 255 /end CHARACTERISTIC
/begin CHARACTERISTIC K_ED_TZ1.P_CODE_OPENLOAD "Fault code TZ1 - OBD P-code reported for open circuit [verified]" VALUE 0x71196 RL_VAL_UW 0 CM_0000 0 65535 /end CHARACTERISTIC
/begin CHARACTERISTIC K_ED_TZ1.P_CODE_SH_TO_GND "Fault code TZ1 - OBD P-code reported for short to ground [verified]" VALUE 0x71194 RL_VAL_UW 0 CM_0000 0 65535 /end CHARACTERISTIC
/begin CHARACTERISTIC K_ED_TZ1.P_CODE_SH_TO_UB "Fault code TZ1 - OBD P-code reported for short to battery voltage [verified]" VALUE 0x71192 RL_VAL_UW 0 CM_0000 0 65535 /end CHARACTERISTIC
/begin CHARACTERISTIC K_ED_TZ1.P_CODE_UNPLAUSIBEL "Fault code TZ1 - OBD P-code reported for implausible signal [verified]" VALUE 0x71198 RL_VAL_UW 0 CM_0000 0 65535 /end CHARACTERISTIC
/begin CHARACTERISTIC K_ED_TZ10.DEC_NACH_EINTRAG "Fault code TZ10 - debounce filter decrement after fault-memory entry [verified]" VALUE 0x71289 RL_VAL_UB 0 CM_0000 0 255 /end CHARACTERISTIC
/begin CHARACTERISTIC K_ED_TZ10.DEC_VOR_EINTRAG "Fault code TZ10 - debounce filter decrement before fault-memory entry [verified]" VALUE 0x71287 RL_VAL_UB 0 CM_0000 0 255 /end CHARACTERISTIC
/begin CHARACTERISTIC K_ED_TZ10.FEHLERSCHWELLE "Fault code TZ10 - debounce filter threshold for setting the fault [verified]" VALUE 0x71284 RL_VAL_UB 0 CM_0000 0 255 /end CHARACTERISTIC
/begin CHARACTERISTIC K_ED_TZ10.INC_NACH_EINTRAG "Fault code TZ10 - debounce filter increment after fault-memory entry [verified]" VALUE 0x71288 RL_VAL_UB 0 CM_0000 0 255 /end CHARACTERISTIC
/begin CHARACTERISTIC K_ED_TZ10.INC_VOR_EINTRAG "Fault code TZ10 - debounce filter increment before fault-memory entry [verified]" VALUE 0x71286 RL_VAL_UB 0 CM_0000 0 255 /end CHARACTERISTIC
/begin CHARACTERISTIC K_ED_TZ10.KLASSENINDEX "Fault code TZ10 - fault class selection (lamp / warning behaviour) [verified]" VALUE 0x7128A RL_VAL_UB 0 CM_0000 0 255 /end CHARACTERISTIC
/begin CHARACTERISTIC K_ED_TZ10.OK_SCHWELLE "Fault code TZ10 - debounce filter threshold for clearing (healing) the fault [verified]" VALUE 0x71285 RL_VAL_UB 0 CM_0000 0 255 /end CHARACTERISTIC
/begin CHARACTERISTIC K_ED_TZ10.P_CODE_OPENLOAD "Fault code TZ10 - OBD P-code reported for open circuit [verified]" VALUE 0x71280 RL_VAL_UW 0 CM_0000 0 65535 /end CHARACTERISTIC
/begin CHARACTERISTIC K_ED_TZ10.P_CODE_SH_TO_GND "Fault code TZ10 - OBD P-code reported for short to ground [verified]" VALUE 0x7127E RL_VAL_UW 0 CM_0000 0 65535 /end CHARACTERISTIC
/begin CHARACTERISTIC K_ED_TZ10.P_CODE_SH_TO_UB "Fault code TZ10 - OBD P-code reported for short to battery voltage [verified]" VALUE 0x7127C RL_VAL_UW 0 CM_0000 0 65535 /end CHARACTERISTIC
/begin CHARACTERISTIC K_ED_TZ10.P_CODE_UNPLAUSIBEL "Fault code TZ10 - OBD P-code reported for implausible signal [verified]" VALUE 0x71282 RL_VAL_UW 0 CM_0000 0 65535 /end CHARACTERISTIC
/begin CHARACTERISTIC K_ED_TZ2.DEC_NACH_EINTRAG "Fault code TZ2 - debounce filter decrement after fault-memory entry [verified]" VALUE 0x711B9 RL_VAL_UB 0 CM_0000 0 255 /end CHARACTERISTIC
/begin CHARACTERISTIC K_ED_TZ2.DEC_VOR_EINTRAG "Fault code TZ2 - debounce filter decrement before fault-memory entry [verified]" VALUE 0x711B7 RL_VAL_UB 0 CM_0000 0 255 /end CHARACTERISTIC
/begin CHARACTERISTIC K_ED_TZ2.FEHLERSCHWELLE "Fault code TZ2 - debounce filter threshold for setting the fault [verified]" VALUE 0x711B4 RL_VAL_UB 0 CM_0000 0 255 /end CHARACTERISTIC
/begin CHARACTERISTIC K_ED_TZ2.INC_NACH_EINTRAG "Fault code TZ2 - debounce filter increment after fault-memory entry [verified]" VALUE 0x711B8 RL_VAL_UB 0 CM_0000 0 255 /end CHARACTERISTIC
/begin CHARACTERISTIC K_ED_TZ2.INC_VOR_EINTRAG "Fault code TZ2 - debounce filter increment before fault-memory entry [verified]" VALUE 0x711B6 RL_VAL_UB 0 CM_0000 0 255 /end CHARACTERISTIC
/begin CHARACTERISTIC K_ED_TZ2.KLASSENINDEX "Fault code TZ2 - fault class selection (lamp / warning behaviour) [verified]" VALUE 0x711BA RL_VAL_UB 0 CM_0000 0 255 /end CHARACTERISTIC
/begin CHARACTERISTIC K_ED_TZ2.OK_SCHWELLE "Fault code TZ2 - debounce filter threshold for clearing (healing) the fault [verified]" VALUE 0x711B5 RL_VAL_UB 0 CM_0000 0 255 /end CHARACTERISTIC
/begin CHARACTERISTIC K_ED_TZ2.P_CODE_OPENLOAD "Fault code TZ2 - OBD P-code reported for open circuit [verified]" VALUE 0x711B0 RL_VAL_UW 0 CM_0000 0 65535 /end CHARACTERISTIC
/begin CHARACTERISTIC K_ED_TZ2.P_CODE_SH_TO_GND "Fault code TZ2 - OBD P-code reported for short to ground [verified]" VALUE 0x711AE RL_VAL_UW 0 CM_0000 0 65535 /end CHARACTERISTIC
/begin CHARACTERISTIC K_ED_TZ2.P_CODE_SH_TO_UB "Fault code TZ2 - OBD P-code reported for short to battery voltage [verified]" VALUE 0x711AC RL_VAL_UW 0 CM_0000 0 65535 /end CHARACTERISTIC
/begin CHARACTERISTIC K_ED_TZ2.P_CODE_UNPLAUSIBEL "Fault code TZ2 - OBD P-code reported for implausible signal [verified]" VALUE 0x711B2 RL_VAL_UW 0 CM_0000 0 65535 /end CHARACTERISTIC
/begin CHARACTERISTIC K_ED_TZ3.DEC_NACH_EINTRAG "Fault code TZ3 - debounce filter decrement after fault-memory entry [verified]" VALUE 0x711D3 RL_VAL_UB 0 CM_0000 0 255 /end CHARACTERISTIC
/begin CHARACTERISTIC K_ED_TZ3.DEC_VOR_EINTRAG "Fault code TZ3 - debounce filter decrement before fault-memory entry [verified]" VALUE 0x711D1 RL_VAL_UB 0 CM_0000 0 255 /end CHARACTERISTIC
/begin CHARACTERISTIC K_ED_TZ3.FEHLERSCHWELLE "Fault code TZ3 - debounce filter threshold for setting the fault [verified]" VALUE 0x711CE RL_VAL_UB 0 CM_0000 0 255 /end CHARACTERISTIC
/begin CHARACTERISTIC K_ED_TZ3.INC_NACH_EINTRAG "Fault code TZ3 - debounce filter increment after fault-memory entry [verified]" VALUE 0x711D2 RL_VAL_UB 0 CM_0000 0 255 /end CHARACTERISTIC
/begin CHARACTERISTIC K_ED_TZ3.INC_VOR_EINTRAG "Fault code TZ3 - debounce filter increment before fault-memory entry [verified]" VALUE 0x711D0 RL_VAL_UB 0 CM_0000 0 255 /end CHARACTERISTIC
/begin CHARACTERISTIC K_ED_TZ3.KLASSENINDEX "Fault code TZ3 - fault class selection (lamp / warning behaviour) [verified]" VALUE 0x711D4 RL_VAL_UB 0 CM_0000 0 255 /end CHARACTERISTIC
/begin CHARACTERISTIC K_ED_TZ3.OK_SCHWELLE "Fault code TZ3 - debounce filter threshold for clearing (healing) the fault [verified]" VALUE 0x711CF RL_VAL_UB 0 CM_0000 0 255 /end CHARACTERISTIC
/begin CHARACTERISTIC K_ED_TZ3.P_CODE_OPENLOAD "Fault code TZ3 - OBD P-code reported for open circuit [verified]" VALUE 0x711CA RL_VAL_UW 0 CM_0000 0 65535 /end CHARACTERISTIC
/begin CHARACTERISTIC K_ED_TZ3.P_CODE_SH_TO_GND "Fault code TZ3 - OBD P-code reported for short to ground [verified]" VALUE 0x711C8 RL_VAL_UW 0 CM_0000 0 65535 /end CHARACTERISTIC
/begin CHARACTERISTIC K_ED_TZ3.P_CODE_SH_TO_UB "Fault code TZ3 - OBD P-code reported for short to battery voltage [verified]" VALUE 0x711C6 RL_VAL_UW 0 CM_0000 0 65535 /end CHARACTERISTIC
/begin CHARACTERISTIC K_ED_TZ3.P_CODE_UNPLAUSIBEL "Fault code TZ3 - OBD P-code reported for implausible signal [verified]" VALUE 0x711CC RL_VAL_UW 0 CM_0000 0 65535 /end CHARACTERISTIC
/begin CHARACTERISTIC K_ED_TZ4.DEC_NACH_EINTRAG "Fault code TZ4 - debounce filter decrement after fault-memory entry [verified]" VALUE 0x711ED RL_VAL_UB 0 CM_0000 0 255 /end CHARACTERISTIC
/begin CHARACTERISTIC K_ED_TZ4.DEC_VOR_EINTRAG "Fault code TZ4 - debounce filter decrement before fault-memory entry [verified]" VALUE 0x711EB RL_VAL_UB 0 CM_0000 0 255 /end CHARACTERISTIC
/begin CHARACTERISTIC K_ED_TZ4.FEHLERSCHWELLE "Fault code TZ4 - debounce filter threshold for setting the fault [verified]" VALUE 0x711E8 RL_VAL_UB 0 CM_0000 0 255 /end CHARACTERISTIC
/begin CHARACTERISTIC K_ED_TZ4.INC_NACH_EINTRAG "Fault code TZ4 - debounce filter increment after fault-memory entry [verified]" VALUE 0x711EC RL_VAL_UB 0 CM_0000 0 255 /end CHARACTERISTIC
/begin CHARACTERISTIC K_ED_TZ4.INC_VOR_EINTRAG "Fault code TZ4 - debounce filter increment before fault-memory entry [verified]" VALUE 0x711EA RL_VAL_UB 0 CM_0000 0 255 /end CHARACTERISTIC
/begin CHARACTERISTIC K_ED_TZ4.KLASSENINDEX "Fault code TZ4 - fault class selection (lamp / warning behaviour) [verified]" VALUE 0x711EE RL_VAL_UB 0 CM_0000 0 255 /end CHARACTERISTIC
/begin CHARACTERISTIC K_ED_TZ4.OK_SCHWELLE "Fault code TZ4 - debounce filter threshold for clearing (healing) the fault [verified]" VALUE 0x711E9 RL_VAL_UB 0 CM_0000 0 255 /end CHARACTERISTIC
/begin CHARACTERISTIC K_ED_TZ4.P_CODE_OPENLOAD "Fault code TZ4 - OBD P-code reported for open circuit [verified]" VALUE 0x711E4 RL_VAL_UW 0 CM_0000 0 65535 /end CHARACTERISTIC
/begin CHARACTERISTIC K_ED_TZ4.P_CODE_SH_TO_GND "Fault code TZ4 - OBD P-code reported for short to ground [verified]" VALUE 0x711E2 RL_VAL_UW 0 CM_0000 0 65535 /end CHARACTERISTIC
/begin CHARACTERISTIC K_ED_TZ4.P_CODE_SH_TO_UB "Fault code TZ4 - OBD P-code reported for short to battery voltage [verified]" VALUE 0x711E0 RL_VAL_UW 0 CM_0000 0 65535 /end CHARACTERISTIC
/begin CHARACTERISTIC K_ED_TZ4.P_CODE_UNPLAUSIBEL "Fault code TZ4 - OBD P-code reported for implausible signal [verified]" VALUE 0x711E6 RL_VAL_UW 0 CM_0000 0 65535 /end CHARACTERISTIC
/begin CHARACTERISTIC K_ED_TZ5.DEC_NACH_EINTRAG "Fault code TZ5 - debounce filter decrement after fault-memory entry [verified]" VALUE 0x71207 RL_VAL_UB 0 CM_0000 0 255 /end CHARACTERISTIC
/begin CHARACTERISTIC K_ED_TZ5.DEC_VOR_EINTRAG "Fault code TZ5 - debounce filter decrement before fault-memory entry [verified]" VALUE 0x71205 RL_VAL_UB 0 CM_0000 0 255 /end CHARACTERISTIC
/begin CHARACTERISTIC K_ED_TZ5.FEHLERSCHWELLE "Fault code TZ5 - debounce filter threshold for setting the fault [verified]" VALUE 0x71202 RL_VAL_UB 0 CM_0000 0 255 /end CHARACTERISTIC
/begin CHARACTERISTIC K_ED_TZ5.INC_NACH_EINTRAG "Fault code TZ5 - debounce filter increment after fault-memory entry [verified]" VALUE 0x71206 RL_VAL_UB 0 CM_0000 0 255 /end CHARACTERISTIC
/begin CHARACTERISTIC K_ED_TZ5.INC_VOR_EINTRAG "Fault code TZ5 - debounce filter increment before fault-memory entry [verified]" VALUE 0x71204 RL_VAL_UB 0 CM_0000 0 255 /end CHARACTERISTIC
/begin CHARACTERISTIC K_ED_TZ5.KLASSENINDEX "Fault code TZ5 - fault class selection (lamp / warning behaviour) [verified]" VALUE 0x71208 RL_VAL_UB 0 CM_0000 0 255 /end CHARACTERISTIC
/begin CHARACTERISTIC K_ED_TZ5.OK_SCHWELLE "Fault code TZ5 - debounce filter threshold for clearing (healing) the fault [verified]" VALUE 0x71203 RL_VAL_UB 0 CM_0000 0 255 /end CHARACTERISTIC
/begin CHARACTERISTIC K_ED_TZ5.P_CODE_OPENLOAD "Fault code TZ5 - OBD P-code reported for open circuit [verified]" VALUE 0x711FE RL_VAL_UW 0 CM_0000 0 65535 /end CHARACTERISTIC
/begin CHARACTERISTIC K_ED_TZ5.P_CODE_SH_TO_GND "Fault code TZ5 - OBD P-code reported for short to ground [verified]" VALUE 0x711FC RL_VAL_UW 0 CM_0000 0 65535 /end CHARACTERISTIC
/begin CHARACTERISTIC K_ED_TZ5.P_CODE_SH_TO_UB "Fault code TZ5 - OBD P-code reported for short to battery voltage [verified]" VALUE 0x711FA RL_VAL_UW 0 CM_0000 0 65535 /end CHARACTERISTIC
/begin CHARACTERISTIC K_ED_TZ5.P_CODE_UNPLAUSIBEL "Fault code TZ5 - OBD P-code reported for implausible signal [verified]" VALUE 0x71200 RL_VAL_UW 0 CM_0000 0 65535 /end CHARACTERISTIC
/begin CHARACTERISTIC K_ED_TZ6.DEC_NACH_EINTRAG "Fault code TZ6 - debounce filter decrement after fault-memory entry [verified]" VALUE 0x71221 RL_VAL_UB 0 CM_0000 0 255 /end CHARACTERISTIC
/begin CHARACTERISTIC K_ED_TZ6.DEC_VOR_EINTRAG "Fault code TZ6 - debounce filter decrement before fault-memory entry [verified]" VALUE 0x7121F RL_VAL_UB 0 CM_0000 0 255 /end CHARACTERISTIC
/begin CHARACTERISTIC K_ED_TZ6.FEHLERSCHWELLE "Fault code TZ6 - debounce filter threshold for setting the fault [verified]" VALUE 0x7121C RL_VAL_UB 0 CM_0000 0 255 /end CHARACTERISTIC
/begin CHARACTERISTIC K_ED_TZ6.INC_NACH_EINTRAG "Fault code TZ6 - debounce filter increment after fault-memory entry [verified]" VALUE 0x71220 RL_VAL_UB 0 CM_0000 0 255 /end CHARACTERISTIC
/begin CHARACTERISTIC K_ED_TZ6.INC_VOR_EINTRAG "Fault code TZ6 - debounce filter increment before fault-memory entry [verified]" VALUE 0x7121E RL_VAL_UB 0 CM_0000 0 255 /end CHARACTERISTIC
/begin CHARACTERISTIC K_ED_TZ6.KLASSENINDEX "Fault code TZ6 - fault class selection (lamp / warning behaviour) [verified]" VALUE 0x71222 RL_VAL_UB 0 CM_0000 0 255 /end CHARACTERISTIC
/begin CHARACTERISTIC K_ED_TZ6.OK_SCHWELLE "Fault code TZ6 - debounce filter threshold for clearing (healing) the fault [verified]" VALUE 0x7121D RL_VAL_UB 0 CM_0000 0 255 /end CHARACTERISTIC
/begin CHARACTERISTIC K_ED_TZ6.P_CODE_OPENLOAD "Fault code TZ6 - OBD P-code reported for open circuit [verified]" VALUE 0x71218 RL_VAL_UW 0 CM_0000 0 65535 /end CHARACTERISTIC
/begin CHARACTERISTIC K_ED_TZ6.P_CODE_SH_TO_GND "Fault code TZ6 - OBD P-code reported for short to ground [verified]" VALUE 0x71216 RL_VAL_UW 0 CM_0000 0 65535 /end CHARACTERISTIC
/begin CHARACTERISTIC K_ED_TZ6.P_CODE_SH_TO_UB "Fault code TZ6 - OBD P-code reported for short to battery voltage [verified]" VALUE 0x71214 RL_VAL_UW 0 CM_0000 0 65535 /end CHARACTERISTIC
/begin CHARACTERISTIC K_ED_TZ6.P_CODE_UNPLAUSIBEL "Fault code TZ6 - OBD P-code reported for implausible signal [verified]" VALUE 0x7121A RL_VAL_UW 0 CM_0000 0 65535 /end CHARACTERISTIC
/begin CHARACTERISTIC K_ED_TZ7.DEC_NACH_EINTRAG "Fault code TZ7 - debounce filter decrement after fault-memory entry [verified]" VALUE 0x7123B RL_VAL_UB 0 CM_0000 0 255 /end CHARACTERISTIC
/begin CHARACTERISTIC K_ED_TZ7.DEC_VOR_EINTRAG "Fault code TZ7 - debounce filter decrement before fault-memory entry [verified]" VALUE 0x71239 RL_VAL_UB 0 CM_0000 0 255 /end CHARACTERISTIC
/begin CHARACTERISTIC K_ED_TZ7.FEHLERSCHWELLE "Fault code TZ7 - debounce filter threshold for setting the fault [verified]" VALUE 0x71236 RL_VAL_UB 0 CM_0000 0 255 /end CHARACTERISTIC
/begin CHARACTERISTIC K_ED_TZ7.INC_NACH_EINTRAG "Fault code TZ7 - debounce filter increment after fault-memory entry [verified]" VALUE 0x7123A RL_VAL_UB 0 CM_0000 0 255 /end CHARACTERISTIC
/begin CHARACTERISTIC K_ED_TZ7.INC_VOR_EINTRAG "Fault code TZ7 - debounce filter increment before fault-memory entry [verified]" VALUE 0x71238 RL_VAL_UB 0 CM_0000 0 255 /end CHARACTERISTIC
/begin CHARACTERISTIC K_ED_TZ7.KLASSENINDEX "Fault code TZ7 - fault class selection (lamp / warning behaviour) [verified]" VALUE 0x7123C RL_VAL_UB 0 CM_0000 0 255 /end CHARACTERISTIC
/begin CHARACTERISTIC K_ED_TZ7.OK_SCHWELLE "Fault code TZ7 - debounce filter threshold for clearing (healing) the fault [verified]" VALUE 0x71237 RL_VAL_UB 0 CM_0000 0 255 /end CHARACTERISTIC
/begin CHARACTERISTIC K_ED_TZ7.P_CODE_OPENLOAD "Fault code TZ7 - OBD P-code reported for open circuit [verified]" VALUE 0x71232 RL_VAL_UW 0 CM_0000 0 65535 /end CHARACTERISTIC
/begin CHARACTERISTIC K_ED_TZ7.P_CODE_SH_TO_GND "Fault code TZ7 - OBD P-code reported for short to ground [verified]" VALUE 0x71230 RL_VAL_UW 0 CM_0000 0 65535 /end CHARACTERISTIC
/begin CHARACTERISTIC K_ED_TZ7.P_CODE_SH_TO_UB "Fault code TZ7 - OBD P-code reported for short to battery voltage [verified]" VALUE 0x7122E RL_VAL_UW 0 CM_0000 0 65535 /end CHARACTERISTIC
/begin CHARACTERISTIC K_ED_TZ7.P_CODE_UNPLAUSIBEL "Fault code TZ7 - OBD P-code reported for implausible signal [verified]" VALUE 0x71234 RL_VAL_UW 0 CM_0000 0 65535 /end CHARACTERISTIC
/begin CHARACTERISTIC K_ED_TZ8.DEC_NACH_EINTRAG "Fault code TZ8 - debounce filter decrement after fault-memory entry [verified]" VALUE 0x71255 RL_VAL_UB 0 CM_0000 0 255 /end CHARACTERISTIC
/begin CHARACTERISTIC K_ED_TZ8.DEC_VOR_EINTRAG "Fault code TZ8 - debounce filter decrement before fault-memory entry [verified]" VALUE 0x71253 RL_VAL_UB 0 CM_0000 0 255 /end CHARACTERISTIC
/begin CHARACTERISTIC K_ED_TZ8.FEHLERSCHWELLE "Fault code TZ8 - debounce filter threshold for setting the fault [verified]" VALUE 0x71250 RL_VAL_UB 0 CM_0000 0 255 /end CHARACTERISTIC
/begin CHARACTERISTIC K_ED_TZ8.INC_NACH_EINTRAG "Fault code TZ8 - debounce filter increment after fault-memory entry [verified]" VALUE 0x71254 RL_VAL_UB 0 CM_0000 0 255 /end CHARACTERISTIC
/begin CHARACTERISTIC K_ED_TZ8.INC_VOR_EINTRAG "Fault code TZ8 - debounce filter increment before fault-memory entry [verified]" VALUE 0x71252 RL_VAL_UB 0 CM_0000 0 255 /end CHARACTERISTIC
/begin CHARACTERISTIC K_ED_TZ8.KLASSENINDEX "Fault code TZ8 - fault class selection (lamp / warning behaviour) [verified]" VALUE 0x71256 RL_VAL_UB 0 CM_0000 0 255 /end CHARACTERISTIC
/begin CHARACTERISTIC K_ED_TZ8.OK_SCHWELLE "Fault code TZ8 - debounce filter threshold for clearing (healing) the fault [verified]" VALUE 0x71251 RL_VAL_UB 0 CM_0000 0 255 /end CHARACTERISTIC
/begin CHARACTERISTIC K_ED_TZ8.P_CODE_OPENLOAD "Fault code TZ8 - OBD P-code reported for open circuit [verified]" VALUE 0x7124C RL_VAL_UW 0 CM_0000 0 65535 /end CHARACTERISTIC
/begin CHARACTERISTIC K_ED_TZ8.P_CODE_SH_TO_GND "Fault code TZ8 - OBD P-code reported for short to ground [verified]" VALUE 0x7124A RL_VAL_UW 0 CM_0000 0 65535 /end CHARACTERISTIC
/begin CHARACTERISTIC K_ED_TZ8.P_CODE_SH_TO_UB "Fault code TZ8 - OBD P-code reported for short to battery voltage [verified]" VALUE 0x71248 RL_VAL_UW 0 CM_0000 0 65535 /end CHARACTERISTIC
/begin CHARACTERISTIC K_ED_TZ8.P_CODE_UNPLAUSIBEL "Fault code TZ8 - OBD P-code reported for implausible signal [verified]" VALUE 0x7124E RL_VAL_UW 0 CM_0000 0 65535 /end CHARACTERISTIC
/begin CHARACTERISTIC K_ED_TZ9.DEC_NACH_EINTRAG "Fault code TZ9 - debounce filter decrement after fault-memory entry [verified]" VALUE 0x7126F RL_VAL_UB 0 CM_0000 0 255 /end CHARACTERISTIC
/begin CHARACTERISTIC K_ED_TZ9.DEC_VOR_EINTRAG "Fault code TZ9 - debounce filter decrement before fault-memory entry [verified]" VALUE 0x7126D RL_VAL_UB 0 CM_0000 0 255 /end CHARACTERISTIC
/begin CHARACTERISTIC K_ED_TZ9.FEHLERSCHWELLE "Fault code TZ9 - debounce filter threshold for setting the fault [verified]" VALUE 0x7126A RL_VAL_UB 0 CM_0000 0 255 /end CHARACTERISTIC
/begin CHARACTERISTIC K_ED_TZ9.INC_NACH_EINTRAG "Fault code TZ9 - debounce filter increment after fault-memory entry [verified]" VALUE 0x7126E RL_VAL_UB 0 CM_0000 0 255 /end CHARACTERISTIC
/begin CHARACTERISTIC K_ED_TZ9.INC_VOR_EINTRAG "Fault code TZ9 - debounce filter increment before fault-memory entry [verified]" VALUE 0x7126C RL_VAL_UB 0 CM_0000 0 255 /end CHARACTERISTIC
/begin CHARACTERISTIC K_ED_TZ9.KLASSENINDEX "Fault code TZ9 - fault class selection (lamp / warning behaviour) [verified]" VALUE 0x71270 RL_VAL_UB 0 CM_0000 0 255 /end CHARACTERISTIC
/begin CHARACTERISTIC K_ED_TZ9.OK_SCHWELLE "Fault code TZ9 - debounce filter threshold for clearing (healing) the fault [verified]" VALUE 0x7126B RL_VAL_UB 0 CM_0000 0 255 /end CHARACTERISTIC
/begin CHARACTERISTIC K_ED_TZ9.P_CODE_OPENLOAD "Fault code TZ9 - OBD P-code reported for open circuit [verified]" VALUE 0x71266 RL_VAL_UW 0 CM_0000 0 65535 /end CHARACTERISTIC
/begin CHARACTERISTIC K_ED_TZ9.P_CODE_SH_TO_GND "Fault code TZ9 - OBD P-code reported for short to ground [verified]" VALUE 0x71264 RL_VAL_UW 0 CM_0000 0 65535 /end CHARACTERISTIC
/begin CHARACTERISTIC K_ED_TZ9.P_CODE_SH_TO_UB "Fault code TZ9 - OBD P-code reported for short to battery voltage [verified]" VALUE 0x71262 RL_VAL_UW 0 CM_0000 0 65535 /end CHARACTERISTIC
/begin CHARACTERISTIC K_ED_TZ9.P_CODE_UNPLAUSIBEL "Fault code TZ9 - OBD P-code reported for implausible signal [verified]" VALUE 0x71268 RL_VAL_UW 0 CM_0000 0 65535 /end CHARACTERISTIC
/begin CHARACTERISTIC K_ED_UBMIN__INJ_ "Lower battery-voltage threshold for electrical diagnoses [verified]" VALUE 0x721A8 RL_VAL_SW 0 CM_0021 -3276.8 3276.7 /end CHARACTERISTIC
/begin CHARACTERISTIC K_ED_VAN_ANSCHL_A1.DEC_NACH_EINTRAG "Fault code VAN_ANSCHL_A1 - debounce filter decrement after fault-memory entry [verified]" VALUE 0x712F1 RL_VAL_UB 0 CM_0000 0 255 /end CHARACTERISTIC
/begin CHARACTERISTIC K_ED_VAN_ANSCHL_A1.DEC_VOR_EINTRAG "Fault code VAN_ANSCHL_A1 - debounce filter decrement before fault-memory entry [verified]" VALUE 0x712EF RL_VAL_UB 0 CM_0000 0 255 /end CHARACTERISTIC
/begin CHARACTERISTIC K_ED_VAN_ANSCHL_A1.FEHLERSCHWELLE "Fault code VAN_ANSCHL_A1 - debounce filter threshold for setting the fault [verified]" VALUE 0x712EC RL_VAL_UB 0 CM_0000 0 255 /end CHARACTERISTIC
/begin CHARACTERISTIC K_ED_VAN_ANSCHL_A1.INC_NACH_EINTRAG "Fault code VAN_ANSCHL_A1 - debounce filter increment after fault-memory entry [verified]" VALUE 0x712F0 RL_VAL_UB 0 CM_0000 0 255 /end CHARACTERISTIC
/begin CHARACTERISTIC K_ED_VAN_ANSCHL_A1.INC_VOR_EINTRAG "Fault code VAN_ANSCHL_A1 - debounce filter increment before fault-memory entry [verified]" VALUE 0x712EE RL_VAL_UB 0 CM_0000 0 255 /end CHARACTERISTIC
/begin CHARACTERISTIC K_ED_VAN_ANSCHL_A1.KLASSENINDEX "Fault code VAN_ANSCHL_A1 - fault class selection (lamp / warning behaviour) [verified]" VALUE 0x712F2 RL_VAL_UB 0 CM_0000 0 255 /end CHARACTERISTIC
/begin CHARACTERISTIC K_ED_VAN_ANSCHL_A1.OK_SCHWELLE "Fault code VAN_ANSCHL_A1 - debounce filter threshold for clearing (healing) the fault [verified]" VALUE 0x712ED RL_VAL_UB 0 CM_0000 0 255 /end CHARACTERISTIC
/begin CHARACTERISTIC K_ED_VAN_ANSCHL_A1.P_CODE_OPENLOAD "Fault code VAN_ANSCHL_A1 - OBD P-code reported for open circuit [verified]" VALUE 0x712E8 RL_VAL_UW 0 CM_0000 0 65535 /end CHARACTERISTIC
/begin CHARACTERISTIC K_ED_VAN_ANSCHL_A1.P_CODE_SH_TO_GND "Fault code VAN_ANSCHL_A1 - OBD P-code reported for short to ground [verified]" VALUE 0x712E6 RL_VAL_UW 0 CM_0000 0 65535 /end CHARACTERISTIC
/begin CHARACTERISTIC K_ED_VAN_ANSCHL_A1.P_CODE_SH_TO_UB "Fault code VAN_ANSCHL_A1 - OBD P-code reported for short to battery voltage [verified]" VALUE 0x712E4 RL_VAL_UW 0 CM_0000 0 65535 /end CHARACTERISTIC
/begin CHARACTERISTIC K_ED_VAN_ANSCHL_A1.P_CODE_UNPLAUSIBEL "Fault code VAN_ANSCHL_A1 - OBD P-code reported for implausible signal [verified]" VALUE 0x712EA RL_VAL_UW 0 CM_0000 0 65535 /end CHARACTERISTIC
/begin CHARACTERISTIC K_ED_VAN_ANSCHL_A2.DEC_NACH_EINTRAG "Fault code VAN_ANSCHL_A2 - debounce filter decrement after fault-memory entry [verified]" VALUE 0x71325 RL_VAL_UB 0 CM_0000 0 255 /end CHARACTERISTIC
/begin CHARACTERISTIC K_ED_VAN_ANSCHL_A2.DEC_VOR_EINTRAG "Fault code VAN_ANSCHL_A2 - debounce filter decrement before fault-memory entry [verified]" VALUE 0x71323 RL_VAL_UB 0 CM_0000 0 255 /end CHARACTERISTIC
/begin CHARACTERISTIC K_ED_VAN_ANSCHL_A2.FEHLERSCHWELLE "Fault code VAN_ANSCHL_A2 - debounce filter threshold for setting the fault [verified]" VALUE 0x71320 RL_VAL_UB 0 CM_0000 0 255 /end CHARACTERISTIC
/begin CHARACTERISTIC K_ED_VAN_ANSCHL_A2.INC_NACH_EINTRAG "Fault code VAN_ANSCHL_A2 - debounce filter increment after fault-memory entry [verified]" VALUE 0x71324 RL_VAL_UB 0 CM_0000 0 255 /end CHARACTERISTIC
/begin CHARACTERISTIC K_ED_VAN_ANSCHL_A2.INC_VOR_EINTRAG "Fault code VAN_ANSCHL_A2 - debounce filter increment before fault-memory entry [verified]" VALUE 0x71322 RL_VAL_UB 0 CM_0000 0 255 /end CHARACTERISTIC
/begin CHARACTERISTIC K_ED_VAN_ANSCHL_A2.KLASSENINDEX "Fault code VAN_ANSCHL_A2 - fault class selection (lamp / warning behaviour) [verified]" VALUE 0x71326 RL_VAL_UB 0 CM_0000 0 255 /end CHARACTERISTIC
/begin CHARACTERISTIC K_ED_VAN_ANSCHL_A2.OK_SCHWELLE "Fault code VAN_ANSCHL_A2 - debounce filter threshold for clearing (healing) the fault [verified]" VALUE 0x71321 RL_VAL_UB 0 CM_0000 0 255 /end CHARACTERISTIC
/begin CHARACTERISTIC K_ED_VAN_ANSCHL_A2.P_CODE_OPENLOAD "Fault code VAN_ANSCHL_A2 - OBD P-code reported for open circuit [verified]" VALUE 0x7131C RL_VAL_UW 0 CM_0000 0 65535 /end CHARACTERISTIC
/begin CHARACTERISTIC K_ED_VAN_ANSCHL_A2.P_CODE_SH_TO_GND "Fault code VAN_ANSCHL_A2 - OBD P-code reported for short to ground [verified]" VALUE 0x7131A RL_VAL_UW 0 CM_0000 0 65535 /end CHARACTERISTIC
/begin CHARACTERISTIC K_ED_VAN_ANSCHL_A2.P_CODE_SH_TO_UB "Fault code VAN_ANSCHL_A2 - OBD P-code reported for short to battery voltage [verified]" VALUE 0x71318 RL_VAL_UW 0 CM_0000 0 65535 /end CHARACTERISTIC
/begin CHARACTERISTIC K_ED_VAN_ANSCHL_A2.P_CODE_UNPLAUSIBEL "Fault code VAN_ANSCHL_A2 - OBD P-code reported for implausible signal [verified]" VALUE 0x7131E RL_VAL_UW 0 CM_0000 0 65535 /end CHARACTERISTIC
/begin CHARACTERISTIC K_ED_VAN_ANSCHL_E1.DEC_NACH_EINTRAG "Fault code VAN_ANSCHL_E1 - debounce filter decrement after fault-memory entry [verified]" VALUE 0x712D7 RL_VAL_UB 0 CM_0000 0 255 /end CHARACTERISTIC
/begin CHARACTERISTIC K_ED_VAN_ANSCHL_E1.DEC_VOR_EINTRAG "Fault code VAN_ANSCHL_E1 - debounce filter decrement before fault-memory entry [verified]" VALUE 0x712D5 RL_VAL_UB 0 CM_0000 0 255 /end CHARACTERISTIC
/begin CHARACTERISTIC K_ED_VAN_ANSCHL_E1.FEHLERSCHWELLE "Fault code VAN_ANSCHL_E1 - debounce filter threshold for setting the fault [verified]" VALUE 0x712D2 RL_VAL_UB 0 CM_0000 0 255 /end CHARACTERISTIC
/begin CHARACTERISTIC K_ED_VAN_ANSCHL_E1.INC_NACH_EINTRAG "Fault code VAN_ANSCHL_E1 - debounce filter increment after fault-memory entry [verified]" VALUE 0x712D6 RL_VAL_UB 0 CM_0000 0 255 /end CHARACTERISTIC
/begin CHARACTERISTIC K_ED_VAN_ANSCHL_E1.INC_VOR_EINTRAG "Fault code VAN_ANSCHL_E1 - debounce filter increment before fault-memory entry [verified]" VALUE 0x712D4 RL_VAL_UB 0 CM_0000 0 255 /end CHARACTERISTIC
/begin CHARACTERISTIC K_ED_VAN_ANSCHL_E1.KLASSENINDEX "Fault code VAN_ANSCHL_E1 - fault class selection (lamp / warning behaviour) [verified]" VALUE 0x712D8 RL_VAL_UB 0 CM_0000 0 255 /end CHARACTERISTIC
/begin CHARACTERISTIC K_ED_VAN_ANSCHL_E1.OK_SCHWELLE "Fault code VAN_ANSCHL_E1 - debounce filter threshold for clearing (healing) the fault [verified]" VALUE 0x712D3 RL_VAL_UB 0 CM_0000 0 255 /end CHARACTERISTIC
/begin CHARACTERISTIC K_ED_VAN_ANSCHL_E1.P_CODE_OPENLOAD "Fault code VAN_ANSCHL_E1 - OBD P-code reported for open circuit [verified]" VALUE 0x712CE RL_VAL_UW 0 CM_0000 0 65535 /end CHARACTERISTIC
/begin CHARACTERISTIC K_ED_VAN_ANSCHL_E1.P_CODE_SH_TO_GND "Fault code VAN_ANSCHL_E1 - OBD P-code reported for short to ground [verified]" VALUE 0x712CC RL_VAL_UW 0 CM_0000 0 65535 /end CHARACTERISTIC
/begin CHARACTERISTIC K_ED_VAN_ANSCHL_E1.P_CODE_SH_TO_UB "Fault code VAN_ANSCHL_E1 - OBD P-code reported for short to battery voltage [verified]" VALUE 0x712CA RL_VAL_UW 0 CM_0000 0 65535 /end CHARACTERISTIC
/begin CHARACTERISTIC K_ED_VAN_ANSCHL_E1.P_CODE_UNPLAUSIBEL "Fault code VAN_ANSCHL_E1 - OBD P-code reported for implausible signal [verified]" VALUE 0x712D0 RL_VAL_UW 0 CM_0000 0 65535 /end CHARACTERISTIC
/begin CHARACTERISTIC K_ED_VAN_ANSCHL_E2.DEC_NACH_EINTRAG "Fault code VAN_ANSCHL_E2 - debounce filter decrement after fault-memory entry [verified]" VALUE 0x7130B RL_VAL_UB 0 CM_0000 0 255 /end CHARACTERISTIC
/begin CHARACTERISTIC K_ED_VAN_ANSCHL_E2.DEC_VOR_EINTRAG "Fault code VAN_ANSCHL_E2 - debounce filter decrement before fault-memory entry [verified]" VALUE 0x71309 RL_VAL_UB 0 CM_0000 0 255 /end CHARACTERISTIC
/begin CHARACTERISTIC K_ED_VAN_ANSCHL_E2.FEHLERSCHWELLE "Fault code VAN_ANSCHL_E2 - debounce filter threshold for setting the fault [verified]" VALUE 0x71306 RL_VAL_UB 0 CM_0000 0 255 /end CHARACTERISTIC
/begin CHARACTERISTIC K_ED_VAN_ANSCHL_E2.INC_NACH_EINTRAG "Fault code VAN_ANSCHL_E2 - debounce filter increment after fault-memory entry [verified]" VALUE 0x7130A RL_VAL_UB 0 CM_0000 0 255 /end CHARACTERISTIC
/begin CHARACTERISTIC K_ED_VAN_ANSCHL_E2.INC_VOR_EINTRAG "Fault code VAN_ANSCHL_E2 - debounce filter increment before fault-memory entry [verified]" VALUE 0x71308 RL_VAL_UB 0 CM_0000 0 255 /end CHARACTERISTIC
/begin CHARACTERISTIC K_ED_VAN_ANSCHL_E2.KLASSENINDEX "Fault code VAN_ANSCHL_E2 - fault class selection (lamp / warning behaviour) [verified]" VALUE 0x7130C RL_VAL_UB 0 CM_0000 0 255 /end CHARACTERISTIC
/begin CHARACTERISTIC K_ED_VAN_ANSCHL_E2.OK_SCHWELLE "Fault code VAN_ANSCHL_E2 - debounce filter threshold for clearing (healing) the fault [verified]" VALUE 0x71307 RL_VAL_UB 0 CM_0000 0 255 /end CHARACTERISTIC
/begin CHARACTERISTIC K_ED_VAN_ANSCHL_E2.P_CODE_OPENLOAD "Fault code VAN_ANSCHL_E2 - OBD P-code reported for open circuit [verified]" VALUE 0x71302 RL_VAL_UW 0 CM_0000 0 65535 /end CHARACTERISTIC
/begin CHARACTERISTIC K_ED_VAN_ANSCHL_E2.P_CODE_SH_TO_GND "Fault code VAN_ANSCHL_E2 - OBD P-code reported for short to ground [verified]" VALUE 0x71300 RL_VAL_UW 0 CM_0000 0 65535 /end CHARACTERISTIC
/begin CHARACTERISTIC K_ED_VAN_ANSCHL_E2.P_CODE_SH_TO_UB "Fault code VAN_ANSCHL_E2 - OBD P-code reported for short to battery voltage [verified]" VALUE 0x712FE RL_VAL_UW 0 CM_0000 0 65535 /end CHARACTERISTIC
/begin CHARACTERISTIC K_ED_VAN_ANSCHL_E2.P_CODE_UNPLAUSIBEL "Fault code VAN_ANSCHL_E2 - OBD P-code reported for implausible signal [verified]" VALUE 0x71304 RL_VAL_UW 0 CM_0000 0 65535 /end CHARACTERISTIC
/begin CHARACTERISTIC K_ED_VAN_DRUCK.DEC_NACH_EINTRAG "Fault code VAN_DRUCK - debounce filter decrement after fault-memory entry [verified]" VALUE 0x71BAD RL_VAL_UB 0 CM_0000 0 255 /end CHARACTERISTIC
/begin CHARACTERISTIC K_ED_VAN_DRUCK.DEC_VOR_EINTRAG "Fault code VAN_DRUCK - debounce filter decrement before fault-memory entry [verified]" VALUE 0x71BAB RL_VAL_UB 0 CM_0000 0 255 /end CHARACTERISTIC
/begin CHARACTERISTIC K_ED_VAN_DRUCK.FEHLERSCHWELLE "Fault code VAN_DRUCK - debounce filter threshold for setting the fault [verified]" VALUE 0x71BA8 RL_VAL_UB 0 CM_0000 0 255 /end CHARACTERISTIC
/begin CHARACTERISTIC K_ED_VAN_DRUCK.INC_NACH_EINTRAG "Fault code VAN_DRUCK - debounce filter increment after fault-memory entry [verified]" VALUE 0x71BAC RL_VAL_UB 0 CM_0000 0 255 /end CHARACTERISTIC
/begin CHARACTERISTIC K_ED_VAN_DRUCK.INC_VOR_EINTRAG "Fault code VAN_DRUCK - debounce filter increment before fault-memory entry [verified]" VALUE 0x71BAA RL_VAL_UB 0 CM_0000 0 255 /end CHARACTERISTIC
/begin CHARACTERISTIC K_ED_VAN_DRUCK.KLASSENINDEX "Fault code VAN_DRUCK - fault class selection (lamp / warning behaviour) [verified]" VALUE 0x71BAE RL_VAL_UB 0 CM_0000 0 255 /end CHARACTERISTIC
/begin CHARACTERISTIC K_ED_VAN_DRUCK.OK_SCHWELLE "Fault code VAN_DRUCK - debounce filter threshold for clearing (healing) the fault [verified]" VALUE 0x71BA9 RL_VAL_UB 0 CM_0000 0 255 /end CHARACTERISTIC
/begin CHARACTERISTIC K_ED_VAN_DRUCK.P_CODE_OPENLOAD "Fault code VAN_DRUCK - OBD P-code reported for open circuit [verified]" VALUE 0x71BA4 RL_VAL_UW 0 CM_0000 0 65535 /end CHARACTERISTIC
/begin CHARACTERISTIC K_ED_VAN_DRUCK.P_CODE_SH_TO_GND "Fault code VAN_DRUCK - OBD P-code reported for short to ground [verified]" VALUE 0x71BA2 RL_VAL_UW 0 CM_0000 0 65535 /end CHARACTERISTIC
/begin CHARACTERISTIC K_ED_VAN_DRUCK.P_CODE_SH_TO_UB "Fault code VAN_DRUCK - OBD P-code reported for short to battery voltage [verified]" VALUE 0x71BA0 RL_VAL_UW 0 CM_0000 0 65535 /end CHARACTERISTIC
/begin CHARACTERISTIC K_ED_VAN_DRUCK.P_CODE_UNPLAUSIBEL "Fault code VAN_DRUCK - OBD P-code reported for implausible signal [verified]" VALUE 0x71BA6 RL_VAL_UW 0 CM_0000 0 65535 /end CHARACTERISTIC
/begin CHARACTERISTIC K_ED_VAN_DSV.DEC_NACH_EINTRAG "Fault code VAN_DSV - debounce filter decrement after fault-memory entry [verified]" VALUE 0x7174F RL_VAL_UB 0 CM_0000 0 255 /end CHARACTERISTIC
/begin CHARACTERISTIC K_ED_VAN_DSV.DEC_VOR_EINTRAG "Fault code VAN_DSV - debounce filter decrement before fault-memory entry [verified]" VALUE 0x7174D RL_VAL_UB 0 CM_0000 0 255 /end CHARACTERISTIC
/begin CHARACTERISTIC K_ED_VAN_DSV.FEHLERSCHWELLE "Fault code VAN_DSV - debounce filter threshold for setting the fault [verified]" VALUE 0x7174A RL_VAL_UB 0 CM_0000 0 255 /end CHARACTERISTIC
/begin CHARACTERISTIC K_ED_VAN_DSV.INC_NACH_EINTRAG "Fault code VAN_DSV - debounce filter increment after fault-memory entry [verified]" VALUE 0x7174E RL_VAL_UB 0 CM_0000 0 255 /end CHARACTERISTIC
/begin CHARACTERISTIC K_ED_VAN_DSV.INC_VOR_EINTRAG "Fault code VAN_DSV - debounce filter increment before fault-memory entry [verified]" VALUE 0x7174C RL_VAL_UB 0 CM_0000 0 255 /end CHARACTERISTIC
/begin CHARACTERISTIC K_ED_VAN_DSV.KLASSENINDEX "Fault code VAN_DSV - fault class selection (lamp / warning behaviour) [verified]" VALUE 0x71750 RL_VAL_UB 0 CM_0000 0 255 /end CHARACTERISTIC
/begin CHARACTERISTIC K_ED_VAN_DSV.OK_SCHWELLE "Fault code VAN_DSV - debounce filter threshold for clearing (healing) the fault [verified]" VALUE 0x7174B RL_VAL_UB 0 CM_0000 0 255 /end CHARACTERISTIC
/begin CHARACTERISTIC K_ED_VAN_DSV.P_CODE_OPENLOAD "Fault code VAN_DSV - OBD P-code reported for open circuit [verified]" VALUE 0x71746 RL_VAL_UW 0 CM_0000 0 65535 /end CHARACTERISTIC
/begin CHARACTERISTIC K_ED_VAN_DSV.P_CODE_SH_TO_GND "Fault code VAN_DSV - OBD P-code reported for short to ground [verified]" VALUE 0x71744 RL_VAL_UW 0 CM_0000 0 65535 /end CHARACTERISTIC
/begin CHARACTERISTIC K_ED_VAN_DSV.P_CODE_SH_TO_UB "Fault code VAN_DSV - OBD P-code reported for short to battery voltage [verified]" VALUE 0x71742 RL_VAL_UW 0 CM_0000 0 65535 /end CHARACTERISTIC
/begin CHARACTERISTIC K_ED_VAN_DSV.P_CODE_UNPLAUSIBEL "Fault code VAN_DSV - OBD P-code reported for implausible signal [verified]" VALUE 0x71748 RL_VAL_UW 0 CM_0000 0 65535 /end CHARACTERISTIC
/begin CHARACTERISTIC K_ED_VAN_HALL_A1.DEC_NACH_EINTRAG "Fault code VAN_HALL_A1 - debounce filter decrement after fault-memory entry [verified]" VALUE 0x70B87 RL_VAL_UB 0 CM_0000 0 255 /end CHARACTERISTIC
/begin CHARACTERISTIC K_ED_VAN_HALL_A1.DEC_VOR_EINTRAG "Fault code VAN_HALL_A1 - debounce filter decrement before fault-memory entry [verified]" VALUE 0x70B85 RL_VAL_UB 0 CM_0000 0 255 /end CHARACTERISTIC
/begin CHARACTERISTIC K_ED_VAN_HALL_A1.FEHLERSCHWELLE "Fault code VAN_HALL_A1 - debounce filter threshold for setting the fault [verified]" VALUE 0x70B82 RL_VAL_UB 0 CM_0000 0 255 /end CHARACTERISTIC
/begin CHARACTERISTIC K_ED_VAN_HALL_A1.INC_NACH_EINTRAG "Fault code VAN_HALL_A1 - debounce filter increment after fault-memory entry [verified]" VALUE 0x70B86 RL_VAL_UB 0 CM_0000 0 255 /end CHARACTERISTIC
/begin CHARACTERISTIC K_ED_VAN_HALL_A1.INC_VOR_EINTRAG "Fault code VAN_HALL_A1 - debounce filter increment before fault-memory entry [verified]" VALUE 0x70B84 RL_VAL_UB 0 CM_0000 0 255 /end CHARACTERISTIC
/begin CHARACTERISTIC K_ED_VAN_HALL_A1.KLASSENINDEX "Fault code VAN_HALL_A1 - fault class selection (lamp / warning behaviour) [verified]" VALUE 0x70B88 RL_VAL_UB 0 CM_0000 0 255 /end CHARACTERISTIC
/begin CHARACTERISTIC K_ED_VAN_HALL_A1.OK_SCHWELLE "Fault code VAN_HALL_A1 - debounce filter threshold for clearing (healing) the fault [verified]" VALUE 0x70B83 RL_VAL_UB 0 CM_0000 0 255 /end CHARACTERISTIC
/begin CHARACTERISTIC K_ED_VAN_HALL_A1.P_CODE_OPENLOAD "Fault code VAN_HALL_A1 - OBD P-code reported for open circuit [verified]" VALUE 0x70B7E RL_VAL_UW 0 CM_0000 0 65535 /end CHARACTERISTIC
/begin CHARACTERISTIC K_ED_VAN_HALL_A1.P_CODE_SH_TO_GND "Fault code VAN_HALL_A1 - OBD P-code reported for short to ground [verified]" VALUE 0x70B7C RL_VAL_UW 0 CM_0000 0 65535 /end CHARACTERISTIC
/begin CHARACTERISTIC K_ED_VAN_HALL_A1.P_CODE_SH_TO_UB "Fault code VAN_HALL_A1 - OBD P-code reported for short to battery voltage [verified]" VALUE 0x70B7A RL_VAL_UW 0 CM_0000 0 65535 /end CHARACTERISTIC
/begin CHARACTERISTIC K_ED_VAN_HALL_A1.P_CODE_UNPLAUSIBEL "Fault code VAN_HALL_A1 - OBD P-code reported for implausible signal [verified]" VALUE 0x70B80 RL_VAL_UW 0 CM_0000 0 65535 /end CHARACTERISTIC
/begin CHARACTERISTIC K_ED_VAN_HALL_A2.DEC_NACH_EINTRAG "Fault code VAN_HALL_A2 - debounce filter decrement after fault-memory entry [verified]" VALUE 0x70BBB RL_VAL_UB 0 CM_0000 0 255 /end CHARACTERISTIC
/begin CHARACTERISTIC K_ED_VAN_HALL_A2.DEC_VOR_EINTRAG "Fault code VAN_HALL_A2 - debounce filter decrement before fault-memory entry [verified]" VALUE 0x70BB9 RL_VAL_UB 0 CM_0000 0 255 /end CHARACTERISTIC
/begin CHARACTERISTIC K_ED_VAN_HALL_A2.FEHLERSCHWELLE "Fault code VAN_HALL_A2 - debounce filter threshold for setting the fault [verified]" VALUE 0x70BB6 RL_VAL_UB 0 CM_0000 0 255 /end CHARACTERISTIC
/begin CHARACTERISTIC K_ED_VAN_HALL_A2.INC_NACH_EINTRAG "Fault code VAN_HALL_A2 - debounce filter increment after fault-memory entry [verified]" VALUE 0x70BBA RL_VAL_UB 0 CM_0000 0 255 /end CHARACTERISTIC
/begin CHARACTERISTIC K_ED_VAN_HALL_A2.INC_VOR_EINTRAG "Fault code VAN_HALL_A2 - debounce filter increment before fault-memory entry [verified]" VALUE 0x70BB8 RL_VAL_UB 0 CM_0000 0 255 /end CHARACTERISTIC
/begin CHARACTERISTIC K_ED_VAN_HALL_A2.KLASSENINDEX "Fault code VAN_HALL_A2 - fault class selection (lamp / warning behaviour) [verified]" VALUE 0x70BBC RL_VAL_UB 0 CM_0000 0 255 /end CHARACTERISTIC
/begin CHARACTERISTIC K_ED_VAN_HALL_A2.OK_SCHWELLE "Fault code VAN_HALL_A2 - debounce filter threshold for clearing (healing) the fault [verified]" VALUE 0x70BB7 RL_VAL_UB 0 CM_0000 0 255 /end CHARACTERISTIC
/begin CHARACTERISTIC K_ED_VAN_HALL_A2.P_CODE_OPENLOAD "Fault code VAN_HALL_A2 - OBD P-code reported for open circuit [verified]" VALUE 0x70BB2 RL_VAL_UW 0 CM_0000 0 65535 /end CHARACTERISTIC
/begin CHARACTERISTIC K_ED_VAN_HALL_A2.P_CODE_SH_TO_GND "Fault code VAN_HALL_A2 - OBD P-code reported for short to ground [verified]" VALUE 0x70BB0 RL_VAL_UW 0 CM_0000 0 65535 /end CHARACTERISTIC
/begin CHARACTERISTIC K_ED_VAN_HALL_A2.P_CODE_SH_TO_UB "Fault code VAN_HALL_A2 - OBD P-code reported for short to battery voltage [verified]" VALUE 0x70BAE RL_VAL_UW 0 CM_0000 0 65535 /end CHARACTERISTIC
/begin CHARACTERISTIC K_ED_VAN_HALL_A2.P_CODE_UNPLAUSIBEL "Fault code VAN_HALL_A2 - OBD P-code reported for implausible signal [verified]" VALUE 0x70BB4 RL_VAL_UW 0 CM_0000 0 65535 /end CHARACTERISTIC
/begin CHARACTERISTIC K_ED_VAN_HALL_E1.DEC_NACH_EINTRAG "Fault code VAN_HALL_E1 - debounce filter decrement after fault-memory entry [verified]" VALUE 0x70B6D RL_VAL_UB 0 CM_0000 0 255 /end CHARACTERISTIC
/begin CHARACTERISTIC K_ED_VAN_HALL_E1.DEC_VOR_EINTRAG "Fault code VAN_HALL_E1 - debounce filter decrement before fault-memory entry [verified]" VALUE 0x70B6B RL_VAL_UB 0 CM_0000 0 255 /end CHARACTERISTIC
/begin CHARACTERISTIC K_ED_VAN_HALL_E1.FEHLERSCHWELLE "Fault code VAN_HALL_E1 - debounce filter threshold for setting the fault [verified]" VALUE 0x70B68 RL_VAL_UB 0 CM_0000 0 255 /end CHARACTERISTIC
/begin CHARACTERISTIC K_ED_VAN_HALL_E1.INC_NACH_EINTRAG "Fault code VAN_HALL_E1 - debounce filter increment after fault-memory entry [verified]" VALUE 0x70B6C RL_VAL_UB 0 CM_0000 0 255 /end CHARACTERISTIC
/begin CHARACTERISTIC K_ED_VAN_HALL_E1.INC_VOR_EINTRAG "Fault code VAN_HALL_E1 - debounce filter increment before fault-memory entry [verified]" VALUE 0x70B6A RL_VAL_UB 0 CM_0000 0 255 /end CHARACTERISTIC
/begin CHARACTERISTIC K_ED_VAN_HALL_E1.KLASSENINDEX "Fault code VAN_HALL_E1 - fault class selection (lamp / warning behaviour) [verified]" VALUE 0x70B6E RL_VAL_UB 0 CM_0000 0 255 /end CHARACTERISTIC
/begin CHARACTERISTIC K_ED_VAN_HALL_E1.OK_SCHWELLE "Fault code VAN_HALL_E1 - debounce filter threshold for clearing (healing) the fault [verified]" VALUE 0x70B69 RL_VAL_UB 0 CM_0000 0 255 /end CHARACTERISTIC
/begin CHARACTERISTIC K_ED_VAN_HALL_E1.P_CODE_OPENLOAD "Fault code VAN_HALL_E1 - OBD P-code reported for open circuit [verified]" VALUE 0x70B64 RL_VAL_UW 0 CM_0000 0 65535 /end CHARACTERISTIC
/begin CHARACTERISTIC K_ED_VAN_HALL_E1.P_CODE_SH_TO_GND "Fault code VAN_HALL_E1 - OBD P-code reported for short to ground [verified]" VALUE 0x70B62 RL_VAL_UW 0 CM_0000 0 65535 /end CHARACTERISTIC
/begin CHARACTERISTIC K_ED_VAN_HALL_E1.P_CODE_SH_TO_UB "Fault code VAN_HALL_E1 - OBD P-code reported for short to battery voltage [verified]" VALUE 0x70B60 RL_VAL_UW 0 CM_0000 0 65535 /end CHARACTERISTIC
/begin CHARACTERISTIC K_ED_VAN_HALL_E1.P_CODE_UNPLAUSIBEL "Fault code VAN_HALL_E1 - OBD P-code reported for implausible signal [verified]" VALUE 0x70B66 RL_VAL_UW 0 CM_0000 0 65535 /end CHARACTERISTIC
/begin CHARACTERISTIC K_ED_VAN_HALL_E2.DEC_NACH_EINTRAG "Fault code VAN_HALL_E2 - debounce filter decrement after fault-memory entry [verified]" VALUE 0x70BA1 RL_VAL_UB 0 CM_0000 0 255 /end CHARACTERISTIC
/begin CHARACTERISTIC K_ED_VAN_HALL_E2.DEC_VOR_EINTRAG "Fault code VAN_HALL_E2 - debounce filter decrement before fault-memory entry [verified]" VALUE 0x70B9F RL_VAL_UB 0 CM_0000 0 255 /end CHARACTERISTIC
/begin CHARACTERISTIC K_ED_VAN_HALL_E2.FEHLERSCHWELLE "Fault code VAN_HALL_E2 - debounce filter threshold for setting the fault [verified]" VALUE 0x70B9C RL_VAL_UB 0 CM_0000 0 255 /end CHARACTERISTIC
/begin CHARACTERISTIC K_ED_VAN_HALL_E2.INC_NACH_EINTRAG "Fault code VAN_HALL_E2 - debounce filter increment after fault-memory entry [verified]" VALUE 0x70BA0 RL_VAL_UB 0 CM_0000 0 255 /end CHARACTERISTIC
/begin CHARACTERISTIC K_ED_VAN_HALL_E2.INC_VOR_EINTRAG "Fault code VAN_HALL_E2 - debounce filter increment before fault-memory entry [verified]" VALUE 0x70B9E RL_VAL_UB 0 CM_0000 0 255 /end CHARACTERISTIC
/begin CHARACTERISTIC K_ED_VAN_HALL_E2.KLASSENINDEX "Fault code VAN_HALL_E2 - fault class selection (lamp / warning behaviour) [verified]" VALUE 0x70BA2 RL_VAL_UB 0 CM_0000 0 255 /end CHARACTERISTIC
/begin CHARACTERISTIC K_ED_VAN_HALL_E2.OK_SCHWELLE "Fault code VAN_HALL_E2 - debounce filter threshold for clearing (healing) the fault [verified]" VALUE 0x70B9D RL_VAL_UB 0 CM_0000 0 255 /end CHARACTERISTIC
/begin CHARACTERISTIC K_ED_VAN_HALL_E2.P_CODE_OPENLOAD "Fault code VAN_HALL_E2 - OBD P-code reported for open circuit [verified]" VALUE 0x70B98 RL_VAL_UW 0 CM_0000 0 65535 /end CHARACTERISTIC
/begin CHARACTERISTIC K_ED_VAN_HALL_E2.P_CODE_SH_TO_GND "Fault code VAN_HALL_E2 - OBD P-code reported for short to ground [verified]" VALUE 0x70B96 RL_VAL_UW 0 CM_0000 0 65535 /end CHARACTERISTIC
/begin CHARACTERISTIC K_ED_VAN_HALL_E2.P_CODE_SH_TO_UB "Fault code VAN_HALL_E2 - OBD P-code reported for short to battery voltage [verified]" VALUE 0x70B94 RL_VAL_UW 0 CM_0000 0 65535 /end CHARACTERISTIC
/begin CHARACTERISTIC K_ED_VAN_HALL_E2.P_CODE_UNPLAUSIBEL "Fault code VAN_HALL_E2 - OBD P-code reported for implausible signal [verified]" VALUE 0x70B9A RL_VAL_UW 0 CM_0000 0 65535 /end CHARACTERISTIC
/begin CHARACTERISTIC K_ED_VAN_REGL_A1.DEC_NACH_EINTRAG "Fault code VAN_REGL_A1 - debounce filter decrement after fault-memory entry [verified]" VALUE 0x70BEF RL_VAL_UB 0 CM_0000 0 255 /end CHARACTERISTIC
/begin CHARACTERISTIC K_ED_VAN_REGL_A1.DEC_VOR_EINTRAG "Fault code VAN_REGL_A1 - debounce filter decrement before fault-memory entry [verified]" VALUE 0x70BED RL_VAL_UB 0 CM_0000 0 255 /end CHARACTERISTIC
/begin CHARACTERISTIC K_ED_VAN_REGL_A1.FEHLERSCHWELLE "Fault code VAN_REGL_A1 - debounce filter threshold for setting the fault [verified]" VALUE 0x70BEA RL_VAL_UB 0 CM_0000 0 255 /end CHARACTERISTIC
/begin CHARACTERISTIC K_ED_VAN_REGL_A1.INC_NACH_EINTRAG "Fault code VAN_REGL_A1 - debounce filter increment after fault-memory entry [verified]" VALUE 0x70BEE RL_VAL_UB 0 CM_0000 0 255 /end CHARACTERISTIC
/begin CHARACTERISTIC K_ED_VAN_REGL_A1.INC_VOR_EINTRAG "Fault code VAN_REGL_A1 - debounce filter increment before fault-memory entry [verified]" VALUE 0x70BEC RL_VAL_UB 0 CM_0000 0 255 /end CHARACTERISTIC
/begin CHARACTERISTIC K_ED_VAN_REGL_A1.KLASSENINDEX "Fault code VAN_REGL_A1 - fault class selection (lamp / warning behaviour) [verified]" VALUE 0x70BF0 RL_VAL_UB 0 CM_0000 0 255 /end CHARACTERISTIC
/begin CHARACTERISTIC K_ED_VAN_REGL_A1.OK_SCHWELLE "Fault code VAN_REGL_A1 - debounce filter threshold for clearing (healing) the fault [verified]" VALUE 0x70BEB RL_VAL_UB 0 CM_0000 0 255 /end CHARACTERISTIC
/begin CHARACTERISTIC K_ED_VAN_REGL_A1.P_CODE_OPENLOAD "Fault code VAN_REGL_A1 - OBD P-code reported for open circuit [verified]" VALUE 0x70BE6 RL_VAL_UW 0 CM_0000 0 65535 /end CHARACTERISTIC
/begin CHARACTERISTIC K_ED_VAN_REGL_A1.P_CODE_SH_TO_GND "Fault code VAN_REGL_A1 - OBD P-code reported for short to ground [verified]" VALUE 0x70BE4 RL_VAL_UW 0 CM_0000 0 65535 /end CHARACTERISTIC
/begin CHARACTERISTIC K_ED_VAN_REGL_A1.P_CODE_SH_TO_UB "Fault code VAN_REGL_A1 - OBD P-code reported for short to battery voltage [verified]" VALUE 0x70BE2 RL_VAL_UW 0 CM_0000 0 65535 /end CHARACTERISTIC
/begin CHARACTERISTIC K_ED_VAN_REGL_A1.P_CODE_UNPLAUSIBEL "Fault code VAN_REGL_A1 - OBD P-code reported for implausible signal [verified]" VALUE 0x70BE8 RL_VAL_UW 0 CM_0000 0 65535 /end CHARACTERISTIC
/begin CHARACTERISTIC K_ED_VAN_REGL_A2.DEC_NACH_EINTRAG "Fault code VAN_REGL_A2 - debounce filter decrement after fault-memory entry [verified]" VALUE 0x70C23 RL_VAL_UB 0 CM_0000 0 255 /end CHARACTERISTIC
/begin CHARACTERISTIC K_ED_VAN_REGL_A2.DEC_VOR_EINTRAG "Fault code VAN_REGL_A2 - debounce filter decrement before fault-memory entry [verified]" VALUE 0x70C21 RL_VAL_UB 0 CM_0000 0 255 /end CHARACTERISTIC
/begin CHARACTERISTIC K_ED_VAN_REGL_A2.FEHLERSCHWELLE "Fault code VAN_REGL_A2 - debounce filter threshold for setting the fault [verified]" VALUE 0x70C1E RL_VAL_UB 0 CM_0000 0 255 /end CHARACTERISTIC
/begin CHARACTERISTIC K_ED_VAN_REGL_A2.INC_NACH_EINTRAG "Fault code VAN_REGL_A2 - debounce filter increment after fault-memory entry [verified]" VALUE 0x70C22 RL_VAL_UB 0 CM_0000 0 255 /end CHARACTERISTIC
/begin CHARACTERISTIC K_ED_VAN_REGL_A2.INC_VOR_EINTRAG "Fault code VAN_REGL_A2 - debounce filter increment before fault-memory entry [verified]" VALUE 0x70C20 RL_VAL_UB 0 CM_0000 0 255 /end CHARACTERISTIC
/begin CHARACTERISTIC K_ED_VAN_REGL_A2.KLASSENINDEX "Fault code VAN_REGL_A2 - fault class selection (lamp / warning behaviour) [verified]" VALUE 0x70C24 RL_VAL_UB 0 CM_0000 0 255 /end CHARACTERISTIC
/begin CHARACTERISTIC K_ED_VAN_REGL_A2.OK_SCHWELLE "Fault code VAN_REGL_A2 - debounce filter threshold for clearing (healing) the fault [verified]" VALUE 0x70C1F RL_VAL_UB 0 CM_0000 0 255 /end CHARACTERISTIC
/begin CHARACTERISTIC K_ED_VAN_REGL_A2.P_CODE_OPENLOAD "Fault code VAN_REGL_A2 - OBD P-code reported for open circuit [verified]" VALUE 0x70C1A RL_VAL_UW 0 CM_0000 0 65535 /end CHARACTERISTIC
/begin CHARACTERISTIC K_ED_VAN_REGL_A2.P_CODE_SH_TO_GND "Fault code VAN_REGL_A2 - OBD P-code reported for short to ground [verified]" VALUE 0x70C18 RL_VAL_UW 0 CM_0000 0 65535 /end CHARACTERISTIC
/begin CHARACTERISTIC K_ED_VAN_REGL_A2.P_CODE_SH_TO_UB "Fault code VAN_REGL_A2 - OBD P-code reported for short to battery voltage [verified]" VALUE 0x70C16 RL_VAL_UW 0 CM_0000 0 65535 /end CHARACTERISTIC
/begin CHARACTERISTIC K_ED_VAN_REGL_A2.P_CODE_UNPLAUSIBEL "Fault code VAN_REGL_A2 - OBD P-code reported for implausible signal [verified]" VALUE 0x70C1C RL_VAL_UW 0 CM_0000 0 65535 /end CHARACTERISTIC
/begin CHARACTERISTIC K_ED_VAN_REGL_E1.DEC_NACH_EINTRAG "Fault code VAN_REGL_E1 - debounce filter decrement after fault-memory entry [verified]" VALUE 0x70BD5 RL_VAL_UB 0 CM_0000 0 255 /end CHARACTERISTIC
/begin CHARACTERISTIC K_ED_VAN_REGL_E1.DEC_VOR_EINTRAG "Fault code VAN_REGL_E1 - debounce filter decrement before fault-memory entry [verified]" VALUE 0x70BD3 RL_VAL_UB 0 CM_0000 0 255 /end CHARACTERISTIC
/begin CHARACTERISTIC K_ED_VAN_REGL_E1.FEHLERSCHWELLE "Fault code VAN_REGL_E1 - debounce filter threshold for setting the fault [verified]" VALUE 0x70BD0 RL_VAL_UB 0 CM_0000 0 255 /end CHARACTERISTIC
/begin CHARACTERISTIC K_ED_VAN_REGL_E1.INC_NACH_EINTRAG "Fault code VAN_REGL_E1 - debounce filter increment after fault-memory entry [verified]" VALUE 0x70BD4 RL_VAL_UB 0 CM_0000 0 255 /end CHARACTERISTIC
/begin CHARACTERISTIC K_ED_VAN_REGL_E1.INC_VOR_EINTRAG "Fault code VAN_REGL_E1 - debounce filter increment before fault-memory entry [verified]" VALUE 0x70BD2 RL_VAL_UB 0 CM_0000 0 255 /end CHARACTERISTIC
/begin CHARACTERISTIC K_ED_VAN_REGL_E1.KLASSENINDEX "Fault code VAN_REGL_E1 - fault class selection (lamp / warning behaviour) [verified]" VALUE 0x70BD6 RL_VAL_UB 0 CM_0000 0 255 /end CHARACTERISTIC
/begin CHARACTERISTIC K_ED_VAN_REGL_E1.OK_SCHWELLE "Fault code VAN_REGL_E1 - debounce filter threshold for clearing (healing) the fault [verified]" VALUE 0x70BD1 RL_VAL_UB 0 CM_0000 0 255 /end CHARACTERISTIC
/begin CHARACTERISTIC K_ED_VAN_REGL_E1.P_CODE_OPENLOAD "Fault code VAN_REGL_E1 - OBD P-code reported for open circuit [verified]" VALUE 0x70BCC RL_VAL_UW 0 CM_0000 0 65535 /end CHARACTERISTIC
/begin CHARACTERISTIC K_ED_VAN_REGL_E1.P_CODE_SH_TO_GND "Fault code VAN_REGL_E1 - OBD P-code reported for short to ground [verified]" VALUE 0x70BCA RL_VAL_UW 0 CM_0000 0 65535 /end CHARACTERISTIC
/begin CHARACTERISTIC K_ED_VAN_REGL_E1.P_CODE_SH_TO_UB "Fault code VAN_REGL_E1 - OBD P-code reported for short to battery voltage [verified]" VALUE 0x70BC8 RL_VAL_UW 0 CM_0000 0 65535 /end CHARACTERISTIC
/begin CHARACTERISTIC K_ED_VAN_REGL_E1.P_CODE_UNPLAUSIBEL "Fault code VAN_REGL_E1 - OBD P-code reported for implausible signal [verified]" VALUE 0x70BCE RL_VAL_UW 0 CM_0000 0 65535 /end CHARACTERISTIC
/begin CHARACTERISTIC K_ED_VAN_REGL_E2.DEC_NACH_EINTRAG "Fault code VAN_REGL_E2 - debounce filter decrement after fault-memory entry [verified]" VALUE 0x70C09 RL_VAL_UB 0 CM_0000 0 255 /end CHARACTERISTIC
/begin CHARACTERISTIC K_ED_VAN_REGL_E2.DEC_VOR_EINTRAG "Fault code VAN_REGL_E2 - debounce filter decrement before fault-memory entry [verified]" VALUE 0x70C07 RL_VAL_UB 0 CM_0000 0 255 /end CHARACTERISTIC
/begin CHARACTERISTIC K_ED_VAN_REGL_E2.FEHLERSCHWELLE "Fault code VAN_REGL_E2 - debounce filter threshold for setting the fault [verified]" VALUE 0x70C04 RL_VAL_UB 0 CM_0000 0 255 /end CHARACTERISTIC
/begin CHARACTERISTIC K_ED_VAN_REGL_E2.INC_NACH_EINTRAG "Fault code VAN_REGL_E2 - debounce filter increment after fault-memory entry [verified]" VALUE 0x70C08 RL_VAL_UB 0 CM_0000 0 255 /end CHARACTERISTIC
/begin CHARACTERISTIC K_ED_VAN_REGL_E2.INC_VOR_EINTRAG "Fault code VAN_REGL_E2 - debounce filter increment before fault-memory entry [verified]" VALUE 0x70C06 RL_VAL_UB 0 CM_0000 0 255 /end CHARACTERISTIC
/begin CHARACTERISTIC K_ED_VAN_REGL_E2.KLASSENINDEX "Fault code VAN_REGL_E2 - fault class selection (lamp / warning behaviour) [verified]" VALUE 0x70C0A RL_VAL_UB 0 CM_0000 0 255 /end CHARACTERISTIC
/begin CHARACTERISTIC K_ED_VAN_REGL_E2.OK_SCHWELLE "Fault code VAN_REGL_E2 - debounce filter threshold for clearing (healing) the fault [verified]" VALUE 0x70C05 RL_VAL_UB 0 CM_0000 0 255 /end CHARACTERISTIC
/begin CHARACTERISTIC K_ED_VAN_REGL_E2.P_CODE_OPENLOAD "Fault code VAN_REGL_E2 - OBD P-code reported for open circuit [verified]" VALUE 0x70C00 RL_VAL_UW 0 CM_0000 0 65535 /end CHARACTERISTIC
/begin CHARACTERISTIC K_ED_VAN_REGL_E2.P_CODE_SH_TO_GND "Fault code VAN_REGL_E2 - OBD P-code reported for short to ground [verified]" VALUE 0x70BFE RL_VAL_UW 0 CM_0000 0 65535 /end CHARACTERISTIC
/begin CHARACTERISTIC K_ED_VAN_REGL_E2.P_CODE_SH_TO_UB "Fault code VAN_REGL_E2 - OBD P-code reported for short to battery voltage [verified]" VALUE 0x70BFC RL_VAL_UW 0 CM_0000 0 65535 /end CHARACTERISTIC
/begin CHARACTERISTIC K_ED_VAN_REGL_E2.P_CODE_UNPLAUSIBEL "Fault code VAN_REGL_E2 - OBD P-code reported for implausible signal [verified]" VALUE 0x70C02 RL_VAL_UW 0 CM_0000 0 65535 /end CHARACTERISTIC
/begin CHARACTERISTIC K_ED_VAN_VENT_A1.DEC_NACH_EINTRAG "Fault code VAN_VENT_A1 - debounce filter decrement after fault-memory entry [verified]" VALUE 0x71359 RL_VAL_UB 0 CM_0000 0 255 /end CHARACTERISTIC
/begin CHARACTERISTIC K_ED_VAN_VENT_A1.DEC_VOR_EINTRAG "Fault code VAN_VENT_A1 - debounce filter decrement before fault-memory entry [verified]" VALUE 0x71357 RL_VAL_UB 0 CM_0000 0 255 /end CHARACTERISTIC
/begin CHARACTERISTIC K_ED_VAN_VENT_A1.FEHLERSCHWELLE "Fault code VAN_VENT_A1 - debounce filter threshold for setting the fault [verified]" VALUE 0x71354 RL_VAL_UB 0 CM_0000 0 255 /end CHARACTERISTIC
/begin CHARACTERISTIC K_ED_VAN_VENT_A1.INC_NACH_EINTRAG "Fault code VAN_VENT_A1 - debounce filter increment after fault-memory entry [verified]" VALUE 0x71358 RL_VAL_UB 0 CM_0000 0 255 /end CHARACTERISTIC
/begin CHARACTERISTIC K_ED_VAN_VENT_A1.INC_VOR_EINTRAG "Fault code VAN_VENT_A1 - debounce filter increment before fault-memory entry [verified]" VALUE 0x71356 RL_VAL_UB 0 CM_0000 0 255 /end CHARACTERISTIC
/begin CHARACTERISTIC K_ED_VAN_VENT_A1.KLASSENINDEX "Fault code VAN_VENT_A1 - fault class selection (lamp / warning behaviour) [verified]" VALUE 0x7135A RL_VAL_UB 0 CM_0000 0 255 /end CHARACTERISTIC
/begin CHARACTERISTIC K_ED_VAN_VENT_A1.OK_SCHWELLE "Fault code VAN_VENT_A1 - debounce filter threshold for clearing (healing) the fault [verified]" VALUE 0x71355 RL_VAL_UB 0 CM_0000 0 255 /end CHARACTERISTIC
/begin CHARACTERISTIC K_ED_VAN_VENT_A1.P_CODE_OPENLOAD "Fault code VAN_VENT_A1 - OBD P-code reported for open circuit [verified]" VALUE 0x71350 RL_VAL_UW 0 CM_0000 0 65535 /end CHARACTERISTIC
/begin CHARACTERISTIC K_ED_VAN_VENT_A1.P_CODE_SH_TO_GND "Fault code VAN_VENT_A1 - OBD P-code reported for short to ground [verified]" VALUE 0x7134E RL_VAL_UW 0 CM_0000 0 65535 /end CHARACTERISTIC
/begin CHARACTERISTIC K_ED_VAN_VENT_A1.P_CODE_SH_TO_UB "Fault code VAN_VENT_A1 - OBD P-code reported for short to battery voltage [verified]" VALUE 0x7134C RL_VAL_UW 0 CM_0000 0 65535 /end CHARACTERISTIC
/begin CHARACTERISTIC K_ED_VAN_VENT_A1.P_CODE_UNPLAUSIBEL "Fault code VAN_VENT_A1 - OBD P-code reported for implausible signal [verified]" VALUE 0x71352 RL_VAL_UW 0 CM_0000 0 65535 /end CHARACTERISTIC
/begin CHARACTERISTIC K_ED_VAN_VENT_A2.DEC_NACH_EINTRAG "Fault code VAN_VENT_A2 - debounce filter decrement after fault-memory entry [verified]" VALUE 0x7138D RL_VAL_UB 0 CM_0000 0 255 /end CHARACTERISTIC
/begin CHARACTERISTIC K_ED_VAN_VENT_A2.DEC_VOR_EINTRAG "Fault code VAN_VENT_A2 - debounce filter decrement before fault-memory entry [verified]" VALUE 0x7138B RL_VAL_UB 0 CM_0000 0 255 /end CHARACTERISTIC
/begin CHARACTERISTIC K_ED_VAN_VENT_A2.FEHLERSCHWELLE "Fault code VAN_VENT_A2 - debounce filter threshold for setting the fault [verified]" VALUE 0x71388 RL_VAL_UB 0 CM_0000 0 255 /end CHARACTERISTIC
/begin CHARACTERISTIC K_ED_VAN_VENT_A2.INC_NACH_EINTRAG "Fault code VAN_VENT_A2 - debounce filter increment after fault-memory entry [verified]" VALUE 0x7138C RL_VAL_UB 0 CM_0000 0 255 /end CHARACTERISTIC
/begin CHARACTERISTIC K_ED_VAN_VENT_A2.INC_VOR_EINTRAG "Fault code VAN_VENT_A2 - debounce filter increment before fault-memory entry [verified]" VALUE 0x7138A RL_VAL_UB 0 CM_0000 0 255 /end CHARACTERISTIC
/begin CHARACTERISTIC K_ED_VAN_VENT_A2.KLASSENINDEX "Fault code VAN_VENT_A2 - fault class selection (lamp / warning behaviour) [verified]" VALUE 0x7138E RL_VAL_UB 0 CM_0000 0 255 /end CHARACTERISTIC
/begin CHARACTERISTIC K_ED_VAN_VENT_A2.OK_SCHWELLE "Fault code VAN_VENT_A2 - debounce filter threshold for clearing (healing) the fault [verified]" VALUE 0x71389 RL_VAL_UB 0 CM_0000 0 255 /end CHARACTERISTIC
/begin CHARACTERISTIC K_ED_VAN_VENT_A2.P_CODE_OPENLOAD "Fault code VAN_VENT_A2 - OBD P-code reported for open circuit [verified]" VALUE 0x71384 RL_VAL_UW 0 CM_0000 0 65535 /end CHARACTERISTIC
/begin CHARACTERISTIC K_ED_VAN_VENT_A2.P_CODE_SH_TO_GND "Fault code VAN_VENT_A2 - OBD P-code reported for short to ground [verified]" VALUE 0x71382 RL_VAL_UW 0 CM_0000 0 65535 /end CHARACTERISTIC
/begin CHARACTERISTIC K_ED_VAN_VENT_A2.P_CODE_SH_TO_UB "Fault code VAN_VENT_A2 - OBD P-code reported for short to battery voltage [verified]" VALUE 0x71380 RL_VAL_UW 0 CM_0000 0 65535 /end CHARACTERISTIC
/begin CHARACTERISTIC K_ED_VAN_VENT_A2.P_CODE_UNPLAUSIBEL "Fault code VAN_VENT_A2 - OBD P-code reported for implausible signal [verified]" VALUE 0x71386 RL_VAL_UW 0 CM_0000 0 65535 /end CHARACTERISTIC
/begin CHARACTERISTIC K_ED_VAN_VENT_E1.DEC_NACH_EINTRAG "Fault code VAN_VENT_E1 - debounce filter decrement after fault-memory entry [verified]" VALUE 0x7133F RL_VAL_UB 0 CM_0000 0 255 /end CHARACTERISTIC
/begin CHARACTERISTIC K_ED_VAN_VENT_E1.DEC_VOR_EINTRAG "Fault code VAN_VENT_E1 - debounce filter decrement before fault-memory entry [verified]" VALUE 0x7133D RL_VAL_UB 0 CM_0000 0 255 /end CHARACTERISTIC
/begin CHARACTERISTIC K_ED_VAN_VENT_E1.FEHLERSCHWELLE "Fault code VAN_VENT_E1 - debounce filter threshold for setting the fault [verified]" VALUE 0x7133A RL_VAL_UB 0 CM_0000 0 255 /end CHARACTERISTIC
/begin CHARACTERISTIC K_ED_VAN_VENT_E1.INC_NACH_EINTRAG "Fault code VAN_VENT_E1 - debounce filter increment after fault-memory entry [verified]" VALUE 0x7133E RL_VAL_UB 0 CM_0000 0 255 /end CHARACTERISTIC
/begin CHARACTERISTIC K_ED_VAN_VENT_E1.INC_VOR_EINTRAG "Fault code VAN_VENT_E1 - debounce filter increment before fault-memory entry [verified]" VALUE 0x7133C RL_VAL_UB 0 CM_0000 0 255 /end CHARACTERISTIC
/begin CHARACTERISTIC K_ED_VAN_VENT_E1.KLASSENINDEX "Fault code VAN_VENT_E1 - fault class selection (lamp / warning behaviour) [verified]" VALUE 0x71340 RL_VAL_UB 0 CM_0000 0 255 /end CHARACTERISTIC
/begin CHARACTERISTIC K_ED_VAN_VENT_E1.OK_SCHWELLE "Fault code VAN_VENT_E1 - debounce filter threshold for clearing (healing) the fault [verified]" VALUE 0x7133B RL_VAL_UB 0 CM_0000 0 255 /end CHARACTERISTIC
/begin CHARACTERISTIC K_ED_VAN_VENT_E1.P_CODE_OPENLOAD "Fault code VAN_VENT_E1 - OBD P-code reported for open circuit [verified]" VALUE 0x71336 RL_VAL_UW 0 CM_0000 0 65535 /end CHARACTERISTIC
/begin CHARACTERISTIC K_ED_VAN_VENT_E1.P_CODE_SH_TO_GND "Fault code VAN_VENT_E1 - OBD P-code reported for short to ground [verified]" VALUE 0x71334 RL_VAL_UW 0 CM_0000 0 65535 /end CHARACTERISTIC
/begin CHARACTERISTIC K_ED_VAN_VENT_E1.P_CODE_SH_TO_UB "Fault code VAN_VENT_E1 - OBD P-code reported for short to battery voltage [verified]" VALUE 0x71332 RL_VAL_UW 0 CM_0000 0 65535 /end CHARACTERISTIC
/begin CHARACTERISTIC K_ED_VAN_VENT_E1.P_CODE_UNPLAUSIBEL "Fault code VAN_VENT_E1 - OBD P-code reported for implausible signal [verified]" VALUE 0x71338 RL_VAL_UW 0 CM_0000 0 65535 /end CHARACTERISTIC
/begin CHARACTERISTIC K_ED_VAN_VENT_E2.DEC_NACH_EINTRAG "Fault code VAN_VENT_E2 - debounce filter decrement after fault-memory entry [verified]" VALUE 0x71373 RL_VAL_UB 0 CM_0000 0 255 /end CHARACTERISTIC
/begin CHARACTERISTIC K_ED_VAN_VENT_E2.DEC_VOR_EINTRAG "Fault code VAN_VENT_E2 - debounce filter decrement before fault-memory entry [verified]" VALUE 0x71371 RL_VAL_UB 0 CM_0000 0 255 /end CHARACTERISTIC
/begin CHARACTERISTIC K_ED_VAN_VENT_E2.FEHLERSCHWELLE "Fault code VAN_VENT_E2 - debounce filter threshold for setting the fault [verified]" VALUE 0x7136E RL_VAL_UB 0 CM_0000 0 255 /end CHARACTERISTIC
/begin CHARACTERISTIC K_ED_VAN_VENT_E2.INC_NACH_EINTRAG "Fault code VAN_VENT_E2 - debounce filter increment after fault-memory entry [verified]" VALUE 0x71372 RL_VAL_UB 0 CM_0000 0 255 /end CHARACTERISTIC
/begin CHARACTERISTIC K_ED_VAN_VENT_E2.INC_VOR_EINTRAG "Fault code VAN_VENT_E2 - debounce filter increment before fault-memory entry [verified]" VALUE 0x71370 RL_VAL_UB 0 CM_0000 0 255 /end CHARACTERISTIC
/begin CHARACTERISTIC K_ED_VAN_VENT_E2.KLASSENINDEX "Fault code VAN_VENT_E2 - fault class selection (lamp / warning behaviour) [verified]" VALUE 0x71374 RL_VAL_UB 0 CM_0000 0 255 /end CHARACTERISTIC
/begin CHARACTERISTIC K_ED_VAN_VENT_E2.OK_SCHWELLE "Fault code VAN_VENT_E2 - debounce filter threshold for clearing (healing) the fault [verified]" VALUE 0x7136F RL_VAL_UB 0 CM_0000 0 255 /end CHARACTERISTIC
/begin CHARACTERISTIC K_ED_VAN_VENT_E2.P_CODE_OPENLOAD "Fault code VAN_VENT_E2 - OBD P-code reported for open circuit [verified]" VALUE 0x7136A RL_VAL_UW 0 CM_0000 0 65535 /end CHARACTERISTIC
/begin CHARACTERISTIC K_ED_VAN_VENT_E2.P_CODE_SH_TO_GND "Fault code VAN_VENT_E2 - OBD P-code reported for short to ground [verified]" VALUE 0x71368 RL_VAL_UW 0 CM_0000 0 65535 /end CHARACTERISTIC
/begin CHARACTERISTIC K_ED_VAN_VENT_E2.P_CODE_SH_TO_UB "Fault code VAN_VENT_E2 - OBD P-code reported for short to battery voltage [verified]" VALUE 0x71366 RL_VAL_UW 0 CM_0000 0 65535 /end CHARACTERISTIC
/begin CHARACTERISTIC K_ED_VAN_VENT_E2.P_CODE_UNPLAUSIBEL "Fault code VAN_VENT_E2 - OBD P-code reported for implausible signal [verified]" VALUE 0x7136C RL_VAL_UW 0 CM_0000 0 65535 /end CHARACTERISTIC
/begin CHARACTERISTIC K_ED_WUC_DELTA_TMOT__INJ_ "Minimum temperature rise for an OBD warm-up cycle [verified]" VALUE 0x72198 RL_VAL_SW 0 CM_0024 -3276.8 3276.7 /end CHARACTERISTIC
/begin CHARACTERISTIC K_ED_WUC_TMOT_MIN__INJ_ "Minimum temperature for an OBD warm-up cycle [verified]" VALUE 0x72196 RL_VAL_SW 0 CM_0006 -3550 3003.5 /end CHARACTERISTIC
/begin CHARACTERISTIC UNK_KL_03C28 "Minimum limit duration, cold start [unassigned]" CURVE 0x73C28 RL_CUR_SW_SW 0 CM_0025 -327.68 327.67 /begin AXIS_DESCR STD_AXIS NO_INPUT_QUANTITY CM_0006 6 -3550 3003.5 /end AXIS_DESCR /end CHARACTERISTIC
/begin CHARACTERISTIC UNK_KL_PKS_PLAU_INC_2 "Second 11-pt increment curve (plausibility), not in PSB 754 [unassigned]" CURVE 0x76D8E RL_CUR_SW_SW 0 CM_0142 -32.768 32.767 /begin AXIS_DESCR STD_AXIS NO_INPUT_QUANTITY CM_0142 11 -32.768 32.767 /end AXIS_DESCR /end CHARACTERISTIC
/begin CHARACTERISTIC UNK_KF_MISC_004BC "Unidentified map (chapter by calling function: unknown). Raw values. [unassigned]" MAP 0x704BC RL_MAP_SW_SW_SW 0 CM_0000 -32768 32767 /begin AXIS_DESCR STD_AXIS NO_INPUT_QUANTITY CM_0000 6 -32768 32767 /end AXIS_DESCR /begin AXIS_DESCR STD_AXIS NO_INPUT_QUANTITY CM_0000 6 -32768 32767 /end AXIS_DESCR /end CHARACTERISTIC
/begin CHARACTERISTIC UNK_KF_MISC_02932 "Unidentified map (chapter by calling function: unknown). Raw values. [unassigned]" MAP 0x72932 RL_MAP_SW_SW_SW 0 CM_0000 -32768 32767 /begin AXIS_DESCR STD_AXIS NO_INPUT_QUANTITY CM_0000 10 -32768 32767 /end AXIS_DESCR /begin AXIS_DESCR STD_AXIS NO_INPUT_QUANTITY CM_0000 10 -32768 32767 /end AXIS_DESCR /end CHARACTERISTIC
/begin CHARACTERISTIC UNK_KF_MISC_02A24 "Unidentified map (chapter by calling function: unknown). Raw values. [unassigned]" MAP 0x72A24 RL_MAP_SW_SW_SW 0 CM_0000 -32768 32767 /begin AXIS_DESCR STD_AXIS NO_INPUT_QUANTITY CM_0000 10 -32768 32767 /end AXIS_DESCR /begin AXIS_DESCR STD_AXIS NO_INPUT_QUANTITY CM_0000 10 -32768 32767 /end AXIS_DESCR /end CHARACTERISTIC
/begin CHARACTERISTIC UNK_KF_MISC_02B16 "Unidentified map (chapter by calling function: unknown). Raw values. [unassigned]" MAP 0x72B16 RL_MAP_SW_SW_SW 0 CM_0000 -32768 32767 /begin AXIS_DESCR STD_AXIS NO_INPUT_QUANTITY CM_0000 10 -32768 32767 /end AXIS_DESCR /begin AXIS_DESCR STD_AXIS NO_INPUT_QUANTITY CM_0000 10 -32768 32767 /end AXIS_DESCR /end CHARACTERISTIC
/begin CHARACTERISTIC UNK_KF_MISC_02C08 "Unidentified map (chapter by calling function: unknown). Raw values. [unassigned]" MAP 0x72C08 RL_MAP_SW_SW_SW 0 CM_0000 -32768 32767 /begin AXIS_DESCR STD_AXIS NO_INPUT_QUANTITY CM_0000 10 -32768 32767 /end AXIS_DESCR /begin AXIS_DESCR STD_AXIS NO_INPUT_QUANTITY CM_0000 10 -32768 32767 /end AXIS_DESCR /end CHARACTERISTIC
/begin CHARACTERISTIC UNK_KF_MISC_02CFA "Unidentified map (chapter by calling function: unknown). Raw values. [unassigned]" MAP 0x72CFA RL_MAP_SW_SW_SW 0 CM_0000 -32768 32767 /begin AXIS_DESCR STD_AXIS NO_INPUT_QUANTITY CM_0000 10 -32768 32767 /end AXIS_DESCR /begin AXIS_DESCR STD_AXIS NO_INPUT_QUANTITY CM_0000 10 -32768 32767 /end AXIS_DESCR /end CHARACTERISTIC
/begin CHARACTERISTIC UNK_KF_MISC_02DEC "Unidentified map (chapter by calling function: unknown). Raw values. [unassigned]" MAP 0x72DEC RL_MAP_SW_SW_SW 0 CM_0000 -32768 32767 /begin AXIS_DESCR STD_AXIS NO_INPUT_QUANTITY CM_0000 10 -32768 32767 /end AXIS_DESCR /begin AXIS_DESCR STD_AXIS NO_INPUT_QUANTITY CM_0000 10 -32768 32767 /end AXIS_DESCR /end CHARACTERISTIC
/begin CHARACTERISTIC UNK_KF_MISC_02EDE "Unidentified map (chapter by calling function: unknown). Raw values. [unassigned]" MAP 0x72EDE RL_MAP_SW_SW_SW 0 CM_0000 -32768 32767 /begin AXIS_DESCR STD_AXIS NO_INPUT_QUANTITY CM_0000 10 -32768 32767 /end AXIS_DESCR /begin AXIS_DESCR STD_AXIS NO_INPUT_QUANTITY CM_0000 10 -32768 32767 /end AXIS_DESCR /end CHARACTERISTIC
/begin CHARACTERISTIC UNK_KF_MISC_02FD0 "Unidentified map (chapter by calling function: unknown). Raw values. [unassigned]" MAP 0x72FD0 RL_MAP_SW_SW_SW 0 CM_0000 -32768 32767 /begin AXIS_DESCR STD_AXIS NO_INPUT_QUANTITY CM_0000 10 -32768 32767 /end AXIS_DESCR /begin AXIS_DESCR STD_AXIS NO_INPUT_QUANTITY CM_0000 10 -32768 32767 /end AXIS_DESCR /end CHARACTERISTIC
/begin CHARACTERISTIC UNK_KF_MISC_030C2 "Unidentified map (chapter by calling function: unknown). Raw values. [unassigned]" MAP 0x730C2 RL_MAP_SW_SW_SW 0 CM_0000 -32768 32767 /begin AXIS_DESCR STD_AXIS NO_INPUT_QUANTITY CM_0000 10 -32768 32767 /end AXIS_DESCR /begin AXIS_DESCR STD_AXIS NO_INPUT_QUANTITY CM_0000 10 -32768 32767 /end AXIS_DESCR /end CHARACTERISTIC
/begin CHARACTERISTIC UNK_KL_ANSAUGLU_03C0E "Unidentified curve (chapter by calling function: Ansauglufttemperatur). Raw values. [unassigned]" CURVE 0x73C0E RL_CUR_SW_SW 0 CM_0000 -32768 32767 /begin AXIS_DESCR STD_AXIS NO_INPUT_QUANTITY CM_0000 6 -32768 32767 /end AXIS_DESCR /end CHARACTERISTIC
/begin CHARACTERISTIC UNK_KL_MISC_0582A "Unidentified curve (chapter by calling function: unknown). Raw values. [unassigned]" CURVE 0x7582A RL_CUR_SW_SW 0 CM_0000 -32768 32767 /begin AXIS_DESCR STD_AXIS NO_INPUT_QUANTITY CM_0000 8 -32768 32767 /end AXIS_DESCR /end CHARACTERISTIC
/begin CHARACTERISTIC UNK_KF_AKTIVEPL_064BC "Unidentified map (chapter by calling function: Aktive Plausibilit?tsdiagnose der LSU 4.9 Sonde). Raw values. [unassigned]" MAP 0x764BC RL_MAP_SW_SW_SW 0 CM_0000 -32768 32767 /begin AXIS_DESCR STD_AXIS NO_INPUT_QUANTITY CM_0000 6 -32768 32767 /end AXIS_DESCR /begin AXIS_DESCR STD_AXIS NO_INPUT_QUANTITY CM_0000 5 -32768 32767 /end AXIS_DESCR /end CHARACTERISTIC
/begin CHARACTERISTIC UNK_KF_AKTIVEPL_06682 "Unidentified map (chapter by calling function: Aktive Plausibilit?tsdiagnose der LSU 4.9 Sonde). Raw values. [unassigned]" MAP 0x76682 RL_MAP_SW_SW_SW 0 CM_0000 -32768 32767 /begin AXIS_DESCR STD_AXIS NO_INPUT_QUANTITY CM_0000 6 -32768 32767 /end AXIS_DESCR /begin AXIS_DESCR STD_AXIS NO_INPUT_QUANTITY CM_0000 5 -32768 32767 /end AXIS_DESCR /end CHARACTERISTIC
/begin CHARACTERISTIC UNK_KF_SEKUNDRL_087BE "Unidentified map (chapter by calling function: Sekund?rlufteinblasung). Raw values. [unassigned]" MAP 0x787BE RL_MAP_SW_SW_SW 0 CM_0000 -32768 32767 /begin AXIS_DESCR STD_AXIS NO_INPUT_QUANTITY CM_0000 8 -32768 32767 /end AXIS_DESCR /begin AXIS_DESCR STD_AXIS NO_INPUT_QUANTITY CM_0000 6 -32768 32767 /end AXIS_DESCR /end CHARACTERISTIC
/begin CHARACTERISTIC UNK_KL_MISC_0892E "Unidentified curve (chapter by calling function: unknown). Raw values. [unassigned]" CURVE 0x7892E RL_CUR_SW_SW 0 CM_0000 -32768 32767 /begin AXIS_DESCR STD_AXIS NO_INPUT_QUANTITY CM_0000 4 -32768 32767 /end AXIS_DESCR /end CHARACTERISTIC
/begin CHARACTERISTIC UNK_KF_MISC_08940 "Unidentified map (chapter by calling function: unknown). Raw values. [unassigned]" MAP 0x78940 RL_MAP_SW_SW_SW 0 CM_0000 -32768 32767 /begin AXIS_DESCR STD_AXIS NO_INPUT_QUANTITY CM_0000 5 -32768 32767 /end AXIS_DESCR /begin AXIS_DESCR STD_AXIS NO_INPUT_QUANTITY CM_0000 8 -32768 32767 /end AXIS_DESCR /end CHARACTERISTIC
/begin CHARACTERISTIC UNK_KF_MISC_089AC "Unidentified map (chapter by calling function: unknown). Raw values. [unassigned]" MAP 0x789AC RL_MAP_SW_SW_SW 0 CM_0000 -32768 32767 /begin AXIS_DESCR STD_AXIS NO_INPUT_QUANTITY CM_0000 16 -32768 32767 /end AXIS_DESCR /begin AXIS_DESCR STD_AXIS NO_INPUT_QUANTITY CM_0000 3 -32768 32767 /end AXIS_DESCR /end CHARACTERISTIC
/begin CHARACTERISTIC UNK_KL_VANOS_0A514 "Unidentified curve (chapter by calling function: Vanos). Raw values. [unassigned]" CURVE 0x7A514 RL_CUR_SW_SW 0 CM_0000 -32768 32767 /begin AXIS_DESCR STD_AXIS NO_INPUT_QUANTITY CM_0000 6 -32768 32767 /end AXIS_DESCR /end CHARACTERISTIC
/begin CHARACTERISTIC UNK_KL_MISC_0B646 "Unidentified curve (chapter by calling function: unknown). Raw values. [unassigned]" CURVE 0x7B646 RL_CUR_SW_SW 0 CM_0000 -32768 32767 /begin AXIS_DESCR STD_AXIS NO_INPUT_QUANTITY CM_0000 4 -32768 32767 /end AXIS_DESCR /end CHARACTERISTIC
/begin CHARACTERISTIC UNK_KL_MISC_0059E "Unidentified curve (chapter by calling function: unknown). Raw values. [unassigned]" CURVE 0x7059E RL_CUR_SW_UB 0 CM_0000 0 255 /begin AXIS_DESCR STD_AXIS NO_INPUT_QUANTITY CM_0000 6 -32768 32767 /end AXIS_DESCR /end CHARACTERISTIC
/begin CHARACTERISTIC UNK_KL_MISC_005B8 "Unidentified curve (chapter by calling function: unknown). Raw values. [unassigned]" CURVE 0x705B8 RL_CUR_SW_UB 0 CM_0000 0 255 /begin AXIS_DESCR STD_AXIS NO_INPUT_QUANTITY CM_0000 12 -32768 32767 /end AXIS_DESCR /end CHARACTERISTIC
/begin CHARACTERISTIC UNK_KL_MISC_005F2 "Unidentified curve (chapter by calling function: unknown). Raw values. [unassigned]" CURVE 0x705F2 RL_CUR_SW_UW 0 CM_0000 0 65535 /begin AXIS_DESCR STD_AXIS NO_INPUT_QUANTITY CM_0000 6 -32768 32767 /end AXIS_DESCR /end CHARACTERISTIC
/begin CHARACTERISTIC UNK_KF_MISC_0062E "Unidentified map (chapter by calling function: unknown). Raw values. [unassigned]" MAP 0x7062E RL_MAP_SW_SW_UW 0 CM_0000 0 65535 /begin AXIS_DESCR STD_AXIS NO_INPUT_QUANTITY CM_0000 12 -32768 32767 /end AXIS_DESCR /begin AXIS_DESCR STD_AXIS NO_INPUT_QUANTITY CM_0000 12 -32768 32767 /end AXIS_DESCR /end CHARACTERISTIC
/begin CHARACTERISTIC UNK_KF_MISC_00780 "Unidentified map (chapter by calling function: unknown). Raw values. [unassigned]" MAP 0x70780 RL_MAP_SW_SW_UW 0 CM_0000 0 65535 /begin AXIS_DESCR STD_AXIS NO_INPUT_QUANTITY CM_0000 12 -32768 32767 /end AXIS_DESCR /begin AXIS_DESCR STD_AXIS NO_INPUT_QUANTITY CM_0000 12 -32768 32767 /end AXIS_DESCR /end CHARACTERISTIC
/begin CHARACTERISTIC UNK_KL_MISC_02208 "Unidentified curve (chapter by calling function: unknown). Raw values. [unassigned]" CURVE 0x72208 RL_CUR_SW_UB 0 CM_0000 0 255 /begin AXIS_DESCR STD_AXIS NO_INPUT_QUANTITY CM_0000 4 -32768 32767 /end AXIS_DESCR /end CHARACTERISTIC
/begin CHARACTERISTIC UNK_KL_MISC_02216 "Unidentified curve (chapter by calling function: unknown). Raw values. [unassigned]" CURVE 0x72216 RL_CUR_SW_UB 0 CM_0000 0 255 /begin AXIS_DESCR STD_AXIS NO_INPUT_QUANTITY CM_0000 4 -32768 32767 /end AXIS_DESCR /end CHARACTERISTIC
/begin CHARACTERISTIC UNK_KL_MISC_02224 "Unidentified curve (chapter by calling function: unknown). Raw values. [unassigned]" CURVE 0x72224 RL_CUR_SW_UB 0 CM_0000 0 255 /begin AXIS_DESCR STD_AXIS NO_INPUT_QUANTITY CM_0000 4 -32768 32767 /end AXIS_DESCR /end CHARACTERISTIC
/begin CHARACTERISTIC UNK_KL_MISC_0290A "Unidentified curve (chapter by calling function: unknown). Raw values. [unassigned]" CURVE 0x7290A RL_CUR_SW_UB 0 CM_0000 0 255 /begin AXIS_DESCR STD_AXIS NO_INPUT_QUANTITY CM_0000 3 -32768 32767 /end AXIS_DESCR /end CHARACTERISTIC
/begin CHARACTERISTIC UNK_KF_MISC_031B4 "Unidentified map (chapter by calling function: unknown). Raw values. [unassigned]" MAP 0x731B4 RL_MAP_SW_SW_SW 0 CM_0000 -32768 32767 /begin AXIS_DESCR STD_AXIS NO_INPUT_QUANTITY CM_0000 10 -32768 32767 /end AXIS_DESCR /begin AXIS_DESCR STD_AXIS NO_INPUT_QUANTITY CM_0000 10 -32768 32767 /end AXIS_DESCR /end CHARACTERISTIC
/begin CHARACTERISTIC UNK_KF_MISC_032A6 "Unidentified map (chapter by calling function: unknown). Raw values. [unassigned]" MAP 0x732A6 RL_MAP_SW_SW_SW 0 CM_0000 -32768 32767 /begin AXIS_DESCR STD_AXIS NO_INPUT_QUANTITY CM_0000 10 -32768 32767 /end AXIS_DESCR /begin AXIS_DESCR STD_AXIS NO_INPUT_QUANTITY CM_0000 10 -32768 32767 /end AXIS_DESCR /end CHARACTERISTIC
/begin CHARACTERISTIC UNK_KF_MISC_03398 "Unidentified map (chapter by calling function: unknown). Raw values. [unassigned]" MAP 0x73398 RL_MAP_SW_SW_SW 0 CM_0000 -32768 32767 /begin AXIS_DESCR STD_AXIS NO_INPUT_QUANTITY CM_0000 10 -32768 32767 /end AXIS_DESCR /begin AXIS_DESCR STD_AXIS NO_INPUT_QUANTITY CM_0000 10 -32768 32767 /end AXIS_DESCR /end CHARACTERISTIC
/begin CHARACTERISTIC UNK_KF_MISC_0348A "Unidentified map (chapter by calling function: unknown). Raw values. [unassigned]" MAP 0x7348A RL_MAP_SW_SW_SW 0 CM_0000 -32768 32767 /begin AXIS_DESCR STD_AXIS NO_INPUT_QUANTITY CM_0000 10 -32768 32767 /end AXIS_DESCR /begin AXIS_DESCR STD_AXIS NO_INPUT_QUANTITY CM_0000 10 -32768 32767 /end AXIS_DESCR /end CHARACTERISTIC
/begin CHARACTERISTIC UNK_KF_MISC_0357C "Unidentified map (chapter by calling function: unknown). Raw values. [unassigned]" MAP 0x7357C RL_MAP_SW_SW_SW 0 CM_0000 -32768 32767 /begin AXIS_DESCR STD_AXIS NO_INPUT_QUANTITY CM_0000 10 -32768 32767 /end AXIS_DESCR /begin AXIS_DESCR STD_AXIS NO_INPUT_QUANTITY CM_0000 10 -32768 32767 /end AXIS_DESCR /end CHARACTERISTIC
/begin CHARACTERISTIC UNK_KF_MISC_0366E "Unidentified map (chapter by calling function: unknown). Raw values. [unassigned]" MAP 0x7366E RL_MAP_SW_SW_SW 0 CM_0000 -32768 32767 /begin AXIS_DESCR STD_AXIS NO_INPUT_QUANTITY CM_0000 10 -32768 32767 /end AXIS_DESCR /begin AXIS_DESCR STD_AXIS NO_INPUT_QUANTITY CM_0000 10 -32768 32767 /end AXIS_DESCR /end CHARACTERISTIC
/begin CHARACTERISTIC UNK_KF_MISC_03760 "Unidentified map (chapter by calling function: unknown). Raw values. [unassigned]" MAP 0x73760 RL_MAP_SW_SW_SW 0 CM_0000 -32768 32767 /begin AXIS_DESCR STD_AXIS NO_INPUT_QUANTITY CM_0000 10 -32768 32767 /end AXIS_DESCR /begin AXIS_DESCR STD_AXIS NO_INPUT_QUANTITY CM_0000 10 -32768 32767 /end AXIS_DESCR /end CHARACTERISTIC
/begin CHARACTERISTIC UNK_KF_MISC_03852 "Unidentified map (chapter by calling function: unknown). Raw values. [unassigned]" MAP 0x73852 RL_MAP_SW_SW_SW 0 CM_0000 -32768 32767 /begin AXIS_DESCR STD_AXIS NO_INPUT_QUANTITY CM_0000 10 -32768 32767 /end AXIS_DESCR /begin AXIS_DESCR STD_AXIS NO_INPUT_QUANTITY CM_0000 10 -32768 32767 /end AXIS_DESCR /end CHARACTERISTIC
/begin CHARACTERISTIC UNK_KF_MISC_03944 "Unidentified map (chapter by calling function: unknown). Raw values. [unassigned]" MAP 0x73944 RL_MAP_SW_SW_SW 0 CM_0000 -32768 32767 /begin AXIS_DESCR STD_AXIS NO_INPUT_QUANTITY CM_0000 10 -32768 32767 /end AXIS_DESCR /begin AXIS_DESCR STD_AXIS NO_INPUT_QUANTITY CM_0000 10 -32768 32767 /end AXIS_DESCR /end CHARACTERISTIC
/begin CHARACTERISTIC UNK_KL_MISC_03E1E "Unidentified curve (chapter by calling function: unknown). Raw values. [unassigned]" CURVE 0x73E1E RL_CUR_SW_SW 0 CM_0000 -32768 32767 /begin AXIS_DESCR STD_AXIS NO_INPUT_QUANTITY CM_0000 4 -32768 32767 /end AXIS_DESCR /end CHARACTERISTIC
/begin CHARACTERISTIC UNK_KL_MISC_03E30 "Unidentified curve (chapter by calling function: unknown). Raw values. [unassigned]" CURVE 0x73E30 RL_CUR_SW_SW 0 CM_0000 -32768 32767 /begin AXIS_DESCR STD_AXIS NO_INPUT_QUANTITY CM_0000 4 -32768 32767 /end AXIS_DESCR /end CHARACTERISTIC
/begin CHARACTERISTIC UNK_KL_MISC_03E42 "Unidentified curve (chapter by calling function: unknown). Raw values. [unassigned]" CURVE 0x73E42 RL_CUR_SW_UB 0 CM_0000 0 255 /begin AXIS_DESCR STD_AXIS NO_INPUT_QUANTITY CM_0000 4 -32768 32767 /end AXIS_DESCR /end CHARACTERISTIC
/begin CHARACTERISTIC UNK_KL_MISC_03E5E "Unidentified curve (chapter by calling function: unknown). Raw values. [unassigned]" CURVE 0x73E5E RL_CUR_SW_UB 0 CM_0000 0 255 /begin AXIS_DESCR STD_AXIS NO_INPUT_QUANTITY CM_0000 4 -32768 32767 /end AXIS_DESCR /end CHARACTERISTIC
/begin CHARACTERISTIC UNK_KL_MISC_03E7E "Unidentified curve (chapter by calling function: unknown). Raw values. [unassigned]" CURVE 0x73E7E RL_CUR_SW_SW 0 CM_0000 -32768 32767 /begin AXIS_DESCR STD_AXIS NO_INPUT_QUANTITY CM_0000 4 -32768 32767 /end AXIS_DESCR /end CHARACTERISTIC
/begin CHARACTERISTIC UNK_KL_MISC_03E90 "Unidentified curve (chapter by calling function: unknown). Raw values. [unassigned]" CURVE 0x73E90 RL_CUR_SW_SW 0 CM_0000 -32768 32767 /begin AXIS_DESCR STD_AXIS NO_INPUT_QUANTITY CM_0000 4 -32768 32767 /end AXIS_DESCR /end CHARACTERISTIC
/begin CHARACTERISTIC UNK_KL_MISC_03EBC "Unidentified curve (chapter by calling function: unknown). Raw values. [unassigned]" CURVE 0x73EBC RL_CUR_SW_SW 0 CM_0000 -32768 32767 /begin AXIS_DESCR STD_AXIS NO_INPUT_QUANTITY CM_0000 6 -32768 32767 /end AXIS_DESCR /end CHARACTERISTIC
/begin CHARACTERISTIC UNK_KF_MISC_03ED6 "Unidentified map (chapter by calling function: unknown). Raw values. [unassigned]" MAP 0x73ED6 RL_MAP_SW_SW_SW 0 CM_0000 -32768 32767 /begin AXIS_DESCR STD_AXIS NO_INPUT_QUANTITY CM_0000 4 -32768 32767 /end AXIS_DESCR /begin AXIS_DESCR STD_AXIS NO_INPUT_QUANTITY CM_0000 4 -32768 32767 /end AXIS_DESCR /end CHARACTERISTIC
/begin CHARACTERISTIC UNK_KF_MISC_03F08 "Unidentified map (chapter by calling function: unknown). Raw values. [unassigned]" MAP 0x73F08 RL_MAP_SW_SW_SW 0 CM_0000 -32768 32767 /begin AXIS_DESCR STD_AXIS NO_INPUT_QUANTITY CM_0000 4 -32768 32767 /end AXIS_DESCR /begin AXIS_DESCR STD_AXIS NO_INPUT_QUANTITY CM_0000 4 -32768 32767 /end AXIS_DESCR /end CHARACTERISTIC
/begin CHARACTERISTIC UNK_KF_MISC_03F6C "Unidentified map (chapter by calling function: unknown). Raw values. [unassigned]" MAP 0x73F6C RL_MAP_SW_SW_SW 0 CM_0000 -32768 32767 /begin AXIS_DESCR STD_AXIS NO_INPUT_QUANTITY CM_0000 4 -32768 32767 /end AXIS_DESCR /begin AXIS_DESCR STD_AXIS NO_INPUT_QUANTITY CM_0000 4 -32768 32767 /end AXIS_DESCR /end CHARACTERISTIC
/begin CHARACTERISTIC UNK_KF_MISC_03F9E "Unidentified map (chapter by calling function: unknown). Raw values. [unassigned]" MAP 0x73F9E RL_MAP_SW_SW_SW 0 CM_0000 -32768 32767 /begin AXIS_DESCR STD_AXIS NO_INPUT_QUANTITY CM_0000 6 -32768 32767 /end AXIS_DESCR /begin AXIS_DESCR STD_AXIS NO_INPUT_QUANTITY CM_0000 6 -32768 32767 /end AXIS_DESCR /end CHARACTERISTIC
/begin CHARACTERISTIC UNK_KF_MISC_04060 "Unidentified map (chapter by calling function: unknown). Raw values. [unassigned]" MAP 0x74060 RL_MAP_SW_SW_SW 0 CM_0000 -32768 32767 /begin AXIS_DESCR STD_AXIS NO_INPUT_QUANTITY CM_0000 6 -32768 32767 /end AXIS_DESCR /begin AXIS_DESCR STD_AXIS NO_INPUT_QUANTITY CM_0000 6 -32768 32767 /end AXIS_DESCR /end CHARACTERISTIC
/begin CHARACTERISTIC UNK_KL_KATALYSA_0414C "Unidentified curve (chapter by calling function: Katalysatorschutz). Raw values. [unassigned]" CURVE 0x7414C RL_CUR_SW_SW 0 CM_0000 -32768 32767 /begin AXIS_DESCR STD_AXIS NO_INPUT_QUANTITY CM_0000 4 -32768 32767 /end AXIS_DESCR /end CHARACTERISTIC
/begin CHARACTERISTIC UNK_KL_KATALYSA_0415E "Unidentified curve (chapter by calling function: Katalysatorschutz). Raw values. [unassigned]" CURVE 0x7415E RL_CUR_SW_SW 0 CM_0000 -32768 32767 /begin AXIS_DESCR STD_AXIS NO_INPUT_QUANTITY CM_0000 4 -32768 32767 /end AXIS_DESCR /end CHARACTERISTIC
/begin CHARACTERISTIC UNK_KL_MISC_0580A "Unidentified curve (chapter by calling function: unknown). Raw values. [unassigned]" CURVE 0x7580A RL_CUR_SW_UW 0 CM_0000 0 65535 /begin AXIS_DESCR STD_AXIS NO_INPUT_QUANTITY CM_0000 3 -32768 32767 /end AXIS_DESCR /end CHARACTERISTIC
/begin CHARACTERISTIC UNK_KL_MISC_05818 "Unidentified curve (chapter by calling function: unknown). Raw values. [unassigned]" CURVE 0x75818 RL_CUR_SW_SW 0 CM_0000 -32768 32767 /begin AXIS_DESCR STD_AXIS NO_INPUT_QUANTITY CM_0000 4 -32768 32767 /end AXIS_DESCR /end CHARACTERISTIC
/begin CHARACTERISTIC UNK_KF_MISC_065E0 "Unidentified map (chapter by calling function: unknown). Raw values. [unassigned]" MAP 0x765E0 RL_MAP_SW_SW_UW 0 CM_0000 0 65535 /begin AXIS_DESCR STD_AXIS NO_INPUT_QUANTITY CM_0000 8 -32768 32767 /end AXIS_DESCR /begin AXIS_DESCR STD_AXIS NO_INPUT_QUANTITY CM_0000 8 -32768 32767 /end AXIS_DESCR /end CHARACTERISTIC
/begin CHARACTERISTIC UNK_KL_KATALYSA_072C8 "Unidentified curve (chapter by calling function: Katalysatorschutz). Raw values. [unassigned]" CURVE 0x772C8 RL_CUR_SW_UB 0 CM_0000 0 255 /begin AXIS_DESCR STD_AXIS NO_INPUT_QUANTITY CM_0000 6 -32768 32767 /end AXIS_DESCR /end CHARACTERISTIC
/begin CHARACTERISTIC UNK_KL_KATALYSA_072EA "Unidentified curve (chapter by calling function: Katalysatorschutz). Raw values. [unassigned]" CURVE 0x772EA RL_CUR_SW_UB 0 CM_0000 0 255 /begin AXIS_DESCR STD_AXIS NO_INPUT_QUANTITY CM_0000 6 -32768 32767 /end AXIS_DESCR /end CHARACTERISTIC
/begin CHARACTERISTIC UNK_KL_KATALYSA_073D6 "Unidentified curve (chapter by calling function: Katalysatorschutz). Raw values. [unassigned]" CURVE 0x773D6 RL_CUR_SW_UB 0 CM_0000 0 255 /begin AXIS_DESCR STD_AXIS NO_INPUT_QUANTITY CM_0000 4 -32768 32767 /end AXIS_DESCR /end CHARACTERISTIC
/begin CHARACTERISTIC UNK_KL_KATALYSA_073E4 "Unidentified curve (chapter by calling function: Katalysatorschutz). Raw values. [unassigned]" CURVE 0x773E4 RL_CUR_SW_UB 0 CM_0000 0 255 /begin AXIS_DESCR STD_AXIS NO_INPUT_QUANTITY CM_0000 4 -32768 32767 /end AXIS_DESCR /end CHARACTERISTIC
/begin CHARACTERISTIC UNK_KL_MISC_07610 "Unidentified curve (chapter by calling function: unknown). Raw values. [unassigned]" CURVE 0x77610 RL_CUR_SW_UW 0 CM_0000 0 65535 /begin AXIS_DESCR STD_AXIS NO_INPUT_QUANTITY CM_0000 7 -32768 32767 /end AXIS_DESCR /end CHARACTERISTIC
/begin CHARACTERISTIC UNK_KL_POWERMAN_07728 "Unidentified curve (chapter by calling function: Powermanagement). Raw values. [unassigned]" CURVE 0x77728 RL_CUR_SW_UB 0 CM_0000 0 255 /begin AXIS_DESCR STD_AXIS NO_INPUT_QUANTITY CM_0000 5 -32768 32767 /end AXIS_DESCR /end CHARACTERISTIC
/begin CHARACTERISTIC UNK_KL_POWERMAN_079BC "Unidentified curve (chapter by calling function: Powermanagement). Raw values. [unassigned]" CURVE 0x779BC RL_CUR_SW_SW 0 CM_0000 -32768 32767 /begin AXIS_DESCR STD_AXIS NO_INPUT_QUANTITY CM_0000 4 -32768 32767 /end AXIS_DESCR /end CHARACTERISTIC
/begin CHARACTERISTIC UNK_KL_MISC_07A8A "Unidentified curve (chapter by calling function: unknown). Raw values. [unassigned]" CURVE 0x77A8A RL_CUR_SW_UB 0 CM_0000 0 255 /begin AXIS_DESCR STD_AXIS NO_INPUT_QUANTITY CM_0000 6 -32768 32767 /end AXIS_DESCR /end CHARACTERISTIC
/begin CHARACTERISTIC UNK_KL_POWERMAN_07FD0 "Unidentified curve (chapter by calling function: Powermanagement). Raw values. [unassigned]" CURVE 0x77FD0 RL_CUR_SW_UB 0 CM_0000 0 255 /begin AXIS_DESCR STD_AXIS NO_INPUT_QUANTITY CM_0000 5 -32768 32767 /end AXIS_DESCR /end CHARACTERISTIC
/begin CHARACTERISTIC UNK_KL_POWERMAN_07FEC "Unidentified curve (chapter by calling function: Powermanagement). Raw values. [unassigned]" CURVE 0x77FEC RL_CUR_SW_UB 0 CM_0000 0 255 /begin AXIS_DESCR STD_AXIS NO_INPUT_QUANTITY CM_0000 4 -32768 32767 /end AXIS_DESCR /end CHARACTERISTIC
/begin CHARACTERISTIC UNK_KL_POWERMAN_0800E "Unidentified curve (chapter by calling function: Powermanagement). Raw values. [unassigned]" CURVE 0x7800E RL_CUR_SW_UB 0 CM_0000 0 255 /begin AXIS_DESCR STD_AXIS NO_INPUT_QUANTITY CM_0000 6 -32768 32767 /end AXIS_DESCR /end CHARACTERISTIC
/begin CHARACTERISTIC UNK_KF_ANSAUGLU_08874 "Unidentified map (chapter by calling function: Ansauglufttemperatur). Raw values. [unassigned]" MAP 0x78874 RL_MAP_SW_SW_UW 0 CM_0000 0 65535 /begin AXIS_DESCR STD_AXIS NO_INPUT_QUANTITY CM_0000 8 -32768 32767 /end AXIS_DESCR /begin AXIS_DESCR STD_AXIS NO_INPUT_QUANTITY CM_0000 4 -32768 32767 /end AXIS_DESCR /end CHARACTERISTIC
/begin CHARACTERISTIC UNK_KL_MISC_08D34 "Unidentified curve (chapter by calling function: unknown). Raw values. [unassigned]" CURVE 0x78D34 RL_CUR_SW_UW 0 CM_0000 0 65535 /begin AXIS_DESCR STD_AXIS NO_INPUT_QUANTITY CM_0000 3 -32768 32767 /end AXIS_DESCR /end CHARACTERISTIC
/begin CHARACTERISTIC UNK_KL_MISC_08D42 "Unidentified curve (chapter by calling function: unknown). Raw values. [unassigned]" CURVE 0x78D42 RL_CUR_SW_UW 0 CM_0000 0 65535 /begin AXIS_DESCR STD_AXIS NO_INPUT_QUANTITY CM_0000 5 -32768 32767 /end AXIS_DESCR /end CHARACTERISTIC
/begin CHARACTERISTIC K_ED_CSS_TIME "Zeit fuer CSS-Denominator [A2L-ref]" VALUE 0x72186 RL_VAL_UW 0 CM_0023 0 6553.5 /end CHARACTERISTIC
/begin CHARACTERISTIC K_ED_INDEX_207_INJ.P_CODE_OPENLOAD "P-Code fuer die Art OPENLOAD [A2L-ref]" VALUE 0x72004 RL_VAL_UW 0 CM_0000 0 65535 /end CHARACTERISTIC
/begin CHARACTERISTIC K_ED_INDEX_207_INJ.P_CODE_SH_TO_GND "P-Code fuer die Art SH_TO_GND [A2L-ref]" VALUE 0x72002 RL_VAL_UW 0 CM_0000 0 65535 /end CHARACTERISTIC
/begin CHARACTERISTIC K_ED_INDEX_207_INJ.P_CODE_SH_TO_UB "P-Code fuer die Art SH_TO_UB [A2L-ref]" VALUE 0x72000 RL_VAL_UW 0 CM_0000 0 65535 /end CHARACTERISTIC
/begin CHARACTERISTIC K_ED_INDEX_208_INJ.P_CODE_OPENLOAD "P-Code fuer die Art OPENLOAD [A2L-ref]" VALUE 0x7201E RL_VAL_UW 0 CM_0000 0 65535 /end CHARACTERISTIC
/begin CHARACTERISTIC K_ED_INDEX_208_INJ.P_CODE_SH_TO_GND "P-Code fuer die Art SH_TO_GND [A2L-ref]" VALUE 0x7201C RL_VAL_UW 0 CM_0000 0 65535 /end CHARACTERISTIC
/begin CHARACTERISTIC K_ED_INDEX_208_INJ.P_CODE_SH_TO_UB "P-Code fuer die Art SH_TO_UB [A2L-ref]" VALUE 0x7201A RL_VAL_UW 0 CM_0000 0 65535 /end CHARACTERISTIC
/begin CHARACTERISTIC K_ED_INDEX_211_INJ.DEC_NACH_EINTRAG "Filterverringerung nach Fehlerspeichereintrag [A2L-ref]" VALUE 0x7203F RL_VAL_UB 0 CM_0000 0 255 /end CHARACTERISTIC
/begin CHARACTERISTIC K_ED_INDEX_211_INJ.DEC_VOR_EINTRAG "Filterverringerung vorm Fehlerspeichereintrag [A2L-ref]" VALUE 0x7203D RL_VAL_UB 0 CM_0000 0 255 /end CHARACTERISTIC
/begin CHARACTERISTIC K_ED_INDEX_211_INJ.FEHLERSCHWELLE "Filterschwelle fuer Fehlereintrag [A2L-ref]" VALUE 0x7203A RL_VAL_UB 0 CM_0000 0 255 /end CHARACTERISTIC
/begin CHARACTERISTIC K_ED_INDEX_211_INJ.INC_NACH_EINTRAG "Filtererhoehung nach Fehlerspeichereintrag [A2L-ref]" VALUE 0x7203E RL_VAL_UB 0 CM_0000 0 255 /end CHARACTERISTIC
/begin CHARACTERISTIC K_ED_INDEX_211_INJ.INC_VOR_EINTRAG "Filtererhoehung vorm Fehlerspeichereintrag [A2L-ref]" VALUE 0x7203C RL_VAL_UB 0 CM_0000 0 255 /end CHARACTERISTIC
/begin CHARACTERISTIC K_ED_INDEX_211_INJ.OK_SCHWELLE "Filterschwelle fuer Fehleraustrag [A2L-ref]" VALUE 0x7203B RL_VAL_UB 0 CM_0000 0 255 /end CHARACTERISTIC
/begin CHARACTERISTIC K_ED_INDEX_211_INJ.P_CODE_SH_TO_GND "P-Code fuer die Art SH_TO_GND [A2L-ref]" VALUE 0x72034 RL_VAL_UW 0 CM_0000 0 65535 /end CHARACTERISTIC
/begin CHARACTERISTIC K_ED_INDEX_211_INJ.P_CODE_SH_TO_UB "P-Code fuer die Art SH_TO_UB [A2L-ref]" VALUE 0x72032 RL_VAL_UW 0 CM_0000 0 65535 /end CHARACTERISTIC
/begin CHARACTERISTIC K_ED_INDEX_212_INJ.FEHLERSCHWELLE "Filterschwelle fuer Fehlereintrag [A2L-ref]" VALUE 0x72088 RL_VAL_UB 0 CM_0000 0 255 /end CHARACTERISTIC
/begin CHARACTERISTIC K_ED_INDEX_212_INJ.INC_VOR_EINTRAG "Filtererhoehung vorm Fehlerspeichereintrag [A2L-ref]" VALUE 0x72056 RL_VAL_UB 0 CM_0000 0 255 /end CHARACTERISTIC
/begin CHARACTERISTIC K_ED_INDEX_212_INJ.OK_SCHWELLE "Filterschwelle fuer Fehleraustrag [A2L-ref]" VALUE 0x72089 RL_VAL_UB 0 CM_0000 0 255 /end CHARACTERISTIC
/begin CHARACTERISTIC K_ED_INDEX_212_INJ.P_CODE_OPENLOAD "P-Code fuer die Art OPENLOAD [A2L-ref]" VALUE 0x72050 RL_VAL_UW 0 CM_0000 0 65535 /end CHARACTERISTIC
/begin CHARACTERISTIC K_ED_INDEX_212_INJ.P_CODE_SH_TO_GND "P-Code fuer die Art SH_TO_GND [A2L-ref]" VALUE 0x7204E RL_VAL_UW 0 CM_0000 0 65535 /end CHARACTERISTIC
/begin CHARACTERISTIC K_ED_INDEX_212_INJ.P_CODE_SH_TO_UB "P-Code fuer die Art SH_TO_UB [A2L-ref]" VALUE 0x7204C RL_VAL_UW 0 CM_0000 0 65535 /end CHARACTERISTIC
/begin CHARACTERISTIC K_ED_INDEX_212_INJ.P_CODE_UNPLAUSIBEL "P-Code fuer die Art UNPLAUSIBEL [A2L-ref]" VALUE 0x72086 RL_VAL_UW 0 CM_0000 0 65535 /end CHARACTERISTIC
/begin CHARACTERISTIC K_ED_INDEX_215_INJ.P_CODE_SH_TO_GND "P-Code fuer die Art SH_TO_GND [A2L-ref]" VALUE 0x7209C RL_VAL_UW 0 CM_0000 0 65535 /end CHARACTERISTIC
/begin CHARACTERISTIC K_ED_INDEX_215_INJ.P_CODE_SH_TO_UB "P-Code fuer die Art SH_TO_UB [A2L-ref]" VALUE 0x7209A RL_VAL_UW 0 CM_0000 0 65535 /end CHARACTERISTIC
/begin CHARACTERISTIC K_ED_INDEX_216_INJ.KLASSENINDEX "Auswahl der Fehlerklasse [A2L-ref]" VALUE 0x720C2 RL_VAL_UB 0 CM_0000 0 255 /end CHARACTERISTIC
/begin CHARACTERISTIC K_ED_INDEX_216_INJ.P_CODE_OPENLOAD "P-Code fuer die Art OPENLOAD [A2L-ref]" VALUE 0x720B8 RL_VAL_UW 0 CM_0000 0 65535 /end CHARACTERISTIC
/begin CHARACTERISTIC K_ED_INDEX_216_INJ.P_CODE_SH_TO_GND "P-Code fuer die Art SH_TO_GND [A2L-ref]" VALUE 0x720B6 RL_VAL_UW 0 CM_0000 0 65535 /end CHARACTERISTIC
/begin CHARACTERISTIC K_ED_INDEX_216_INJ.P_CODE_SH_TO_UB "P-Code fuer die Art SH_TO_UB [A2L-ref]" VALUE 0x720B4 RL_VAL_UW 0 CM_0000 0 65535 /end CHARACTERISTIC
/begin CHARACTERISTIC K_ED_INDEX_216_INJ.P_CODE_UNPLAUSIBEL "P-Code fuer die Art UNPLAUSIBEL [A2L-ref]" VALUE 0x720BA RL_VAL_UW 0 CM_0000 0 65535 /end CHARACTERISTIC
/begin CHARACTERISTIC K_ED_INDEX_217_INJ.KLASSENINDEX "Auswahl der Fehlerklasse [A2L-ref]" VALUE 0x720DC RL_VAL_UB 0 CM_0000 0 255 /end CHARACTERISTIC
/begin CHARACTERISTIC K_ED_INDEX_217_INJ.P_CODE_OPENLOAD "P-Code fuer die Art OPENLOAD [A2L-ref]" VALUE 0x720D2 RL_VAL_UW 0 CM_0000 0 65535 /end CHARACTERISTIC
/begin CHARACTERISTIC K_ED_INDEX_217_INJ.P_CODE_SH_TO_GND "P-Code fuer die Art SH_TO_GND [A2L-ref]" VALUE 0x720D0 RL_VAL_UW 0 CM_0000 0 65535 /end CHARACTERISTIC
/begin CHARACTERISTIC K_ED_INDEX_217_INJ.P_CODE_SH_TO_UB "P-Code fuer die Art SH_TO_UB [A2L-ref]" VALUE 0x720CE RL_VAL_UW 0 CM_0000 0 65535 /end CHARACTERISTIC
/begin CHARACTERISTIC K_ED_INDEX_217_INJ.P_CODE_UNPLAUSIBEL "P-Code fuer die Art UNPLAUSIBEL [A2L-ref]" VALUE 0x720D4 RL_VAL_UW 0 CM_0000 0 65535 /end CHARACTERISTIC
/begin CHARACTERISTIC K_ED_INDEX_218_INJ.KLASSENINDEX "Auswahl der Fehlerklasse [A2L-ref]" VALUE 0x720F6 RL_VAL_UB 0 CM_0000 0 255 /end CHARACTERISTIC
/begin CHARACTERISTIC K_ED_INDEX_218_INJ.P_CODE_OPENLOAD "P-Code fuer die Art OPENLOAD [A2L-ref]" VALUE 0x720EC RL_VAL_UW 0 CM_0000 0 65535 /end CHARACTERISTIC
/begin CHARACTERISTIC K_ED_INDEX_218_INJ.P_CODE_SH_TO_GND "P-Code fuer die Art SH_TO_GND [A2L-ref]" VALUE 0x720EA RL_VAL_UW 0 CM_0000 0 65535 /end CHARACTERISTIC
/begin CHARACTERISTIC K_ED_INDEX_218_INJ.P_CODE_SH_TO_UB "P-Code fuer die Art SH_TO_UB [A2L-ref]" VALUE 0x720E8 RL_VAL_UW 0 CM_0000 0 65535 /end CHARACTERISTIC
/begin CHARACTERISTIC K_ED_INDEX_218_INJ.P_CODE_UNPLAUSIBEL "P-Code fuer die Art UNPLAUSIBEL [A2L-ref]" VALUE 0x720EE RL_VAL_UW 0 CM_0000 0 65535 /end CHARACTERISTIC
/begin CHARACTERISTIC K_ED_INDEX_219_INJ.KLASSENINDEX "Auswahl der Fehlerklasse [A2L-ref]" VALUE 0x72110 RL_VAL_UB 0 CM_0000 0 255 /end CHARACTERISTIC
/begin CHARACTERISTIC K_ED_INDEX_219_INJ.P_CODE_OPENLOAD "P-Code fuer die Art OPENLOAD [A2L-ref]" VALUE 0x72106 RL_VAL_UW 0 CM_0000 0 65535 /end CHARACTERISTIC
/begin CHARACTERISTIC K_ED_INDEX_219_INJ.P_CODE_SH_TO_GND "P-Code fuer die Art SH_TO_GND [A2L-ref]" VALUE 0x72104 RL_VAL_UW 0 CM_0000 0 65535 /end CHARACTERISTIC
/begin CHARACTERISTIC K_ED_INDEX_219_INJ.P_CODE_SH_TO_UB "P-Code fuer die Art SH_TO_UB [A2L-ref]" VALUE 0x72102 RL_VAL_UW 0 CM_0000 0 65535 /end CHARACTERISTIC
/begin CHARACTERISTIC K_ED_INDEX_219_INJ.P_CODE_UNPLAUSIBEL "P-Code fuer die Art UNPLAUSIBEL [A2L-ref]" VALUE 0x72108 RL_VAL_UW 0 CM_0000 0 65535 /end CHARACTERISTIC
/begin CHARACTERISTIC K_ED_INDEX_220_INJ.KLASSENINDEX "Auswahl der Fehlerklasse [A2L-ref]" VALUE 0x7212A RL_VAL_UB 0 CM_0000 0 255 /end CHARACTERISTIC
/begin CHARACTERISTIC K_ED_INDEX_220_INJ.P_CODE_OPENLOAD "P-Code fuer die Art OPENLOAD [A2L-ref]" VALUE 0x72120 RL_VAL_UW 0 CM_0000 0 65535 /end CHARACTERISTIC
/begin CHARACTERISTIC K_ED_INDEX_220_INJ.P_CODE_SH_TO_GND "P-Code fuer die Art SH_TO_GND [A2L-ref]" VALUE 0x7211E RL_VAL_UW 0 CM_0000 0 65535 /end CHARACTERISTIC
/begin CHARACTERISTIC K_ED_INDEX_220_INJ.P_CODE_SH_TO_UB "P-Code fuer die Art SH_TO_UB [A2L-ref]" VALUE 0x7211C RL_VAL_UW 0 CM_0000 0 65535 /end CHARACTERISTIC
/begin CHARACTERISTIC K_ED_INDEX_220_INJ.P_CODE_UNPLAUSIBEL "P-Code fuer die Art UNPLAUSIBEL [A2L-ref]" VALUE 0x72122 RL_VAL_UW 0 CM_0000 0 65535 /end CHARACTERISTIC
/begin CHARACTERISTIC K_ED_INDEX_221_INJ.P_CODE_OPENLOAD "P-Code fuer die Art OPENLOAD [A2L-ref]" VALUE 0x7213A RL_VAL_UW 0 CM_0000 0 65535 /end CHARACTERISTIC
/begin CHARACTERISTIC K_ED_INDEX_221_INJ.P_CODE_SH_TO_GND "P-Code fuer die Art SH_TO_GND [A2L-ref]" VALUE 0x72138 RL_VAL_UW 0 CM_0000 0 65535 /end CHARACTERISTIC
/begin CHARACTERISTIC K_ED_INDEX_221_INJ.P_CODE_SH_TO_UB "P-Code fuer die Art SH_TO_UB [A2L-ref]" VALUE 0x72136 RL_VAL_UW 0 CM_0000 0 65535 /end CHARACTERISTIC
/begin CHARACTERISTIC K_ED_INDEX_221_INJ.P_CODE_UNPLAUSIBEL "P-Code fuer die Art UNPLAUSIBEL [A2L-ref]" VALUE 0x7213C RL_VAL_UW 0 CM_0000 0 65535 /end CHARACTERISTIC
/begin CHARACTERISTIC K_ED_INDEX_222_INJ.P_CODE_OPENLOAD "P-Code fuer die Art OPENLOAD [A2L-ref]" VALUE 0x72156 RL_VAL_UW 0 CM_0000 0 65535 /end CHARACTERISTIC
/begin CHARACTERISTIC K_ED_INDEX_222_INJ.P_CODE_SH_TO_GND "P-Code fuer die Art SH_TO_GND [A2L-ref]" VALUE 0x72154 RL_VAL_UW 0 CM_0000 0 65535 /end CHARACTERISTIC
/begin CHARACTERISTIC K_ED_INDEX_222_INJ.P_CODE_SH_TO_UB "P-Code fuer die Art SH_TO_UB [A2L-ref]" VALUE 0x72152 RL_VAL_UW 0 CM_0000 0 65535 /end CHARACTERISTIC
/begin CHARACTERISTIC K_ED_INDEX_223_INJ.P_CODE_OPENLOAD "P-Code fuer die Art OPENLOAD [A2L-ref]" VALUE 0x72170 RL_VAL_UW 0 CM_0000 0 65535 /end CHARACTERISTIC
/begin CHARACTERISTIC K_ED_INDEX_223_INJ.P_CODE_SH_TO_GND "P-Code fuer die Art SH_TO_GND [A2L-ref]" VALUE 0x7216E RL_VAL_UW 0 CM_0000 0 65535 /end CHARACTERISTIC
/begin CHARACTERISTIC K_ED_INDEX_223_INJ.P_CODE_SH_TO_UB "P-Code fuer die Art SH_TO_UB [A2L-ref]" VALUE 0x7216C RL_VAL_UW 0 CM_0000 0 65535 /end CHARACTERISTIC
/begin CHARACTERISTIC K_ED_MIL_MASKE "Auswahl wer Mil ansteuert [A2L-ref]" VALUE 0x72182 RL_VAL_UB 0 CM_0000 0 255 /end CHARACTERISTIC
/begin CHARACTERISTIC K_ED_RBM_TIME_SLP "SLP-Mindestzeit fuer Fahrzyklus [A2L-ref]" VALUE 0x72184 RL_VAL_UW 0 CM_0023 0 6553.5 /end CHARACTERISTIC
/begin CHARACTERISTIC K_ED_SCDN_ABDECKUNG_AUSTRAG "Similar Abdeckung fuer Fehlerspeicheraustrag [A2L-ref]" VALUE 0x72194 RL_VAL_UW 0 CM_0016 0 63.99902344 /end CHARACTERISTIC
/begin CHARACTERISTIC K_ED_SCDN_ABDECKUNG_EINTRAG "Similar Abdeckung fuer Fehlerspeichereintrag [A2L-ref]" VALUE 0x72192 RL_VAL_UW 0 CM_0016 0 63.99902344 /end CHARACTERISTIC
/begin CHARACTERISTIC K_ED_SK_TR_INJ.DEC_NACH_EINTRAG "Filterverringerung nach Fehlerspeichereintrag [A2L-ref]" VALUE 0x70AD1 RL_VAL_UB 0 CM_0000 0 255 /end CHARACTERISTIC
/begin CHARACTERISTIC K_ED_SK_TR_INJ.DEC_VOR_EINTRAG "Filterverringerung vorm Fehlerspeichereintrag [A2L-ref]" VALUE 0x70ACF RL_VAL_UB 0 CM_0000 0 255 /end CHARACTERISTIC
/begin CHARACTERISTIC K_ED_SK_TR_INJ.FEHLERSCHWELLE "Filterschwelle fuer Fehlereintrag [A2L-ref]" VALUE 0x70ACC RL_VAL_UB 0 CM_0000 0 255 /end CHARACTERISTIC
/begin CHARACTERISTIC K_ED_SK_TR_INJ.INC_NACH_EINTRAG "Filtererhoehung nach Fehlerspeichereintrag [A2L-ref]" VALUE 0x70AD0 RL_VAL_UB 0 CM_0000 0 255 /end CHARACTERISTIC
/begin CHARACTERISTIC K_ED_SK_TR_INJ.INC_VOR_EINTRAG "Filtererhoehung vorm Fehlerspeichereintrag [A2L-ref]" VALUE 0x70ACE RL_VAL_UB 0 CM_0000 0 255 /end CHARACTERISTIC
/begin CHARACTERISTIC K_ED_SK_TR_INJ.OK_SCHWELLE "Filterschwelle fuer Fehleraustrag [A2L-ref]" VALUE 0x70ACD RL_VAL_UB 0 CM_0000 0 255 /end CHARACTERISTIC
/begin CHARACTERISTIC K_ED_SK_TR_INJ.P_CODE_OPENLOAD "P-Code fuer die Art OPENLOAD [A2L-ref]" VALUE 0x70AC8 RL_VAL_UW 0 CM_0000 0 65535 /end CHARACTERISTIC
/begin CHARACTERISTIC K_ED_SK_TR_INJ.P_CODE_SH_TO_GND "P-Code fuer die Art SH_TO_GND [A2L-ref]" VALUE 0x70AC6 RL_VAL_UW 0 CM_0000 0 65535 /end CHARACTERISTIC
/begin CHARACTERISTIC K_ED_SK_TR_INJ.P_CODE_SH_TO_UB "P-Code fuer die Art SH_TO_UB [A2L-ref]" VALUE 0x70AC4 RL_VAL_UW 0 CM_0000 0 65535 /end CHARACTERISTIC
/begin CHARACTERISTIC K_ED_SK_TR_INJ.P_CODE_UNPLAUSIBEL "P-Code fuer die Art UNPLAUSIBEL [A2L-ref]" VALUE 0x70ACA RL_VAL_UW 0 CM_0000 0 65535 /end CHARACTERISTIC
/begin CHARACTERISTIC K_ED_RBM_EVAP_TEMP_DELTA "Max. Differenz zwischen tmot und tumg fuer EVAP [EST]" VALUE 0x72190 RL_VAL_SW 0 CM_0024 -3276.8 3276.7 /end CHARACTERISTIC
/begin COMPU_METHOD CM_0000 "X" RAT_FUNC "%.4g" "-" COEFFS 0 1 0 0 0 1 /end COMPU_METHOD
/begin COMPU_METHOD CM_0006 "X*0.1-273.2" RAT_FUNC "%.4g" "?C" COEFFS 0 1 273.2 0 0 0.1 /end COMPU_METHOD
/begin COMPU_METHOD CM_0016 "X*0.0009765625" RAT_FUNC "%.4g" "-" COEFFS 0 1 0 0 0 0.0009765625 /end COMPU_METHOD
/begin COMPU_METHOD CM_0021 "X*0.1" RAT_FUNC "%.4g" "V" COEFFS 0 1 0 0 0 0.1 /end COMPU_METHOD
/begin COMPU_METHOD CM_0023 "X*0.1" RAT_FUNC "%.4g" "s" COEFFS 0 1 0 0 0 0.1 /end COMPU_METHOD
/begin COMPU_METHOD CM_0024 "X*0.1" RAT_FUNC "%.4g" "Kelvin" COEFFS 0 1 0 0 0 0.1 /end COMPU_METHOD
/begin COMPU_METHOD CM_0025 "X*0.01" RAT_FUNC "%.4g" "s" COEFFS 0 1 0 0 0 0.01 /end COMPU_METHOD
/begin COMPU_METHOD CM_0142 "X*0.001" RAT_FUNC "%.4g" "bar" COEFFS 0 1 0 0 0 0.001 /end COMPU_METHOD
/begin RECORD_LAYOUT RL_CUR_SW_SW FNC_VALUES 4 SWORD COLUMN_DIR DIRECT AXIS_PTS_X 3 SWORD INDEX_INCR DIRECT NO_AXIS_PTS_X 1 UBYTE RESERVED 2 BYTE /end RECORD_LAYOUT
/begin RECORD_LAYOUT RL_CUR_SW_UB FNC_VALUES 4 UBYTE COLUMN_DIR DIRECT AXIS_PTS_X 3 SWORD INDEX_INCR DIRECT NO_AXIS_PTS_X 1 UBYTE RESERVED 2 BYTE /end RECORD_LAYOUT
/begin RECORD_LAYOUT RL_CUR_SW_UW FNC_VALUES 4 UWORD COLUMN_DIR DIRECT AXIS_PTS_X 3 SWORD INDEX_INCR DIRECT NO_AXIS_PTS_X 1 UBYTE RESERVED 2 BYTE /end RECORD_LAYOUT
/begin RECORD_LAYOUT RL_MAP_SW_SW_SW FNC_VALUES 5 SWORD COLUMN_DIR DIRECT AXIS_PTS_X 3 SWORD INDEX_INCR DIRECT AXIS_PTS_Y 4 SWORD INDEX_INCR DIRECT NO_AXIS_PTS_X 1 UBYTE NO_AXIS_PTS_Y 2 UBYTE /end RECORD_LAYOUT
/begin RECORD_LAYOUT RL_MAP_SW_SW_UW FNC_VALUES 5 UWORD COLUMN_DIR DIRECT AXIS_PTS_X 3 SWORD INDEX_INCR DIRECT AXIS_PTS_Y 4 SWORD INDEX_INCR DIRECT NO_AXIS_PTS_X 1 UBYTE NO_AXIS_PTS_Y 2 UBYTE /end RECORD_LAYOUT
/begin RECORD_LAYOUT RL_VAL_SW FNC_VALUES 1 SWORD COLUMN_DIR DIRECT /end RECORD_LAYOUT
/begin RECORD_LAYOUT RL_VAL_UB FNC_VALUES 1 UBYTE COLUMN_DIR DIRECT /end RECORD_LAYOUT
/begin RECORD_LAYOUT RL_VAL_UW FNC_VALUES 1 UWORD COLUMN_DIR DIRECT /end RECORD_LAYOUT
/begin GROUP G_y_Fault_paths__K_ED_ "y Fault paths (K_ED)" ROOT
 /begin REF_CHARACTERISTIC K_ED_SL_DURCHS_HSTRANG.P_CODE_OPENLOAD K_ED_SL_DURCHS_HSTRANG.P_CODE_SH_TO_GND K_ED_SL_DURCHS_HSTRANG.P_CODE_SH_TO_UB K_ED_SL_DURCHS_HSTRANG.P_CODE_UNPLAUSIBEL K_ED_SL_ML_HFM.DEC_NACH_EINTRAG K_ED_SL_ML_HFM.DEC_VOR_EINTRAG K_ED_SL_ML_HFM.FEHLERSCHWELLE K_ED_SL_ML_HFM.INC_NACH_EINTRAG K_ED_SL_ML_HFM.INC_VOR_EINTRAG K_ED_SL_ML_HFM.KLASSENINDEX K_ED_SL_ML_HFM.OK_SCHWELLE K_ED_SL_ML_HFM.P_CODE_OPENLOAD K_ED_SL_ML_HFM.P_CODE_SH_TO_GND K_ED_SL_ML_HFM.P_CODE_SH_TO_UB K_ED_SL_ML_HFM.P_CODE_UNPLAUSIBEL K_ED_SL_ML_HFM_OBD.DEC_NACH_EINTRAG K_ED_SL_ML_HFM_OBD.DEC_VOR_EINTRAG K_ED_SL_ML_HFM_OBD.FEHLERSCHWELLE K_ED_SL_ML_HFM_OBD.INC_NACH_EINTRAG K_ED_SL_ML_HFM_OBD.INC_VOR_EINTRAG K_ED_SL_ML_HFM_OBD.KLASSENINDEX K_ED_SL_ML_HFM_OBD.OK_SCHWELLE K_ED_SL_ML_HFM_OBD.P_CODE_OPENLOAD K_ED_SL_ML_HFM_OBD.P_CODE_SH_TO_GND K_ED_SL_ML_HFM_OBD.P_CODE_SH_TO_UB K_ED_SL_ML_HFM_OBD.P_CODE_UNPLAUSIBEL K_ED_S_GETR_HS.DEC_NACH_EINTRAG K_ED_S_GETR_HS.DEC_VOR_EINTRAG K_ED_S_GETR_HS.FEHLERSCHWELLE K_ED_S_GETR_HS.INC_NACH_EINTRAG K_ED_S_GETR_HS.INC_VOR_EINTRAG K_ED_S_GETR_HS.KLASSENINDEX K_ED_S_GETR_HS.OK_SCHWELLE K_ED_S_GETR_HS.P_CODE_OPENLOAD K_ED_S_GETR_HS.P_CODE_SH_TO_GND K_ED_S_GETR_HS.P_CODE_SH_TO_UB K_ED_S_GETR_HS.P_CODE_UNPLAUSIBEL K_ED_S_KUPP_HS.DEC_NACH_EINTRAG K_ED_S_KUPP_HS.DEC_VOR_EINTRAG K_ED_S_KUPP_HS.FEHLERSCHWELLE K_ED_S_KUPP_HS.INC_NACH_EINTRAG K_ED_S_KUPP_HS.INC_VOR_EINTRAG K_ED_S_KUPP_HS.KLASSENINDEX K_ED_S_KUPP_HS.OK_SCHWELLE K_ED_S_KUPP_HS.P_CODE_OPENLOAD K_ED_S_KUPP_HS.P_CODE_SH_TO_GND K_ED_S_KUPP_HS.P_CODE_SH_TO_UB K_ED_S_KUPP_HS.P_CODE_UNPLAUSIBEL K_ED_S_POEL_DIAG.DEC_NACH_EINTRAG K_ED_S_POEL_DIAG.DEC_VOR_EINTRAG K_ED_S_POEL_DIAG.FEHLERSCHWELLE K_ED_S_POEL_DIAG.INC_NACH_EINTRAG K_ED_S_POEL_DIAG.INC_VOR_EINTRAG K_ED_S_POEL_DIAG.KLASSENINDEX K_ED_S_POEL_DIAG.OK_SCHWELLE K_ED_S_POEL_DIAG.P_CODE_OPENLOAD K_ED_S_POEL_DIAG.P_CODE_SH_TO_GND K_ED_S_POEL_DIAG.P_CODE_SH_TO_UB K_ED_S_POEL_DIAG.P_CODE_UNPLAUSIBEL K_ED_TANK_LEER.DEC_NACH_EINTRAG K_ED_TANK_LEER.DEC_VOR_EINTRAG K_ED_TANK_LEER.FEHLERSCHWELLE K_ED_TANK_LEER.INC_NACH_EINTRAG K_ED_TANK_LEER.INC_VOR_EINTRAG K_ED_TANK_LEER.KLASSENINDEX K_ED_TANK_LEER.OK_SCHWELLE K_ED_TANK_LEER.P_CODE_OPENLOAD K_ED_TANK_LEER.P_CODE_SH_TO_GND K_ED_TANK_LEER.P_CODE_SH_TO_UB K_ED_TANK_LEER.P_CODE_UNPLAUSIBEL K_ED_TD.DEC_NACH_EINTRAG K_ED_TD.DEC_VOR_EINTRAG K_ED_TD.FEHLERSCHWELLE K_ED_TD.INC_NACH_EINTRAG K_ED_TD.INC_VOR_EINTRAG K_ED_TD.KLASSENINDEX K_ED_TD.OK_SCHWELLE K_ED_TD.P_CODE_OPENLOAD K_ED_TD.P_CODE_SH_TO_GND K_ED_TD.P_CODE_SH_TO_UB K_ED_TD.P_CODE_UNPLAUSIBEL K_ED_TEV1.DEC_NACH_EINTRAG K_ED_TEV1.DEC_VOR_EINTRAG K_ED_TEV1.FEHLERSCHWELLE K_ED_TEV1.INC_NACH_EINTRAG K_ED_TEV1.INC_VOR_EINTRAG K_ED_TEV1.KLASSENINDEX K_ED_TEV1.OK_SCHWELLE K_ED_TEV1.P_CODE_OPENLOAD K_ED_TEV1.P_CODE_SH_TO_GND K_ED_TEV1.P_CODE_SH_TO_UB K_ED_TEV1.P_CODE_UNPLAUSIBEL K_ED_TEV2.DEC_NACH_EINTRAG K_ED_TEV2.DEC_VOR_EINTRAG K_ED_TEV2.FEHLERSCHWELLE K_ED_TEV2.INC_NACH_EINTRAG K_ED_TEV2.INC_VOR_EINTRAG K_ED_TEV2.KLASSENINDEX K_ED_TEV2.OK_SCHWELLE K_ED_TEV2.P_CODE_OPENLOAD K_ED_TEV2.P_CODE_SH_TO_GND K_ED_TEV2.P_CODE_SH_TO_UB K_ED_TEV2.P_CODE_UNPLAUSIBEL K_ED_TE_OBD_1.DEC_NACH_EINTRAG K_ED_TE_OBD_1.DEC_VOR_EINTRAG K_ED_TE_OBD_1.FEHLERSCHWELLE K_ED_TE_OBD_1.INC_NACH_EINTRAG K_ED_TE_OBD_1.INC_VOR_EINTRAG K_ED_TE_OBD_1.KLASSENINDEX K_ED_TE_OBD_1.OK_SCHWELLE K_ED_TE_OBD_1.P_CODE_OPENLOAD K_ED_TE_OBD_1.P_CODE_SH_TO_GND K_ED_TE_OBD_1.P_CODE_SH_TO_UB K_ED_TE_OBD_1.P_CODE_UNPLAUSIBEL K_ED_TE_OBD_2.DEC_NACH_EINTRAG K_ED_TE_OBD_2.DEC_VOR_EINTRAG K_ED_TE_OBD_2.FEHLERSCHWELLE K_ED_TE_OBD_2.INC_NACH_EINTRAG K_ED_TE_OBD_2.INC_VOR_EINTRAG K_ED_TE_OBD_2.KLASSENINDEX K_ED_TE_OBD_2.OK_SCHWELLE K_ED_TE_OBD_2.P_CODE_OPENLOAD K_ED_TE_OBD_2.P_CODE_SH_TO_GND K_ED_TE_OBD_2.P_CODE_SH_TO_UB K_ED_TE_OBD_2.P_CODE_UNPLAUSIBEL K_ED_TGETR_HS.DEC_NACH_EINTRAG K_ED_TGETR_HS.DEC_VOR_EINTRAG K_ED_TGETR_HS.FEHLERSCHWELLE K_ED_TGETR_HS.INC_NACH_EINTRAG K_ED_TGETR_HS.INC_VOR_EINTRAG K_ED_TGETR_HS.KLASSENINDEX K_ED_TGETR_HS.OK_SCHWELLE K_ED_TGETR_HS.P_CODE_OPENLOAD K_ED_TGETR_HS.P_CODE_SH_TO_GND K_ED_TGETR_HS.P_CODE_SH_TO_UB K_ED_TGETR_HS.P_CODE_UNPLAUSIBEL K_ED_TZ1.DEC_NACH_EINTRAG K_ED_TZ1.DEC_VOR_EINTRAG K_ED_TZ1.FEHLERSCHWELLE K_ED_TZ1.INC_NACH_EINTRAG K_ED_TZ1.INC_VOR_EINTRAG K_ED_TZ1.KLASSENINDEX K_ED_TZ1.OK_SCHWELLE K_ED_TZ1.P_CODE_OPENLOAD K_ED_TZ1.P_CODE_SH_TO_GND K_ED_TZ1.P_CODE_SH_TO_UB K_ED_TZ1.P_CODE_UNPLAUSIBEL K_ED_TZ10.DEC_NACH_EINTRAG K_ED_TZ10.DEC_VOR_EINTRAG K_ED_TZ10.FEHLERSCHWELLE K_ED_TZ10.INC_NACH_EINTRAG K_ED_TZ10.INC_VOR_EINTRAG K_ED_TZ10.KLASSENINDEX K_ED_TZ10.OK_SCHWELLE K_ED_TZ10.P_CODE_OPENLOAD K_ED_TZ10.P_CODE_SH_TO_GND K_ED_TZ10.P_CODE_SH_TO_UB K_ED_TZ10.P_CODE_UNPLAUSIBEL K_ED_TZ2.DEC_NACH_EINTRAG K_ED_TZ2.DEC_VOR_EINTRAG K_ED_TZ2.FEHLERSCHWELLE K_ED_TZ2.INC_NACH_EINTRAG K_ED_TZ2.INC_VOR_EINTRAG K_ED_TZ2.KLASSENINDEX K_ED_TZ2.OK_SCHWELLE K_ED_TZ2.P_CODE_OPENLOAD K_ED_TZ2.P_CODE_SH_TO_GND K_ED_TZ2.P_CODE_SH_TO_UB K_ED_TZ2.P_CODE_UNPLAUSIBEL K_ED_TZ3.DEC_NACH_EINTRAG K_ED_TZ3.DEC_VOR_EINTRAG K_ED_TZ3.FEHLERSCHWELLE K_ED_TZ3.INC_NACH_EINTRAG K_ED_TZ3.INC_VOR_EINTRAG K_ED_TZ3.KLASSENINDEX K_ED_TZ3.OK_SCHWELLE K_ED_TZ3.P_CODE_OPENLOAD K_ED_TZ3.P_CODE_SH_TO_GND K_ED_TZ3.P_CODE_SH_TO_UB K_ED_TZ3.P_CODE_UNPLAUSIBEL K_ED_TZ4.DEC_NACH_EINTRAG K_ED_TZ4.DEC_VOR_EINTRAG K_ED_TZ4.FEHLERSCHWELLE K_ED_TZ4.INC_NACH_EINTRAG K_ED_TZ4.INC_VOR_EINTRAG K_ED_TZ4.KLASSENINDEX K_ED_TZ4.OK_SCHWELLE K_ED_TZ4.P_CODE_OPENLOAD K_ED_TZ4.P_CODE_SH_TO_GND K_ED_TZ4.P_CODE_SH_TO_UB K_ED_TZ4.P_CODE_UNPLAUSIBEL K_ED_TZ5.DEC_NACH_EINTRAG K_ED_TZ5.DEC_VOR_EINTRAG K_ED_TZ5.FEHLERSCHWELLE K_ED_TZ5.INC_NACH_EINTRAG K_ED_TZ5.INC_VOR_EINTRAG K_ED_TZ5.KLASSENINDEX K_ED_TZ5.OK_SCHWELLE K_ED_TZ5.P_CODE_OPENLOAD K_ED_TZ5.P_CODE_SH_TO_GND K_ED_TZ5.P_CODE_SH_TO_UB K_ED_TZ5.P_CODE_UNPLAUSIBEL K_ED_TZ6.DEC_NACH_EINTRAG K_ED_TZ6.DEC_VOR_EINTRAG K_ED_TZ6.FEHLERSCHWELLE K_ED_TZ6.INC_NACH_EINTRAG K_ED_TZ6.INC_VOR_EINTRAG K_ED_TZ6.KLASSENINDEX K_ED_TZ6.OK_SCHWELLE K_ED_TZ6.P_CODE_OPENLOAD K_ED_TZ6.P_CODE_SH_TO_GND K_ED_TZ6.P_CODE_SH_TO_UB K_ED_TZ6.P_CODE_UNPLAUSIBEL K_ED_TZ7.DEC_NACH_EINTRAG K_ED_TZ7.DEC_VOR_EINTRAG K_ED_TZ7.FEHLERSCHWELLE K_ED_TZ7.INC_NACH_EINTRAG K_ED_TZ7.INC_VOR_EINTRAG K_ED_TZ7.KLASSENINDEX K_ED_TZ7.OK_SCHWELLE K_ED_TZ7.P_CODE_OPENLOAD K_ED_TZ7.P_CODE_SH_TO_GND K_ED_TZ7.P_CODE_SH_TO_UB K_ED_TZ7.P_CODE_UNPLAUSIBEL K_ED_TZ8.DEC_NACH_EINTRAG K_ED_TZ8.DEC_VOR_EINTRAG K_ED_TZ8.FEHLERSCHWELLE K_ED_TZ8.INC_NACH_EINTRAG K_ED_TZ8.INC_VOR_EINTRAG K_ED_TZ8.KLASSENINDEX K_ED_TZ8.OK_SCHWELLE K_ED_TZ8.P_CODE_OPENLOAD K_ED_TZ8.P_CODE_SH_TO_GND K_ED_TZ8.P_CODE_SH_TO_UB K_ED_TZ8.P_CODE_UNPLAUSIBEL K_ED_TZ9.DEC_NACH_EINTRAG K_ED_TZ9.DEC_VOR_EINTRAG K_ED_TZ9.FEHLERSCHWELLE K_ED_TZ9.INC_NACH_EINTRAG K_ED_TZ9.INC_VOR_EINTRAG K_ED_TZ9.KLASSENINDEX K_ED_TZ9.OK_SCHWELLE K_ED_TZ9.P_CODE_OPENLOAD K_ED_TZ9.P_CODE_SH_TO_GND K_ED_TZ9.P_CODE_SH_TO_UB K_ED_TZ9.P_CODE_UNPLAUSIBEL K_ED_UBMIN__INJ_ K_ED_VAN_ANSCHL_A1.DEC_NACH_EINTRAG K_ED_VAN_ANSCHL_A1.DEC_VOR_EINTRAG K_ED_VAN_ANSCHL_A1.FEHLERSCHWELLE K_ED_VAN_ANSCHL_A1.INC_NACH_EINTRAG K_ED_VAN_ANSCHL_A1.INC_VOR_EINTRAG K_ED_VAN_ANSCHL_A1.KLASSENINDEX K_ED_VAN_ANSCHL_A1.OK_SCHWELLE K_ED_VAN_ANSCHL_A1.P_CODE_OPENLOAD K_ED_VAN_ANSCHL_A1.P_CODE_SH_TO_GND K_ED_VAN_ANSCHL_A1.P_CODE_SH_TO_UB K_ED_VAN_ANSCHL_A1.P_CODE_UNPLAUSIBEL K_ED_VAN_ANSCHL_A2.DEC_NACH_EINTRAG K_ED_VAN_ANSCHL_A2.DEC_VOR_EINTRAG K_ED_VAN_ANSCHL_A2.FEHLERSCHWELLE K_ED_VAN_ANSCHL_A2.INC_NACH_EINTRAG K_ED_VAN_ANSCHL_A2.INC_VOR_EINTRAG K_ED_VAN_ANSCHL_A2.KLASSENINDEX K_ED_VAN_ANSCHL_A2.OK_SCHWELLE K_ED_VAN_ANSCHL_A2.P_CODE_OPENLOAD K_ED_VAN_ANSCHL_A2.P_CODE_SH_TO_GND K_ED_VAN_ANSCHL_A2.P_CODE_SH_TO_UB K_ED_VAN_ANSCHL_A2.P_CODE_UNPLAUSIBEL K_ED_VAN_ANSCHL_E1.DEC_NACH_EINTRAG K_ED_VAN_ANSCHL_E1.DEC_VOR_EINTRAG K_ED_VAN_ANSCHL_E1.FEHLERSCHWELLE K_ED_VAN_ANSCHL_E1.INC_NACH_EINTRAG K_ED_VAN_ANSCHL_E1.INC_VOR_EINTRAG K_ED_VAN_ANSCHL_E1.KLASSENINDEX K_ED_VAN_ANSCHL_E1.OK_SCHWELLE K_ED_VAN_ANSCHL_E1.P_CODE_OPENLOAD K_ED_VAN_ANSCHL_E1.P_CODE_SH_TO_GND K_ED_VAN_ANSCHL_E1.P_CODE_SH_TO_UB K_ED_VAN_ANSCHL_E1.P_CODE_UNPLAUSIBEL K_ED_VAN_ANSCHL_E2.DEC_NACH_EINTRAG K_ED_VAN_ANSCHL_E2.DEC_VOR_EINTRAG K_ED_VAN_ANSCHL_E2.FEHLERSCHWELLE K_ED_VAN_ANSCHL_E2.INC_NACH_EINTRAG K_ED_VAN_ANSCHL_E2.INC_VOR_EINTRAG K_ED_VAN_ANSCHL_E2.KLASSENINDEX K_ED_VAN_ANSCHL_E2.OK_SCHWELLE K_ED_VAN_ANSCHL_E2.P_CODE_OPENLOAD K_ED_VAN_ANSCHL_E2.P_CODE_SH_TO_GND K_ED_VAN_ANSCHL_E2.P_CODE_SH_TO_UB K_ED_VAN_ANSCHL_E2.P_CODE_UNPLAUSIBEL K_ED_VAN_DRUCK.DEC_NACH_EINTRAG K_ED_VAN_DRUCK.DEC_VOR_EINTRAG K_ED_VAN_DRUCK.FEHLERSCHWELLE K_ED_VAN_DRUCK.INC_NACH_EINTRAG K_ED_VAN_DRUCK.INC_VOR_EINTRAG K_ED_VAN_DRUCK.KLASSENINDEX K_ED_VAN_DRUCK.OK_SCHWELLE K_ED_VAN_DRUCK.P_CODE_OPENLOAD K_ED_VAN_DRUCK.P_CODE_SH_TO_GND K_ED_VAN_DRUCK.P_CODE_SH_TO_UB K_ED_VAN_DRUCK.P_CODE_UNPLAUSIBEL K_ED_VAN_DSV.DEC_NACH_EINTRAG K_ED_VAN_DSV.DEC_VOR_EINTRAG K_ED_VAN_DSV.FEHLERSCHWELLE K_ED_VAN_DSV.INC_NACH_EINTRAG K_ED_VAN_DSV.INC_VOR_EINTRAG K_ED_VAN_DSV.KLASSENINDEX K_ED_VAN_DSV.OK_SCHWELLE K_ED_VAN_DSV.P_CODE_OPENLOAD K_ED_VAN_DSV.P_CODE_SH_TO_GND K_ED_VAN_DSV.P_CODE_SH_TO_UB K_ED_VAN_DSV.P_CODE_UNPLAUSIBEL K_ED_VAN_HALL_A1.DEC_NACH_EINTRAG K_ED_VAN_HALL_A1.DEC_VOR_EINTRAG K_ED_VAN_HALL_A1.FEHLERSCHWELLE K_ED_VAN_HALL_A1.INC_NACH_EINTRAG K_ED_VAN_HALL_A1.INC_VOR_EINTRAG K_ED_VAN_HALL_A1.KLASSENINDEX K_ED_VAN_HALL_A1.OK_SCHWELLE K_ED_VAN_HALL_A1.P_CODE_OPENLOAD K_ED_VAN_HALL_A1.P_CODE_SH_TO_GND K_ED_VAN_HALL_A1.P_CODE_SH_TO_UB K_ED_VAN_HALL_A1.P_CODE_UNPLAUSIBEL K_ED_VAN_HALL_A2.DEC_NACH_EINTRAG K_ED_VAN_HALL_A2.DEC_VOR_EINTRAG K_ED_VAN_HALL_A2.FEHLERSCHWELLE K_ED_VAN_HALL_A2.INC_NACH_EINTRAG K_ED_VAN_HALL_A2.INC_VOR_EINTRAG K_ED_VAN_HALL_A2.KLASSENINDEX K_ED_VAN_HALL_A2.OK_SCHWELLE K_ED_VAN_HALL_A2.P_CODE_OPENLOAD K_ED_VAN_HALL_A2.P_CODE_SH_TO_GND K_ED_VAN_HALL_A2.P_CODE_SH_TO_UB K_ED_VAN_HALL_A2.P_CODE_UNPLAUSIBEL K_ED_VAN_HALL_E1.DEC_NACH_EINTRAG K_ED_VAN_HALL_E1.DEC_VOR_EINTRAG K_ED_VAN_HALL_E1.FEHLERSCHWELLE K_ED_VAN_HALL_E1.INC_NACH_EINTRAG K_ED_VAN_HALL_E1.INC_VOR_EINTRAG K_ED_VAN_HALL_E1.KLASSENINDEX K_ED_VAN_HALL_E1.OK_SCHWELLE K_ED_VAN_HALL_E1.P_CODE_OPENLOAD K_ED_VAN_HALL_E1.P_CODE_SH_TO_GND K_ED_VAN_HALL_E1.P_CODE_SH_TO_UB K_ED_VAN_HALL_E1.P_CODE_UNPLAUSIBEL K_ED_VAN_HALL_E2.DEC_NACH_EINTRAG K_ED_VAN_HALL_E2.DEC_VOR_EINTRAG K_ED_VAN_HALL_E2.FEHLERSCHWELLE K_ED_VAN_HALL_E2.INC_NACH_EINTRAG K_ED_VAN_HALL_E2.INC_VOR_EINTRAG K_ED_VAN_HALL_E2.KLASSENINDEX K_ED_VAN_HALL_E2.OK_SCHWELLE K_ED_VAN_HALL_E2.P_CODE_OPENLOAD K_ED_VAN_HALL_E2.P_CODE_SH_TO_GND K_ED_VAN_HALL_E2.P_CODE_SH_TO_UB K_ED_VAN_HALL_E2.P_CODE_UNPLAUSIBEL K_ED_VAN_REGL_A1.DEC_NACH_EINTRAG K_ED_VAN_REGL_A1.DEC_VOR_EINTRAG K_ED_VAN_REGL_A1.FEHLERSCHWELLE K_ED_VAN_REGL_A1.INC_NACH_EINTRAG K_ED_VAN_REGL_A1.INC_VOR_EINTRAG K_ED_VAN_REGL_A1.KLASSENINDEX K_ED_VAN_REGL_A1.OK_SCHWELLE K_ED_VAN_REGL_A1.P_CODE_OPENLOAD K_ED_VAN_REGL_A1.P_CODE_SH_TO_GND K_ED_VAN_REGL_A1.P_CODE_SH_TO_UB K_ED_VAN_REGL_A1.P_CODE_UNPLAUSIBEL K_ED_VAN_REGL_A2.DEC_NACH_EINTRAG K_ED_VAN_REGL_A2.DEC_VOR_EINTRAG K_ED_VAN_REGL_A2.FEHLERSCHWELLE K_ED_VAN_REGL_A2.INC_NACH_EINTRAG K_ED_VAN_REGL_A2.INC_VOR_EINTRAG K_ED_VAN_REGL_A2.KLASSENINDEX K_ED_VAN_REGL_A2.OK_SCHWELLE K_ED_VAN_REGL_A2.P_CODE_OPENLOAD K_ED_VAN_REGL_A2.P_CODE_SH_TO_GND K_ED_VAN_REGL_A2.P_CODE_SH_TO_UB K_ED_VAN_REGL_A2.P_CODE_UNPLAUSIBEL K_ED_VAN_REGL_E1.DEC_NACH_EINTRAG K_ED_VAN_REGL_E1.DEC_VOR_EINTRAG K_ED_VAN_REGL_E1.FEHLERSCHWELLE K_ED_VAN_REGL_E1.INC_NACH_EINTRAG K_ED_VAN_REGL_E1.INC_VOR_EINTRAG K_ED_VAN_REGL_E1.KLASSENINDEX K_ED_VAN_REGL_E1.OK_SCHWELLE K_ED_VAN_REGL_E1.P_CODE_OPENLOAD K_ED_VAN_REGL_E1.P_CODE_SH_TO_GND K_ED_VAN_REGL_E1.P_CODE_SH_TO_UB K_ED_VAN_REGL_E1.P_CODE_UNPLAUSIBEL K_ED_VAN_REGL_E2.DEC_NACH_EINTRAG K_ED_VAN_REGL_E2.DEC_VOR_EINTRAG K_ED_VAN_REGL_E2.FEHLERSCHWELLE K_ED_VAN_REGL_E2.INC_NACH_EINTRAG K_ED_VAN_REGL_E2.INC_VOR_EINTRAG K_ED_VAN_REGL_E2.KLASSENINDEX K_ED_VAN_REGL_E2.OK_SCHWELLE K_ED_VAN_REGL_E2.P_CODE_OPENLOAD K_ED_VAN_REGL_E2.P_CODE_SH_TO_GND K_ED_VAN_REGL_E2.P_CODE_SH_TO_UB K_ED_VAN_REGL_E2.P_CODE_UNPLAUSIBEL K_ED_VAN_VENT_A1.DEC_NACH_EINTRAG K_ED_VAN_VENT_A1.DEC_VOR_EINTRAG K_ED_VAN_VENT_A1.FEHLERSCHWELLE K_ED_VAN_VENT_A1.INC_NACH_EINTRAG K_ED_VAN_VENT_A1.INC_VOR_EINTRAG K_ED_VAN_VENT_A1.KLASSENINDEX K_ED_VAN_VENT_A1.OK_SCHWELLE K_ED_VAN_VENT_A1.P_CODE_OPENLOAD K_ED_VAN_VENT_A1.P_CODE_SH_TO_GND K_ED_VAN_VENT_A1.P_CODE_SH_TO_UB K_ED_VAN_VENT_A1.P_CODE_UNPLAUSIBEL K_ED_VAN_VENT_A2.DEC_NACH_EINTRAG K_ED_VAN_VENT_A2.DEC_VOR_EINTRAG K_ED_VAN_VENT_A2.FEHLERSCHWELLE K_ED_VAN_VENT_A2.INC_NACH_EINTRAG K_ED_VAN_VENT_A2.INC_VOR_EINTRAG K_ED_VAN_VENT_A2.KLASSENINDEX K_ED_VAN_VENT_A2.OK_SCHWELLE K_ED_VAN_VENT_A2.P_CODE_OPENLOAD K_ED_VAN_VENT_A2.P_CODE_SH_TO_GND K_ED_VAN_VENT_A2.P_CODE_SH_TO_UB K_ED_VAN_VENT_A2.P_CODE_UNPLAUSIBEL K_ED_VAN_VENT_E1.DEC_NACH_EINTRAG K_ED_VAN_VENT_E1.DEC_VOR_EINTRAG K_ED_VAN_VENT_E1.FEHLERSCHWELLE K_ED_VAN_VENT_E1.INC_NACH_EINTRAG K_ED_VAN_VENT_E1.INC_VOR_EINTRAG K_ED_VAN_VENT_E1.KLASSENINDEX K_ED_VAN_VENT_E1.OK_SCHWELLE K_ED_VAN_VENT_E1.P_CODE_OPENLOAD K_ED_VAN_VENT_E1.P_CODE_SH_TO_GND K_ED_VAN_VENT_E1.P_CODE_SH_TO_UB K_ED_VAN_VENT_E1.P_CODE_UNPLAUSIBEL K_ED_VAN_VENT_E2.DEC_NACH_EINTRAG K_ED_VAN_VENT_E2.DEC_VOR_EINTRAG K_ED_VAN_VENT_E2.FEHLERSCHWELLE K_ED_VAN_VENT_E2.INC_NACH_EINTRAG K_ED_VAN_VENT_E2.INC_VOR_EINTRAG K_ED_VAN_VENT_E2.KLASSENINDEX K_ED_VAN_VENT_E2.OK_SCHWELLE K_ED_VAN_VENT_E2.P_CODE_OPENLOAD K_ED_VAN_VENT_E2.P_CODE_SH_TO_GND K_ED_VAN_VENT_E2.P_CODE_SH_TO_UB K_ED_VAN_VENT_E2.P_CODE_UNPLAUSIBEL K_ED_WUC_DELTA_TMOT__INJ_ K_ED_WUC_TMOT_MIN__INJ_ K_ED_CSS_TIME K_ED_INDEX_207_INJ.P_CODE_OPENLOAD K_ED_INDEX_207_INJ.P_CODE_SH_TO_GND K_ED_INDEX_207_INJ.P_CODE_SH_TO_UB K_ED_INDEX_208_INJ.P_CODE_OPENLOAD K_ED_INDEX_208_INJ.P_CODE_SH_TO_GND K_ED_INDEX_208_INJ.P_CODE_SH_TO_UB K_ED_INDEX_211_INJ.DEC_NACH_EINTRAG K_ED_INDEX_211_INJ.DEC_VOR_EINTRAG K_ED_INDEX_211_INJ.FEHLERSCHWELLE K_ED_INDEX_211_INJ.INC_NACH_EINTRAG K_ED_INDEX_211_INJ.INC_VOR_EINTRAG K_ED_INDEX_211_INJ.OK_SCHWELLE K_ED_INDEX_211_INJ.P_CODE_SH_TO_GND K_ED_INDEX_211_INJ.P_CODE_SH_TO_UB K_ED_INDEX_212_INJ.FEHLERSCHWELLE K_ED_INDEX_212_INJ.INC_VOR_EINTRAG K_ED_INDEX_212_INJ.OK_SCHWELLE K_ED_INDEX_212_INJ.P_CODE_OPENLOAD K_ED_INDEX_212_INJ.P_CODE_SH_TO_GND K_ED_INDEX_212_INJ.P_CODE_SH_TO_UB K_ED_INDEX_212_INJ.P_CODE_UNPLAUSIBEL K_ED_INDEX_215_INJ.P_CODE_SH_TO_GND K_ED_INDEX_215_INJ.P_CODE_SH_TO_UB K_ED_INDEX_216_INJ.KLASSENINDEX K_ED_INDEX_216_INJ.P_CODE_OPENLOAD K_ED_INDEX_216_INJ.P_CODE_SH_TO_GND K_ED_INDEX_216_INJ.P_CODE_SH_TO_UB K_ED_INDEX_216_INJ.P_CODE_UNPLAUSIBEL K_ED_INDEX_217_INJ.KLASSENINDEX K_ED_INDEX_217_INJ.P_CODE_OPENLOAD K_ED_INDEX_217_INJ.P_CODE_SH_TO_GND K_ED_INDEX_217_INJ.P_CODE_SH_TO_UB K_ED_INDEX_217_INJ.P_CODE_UNPLAUSIBEL K_ED_INDEX_218_INJ.KLASSENINDEX K_ED_INDEX_218_INJ.P_CODE_OPENLOAD K_ED_INDEX_218_INJ.P_CODE_SH_TO_GND K_ED_INDEX_218_INJ.P_CODE_SH_TO_UB K_ED_INDEX_218_INJ.P_CODE_UNPLAUSIBEL K_ED_INDEX_219_INJ.KLASSENINDEX K_ED_INDEX_219_INJ.P_CODE_OPENLOAD K_ED_INDEX_219_INJ.P_CODE_SH_TO_GND K_ED_INDEX_219_INJ.P_CODE_SH_TO_UB K_ED_INDEX_219_INJ.P_CODE_UNPLAUSIBEL K_ED_INDEX_220_INJ.KLASSENINDEX K_ED_INDEX_220_INJ.P_CODE_OPENLOAD K_ED_INDEX_220_INJ.P_CODE_SH_TO_GND K_ED_INDEX_220_INJ.P_CODE_SH_TO_UB K_ED_INDEX_220_INJ.P_CODE_UNPLAUSIBEL K_ED_INDEX_221_INJ.P_CODE_OPENLOAD K_ED_INDEX_221_INJ.P_CODE_SH_TO_GND K_ED_INDEX_221_INJ.P_CODE_SH_TO_UB K_ED_INDEX_221_INJ.P_CODE_UNPLAUSIBEL K_ED_INDEX_222_INJ.P_CODE_OPENLOAD K_ED_INDEX_222_INJ.P_CODE_SH_TO_GND K_ED_INDEX_222_INJ.P_CODE_SH_TO_UB K_ED_INDEX_223_INJ.P_CODE_OPENLOAD K_ED_INDEX_223_INJ.P_CODE_SH_TO_GND K_ED_INDEX_223_INJ.P_CODE_SH_TO_UB K_ED_MIL_MASKE K_ED_RBM_TIME_SLP K_ED_SCDN_ABDECKUNG_AUSTRAG K_ED_SCDN_ABDECKUNG_EINTRAG K_ED_SK_TR_INJ.DEC_NACH_EINTRAG K_ED_SK_TR_INJ.DEC_VOR_EINTRAG K_ED_SK_TR_INJ.FEHLERSCHWELLE K_ED_SK_TR_INJ.INC_NACH_EINTRAG K_ED_SK_TR_INJ.INC_VOR_EINTRAG K_ED_SK_TR_INJ.OK_SCHWELLE K_ED_SK_TR_INJ.P_CODE_OPENLOAD K_ED_SK_TR_INJ.P_CODE_SH_TO_GND K_ED_SK_TR_INJ.P_CODE_SH_TO_UB K_ED_SK_TR_INJ.P_CODE_UNPLAUSIBEL K_ED_RBM_EVAP_TEMP_DELTA /end REF_CHARACTERISTIC
/end GROUP
/begin GROUP G_z_Unidentified___maps "z Unidentified - maps" ROOT
 /begin REF_CHARACTERISTIC UNK_KL_03C28 UNK_KL_PKS_PLAU_INC_2 UNK_KF_MISC_004BC UNK_KF_MISC_02932 UNK_KF_MISC_02A24 UNK_KF_MISC_02B16 UNK_KF_MISC_02C08 UNK_KF_MISC_02CFA UNK_KF_MISC_02DEC UNK_KF_MISC_02EDE UNK_KF_MISC_02FD0 UNK_KF_MISC_030C2 UNK_KL_ANSAUGLU_03C0E UNK_KL_MISC_0582A UNK_KF_AKTIVEPL_064BC UNK_KF_AKTIVEPL_06682 UNK_KF_SEKUNDRL_087BE UNK_KL_MISC_0892E UNK_KF_MISC_08940 UNK_KF_MISC_089AC UNK_KL_VANOS_0A514 UNK_KL_MISC_0B646 UNK_KL_MISC_0059E UNK_KL_MISC_005B8 UNK_KL_MISC_005F2 UNK_KF_MISC_0062E UNK_KF_MISC_00780 UNK_KL_MISC_02208 UNK_KL_MISC_02216 UNK_KL_MISC_02224 UNK_KL_MISC_0290A UNK_KF_MISC_031B4 UNK_KF_MISC_032A6 UNK_KF_MISC_03398 UNK_KF_MISC_0348A UNK_KF_MISC_0357C UNK_KF_MISC_0366E UNK_KF_MISC_03760 UNK_KF_MISC_03852 UNK_KF_MISC_03944 UNK_KL_MISC_03E1E UNK_KL_MISC_03E30 UNK_KL_MISC_03E42 UNK_KL_MISC_03E5E UNK_KL_MISC_03E7E UNK_KL_MISC_03E90 UNK_KL_MISC_03EBC UNK_KF_MISC_03ED6 UNK_KF_MISC_03F08 UNK_KF_MISC_03F6C UNK_KF_MISC_03F9E UNK_KF_MISC_04060 UNK_KL_KATALYSA_0414C UNK_KL_KATALYSA_0415E UNK_KL_MISC_0580A UNK_KL_MISC_05818 UNK_KF_MISC_065E0 UNK_KL_KATALYSA_072C8 UNK_KL_KATALYSA_072EA UNK_KL_KATALYSA_073D6 UNK_KL_KATALYSA_073E4 UNK_KL_MISC_07610 UNK_KL_POWERMAN_07728 UNK_KL_POWERMAN_079BC UNK_KL_MISC_07A8A UNK_KL_POWERMAN_07FD0 UNK_KL_POWERMAN_07FEC UNK_KL_POWERMAN_0800E UNK_KF_ANSAUGLU_08874 UNK_KL_MISC_08D34 UNK_KL_MISC_08D42 /end REF_CHARACTERISTIC
/end GROUP
/end MODULE
/end PROJECT
