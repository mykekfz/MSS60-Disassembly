ASAP2_VERSION 1 60
/begin PROJECT MSS60_V762_INJ "MSS60 (S65) V762 INJ CPU - generated 04.11.2026 from the reverse-engineered XDF"
/begin HEADER "Calibration description (characteristics from the XDF; measurements = V530 RAM names transferred to V762 addresses, confidence in each long identifier). Status tag in every long identifier: verified (checked against the code) / A2L-ref (placed from the V530 A2L) / EST (estimated) / unassigned (UNK placeholder)." VERSION "V762-RE-04112026" /end HEADER
/begin MODULE INJ "MSS60 V762 INJ"
/begin MOD_COMMON "" BYTE_ORDER MSB_FIRST ALIGNMENT_BYTE 1 ALIGNMENT_WORD 2 ALIGNMENT_LONG 4 /end MOD_COMMON
/begin MEASUREMENT ed_fil_te_obd_1.fehler_aufrufe_nv "Gesamtzahl der Fehleraufrufe [RAM name from V530, interpolated]" UBYTE M_FORMULA_0003 0 0 0 255 ECU_ADDRESS 0x3FA6C5 /end MEASUREMENT
/begin MEASUREMENT ed_fil_te_obd_1.filter_max_nv "Maximaler Fehlerfilterwert [RAM name from V530, interpolated]" UBYTE M_FORMULA_0003 0 0 0 255 ECU_ADDRESS 0x3FA6C4 /end MEASUREMENT
/begin MEASUREMENT ed_fil_te_obd_2.filter_nv "Filterwert vor und nach Eintrag [RAM name from V530, interpolated]" UBYTE M_FORMULA_0003 0 0 0 255 ECU_ADDRESS 0x3FA6C6 /end MEASUREMENT
/begin MEASUREMENT ed_fil_te_obd_2.zyklus_filter_nv "Vorwaertsfilter zur Fehlerzustandsbestaetigung [RAM name from V530, interpolated]" UBYTE M_FORMULA_0003 0 0 0 255 ECU_ADDRESS 0x3FA6C7 /end MEASUREMENT
/begin MEASUREMENT ed_fil_te_obd_2.fehler_aufrufe_nv "Gesamtzahl der Fehleraufrufe [RAM name from V530, interpolated]" UBYTE M_FORMULA_0003 0 0 0 255 ECU_ADDRESS 0x3FA6CB /end MEASUREMENT
/begin MEASUREMENT ed_fil_te_obd_2.filter_max_nv "Maximaler Fehlerfilterwert [RAM name from V530, interpolated]" UBYTE M_FORMULA_0003 0 0 0 255 ECU_ADDRESS 0x3FA6CA /end MEASUREMENT
/begin MEASUREMENT ed_fil_tev1.filter_nv "Filterwert vor und nach Eintrag [RAM name from V530, interpolated]" UBYTE M_FORMULA_0003 0 0 0 255 ECU_ADDRESS 0x3FA6CC /end MEASUREMENT
/begin MEASUREMENT ed_fil_tev1.zyklus_filter_nv "Vorwaertsfilter zur Fehlerzustandsbestaetigung [RAM name from V530, interpolated]" UBYTE M_FORMULA_0003 0 0 0 255 ECU_ADDRESS 0x3FA6CD /end MEASUREMENT
/begin MEASUREMENT ed_fil_tev1.fehler_aufrufe_nv "Gesamtzahl der Fehleraufrufe [RAM name from V530, interpolated]" UBYTE M_FORMULA_0003 0 0 0 255 ECU_ADDRESS 0x3FA6D1 /end MEASUREMENT
/begin MEASUREMENT ed_fil_tev1.filter_max_nv "Maximaler Fehlerfilterwert [RAM name from V530, interpolated]" UBYTE M_FORMULA_0003 0 0 0 255 ECU_ADDRESS 0x3FA6D0 /end MEASUREMENT
/begin MEASUREMENT ed_fil_tev2.filter_nv "Filterwert vor und nach Eintrag [RAM name from V530, interpolated]" UBYTE M_FORMULA_0003 0 0 0 255 ECU_ADDRESS 0x3FA6D2 /end MEASUREMENT
/begin MEASUREMENT ed_fil_tev2.zyklus_filter_nv "Vorwaertsfilter zur Fehlerzustandsbestaetigung [RAM name from V530, interpolated]" UBYTE M_FORMULA_0003 0 0 0 255 ECU_ADDRESS 0x3FA6D3 /end MEASUREMENT
/begin MEASUREMENT ed_fil_e2_inj.filter_nv "Filterwert vor und nach Eintrag [RAM name from V530, interpolated]" UBYTE M_FORMULA_0003 0 0 0 255 ECU_ADDRESS 0x3FA6D8 /end MEASUREMENT
/begin MEASUREMENT ed_fil_e2_inj.zyklus_filter_nv "Vorwaertsfilter zur Fehlerzustandsbestaetigung [RAM name from V530, interpolated]" UBYTE M_FORMULA_0003 0 0 0 255 ECU_ADDRESS 0x3FA6D9 /end MEASUREMENT
/begin MEASUREMENT ed_fil_tev2.fehler_aufrufe_nv "Gesamtzahl der Fehleraufrufe [RAM name from V530, interpolated]" UBYTE M_FORMULA_0003 0 0 0 255 ECU_ADDRESS 0x3FA6D7 /end MEASUREMENT
/begin MEASUREMENT ed_fil_tev2.filter_max_nv "Maximaler Fehlerfilterwert [RAM name from V530, interpolated]" UBYTE M_FORMULA_0003 0 0 0 255 ECU_ADDRESS 0x3FA6D6 /end MEASUREMENT
/begin MEASUREMENT ed_fil_e2_inj.fehler_aufrufe_nv "Gesamtzahl der Fehleraufrufe [RAM name from V530, interpolated]" UBYTE M_FORMULA_0003 0 0 0 255 ECU_ADDRESS 0x3FA6DD /end MEASUREMENT
/begin MEASUREMENT ed_fil_e2_inj.filter_max_nv "Maximaler Fehlerfilterwert [RAM name from V530, interpolated]" UBYTE M_FORMULA_0003 0 0 0 255 ECU_ADDRESS 0x3FA6DC /end MEASUREMENT
/begin MEASUREMENT ed_fil_kw.filter_nv "Filterwert vor und nach Eintrag [RAM name from V530, interpolated]" UBYTE M_FORMULA_0003 0 0 0 255 ECU_ADDRESS 0x3FA6DE /end MEASUREMENT
/begin MEASUREMENT ed_fil_kw.zyklus_filter_nv "Vorwaertsfilter zur Fehlerzustandsbestaetigung [RAM name from V530, interpolated]" UBYTE M_FORMULA_0003 0 0 0 255 ECU_ADDRESS 0x3FA6DF /end MEASUREMENT
/begin MEASUREMENT ed_fil_fst.art_aktuell_nv "Fehlerart und Statusbits [RAM name from V530, interpolated]" UWORD NO_COMPU_METHOD 0 0 0 65535 ECU_ADDRESS 0x3FA6FE FORMAT "%.4g" /end MEASUREMENT
/begin MEASUREMENT ed_fil_fst.fehler_aufrufe_nv "Gesamtzahl der Fehleraufrufe [RAM name from V530, interpolated]" UBYTE M_FORMULA_0003 0 0 0 255 ECU_ADDRESS 0x3FA701 /end MEASUREMENT
/begin MEASUREMENT ed_fil_fst.filter_max_nv "Maximaler Fehlerfilterwert [RAM name from V530, interpolated]" UBYTE M_FORMULA_0003 0 0 0 255 ECU_ADDRESS 0x3FA700 /end MEASUREMENT
/begin MEASUREMENT ed_fil_fst.filter_nv "Filterwert vor und nach Eintrag [RAM name from V530, interpolated]" UBYTE M_FORMULA_0003 0 0 0 255 ECU_ADDRESS 0x3FA6FC /end MEASUREMENT
/begin MEASUREMENT ed_fil_fst.zyklus_filter_nv "Vorwaertsfilter zur Fehlerzustandsbestaetigung [RAM name from V530, interpolated]" UBYTE M_FORMULA_0003 0 0 0 255 ECU_ADDRESS 0x3FA6FD /end MEASUREMENT
/begin MEASUREMENT ed_fil_kge1.art_aktuell_nv "Fehlerart und Statusbits [RAM name from V530, interpolated]" UWORD NO_COMPU_METHOD 0 0 0 65535 ECU_ADDRESS 0x3FA6F2 FORMAT "%.4g" /end MEASUREMENT
/begin MEASUREMENT ed_fil_kge1.fehler_aufrufe_nv "Gesamtzahl der Fehleraufrufe [RAM name from V530, interpolated]" UBYTE M_FORMULA_0003 0 0 0 255 ECU_ADDRESS 0x3FA6F5 /end MEASUREMENT
/begin MEASUREMENT ed_fil_kge1.filter_max_nv "Maximaler Fehlerfilterwert [RAM name from V530, interpolated]" UBYTE M_FORMULA_0003 0 0 0 255 ECU_ADDRESS 0x3FA6F4 /end MEASUREMENT
/begin MEASUREMENT ed_fil_kge1.filter_nv "Filterwert vor und nach Eintrag [RAM name from V530, interpolated]" UBYTE M_FORMULA_0003 0 0 0 255 ECU_ADDRESS 0x3FA6F0 /end MEASUREMENT
/begin MEASUREMENT ed_fil_kge1.zyklus_filter_nv "Vorwaertsfilter zur Fehlerzustandsbestaetigung [RAM name from V530, interpolated]" UBYTE M_FORMULA_0003 0 0 0 255 ECU_ADDRESS 0x3FA6F1 /end MEASUREMENT
/begin MEASUREMENT ed_fil_kge2.art_aktuell_nv "Fehlerart und Statusbits [RAM name from V530, interpolated]" UWORD NO_COMPU_METHOD 0 0 0 65535 ECU_ADDRESS 0x3FA6F8 FORMAT "%.4g" /end MEASUREMENT
/begin MEASUREMENT ed_fil_kge2.fehler_aufrufe_nv "Gesamtzahl der Fehleraufrufe [RAM name from V530, interpolated]" UBYTE M_FORMULA_0003 0 0 0 255 ECU_ADDRESS 0x3FA6FB /end MEASUREMENT
/begin MEASUREMENT ed_fil_kge2.filter_max_nv "Maximaler Fehlerfilterwert [RAM name from V530, interpolated]" UBYTE M_FORMULA_0003 0 0 0 255 ECU_ADDRESS 0x3FA6FA /end MEASUREMENT
/begin MEASUREMENT ed_fil_kge2.filter_nv "Filterwert vor und nach Eintrag [RAM name from V530, interpolated]" UBYTE M_FORMULA_0003 0 0 0 255 ECU_ADDRESS 0x3FA6F6 /end MEASUREMENT
/begin MEASUREMENT ed_fil_kge2.zyklus_filter_nv "Vorwaertsfilter zur Fehlerzustandsbestaetigung [RAM name from V530, interpolated]" UBYTE M_FORMULA_0003 0 0 0 255 ECU_ADDRESS 0x3FA6F7 /end MEASUREMENT
/begin MEASUREMENT ed_fil_kw.fehler_aufrufe_nv "Gesamtzahl der Fehleraufrufe [RAM name from V530, interpolated]" UBYTE M_FORMULA_0003 0 0 0 255 ECU_ADDRESS 0x3FA6E3 /end MEASUREMENT
/begin MEASUREMENT ed_fil_kw.filter_max_nv "Maximaler Fehlerfilterwert [RAM name from V530, interpolated]" UBYTE M_FORMULA_0003 0 0 0 255 ECU_ADDRESS 0x3FA6E2 /end MEASUREMENT
/begin MEASUREMENT ed_fil_la1_adapt.art_aktuell_nv "Fehlerart und Statusbits [RAM name from V530, interpolated]" UWORD NO_COMPU_METHOD 0 0 0 65535 ECU_ADDRESS 0x3FA6E6 FORMAT "%.4g" /end MEASUREMENT
/begin MEASUREMENT ed_fil_la1_adapt.fehler_aufrufe_nv "Gesamtzahl der Fehleraufrufe [RAM name from V530, interpolated]" UBYTE M_FORMULA_0003 0 0 0 255 ECU_ADDRESS 0x3FA6E9 /end MEASUREMENT
/begin MEASUREMENT ed_fil_la1_adapt.filter_max_nv "Maximaler Fehlerfilterwert [RAM name from V530, interpolated]" UBYTE M_FORMULA_0003 0 0 0 255 ECU_ADDRESS 0x3FA6E8 /end MEASUREMENT
/begin MEASUREMENT ed_fil_la1_adapt.filter_nv "Filterwert vor und nach Eintrag [RAM name from V530, interpolated]" UBYTE M_FORMULA_0003 0 0 0 255 ECU_ADDRESS 0x3FA6E4 /end MEASUREMENT
/begin MEASUREMENT ed_fil_la1_adapt.zyklus_filter_nv "Vorwaertsfilter zur Fehlerzustandsbestaetigung [RAM name from V530, interpolated]" UBYTE M_FORMULA_0003 0 0 0 255 ECU_ADDRESS 0x3FA6E5 /end MEASUREMENT
/begin MEASUREMENT ed_fil_la2_adapt.art_aktuell_nv "Fehlerart und Statusbits [RAM name from V530, interpolated]" UWORD NO_COMPU_METHOD 0 0 0 65535 ECU_ADDRESS 0x3FA6EC FORMAT "%.4g" /end MEASUREMENT
/begin MEASUREMENT ed_fil_la2_adapt.fehler_aufrufe_nv "Gesamtzahl der Fehleraufrufe [RAM name from V530, interpolated]" UBYTE M_FORMULA_0003 0 0 0 255 ECU_ADDRESS 0x3FA6EF /end MEASUREMENT
/begin MEASUREMENT ed_fil_la2_adapt.filter_max_nv "Maximaler Fehlerfilterwert [RAM name from V530, interpolated]" UBYTE M_FORMULA_0003 0 0 0 255 ECU_ADDRESS 0x3FA6EE /end MEASUREMENT
/begin MEASUREMENT ed_fil_la2_adapt.filter_nv "Filterwert vor und nach Eintrag [RAM name from V530, interpolated]" UBYTE M_FORMULA_0003 0 0 0 255 ECU_ADDRESS 0x3FA6EA /end MEASUREMENT
/begin MEASUREMENT ed_fil_la2_adapt.zyklus_filter_nv "Vorwaertsfilter zur Fehlerzustandsbestaetigung [RAM name from V530, interpolated]" UBYTE M_FORMULA_0003 0 0 0 255 ECU_ADDRESS 0x3FA6EB /end MEASUREMENT
/begin MEASUREMENT ed_fil_sl_durchs_b1.art_aktuell_nv "Fehlerart und Statusbits [RAM name from V530, interpolated]" UWORD NO_COMPU_METHOD 0 0 0 65535 ECU_ADDRESS 0x3FA70A FORMAT "%.4g" /end MEASUREMENT
/begin MEASUREMENT ed_fil_sl_durchs_b1.fehler_aufrufe_nv "Gesamtzahl der Fehleraufrufe [RAM name from V530, interpolated]" UBYTE M_FORMULA_0003 0 0 0 255 ECU_ADDRESS 0x3FA70D /end MEASUREMENT
/begin MEASUREMENT ed_fil_sl_durchs_b1.filter_max_nv "Maximaler Fehlerfilterwert [RAM name from V530, interpolated]" UBYTE M_FORMULA_0003 0 0 0 255 ECU_ADDRESS 0x3FA70C /end MEASUREMENT
/begin MEASUREMENT ed_fil_sl_durchs_b1.filter_nv "Filterwert vor und nach Eintrag [RAM name from V530, interpolated]" UBYTE M_FORMULA_0003 0 0 0 255 ECU_ADDRESS 0x3FA708 /end MEASUREMENT
/begin MEASUREMENT ed_fil_sl_durchs_b1.zyklus_filter_nv "Vorwaertsfilter zur Fehlerzustandsbestaetigung [RAM name from V530, interpolated]" UBYTE M_FORMULA_0003 0 0 0 255 ECU_ADDRESS 0x3FA709 /end MEASUREMENT
/begin MEASUREMENT ed_fil_sl_durchs_b2.art_aktuell_nv "Fehlerart und Statusbits [RAM name from V530, interpolated]" UWORD NO_COMPU_METHOD 0 0 0 65535 ECU_ADDRESS 0x3FA710 FORMAT "%.4g" /end MEASUREMENT
/begin MEASUREMENT ed_fil_sl_durchs_b2.fehler_aufrufe_nv "Gesamtzahl der Fehleraufrufe [RAM name from V530, interpolated]" UBYTE M_FORMULA_0003 0 0 0 255 ECU_ADDRESS 0x3FA713 /end MEASUREMENT
/begin MEASUREMENT ed_fil_sl_durchs_b2.filter_max_nv "Maximaler Fehlerfilterwert [RAM name from V530, interpolated]" UBYTE M_FORMULA_0003 0 0 0 255 ECU_ADDRESS 0x3FA712 /end MEASUREMENT
/begin MEASUREMENT ed_fil_sl_durchs_b2.filter_nv "Filterwert vor und nach Eintrag [RAM name from V530, interpolated]" UBYTE M_FORMULA_0003 0 0 0 255 ECU_ADDRESS 0x3FA70E /end MEASUREMENT
/begin MEASUREMENT ed_fil_sl_durchs_b2.zyklus_filter_nv "Vorwaertsfilter zur Fehlerzustandsbestaetigung [RAM name from V530, interpolated]" UBYTE M_FORMULA_0003 0 0 0 255 ECU_ADDRESS 0x3FA70F /end MEASUREMENT
/begin MEASUREMENT ed_fil_sl_durchs_hstrang.filter_nv "Filterwert vor und nach Eintrag [RAM name from V530, interpolated]" UBYTE M_FORMULA_0003 0 0 0 255 ECU_ADDRESS 0x3FA714 /end MEASUREMENT
/begin MEASUREMENT ed_fil_sl_durchs_hstrang.zyklus_filter_nv "Vorwaertsfilter zur Fehlerzustandsbestaetigung [RAM name from V530, interpolated]" UBYTE M_FORMULA_0003 0 0 0 255 ECU_ADDRESS 0x3FA715 /end MEASUREMENT
/begin MEASUREMENT ed_fil_slp.art_aktuell_nv "Fehlerart und Statusbits [RAM name from V530, interpolated]" UWORD NO_COMPU_METHOD 0 0 0 65535 ECU_ADDRESS 0x3FA704 FORMAT "%.4g" /end MEASUREMENT
/begin MEASUREMENT ed_fil_slp.fehler_aufrufe_nv "Gesamtzahl der Fehleraufrufe [RAM name from V530, interpolated]" UBYTE M_FORMULA_0003 0 0 0 255 ECU_ADDRESS 0x3FA707 /end MEASUREMENT
/begin MEASUREMENT ed_fil_slp.filter_max_nv "Maximaler Fehlerfilterwert [RAM name from V530, interpolated]" UBYTE M_FORMULA_0003 0 0 0 255 ECU_ADDRESS 0x3FA706 /end MEASUREMENT
/begin MEASUREMENT ed_fil_slp.filter_nv "Filterwert vor und nach Eintrag [RAM name from V530, interpolated]" UBYTE M_FORMULA_0003 0 0 0 255 ECU_ADDRESS 0x3FA702 /end MEASUREMENT
/begin MEASUREMENT ed_fil_slp.zyklus_filter_nv "Vorwaertsfilter zur Fehlerzustandsbestaetigung [RAM name from V530, interpolated]" UBYTE M_FORMULA_0003 0 0 0 255 ECU_ADDRESS 0x3FA703 /end MEASUREMENT
/begin MEASUREMENT ed_fil_fetrawe.filter_nv "Filterwert vor und nach Eintrag [RAM name from V530, interpolated]" UBYTE M_FORMULA_0003 0 0 0 255 ECU_ADDRESS 0x3FA71A /end MEASUREMENT
/begin MEASUREMENT ed_fil_fetrawe.zyklus_filter_nv "Vorwaertsfilter zur Fehlerzustandsbestaetigung [RAM name from V530, interpolated]" UBYTE M_FORMULA_0003 0 0 0 255 ECU_ADDRESS 0x3FA71B /end MEASUREMENT
/begin MEASUREMENT ed_fil_sl_durchs_hstrang.fehler_aufrufe_nv "Gesamtzahl der Fehleraufrufe [RAM name from V530, interpolated]" UBYTE M_FORMULA_0003 0 0 0 255 ECU_ADDRESS 0x3FA719 /end MEASUREMENT
/begin MEASUREMENT ed_fil_sl_durchs_hstrang.filter_max_nv "Maximaler Fehlerfilterwert [RAM name from V530, interpolated]" UBYTE M_FORMULA_0003 0 0 0 255 ECU_ADDRESS 0x3FA718 /end MEASUREMENT
/begin MEASUREMENT ed_fil_fetrawe.fehler_aufrufe_nv "Gesamtzahl der Fehleraufrufe [RAM name from V530, interpolated]" UBYTE M_FORMULA_0003 0 0 0 255 ECU_ADDRESS 0x3FA71F /end MEASUREMENT
/begin MEASUREMENT ed_fil_fetrawe.filter_max_nv "Maximaler Fehlerfilterwert [RAM name from V530, interpolated]" UBYTE M_FORMULA_0003 0 0 0 255 ECU_ADDRESS 0x3FA71E /end MEASUREMENT
/begin MEASUREMENT ed_fil_s_getr_hs.filter_nv "Filterwert vor und nach Eintrag [RAM name from V530, interpolated]" UBYTE M_FORMULA_0003 0 0 0 255 ECU_ADDRESS 0x3FA720 /end MEASUREMENT
/begin MEASUREMENT ed_fil_s_getr_hs.zyklus_filter_nv "Vorwaertsfilter zur Fehlerzustandsbestaetigung [RAM name from V530, interpolated]" UBYTE M_FORMULA_0003 0 0 0 255 ECU_ADDRESS 0x3FA721 /end MEASUREMENT
/begin MEASUREMENT ed_fil_s_getr_hs.fehler_aufrufe_nv "Gesamtzahl der Fehleraufrufe [RAM name from V530, interpolated]" UBYTE M_FORMULA_0003 0 0 0 255 ECU_ADDRESS 0x3FA725 /end MEASUREMENT
/begin MEASUREMENT ed_fil_s_getr_hs.filter_max_nv "Maximaler Fehlerfilterwert [RAM name from V530, interpolated]" UBYTE M_FORMULA_0003 0 0 0 255 ECU_ADDRESS 0x3FA724 /end MEASUREMENT
/begin MEASUREMENT ed_fil_s_kupp_hs.filter_nv "Filterwert vor und nach Eintrag [RAM name from V530, interpolated]" UBYTE M_FORMULA_0003 0 0 0 255 ECU_ADDRESS 0x3FA726 /end MEASUREMENT
/begin MEASUREMENT ed_fil_s_kupp_hs.zyklus_filter_nv "Vorwaertsfilter zur Fehlerzustandsbestaetigung [RAM name from V530, interpolated]" UBYTE M_FORMULA_0003 0 0 0 255 ECU_ADDRESS 0x3FA727 /end MEASUREMENT
/begin MEASUREMENT ed_fil_s_kupp_hs.fehler_aufrufe_nv "Gesamtzahl der Fehleraufrufe [RAM name from V530, interpolated]" UBYTE M_FORMULA_0003 0 0 0 255 ECU_ADDRESS 0x3FA72B /end MEASUREMENT
/begin MEASUREMENT ed_fil_s_kupp_hs.filter_max_nv "Maximaler Fehlerfilterwert [RAM name from V530, interpolated]" UBYTE M_FORMULA_0003 0 0 0 255 ECU_ADDRESS 0x3FA72A /end MEASUREMENT
/begin MEASUREMENT ed_fil_van_druck.filter_nv "Filterwert vor und nach Eintrag [RAM name from V530, interpolated]" UBYTE M_FORMULA_0003 0 0 0 255 ECU_ADDRESS 0x3FA72C /end MEASUREMENT
/begin MEASUREMENT ed_fil_van_druck.zyklus_filter_nv "Vorwaertsfilter zur Fehlerzustandsbestaetigung [RAM name from V530, interpolated]" UBYTE M_FORMULA_0003 0 0 0 255 ECU_ADDRESS 0x3FA72D /end MEASUREMENT
/begin MEASUREMENT ed_fil_elu.filter_nv "Filterwert vor und nach Eintrag [RAM name from V530, interpolated]" UBYTE M_FORMULA_0003 0 0 0 255 ECU_ADDRESS 0x3FA738 /end MEASUREMENT
/begin MEASUREMENT ed_fil_elu.zyklus_filter_nv "Vorwaertsfilter zur Fehlerzustandsbestaetigung [RAM name from V530, interpolated]" UBYTE M_FORMULA_0003 0 0 0 255 ECU_ADDRESS 0x3FA739 /end MEASUREMENT
/begin MEASUREMENT ed_fil_elup.art_aktuell_nv "Fehlerart und Statusbits [RAM name from V530, interpolated]" UWORD NO_COMPU_METHOD 0 0 0 65535 ECU_ADDRESS 0x3FA734 FORMAT "%.4g" /end MEASUREMENT
/begin MEASUREMENT ed_fil_elup.fehler_aufrufe_nv "Gesamtzahl der Fehleraufrufe [RAM name from V530, interpolated]" UBYTE M_FORMULA_0003 0 0 0 255 ECU_ADDRESS 0x3FA737 /end MEASUREMENT
/begin MEASUREMENT ed_fil_elup.filter_max_nv "Maximaler Fehlerfilterwert [RAM name from V530, interpolated]" UBYTE M_FORMULA_0003 0 0 0 255 ECU_ADDRESS 0x3FA736 /end MEASUREMENT
/begin MEASUREMENT ed_fil_elup.filter_nv "Filterwert vor und nach Eintrag [RAM name from V530, interpolated]" UBYTE M_FORMULA_0003 0 0 0 255 ECU_ADDRESS 0x3FA732 /end MEASUREMENT
/begin MEASUREMENT ed_fil_elup.zyklus_filter_nv "Vorwaertsfilter zur Fehlerzustandsbestaetigung [RAM name from V530, interpolated]" UBYTE M_FORMULA_0003 0 0 0 255 ECU_ADDRESS 0x3FA733 /end MEASUREMENT
/begin MEASUREMENT ed_fil_van_druck.fehler_aufrufe_nv "Gesamtzahl der Fehleraufrufe [RAM name from V530, interpolated]" UBYTE M_FORMULA_0003 0 0 0 255 ECU_ADDRESS 0x3FA731 /end MEASUREMENT
/begin MEASUREMENT ed_fil_van_druck.filter_max_nv "Maximaler Fehlerfilterwert [RAM name from V530, interpolated]" UBYTE M_FORMULA_0003 0 0 0 255 ECU_ADDRESS 0x3FA730 /end MEASUREMENT
/begin MEASUREMENT ed_fil_elu.fehler_aufrufe_nv "Gesamtzahl der Fehleraufrufe [RAM name from V530, interpolated]" UBYTE M_FORMULA_0003 0 0 0 255 ECU_ADDRESS 0x3FA73D /end MEASUREMENT
/begin MEASUREMENT ed_fil_elu.filter_max_nv "Maximaler Fehlerfilterwert [RAM name from V530, interpolated]" UBYTE M_FORMULA_0003 0 0 0 255 ECU_ADDRESS 0x3FA73C /end MEASUREMENT
/begin MEASUREMENT ed_fil_fst_geber.art_aktuell_nv "Fehlerart und Statusbits [RAM name from V530, interpolated]" UWORD NO_COMPU_METHOD 0 0 0 65535 ECU_ADDRESS 0x3FA76A FORMAT "%.4g" /end MEASUREMENT
/begin MEASUREMENT ed_fil_fst_geber.fehler_aufrufe_nv "Gesamtzahl der Fehleraufrufe [RAM name from V530, interpolated]" UBYTE M_FORMULA_0003 0 0 0 255 ECU_ADDRESS 0x3FA76D /end MEASUREMENT
/begin MEASUREMENT ed_fil_fst_geber.filter_max_nv "Maximaler Fehlerfilterwert [RAM name from V530, interpolated]" UBYTE M_FORMULA_0003 0 0 0 255 ECU_ADDRESS 0x3FA76C /end MEASUREMENT
/begin MEASUREMENT ed_fil_fst_geber.filter_nv "Filterwert vor und nach Eintrag [RAM name from V530, interpolated]" UBYTE M_FORMULA_0003 0 0 0 255 ECU_ADDRESS 0x3FA768 /end MEASUREMENT
/begin MEASUREMENT ed_fil_fst_geber.zyklus_filter_nv "Vorwaertsfilter zur Fehlerzustandsbestaetigung [RAM name from V530, interpolated]" UBYTE M_FORMULA_0003 0 0 0 255 ECU_ADDRESS 0x3FA769 /end MEASUREMENT
/begin MEASUREMENT ed_fil_kats_b1.art_aktuell_nv "Fehlerart und Statusbits [RAM name from V530, interpolated]" UWORD NO_COMPU_METHOD 0 0 0 65535 ECU_ADDRESS 0x3FA752 FORMAT "%.4g" /end MEASUREMENT
/begin MEASUREMENT ed_fil_kats_b1.fehler_aufrufe_nv "Gesamtzahl der Fehleraufrufe [RAM name from V530, interpolated]" UBYTE M_FORMULA_0003 0 0 0 255 ECU_ADDRESS 0x3FA755 /end MEASUREMENT
/begin MEASUREMENT ed_fil_kats_b1.filter_max_nv "Maximaler Fehlerfilterwert [RAM name from V530, interpolated]" UBYTE M_FORMULA_0003 0 0 0 255 ECU_ADDRESS 0x3FA754 /end MEASUREMENT
/begin MEASUREMENT ed_fil_kats_b1.filter_nv "Filterwert vor und nach Eintrag [RAM name from V530, interpolated]" UBYTE M_FORMULA_0003 0 0 0 255 ECU_ADDRESS 0x3FA750 /end MEASUREMENT
/begin MEASUREMENT ed_fil_kats_b1.zyklus_filter_nv "Vorwaertsfilter zur Fehlerzustandsbestaetigung [RAM name from V530, interpolated]" UBYTE M_FORMULA_0003 0 0 0 255 ECU_ADDRESS 0x3FA751 /end MEASUREMENT
/begin MEASUREMENT ed_fil_kats_b2.art_aktuell_nv "Fehlerart und Statusbits [RAM name from V530, interpolated]" UWORD NO_COMPU_METHOD 0 0 0 65535 ECU_ADDRESS 0x3FA758 FORMAT "%.4g" /end MEASUREMENT
/begin MEASUREMENT ed_fil_kats_b2.fehler_aufrufe_nv "Gesamtzahl der Fehleraufrufe [RAM name from V530, interpolated]" UBYTE M_FORMULA_0003 0 0 0 255 ECU_ADDRESS 0x3FA75B /end MEASUREMENT
/begin MEASUREMENT ed_fil_kats_b2.filter_max_nv "Maximaler Fehlerfilterwert [RAM name from V530, interpolated]" UBYTE M_FORMULA_0003 0 0 0 255 ECU_ADDRESS 0x3FA75A /end MEASUREMENT
/begin MEASUREMENT ed_fil_kats_b2.filter_nv "Filterwert vor und nach Eintrag [RAM name from V530, interpolated]" UBYTE M_FORMULA_0003 0 0 0 255 ECU_ADDRESS 0x3FA756 /end MEASUREMENT
/begin MEASUREMENT ed_fil_kats_b2.zyklus_filter_nv "Vorwaertsfilter zur Fehlerzustandsbestaetigung [RAM name from V530, interpolated]" UBYTE M_FORMULA_0003 0 0 0 255 ECU_ADDRESS 0x3FA757 /end MEASUREMENT
/begin MEASUREMENT ed_fil_ksd1.art_aktuell_nv "Fehlerart und Statusbits [RAM name from V530, interpolated]" UWORD NO_COMPU_METHOD 0 0 0 65535 ECU_ADDRESS 0x3FA746 FORMAT "%.4g" /end MEASUREMENT
/begin MEASUREMENT ed_fil_ksd1.fehler_aufrufe_nv "Gesamtzahl der Fehleraufrufe [RAM name from V530, interpolated]" UBYTE M_FORMULA_0003 0 0 0 255 ECU_ADDRESS 0x3FA749 /end MEASUREMENT
/begin MEASUREMENT ed_fil_ksd1.filter_max_nv "Maximaler Fehlerfilterwert [RAM name from V530, interpolated]" UBYTE M_FORMULA_0003 0 0 0 255 ECU_ADDRESS 0x3FA748 /end MEASUREMENT
/begin MEASUREMENT ed_fil_ksd1.filter_nv "Filterwert vor und nach Eintrag [RAM name from V530, interpolated]" UBYTE M_FORMULA_0003 0 0 0 255 ECU_ADDRESS 0x3FA744 /end MEASUREMENT
/begin MEASUREMENT ed_fil_ksd1.zyklus_filter_nv "Vorwaertsfilter zur Fehlerzustandsbestaetigung [RAM name from V530, interpolated]" UBYTE M_FORMULA_0003 0 0 0 255 ECU_ADDRESS 0x3FA745 /end MEASUREMENT
/begin MEASUREMENT ed_fil_ksd2.art_aktuell_nv "Fehlerart und Statusbits [RAM name from V530, interpolated]" UWORD NO_COMPU_METHOD 0 0 0 65535 ECU_ADDRESS 0x3FA74C FORMAT "%.4g" /end MEASUREMENT
/begin MEASUREMENT ed_fil_ksd2.fehler_aufrufe_nv "Gesamtzahl der Fehleraufrufe [RAM name from V530, interpolated]" UBYTE M_FORMULA_0003 0 0 0 255 ECU_ADDRESS 0x3FA74F /end MEASUREMENT
/begin MEASUREMENT ed_fil_ksd2.filter_max_nv "Maximaler Fehlerfilterwert [RAM name from V530, interpolated]" UBYTE M_FORMULA_0003 0 0 0 255 ECU_ADDRESS 0x3FA74E /end MEASUREMENT
/begin MEASUREMENT ed_fil_ksd2.filter_nv "Filterwert vor und nach Eintrag [RAM name from V530, interpolated]" UBYTE M_FORMULA_0003 0 0 0 255 ECU_ADDRESS 0x3FA74A /end MEASUREMENT
/begin MEASUREMENT ed_fil_ksd2.zyklus_filter_nv "Vorwaertsfilter zur Fehlerzustandsbestaetigung [RAM name from V530, interpolated]" UBYTE M_FORMULA_0003 0 0 0 255 ECU_ADDRESS 0x3FA74B /end MEASUREMENT
/begin MEASUREMENT ed_fil_pt_anfradmom.art_aktuell_nv "Fehlerart und Statusbits [RAM name from V530, interpolated]" UWORD NO_COMPU_METHOD 0 0 0 65535 ECU_ADDRESS 0x3FA764 FORMAT "%.4g" /end MEASUREMENT
/begin MEASUREMENT ed_fil_pt_anfradmom.fehler_aufrufe_nv "Gesamtzahl der Fehleraufrufe [RAM name from V530, interpolated]" UBYTE M_FORMULA_0003 0 0 0 255 ECU_ADDRESS 0x3FA767 /end MEASUREMENT
/begin MEASUREMENT ed_fil_pt_anfradmom.filter_max_nv "Maximaler Fehlerfilterwert [RAM name from V530, interpolated]" UBYTE M_FORMULA_0003 0 0 0 255 ECU_ADDRESS 0x3FA766 /end MEASUREMENT
/begin MEASUREMENT ed_fil_pt_anfradmom.filter_nv "Filterwert vor und nach Eintrag [RAM name from V530, interpolated]" UBYTE M_FORMULA_0003 0 0 0 255 ECU_ADDRESS 0x3FA762 /end MEASUREMENT
/begin MEASUREMENT ed_fil_pt_anfradmom.zyklus_filter_nv "Vorwaertsfilter zur Fehlerzustandsbestaetigung [RAM name from V530, interpolated]" UBYTE M_FORMULA_0003 0 0 0 255 ECU_ADDRESS 0x3FA763 /end MEASUREMENT
/begin MEASUREMENT ed_fil_pt_grb3.art_aktuell_nv "Fehlerart und Statusbits [RAM name from V530, interpolated]" UWORD NO_COMPU_METHOD 0 0 0 65535 ECU_ADDRESS 0x3FA75E FORMAT "%.4g" /end MEASUREMENT
/begin MEASUREMENT ed_fil_pt_grb3.fehler_aufrufe_nv "Gesamtzahl der Fehleraufrufe [RAM name from V530, interpolated]" UBYTE M_FORMULA_0003 0 0 0 255 ECU_ADDRESS 0x3FA761 /end MEASUREMENT
/begin MEASUREMENT ed_fil_pt_grb3.filter_max_nv "Maximaler Fehlerfilterwert [RAM name from V530, interpolated]" UBYTE M_FORMULA_0003 0 0 0 255 ECU_ADDRESS 0x3FA760 /end MEASUREMENT
/begin MEASUREMENT ed_fil_pt_grb3.filter_nv "Filterwert vor und nach Eintrag [RAM name from V530, interpolated]" UBYTE M_FORMULA_0003 0 0 0 255 ECU_ADDRESS 0x3FA75C /end MEASUREMENT
/begin MEASUREMENT ed_fil_pt_grb3.zyklus_filter_nv "Vorwaertsfilter zur Fehlerzustandsbestaetigung [RAM name from V530, interpolated]" UBYTE M_FORMULA_0003 0 0 0 255 ECU_ADDRESS 0x3FA75D /end MEASUREMENT
/begin MEASUREMENT ed_fil_pt_statanh.art_aktuell_nv "Fehlerart und Statusbits [RAM name from V530, interpolated]" UWORD NO_COMPU_METHOD 0 0 0 65535 ECU_ADDRESS 0x3FA740 FORMAT "%.4g" /end MEASUREMENT
/begin MEASUREMENT ed_fil_pt_statanh.fehler_aufrufe_nv "Gesamtzahl der Fehleraufrufe [RAM name from V530, interpolated]" UBYTE M_FORMULA_0003 0 0 0 255 ECU_ADDRESS 0x3FA743 /end MEASUREMENT
/begin MEASUREMENT ed_fil_pt_statanh.filter_max_nv "Maximaler Fehlerfilterwert [RAM name from V530, interpolated]" UBYTE M_FORMULA_0003 0 0 0 255 ECU_ADDRESS 0x3FA742 /end MEASUREMENT
/begin MEASUREMENT ed_fil_pt_statanh.filter_nv "Filterwert vor und nach Eintrag [RAM name from V530, interpolated]" UBYTE M_FORMULA_0003 0 0 0 255 ECU_ADDRESS 0x3FA73E /end MEASUREMENT
/begin MEASUREMENT ed_fil_pt_statanh.zyklus_filter_nv "Vorwaertsfilter zur Fehlerzustandsbestaetigung [RAM name from V530, interpolated]" UBYTE M_FORMULA_0003 0 0 0 255 ECU_ADDRESS 0x3FA73F /end MEASUREMENT
/begin MEASUREMENT ed_fil_tank_leer.filter_nv "Filterwert vor und nach Eintrag [RAM name from V530, interpolated]" UBYTE M_FORMULA_0003 0 0 0 255 ECU_ADDRESS 0x3FA76E /end MEASUREMENT
/begin MEASUREMENT ed_fil_tank_leer.zyklus_filter_nv "Vorwaertsfilter zur Fehlerzustandsbestaetigung [RAM name from V530, interpolated]" UBYTE M_FORMULA_0003 0 0 0 255 ECU_ADDRESS 0x3FA76F /end MEASUREMENT
/begin MEASUREMENT ed_fil_dmtl_feinleck.filter_nv "Filterwert vor und nach Eintrag [RAM name from V530, interpolated]" UBYTE M_FORMULA_0003 0 0 0 255 ECU_ADDRESS 0x3FA77A /end MEASUREMENT
/begin MEASUREMENT ed_fil_dmtl_feinleck.zyklus_filter_nv "Vorwaertsfilter zur Fehlerzustandsbestaetigung [RAM name from V530, interpolated]" UBYTE M_FORMULA_0003 0 0 0 255 ECU_ADDRESS 0x3FA77B /end MEASUREMENT
/begin MEASUREMENT ed_fil_pt_toma.art_aktuell_nv "Fehlerart und Statusbits [RAM name from V530, interpolated]" UWORD NO_COMPU_METHOD 0 0 0 65535 ECU_ADDRESS 0x3FA776 FORMAT "%.4g" /end MEASUREMENT
/begin MEASUREMENT ed_fil_pt_toma.fehler_aufrufe_nv "Gesamtzahl der Fehleraufrufe [RAM name from V530, interpolated]" UBYTE M_FORMULA_0003 0 0 0 255 ECU_ADDRESS 0x3FA779 /end MEASUREMENT
/begin MEASUREMENT ed_fil_pt_toma.filter_max_nv "Maximaler Fehlerfilterwert [RAM name from V530, interpolated]" UBYTE M_FORMULA_0003 0 0 0 255 ECU_ADDRESS 0x3FA778 /end MEASUREMENT
/begin MEASUREMENT ed_fil_pt_toma.filter_nv "Filterwert vor und nach Eintrag [RAM name from V530, interpolated]" UBYTE M_FORMULA_0003 0 0 0 255 ECU_ADDRESS 0x3FA774 /end MEASUREMENT
/begin MEASUREMENT ed_fil_pt_toma.zyklus_filter_nv "Vorwaertsfilter zur Fehlerzustandsbestaetigung [RAM name from V530, interpolated]" UBYTE M_FORMULA_0003 0 0 0 255 ECU_ADDRESS 0x3FA775 /end MEASUREMENT
/begin MEASUREMENT ed_fil_tank_leer.fehler_aufrufe_nv "Gesamtzahl der Fehleraufrufe [RAM name from V530, interpolated]" UBYTE M_FORMULA_0003 0 0 0 255 ECU_ADDRESS 0x3FA773 /end MEASUREMENT
/begin MEASUREMENT ed_fil_tank_leer.filter_max_nv "Maximaler Fehlerfilterwert [RAM name from V530, interpolated]" UBYTE M_FORMULA_0003 0 0 0 255 ECU_ADDRESS 0x3FA772 /end MEASUREMENT
/begin MEASUREMENT ed_fil_dmtl_feinleck.fehler_aufrufe_nv "Gesamtzahl der Fehleraufrufe [RAM name from V530, interpolated]" UBYTE M_FORMULA_0003 0 0 0 255 ECU_ADDRESS 0x3FA77F /end MEASUREMENT
/begin MEASUREMENT ed_fil_dmtl_feinleck.filter_max_nv "Maximaler Fehlerfilterwert [RAM name from V530, interpolated]" UBYTE M_FORMULA_0003 0 0 0 255 ECU_ADDRESS 0x3FA77E /end MEASUREMENT
/begin MEASUREMENT ed_fil_pumg_obd.filter_nv "Filterwert vor und nach Eintrag [RAM name from V530, interpolated]" UBYTE M_FORMULA_0003 0 0 0 255 ECU_ADDRESS 0x3FA780 /end MEASUREMENT
/begin MEASUREMENT ed_fil_pumg_obd.zyklus_filter_nv "Vorwaertsfilter zur Fehlerzustandsbestaetigung [RAM name from V530, interpolated]" UBYTE M_FORMULA_0003 0 0 0 255 ECU_ADDRESS 0x3FA781 /end MEASUREMENT
/begin MEASUREMENT ed_fil_pumg_obd.fehler_aufrufe_nv "Gesamtzahl der Fehleraufrufe [RAM name from V530, interpolated]" UBYTE M_FORMULA_0003 0 0 0 255 ECU_ADDRESS 0x3FA785 /end MEASUREMENT
/begin MEASUREMENT ed_fil_pumg_obd.filter_max_nv "Maximaler Fehlerfilterwert [RAM name from V530, interpolated]" UBYTE M_FORMULA_0003 0 0 0 255 ECU_ADDRESS 0x3FA784 /end MEASUREMENT
/begin MEASUREMENT ed_fil_sl_ml_hfm_obd.filter_nv "Filterwert vor und nach Eintrag [RAM name from V530, interpolated]" UBYTE M_FORMULA_0003 0 0 0 255 ECU_ADDRESS 0x3FA786 /end MEASUREMENT
/begin MEASUREMENT ed_fil_sl_ml_hfm_obd.zyklus_filter_nv "Vorwaertsfilter zur Fehlerzustandsbestaetigung [RAM name from V530, interpolated]" UBYTE M_FORMULA_0003 0 0 0 255 ECU_ADDRESS 0x3FA787 /end MEASUREMENT
/begin MEASUREMENT ed_fil_la1_trim_ad.art_aktuell_nv "Fehlerart und Statusbits [RAM name from V530, interpolated]" UWORD NO_COMPU_METHOD 0 0 0 65535 ECU_ADDRESS 0x3FA78E FORMAT "%.4g" /end MEASUREMENT
/begin MEASUREMENT ed_fil_la1_trim_ad.fehler_aufrufe_nv "Gesamtzahl der Fehleraufrufe [RAM name from V530, interpolated]" UBYTE M_FORMULA_0003 0 0 0 255 ECU_ADDRESS 0x3FA791 /end MEASUREMENT
/begin MEASUREMENT ed_fil_la1_trim_ad.filter_max_nv "Maximaler Fehlerfilterwert [RAM name from V530, interpolated]" UBYTE M_FORMULA_0003 0 0 0 255 ECU_ADDRESS 0x3FA790 /end MEASUREMENT
/begin MEASUREMENT ed_fil_la1_trim_ad.filter_nv "Filterwert vor und nach Eintrag [RAM name from V530, interpolated]" UBYTE M_FORMULA_0003 0 0 0 255 ECU_ADDRESS 0x3FA78C /end MEASUREMENT
/begin MEASUREMENT ed_fil_la1_trim_ad.zyklus_filter_nv "Vorwaertsfilter zur Fehlerzustandsbestaetigung [RAM name from V530, interpolated]" UBYTE M_FORMULA_0003 0 0 0 255 ECU_ADDRESS 0x3FA78D /end MEASUREMENT
/begin MEASUREMENT ed_fil_la2_trim_ad.art_aktuell_nv "Fehlerart und Statusbits [RAM name from V530, interpolated]" UWORD NO_COMPU_METHOD 0 0 0 65535 ECU_ADDRESS 0x3FA794 FORMAT "%.4g" /end MEASUREMENT
/begin MEASUREMENT ed_fil_la2_trim_ad.fehler_aufrufe_nv "Gesamtzahl der Fehleraufrufe [RAM name from V530, interpolated]" UBYTE M_FORMULA_0003 0 0 0 255 ECU_ADDRESS 0x3FA797 /end MEASUREMENT
/begin MEASUREMENT ed_fil_la2_trim_ad.filter_max_nv "Maximaler Fehlerfilterwert [RAM name from V530, interpolated]" UBYTE M_FORMULA_0003 0 0 0 255 ECU_ADDRESS 0x3FA796 /end MEASUREMENT
/begin MEASUREMENT ed_fil_la2_trim_ad.filter_nv "Filterwert vor und nach Eintrag [RAM name from V530, interpolated]" UBYTE M_FORMULA_0003 0 0 0 255 ECU_ADDRESS 0x3FA792 /end MEASUREMENT
/begin MEASUREMENT ed_fil_la2_trim_ad.zyklus_filter_nv "Vorwaertsfilter zur Fehlerzustandsbestaetigung [RAM name from V530, interpolated]" UBYTE M_FORMULA_0003 0 0 0 255 ECU_ADDRESS 0x3FA793 /end MEASUREMENT
/begin MEASUREMENT ed_fil_lank1_obd_we.art_aktuell_nv "Fehlerart und Statusbits [RAM name from V530, interpolated]" UWORD NO_COMPU_METHOD 0 0 0 65535 ECU_ADDRESS 0x3FA7A6 FORMAT "%.4g" /end MEASUREMENT
/begin MEASUREMENT ed_fil_lank1_obd_we.fehler_aufrufe_nv "Gesamtzahl der Fehleraufrufe [RAM name from V530, interpolated]" UBYTE M_FORMULA_0003 0 0 0 255 ECU_ADDRESS 0x3FA7A9 /end MEASUREMENT
/begin MEASUREMENT ed_fil_lank1_obd_we.filter_max_nv "Maximaler Fehlerfilterwert [RAM name from V530, interpolated]" UBYTE M_FORMULA_0003 0 0 0 255 ECU_ADDRESS 0x3FA7A8 /end MEASUREMENT
/begin MEASUREMENT ed_fil_lank1_obd_we.filter_nv "Filterwert vor und nach Eintrag [RAM name from V530, interpolated]" UBYTE M_FORMULA_0003 0 0 0 255 ECU_ADDRESS 0x3FA7A4 /end MEASUREMENT
/begin MEASUREMENT ed_fil_lank1_obd_we.zyklus_filter_nv "Vorwaertsfilter zur Fehlerzustandsbestaetigung [RAM name from V530, interpolated]" UBYTE M_FORMULA_0003 0 0 0 255 ECU_ADDRESS 0x3FA7A5 /end MEASUREMENT
/begin MEASUREMENT ed_fil_lank1_openload.art_aktuell_nv "Fehlerart und Statusbits [RAM name from V530, interpolated]" UWORD NO_COMPU_METHOD 0 0 0 65535 ECU_ADDRESS 0x3FA79A FORMAT "%.4g" /end MEASUREMENT
/begin MEASUREMENT ed_fil_lank1_openload.fehler_aufrufe_nv "Gesamtzahl der Fehleraufrufe [RAM name from V530, interpolated]" UBYTE M_FORMULA_0003 0 0 0 255 ECU_ADDRESS 0x3FA79D /end MEASUREMENT
/begin MEASUREMENT ed_fil_lank1_openload.filter_max_nv "Maximaler Fehlerfilterwert [RAM name from V530, interpolated]" UBYTE M_FORMULA_0003 0 0 0 255 ECU_ADDRESS 0x3FA79C /end MEASUREMENT
/begin MEASUREMENT ed_fil_lank1_openload.filter_nv "Filterwert vor und nach Eintrag [RAM name from V530, interpolated]" UBYTE M_FORMULA_0003 0 0 0 255 ECU_ADDRESS 0x3FA798 /end MEASUREMENT
/begin MEASUREMENT ed_fil_lank1_openload.zyklus_filter_nv "Vorwaertsfilter zur Fehlerzustandsbestaetigung [RAM name from V530, interpolated]" UBYTE M_FORMULA_0003 0 0 0 255 ECU_ADDRESS 0x3FA799 /end MEASUREMENT
/begin MEASUREMENT ed_fil_lank2_obd_we.art_aktuell_nv "Fehlerart und Statusbits [RAM name from V530, interpolated]" UWORD NO_COMPU_METHOD 0 0 0 65535 ECU_ADDRESS 0x3FA7AC FORMAT "%.4g" /end MEASUREMENT
/begin MEASUREMENT ed_fil_lank2_obd_we.fehler_aufrufe_nv "Gesamtzahl der Fehleraufrufe [RAM name from V530, interpolated]" UBYTE M_FORMULA_0003 0 0 0 255 ECU_ADDRESS 0x3FA7AF /end MEASUREMENT
/begin MEASUREMENT ed_fil_lank2_obd_we.filter_max_nv "Maximaler Fehlerfilterwert [RAM name from V530, interpolated]" UBYTE M_FORMULA_0003 0 0 0 255 ECU_ADDRESS 0x3FA7AE /end MEASUREMENT
/begin MEASUREMENT ed_fil_lank2_obd_we.filter_nv "Filterwert vor und nach Eintrag [RAM name from V530, interpolated]" UBYTE M_FORMULA_0003 0 0 0 255 ECU_ADDRESS 0x3FA7AA /end MEASUREMENT
/begin MEASUREMENT ed_fil_lank2_obd_we.zyklus_filter_nv "Vorwaertsfilter zur Fehlerzustandsbestaetigung [RAM name from V530, interpolated]" UBYTE M_FORMULA_0003 0 0 0 255 ECU_ADDRESS 0x3FA7AB /end MEASUREMENT
/begin MEASUREMENT ed_fil_lank2_openload.art_aktuell_nv "Fehlerart und Statusbits [RAM name from V530, interpolated]" UWORD NO_COMPU_METHOD 0 0 0 65535 ECU_ADDRESS 0x3FA7A0 FORMAT "%.4g" /end MEASUREMENT
/begin MEASUREMENT ed_fil_lank2_openload.fehler_aufrufe_nv "Gesamtzahl der Fehleraufrufe [RAM name from V530, interpolated]" UBYTE M_FORMULA_0003 0 0 0 255 ECU_ADDRESS 0x3FA7A3 /end MEASUREMENT
/begin MEASUREMENT ed_fil_lank2_openload.filter_max_nv "Maximaler Fehlerfilterwert [RAM name from V530, interpolated]" UBYTE M_FORMULA_0003 0 0 0 255 ECU_ADDRESS 0x3FA7A2 /end MEASUREMENT
/begin MEASUREMENT ed_fil_lank2_openload.filter_nv "Filterwert vor und nach Eintrag [RAM name from V530, interpolated]" UBYTE M_FORMULA_0003 0 0 0 255 ECU_ADDRESS 0x3FA79E /end MEASUREMENT
/begin MEASUREMENT ed_fil_lank2_openload.zyklus_filter_nv "Vorwaertsfilter zur Fehlerzustandsbestaetigung [RAM name from V530, interpolated]" UBYTE M_FORMULA_0003 0 0 0 255 ECU_ADDRESS 0x3FA79F /end MEASUREMENT
/begin MEASUREMENT ed_fil_lshnk1_r.filter_nv "Filterwert vor und nach Eintrag [RAM name from V530, interpolated]" UBYTE M_FORMULA_0003 0 0 0 255 ECU_ADDRESS 0x3FA7B0 /end MEASUREMENT
/begin MEASUREMENT ed_fil_lshnk1_r.zyklus_filter_nv "Vorwaertsfilter zur Fehlerzustandsbestaetigung [RAM name from V530, interpolated]" UBYTE M_FORMULA_0003 0 0 0 255 ECU_ADDRESS 0x3FA7B1 /end MEASUREMENT
/begin MEASUREMENT ed_fil_sl_ml_hfm_obd.fehler_aufrufe_nv "Gesamtzahl der Fehleraufrufe [RAM name from V530, interpolated]" UBYTE M_FORMULA_0003 0 0 0 255 ECU_ADDRESS 0x3FA78B /end MEASUREMENT
/begin MEASUREMENT ed_fil_sl_ml_hfm_obd.filter_max_nv "Maximaler Fehlerfilterwert [RAM name from V530, interpolated]" UBYTE M_FORMULA_0003 0 0 0 255 ECU_ADDRESS 0x3FA78A /end MEASUREMENT
/begin MEASUREMENT ed_fil_lshnk1_r.fehler_aufrufe_nv "Gesamtzahl der Fehleraufrufe [RAM name from V530, interpolated]" UBYTE M_FORMULA_0003 0 0 0 255 ECU_ADDRESS 0x3FA7B5 /end MEASUREMENT
/begin MEASUREMENT ed_fil_lshnk1_r.filter_max_nv "Maximaler Fehlerfilterwert [RAM name from V530, interpolated]" UBYTE M_FORMULA_0003 0 0 0 255 ECU_ADDRESS 0x3FA7B4 /end MEASUREMENT
/begin MEASUREMENT ed_fil_lshnk2_r.filter_nv "Filterwert vor und nach Eintrag [RAM name from V530, interpolated]" UBYTE M_FORMULA_0003 0 0 0 255 ECU_ADDRESS 0x3FA7B6 /end MEASUREMENT
/begin MEASUREMENT ed_fil_lshnk2_r.zyklus_filter_nv "Vorwaertsfilter zur Fehlerzustandsbestaetigung [RAM name from V530, interpolated]" UBYTE M_FORMULA_0003 0 0 0 255 ECU_ADDRESS 0x3FA7B7 /end MEASUREMENT
/begin MEASUREMENT ed_fil_lshnk2_r.fehler_aufrufe_nv "Gesamtzahl der Fehleraufrufe [RAM name from V530, interpolated]" UBYTE M_FORMULA_0003 0 0 0 255 ECU_ADDRESS 0x3FA7BB /end MEASUREMENT
/begin MEASUREMENT ed_fil_lshnk2_r.filter_max_nv "Maximaler Fehlerfilterwert [RAM name from V530, interpolated]" UBYTE M_FORMULA_0003 0 0 0 255 ECU_ADDRESS 0x3FA7BA /end MEASUREMENT
/begin MEASUREMENT ed_fil_pks_modell.filter_nv "Filterwert vor und nach Eintrag [RAM name from V530, interpolated]" UBYTE M_FORMULA_0003 0 0 0 255 ECU_ADDRESS 0x3FA7BC /end MEASUREMENT
/begin MEASUREMENT ed_fil_pks_modell.zyklus_filter_nv "Vorwaertsfilter zur Fehlerzustandsbestaetigung [RAM name from V530, interpolated]" UBYTE M_FORMULA_0003 0 0 0 255 ECU_ADDRESS 0x3FA7BD /end MEASUREMENT
/begin MEASUREMENT ed_fil_pks_modell.fehler_aufrufe_nv "Gesamtzahl der Fehleraufrufe [RAM name from V530, interpolated]" UBYTE M_FORMULA_0003 0 0 0 255 ECU_ADDRESS 0x3FA7C1 /end MEASUREMENT
/begin MEASUREMENT ed_fil_pks_modell.filter_max_nv "Maximaler Fehlerfilterwert [RAM name from V530, interpolated]" UBYTE M_FORMULA_0003 0 0 0 255 ECU_ADDRESS 0x3FA7C0 /end MEASUREMENT
/begin MEASUREMENT ed_fil_pks_paufbau.filter_nv "Filterwert vor und nach Eintrag [RAM name from V530, interpolated]" UBYTE M_FORMULA_0003 0 0 0 255 ECU_ADDRESS 0x3FA7C2 /end MEASUREMENT
/begin MEASUREMENT ed_fil_pks_paufbau.zyklus_filter_nv "Vorwaertsfilter zur Fehlerzustandsbestaetigung [RAM name from V530, interpolated]" UBYTE M_FORMULA_0003 0 0 0 255 ECU_ADDRESS 0x3FA7C3 /end MEASUREMENT
/begin MEASUREMENT ed_fil_pks_adapt_anschl.art_aktuell_nv "Fehlerart und Statusbits [RAM name from V530, interpolated]" UWORD NO_COMPU_METHOD 0 0 0 65535 ECU_ADDRESS 0x3FA7CA FORMAT "%.4g" /end MEASUREMENT
/begin MEASUREMENT ed_fil_pks_adapt_anschl.fehler_aufrufe_nv "Gesamtzahl der Fehleraufrufe [RAM name from V530, interpolated]" UBYTE M_FORMULA_0003 0 0 0 255 ECU_ADDRESS 0x3FA7CD /end MEASUREMENT
/begin MEASUREMENT ed_fil_pks_adapt_anschl.filter_max_nv "Maximaler Fehlerfilterwert [RAM name from V530, interpolated]" UBYTE M_FORMULA_0003 0 0 0 255 ECU_ADDRESS 0x3FA7CC /end MEASUREMENT
/begin MEASUREMENT ed_fil_pks_adapt_anschl.filter_nv "Filterwert vor und nach Eintrag [RAM name from V530, interpolated]" UBYTE M_FORMULA_0003 0 0 0 255 ECU_ADDRESS 0x3FA7C8 /end MEASUREMENT
/begin MEASUREMENT ed_fil_pks_adapt_anschl.zyklus_filter_nv "Vorwaertsfilter zur Fehlerzustandsbestaetigung [RAM name from V530, interpolated]" UBYTE M_FORMULA_0003 0 0 0 255 ECU_ADDRESS 0x3FA7C9 /end MEASUREMENT
/begin MEASUREMENT ed_fil_pks_paufbau.fehler_aufrufe_nv "Gesamtzahl der Fehleraufrufe [RAM name from V530, interpolated]" UBYTE M_FORMULA_0003 0 0 0 255 ECU_ADDRESS 0x3FA7C7 /end MEASUREMENT
/begin MEASUREMENT ed_fil_pks_paufbau.filter_max_nv "Maximaler Fehlerfilterwert [RAM name from V530, interpolated]" UBYTE M_FORMULA_0003 0 0 0 255 ECU_ADDRESS 0x3FA7C6 /end MEASUREMENT
/begin MEASUREMENT ed_fil_tgetr_hs.filter_nv "Filterwert vor und nach Eintrag [RAM name from V530, interpolated]" UBYTE M_FORMULA_0003 0 0 0 255 ECU_ADDRESS 0x3FA7CE /end MEASUREMENT
/begin MEASUREMENT ed_fil_tgetr_hs.zyklus_filter_nv "Vorwaertsfilter zur Fehlerzustandsbestaetigung [RAM name from V530, interpolated]" UBYTE M_FORMULA_0003 0 0 0 255 ECU_ADDRESS 0x3FA7CF /end MEASUREMENT
/begin MEASUREMENT ed_rbm_hfm1.denominator_nv "Fahrzyklen [RAM name from V530, interpolated]" UWORD M_FORMULA_0010 0 0 0 65535 ECU_ADDRESS 0x3FA892 /end MEASUREMENT
/begin MEASUREMENT ed_rbm_hfm1.numerator_nv "Diagnosezyklen [RAM name from V530, interpolated]" UWORD M_FORMULA_0010 0 0 0 65535 ECU_ADDRESS 0x3FA890 /end MEASUREMENT
/begin MEASUREMENT ed_rbm_hfm2.denominator_nv "Fahrzyklen [RAM name from V530, interpolated]" UWORD M_FORMULA_0010 0 0 0 65535 ECU_ADDRESS 0x3FA896 /end MEASUREMENT
/begin MEASUREMENT ed_rbm_hfm2.numerator_nv "Diagnosezyklen [RAM name from V530, interpolated]" UWORD M_FORMULA_0010 0 0 0 65535 ECU_ADDRESS 0x3FA894 /end MEASUREMENT
/begin MEASUREMENT ed_rbm_psau1.denominator_nv "Fahrzyklen [RAM name from V530, interpolated]" UWORD M_FORMULA_0010 0 0 0 65535 ECU_ADDRESS 0x3FA89A /end MEASUREMENT
/begin MEASUREMENT ed_rbm_psau1.numerator_nv "Diagnosezyklen [RAM name from V530, interpolated]" UWORD M_FORMULA_0010 0 0 0 65535 ECU_ADDRESS 0x3FA898 /end MEASUREMENT
/begin MEASUREMENT ed_rbm_psau2.denominator_nv "Fahrzyklen [RAM name from V530, interpolated]" UWORD M_FORMULA_0010 0 0 0 65535 ECU_ADDRESS 0x3FA89E /end MEASUREMENT
/begin MEASUREMENT ed_rbm_psau2.numerator_nv "Diagnosezyklen [RAM name from V530, interpolated]" UWORD M_FORMULA_0010 0 0 0 65535 ECU_ADDRESS 0x3FA89C /end MEASUREMENT
/begin MEASUREMENT ed_rbm_pumg.denominator_nv "Fahrzyklen [RAM name from V530, interpolated]" UWORD M_FORMULA_0010 0 0 0 65535 ECU_ADDRESS 0x3FA88E /end MEASUREMENT
/begin MEASUREMENT ed_rbm_pumg.numerator_nv "Diagnosezyklen [RAM name from V530, interpolated]" UWORD M_FORMULA_0010 0 0 0 65535 ECU_ADDRESS 0x3FA88C /end MEASUREMENT
/begin MEASUREMENT ed_rbm_sk_tr_inj.denominator_nv "Fahrzyklen [RAM name from V530, interpolated]" UWORD M_FORMULA_0010 0 0 0 65535 ECU_ADDRESS 0x3FA88A /end MEASUREMENT
/begin MEASUREMENT ed_rbm_van_hall_a1.denominator_nv "Fahrzyklen [RAM name from V530, interpolated]" UWORD M_FORMULA_0010 0 0 0 65535 ECU_ADDRESS 0x3FA8A6 /end MEASUREMENT
/begin MEASUREMENT ed_rbm_van_hall_a1.numerator_nv "Diagnosezyklen [RAM name from V530, interpolated]" UWORD M_FORMULA_0010 0 0 0 65535 ECU_ADDRESS 0x3FA8A4 /end MEASUREMENT
/begin MEASUREMENT ed_rbm_van_hall_a2.denominator_nv "Fahrzyklen [RAM name from V530, interpolated]" UWORD M_FORMULA_0010 0 0 0 65535 ECU_ADDRESS 0x3FA8AE /end MEASUREMENT
/begin MEASUREMENT ed_rbm_van_hall_a2.numerator_nv "Diagnosezyklen [RAM name from V530, interpolated]" UWORD M_FORMULA_0010 0 0 0 65535 ECU_ADDRESS 0x3FA8AC /end MEASUREMENT
/begin MEASUREMENT ed_rbm_van_hall_e1.denominator_nv "Fahrzyklen [RAM name from V530, interpolated]" UWORD M_FORMULA_0010 0 0 0 65535 ECU_ADDRESS 0x3FA8A2 /end MEASUREMENT
/begin MEASUREMENT ed_rbm_van_hall_e1.numerator_nv "Diagnosezyklen [RAM name from V530, interpolated]" UWORD M_FORMULA_0010 0 0 0 65535 ECU_ADDRESS 0x3FA8A0 /end MEASUREMENT
/begin MEASUREMENT ed_rbm_van_hall_e2.denominator_nv "Fahrzyklen [RAM name from V530, interpolated]" UWORD M_FORMULA_0010 0 0 0 65535 ECU_ADDRESS 0x3FA8AA /end MEASUREMENT
/begin MEASUREMENT ed_rbm_van_hall_e2.numerator_nv "Diagnosezyklen [RAM name from V530, interpolated]" UWORD M_FORMULA_0010 0 0 0 65535 ECU_ADDRESS 0x3FA8A8 /end MEASUREMENT
/begin MEASUREMENT ed_rbm_van_regl_e1.denominator_nv "Fahrzyklen [RAM name from V530, interpolated]" UWORD M_FORMULA_0010 0 0 0 65535 ECU_ADDRESS 0x3FA8B2 /end MEASUREMENT
/begin MEASUREMENT ed_rbm_van_regl_e1.numerator_nv "Diagnosezyklen [RAM name from V530, interpolated]" UWORD M_FORMULA_0010 0 0 0 65535 ECU_ADDRESS 0x3FA8B0 /end MEASUREMENT
/begin MEASUREMENT ed_rbm_van_regl_a1.denominator_nv "Fahrzyklen [RAM name from V530, interpolated]" UWORD M_FORMULA_0010 0 0 0 65535 ECU_ADDRESS 0x3FA8B6 /end MEASUREMENT
/begin MEASUREMENT ed_rbm_index_15_inj.denominator_nv "Fahrzyklen [RAM name from V530, interpolated]" UWORD M_FORMULA_0010 0 0 0 65535 ECU_ADDRESS 0x3FA8C6 /end MEASUREMENT
/begin MEASUREMENT ed_rbm_index_15_inj.numerator_nv "Diagnosezyklen [RAM name from V530, interpolated]" UWORD M_FORMULA_0010 0 0 0 65535 ECU_ADDRESS 0x3FA8C4 /end MEASUREMENT
/begin MEASUREMENT ed_rbm_lavk1.denominator_nv "Fahrzyklen [RAM name from V530, interpolated]" UWORD M_FORMULA_0010 0 0 0 65535 ECU_ADDRESS 0x3FA8DA /end MEASUREMENT
/begin MEASUREMENT ed_rbm_lavk1.numerator_nv "Diagnosezyklen [RAM name from V530, interpolated]" UWORD M_FORMULA_0010 0 0 0 65535 ECU_ADDRESS 0x3FA8D8 /end MEASUREMENT
/begin MEASUREMENT ed_rbm_lavk2.denominator_nv "Fahrzyklen [RAM name from V530, interpolated]" UWORD M_FORMULA_0010 0 0 0 65535 ECU_ADDRESS 0x3FA8DE /end MEASUREMENT
/begin MEASUREMENT ed_rbm_lavk2.numerator_nv "Diagnosezyklen [RAM name from V530, interpolated]" UWORD M_FORMULA_0010 0 0 0 65535 ECU_ADDRESS 0x3FA8DC /end MEASUREMENT
/begin MEASUREMENT ed_rbm_nw_sync.denominator_nv "Fahrzyklen [RAM name from V530, interpolated]" UWORD M_FORMULA_0010 0 0 0 65535 ECU_ADDRESS 0x3FA8C2 /end MEASUREMENT
/begin MEASUREMENT ed_rbm_nw_sync.numerator_nv "Diagnosezyklen [RAM name from V530, interpolated]" UWORD M_FORMULA_0010 0 0 0 65535 ECU_ADDRESS 0x3FA8C0 /end MEASUREMENT
/begin MEASUREMENT ed_rbm_pctrl_inj.denominator_nv "Fahrzyklen [RAM name from V530, interpolated]" UWORD M_FORMULA_0010 0 0 0 65535 ECU_ADDRESS 0x3FA8CA /end MEASUREMENT
/begin MEASUREMENT ed_rbm_pctrl_inj.numerator_nv "Diagnosezyklen [RAM name from V530, interpolated]" UWORD M_FORMULA_0010 0 0 0 65535 ECU_ADDRESS 0x3FA8C8 /end MEASUREMENT
/begin MEASUREMENT ed_rbm_pks.denominator_nv "Fahrzyklen [RAM name from V530, interpolated]" UWORD M_FORMULA_0010 0 0 0 65535 ECU_ADDRESS 0x3FA8D2 /end MEASUREMENT
/begin MEASUREMENT ed_rbm_pks.numerator_nv "Diagnosezyklen [RAM name from V530, interpolated]" UWORD M_FORMULA_0010 0 0 0 65535 ECU_ADDRESS 0x3FA8D0 /end MEASUREMENT
/begin MEASUREMENT ed_rbm_pt_statdkg.denominator_nv "Fahrzyklen [RAM name from V530, interpolated]" UWORD M_FORMULA_0010 0 0 0 65535 ECU_ADDRESS 0x3FA8CE /end MEASUREMENT
/begin MEASUREMENT ed_rbm_pt_statdkg.numerator_nv "Diagnosezyklen [RAM name from V530, interpolated]" UWORD M_FORMULA_0010 0 0 0 65535 ECU_ADDRESS 0x3FA8CC /end MEASUREMENT
/begin MEASUREMENT ed_rbm_pt_statr.denominator_nv "Fahrzyklen [RAM name from V530, interpolated]" UWORD M_FORMULA_0010 0 0 0 65535 ECU_ADDRESS 0x3FA8D6 /end MEASUREMENT
/begin MEASUREMENT ed_rbm_pt_statr.numerator_nv "Diagnosezyklen [RAM name from V530, interpolated]" UWORD M_FORMULA_0010 0 0 0 65535 ECU_ADDRESS 0x3FA8D4 /end MEASUREMENT
/begin MEASUREMENT ed_rbm_pt_grb.denominator_nv "Fahrzyklen [RAM name from V530, interpolated]" UWORD M_FORMULA_0010 0 0 0 65535 ECU_ADDRESS 0x3FA97A /end MEASUREMENT
/begin MEASUREMENT ed_rbm_pt_grb.numerator_nv "Diagnosezyklen [RAM name from V530, interpolated]" UWORD M_FORMULA_0010 0 0 0 65535 ECU_ADDRESS 0x3FA978 /end MEASUREMENT
/begin MEASUREMENT ed_rbm_pt_grb2.denominator_nv "Fahrzyklen [RAM name from V530, interpolated]" UWORD M_FORMULA_0010 0 0 0 65535 ECU_ADDRESS 0x3FA97E /end MEASUREMENT
/begin MEASUREMENT ed_rbm_pt_grb2.numerator_nv "Diagnosezyklen [RAM name from V530, interpolated]" UWORD M_FORMULA_0010 0 0 0 65535 ECU_ADDRESS 0x3FA97C /end MEASUREMENT
/begin MEASUREMENT lavk_obd_dyn_wert_min_nv_b1 "min. Diagnosewert ueber alle Diag.Durchlaeufe [RAM name from V530, interpolated]" UWORD M_FORMULA_0025 0 0 0 3.999938965 ECU_ADDRESS 0x3FB2FA /end MEASUREMENT
/begin MEASUREMENT lavk_obd_dyn_wert_min_nv_b2 "min. Diagnosewert ueber alle Diag.Durchlaeufe [RAM name from V530, interpolated]" UWORD M_FORMULA_0025 0 0 0 3.999938965 ECU_ADDRESS 0x3FB2FC /end MEASUREMENT
/begin MEASUREMENT lshvk_r_ad_gain_b2 "Faktor-Sonden-Ri-Adaption [RAM name from V530, interpolated]" UWORD M_FORMULA_0073 0 0 0 63.99902344 ECU_ADDRESS 0x3FB300 /end MEASUREMENT
/begin MEASUREMENT lshvk_diag_r_adapt_b1 "adaptierter Heizerwiderstand VKAT [RAM name from V530, interpolated]" UWORD M_FORMULA_0541 0 0 0 6553.5 ECU_ADDRESS 0x3FB30A /end MEASUREMENT
/begin MEASUREMENT lshvk_diag_r_adapt_b2 "adaptierter Heizerwiderstand VKAT [RAM name from V530, interpolated]" UWORD M_FORMULA_0541 0 0 0 6553.5 ECU_ADDRESS 0x3FB30C /end MEASUREMENT
/begin MEASUREMENT lshvk_r_ad_offs_b2 "Offset-Sonden-Ri-Adaption [RAM name from V530, interpolated]" SWORD M_FORMULA_0536 0 0 -160000 159995.1172 ECU_ADDRESS 0x3FB308 /end MEASUREMENT
/begin MEASUREMENT dmtl_i_filt.rest "DMTL Strom korr. Filter-Rest [RAM name from V530, interpolated]" UWORD M_FORMULA_0554 0 0 0 8.999862671 ECU_ADDRESS 0x3FB3A0 /end MEASUREMENT
/begin MEASUREMENT dmtl_crb_cid "dmtl_crb_cid [RAM name from V530, interpolated]" UBYTE M_FORMULA_0003 0 0 0 255 ECU_ADDRESS 0x3FB3AA /end MEASUREMENT
/begin MEASUREMENT dmtl_crb_mess "Strom Diagnosemodul Tankleck [RAM name from V530, interpolated]" UWORD M_FORMULA_0553 0 0 0 147.45375 ECU_ADDRESS 0x3FB3AC /end MEASUREMENT
/begin MEASUREMENT fst_min_nv "Min. Fuellstand, fuer Nachtankerkennung [RAM name from V530, interpolated]" UBYTE M_FORMULA_0559 0 0 0 127.5 ECU_ADDRESS 0x3FB3C9 /end MEASUREMENT
/begin MEASUREMENT fst_rechts.rest "Filter Rest Geberwert rechts [RAM name from V530, interpolated]" UBYTE M_FORMULA_0560 0 0 0 0.498046875 ECU_ADDRESS 0x3FB3CB /end MEASUREMENT
/begin MEASUREMENT fst_verbr_nv "Verbrauchter Kraftstoff [RAM name from V530, interpolated]" UWORD M_FORMULA_0561 0 0 0 67.10784 ECU_ADDRESS 0x3FB3CC /end MEASUREMENT
/begin MEASUREMENT Qeladold7 "zuletzt gesp. qelad [RAM name from V530, interpolated]" UWORD M_FORMULA_0498 0 0 0 1192.750253 ECU_ADDRESS 0x3FB55E /end MEASUREMENT
/begin MEASUREMENT Qladold7 "zuletzt gesp. qlad [RAM name from V530, interpolated]" UWORD M_FORMULA_0498 0 0 0 1192.750253 ECU_ADDRESS 0x3FB560 /end MEASUREMENT
/begin MEASUREMENT Fs_pm "Fehlerspeicher Powermanagement, Bitcodiert [RAM name from V530, interpolated]" UBYTE M_FORMULA_0003 0 0 0 255 ECU_ADDRESS 0x3FB564 /end MEASUREMENT
/begin MEASUREMENT Dfsiggen "Auslastungsgrad Generator [RAM name from V530, interpolated]" UBYTE M_FORMULA_0475 0 0 0 99.609375 ECU_ADDRESS 0x3FBBE1 /end MEASUREMENT
/begin MEASUREMENT Gen_typkenn "Typkennung Generator [RAM name from V530, interpolated]" UBYTE M_FORMULA_0003 0 0 0 255 ECU_ADDRESS 0x3FBBE3 /end MEASUREMENT
/begin MEASUREMENT Tlrfgen "Sollwert Load-Response-Zeit, empfangen vom Generator [RAM name from V530, interpolated]" UBYTE M_FORMULA_0461 0 0 0 25.5 ECU_ADDRESS 0x3FBBE4 /end MEASUREMENT
/begin MEASUREMENT Oz_testtoel2 "Oz_testtoel2 [RAM name from V530, interpolated]" SWORD M_FORMULA_0431 0 0 -3276.8 3276.7 ECU_ADDRESS 0x3FBCD2 /end MEASUREMENT
/begin MEASUREMENT Oz_nivzeit "Zeit nach dem KF_OZZEIT [RAM name from V530, interpolated]" UWORD M_FORMULA_0021 0 0 0 655.35 ECU_ADDRESS 0x3FBCD6 /end MEASUREMENT
/begin MEASUREMENT Oz_pzdivp "Verh???ltnis oz_luftalt/oz_luftneu [RAM name from V530, interpolated]" UWORD M_FORMULA_0024 0 0 0 1.999969482 ECU_ADDRESS 0x3FBCDA /end MEASUREMENT
/begin MEASUREMENT T_diode "Diodentemparatur [RAM name from V530, interpolated]" SWORD M_FORMULA_0431 0 0 -3276.8 3276.7 ECU_ADDRESS 0x3FDD0A /end MEASUREMENT
/begin MEASUREMENT Oz_offset_ll_l "l-beschl. korr. Oelniveauwert [RAM name from V530, interpolated]" SBYTE M_FORMULA_0436 0 0 -37.5 37.20703125 ECU_ADDRESS 0x3FCBF0 /end MEASUREMENT
/begin MEASUREMENT St_bsd_ktenable "Zustand aktivierte BSD Komponententreiber [RAM name from V530, interpolated]" UBYTE M_FORMULA_0003 0 0 0 255 ECU_ADDRESS 0x3FCC44 /end MEASUREMENT
/begin MEASUREMENT St_bsd_ktenable.B_dev_gen1 "Generator 1 enabled [RAM name from V530, interpolated]" UBYTE NO_COMPU_METHOD 0 0 0 255 ECU_ADDRESS 0x3FCC44 FORMAT "%.4g" /end MEASUREMENT
/begin MEASUREMENT St_bsd_ktenable.B_dev_gen2 "Generator 2 enabled [RAM name from V530, interpolated]" UBYTE NO_COMPU_METHOD 0 0 0 255 ECU_ADDRESS 0x3FCC44 FORMAT "%.4g" /end MEASUREMENT
/begin MEASUREMENT St_bsd_ktenable.B_dev_glrd "Diesel Gluehsteuergeraet enabled [RAM name from V530, interpolated]" UBYTE NO_COMPU_METHOD 0 0 0 255 ECU_ADDRESS 0x3FCC44 FORMAT "%.4g" /end MEASUREMENT
/begin MEASUREMENT St_bsd_ktenable.B_dev_ibs "IBS enabled [RAM name from V530, interpolated]" UBYTE NO_COMPU_METHOD 0 0 0 255 ECU_ADDRESS 0x3FCC44 FORMAT "%.4g" /end MEASUREMENT
/begin MEASUREMENT St_bsd_ktenable.B_dev_oz "Oelzustandssensor/QLT enabled [RAM name from V530, interpolated]" UBYTE NO_COMPU_METHOD 0 0 0 255 ECU_ADDRESS 0x3FCC44 FORMAT "%.4g" /end MEASUREMENT
/begin MEASUREMENT St_bsd_ktenable.B_dev_ozon "Ozonsensor enabled [RAM name from V530, interpolated]" UBYTE NO_COMPU_METHOD 0 0 0 255 ECU_ADDRESS 0x3FCC44 FORMAT "%.4g" /end MEASUREMENT
/begin MEASUREMENT St_bsd_ktenable.B_dev_wapue "Wasserpumpe Elektrik enabled [RAM name from V530, interpolated]" UBYTE NO_COMPU_METHOD 0 0 0 255 ECU_ADDRESS 0x3FCC44 FORMAT "%.4g" /end MEASUREMENT
/begin MEASUREMENT St_bsd_ktenable.B_dev_wapum "Wasserpumpe Motor enabled [RAM name from V530, interpolated]" UBYTE NO_COMPU_METHOD 0 0 0 255 ECU_ADDRESS 0x3FCC44 FORMAT "%.4g" /end MEASUREMENT
/begin MEASUREMENT batt_tausch_exd_timeout "Batterietausch-Erkennungszeit [RAM name from V530, interpolated]" UBYTE M_FORMULA_0461 0 0 0 25.5 ECU_ADDRESS 0x3FCC47 /end MEASUREMENT
/begin MEASUREMENT history_reset_exd_timeout "Ruhestrommessung-Erkennungszeit [RAM name from V530, interpolated]" UBYTE M_FORMULA_0461 0 0 0 25.5 ECU_ADDRESS 0x3FCC48 /end MEASUREMENT
/begin MEASUREMENT can_klst_s_roh "KLST-Rohinfo [RAM name from V530, interpolated]" UBYTE M_FORMULA_0003 0 0 0 255 ECU_ADDRESS 0x3FCC83 /end MEASUREMENT
/begin MEASUREMENT can_alive_grb2_cnt "Fehler Alive [RAM name from V530, interpolated]" UBYTE M_FORMULA_0003 0 0 0 255 ECU_ADDRESS 0x3FCC8F /end MEASUREMENT
/begin MEASUREMENT can_chksum_grb2_cnt "Fehler Checksumme [RAM name from V530, interpolated]" UBYTE M_FORMULA_0003 0 0 0 255 ECU_ADDRESS 0x3FCC91 /end MEASUREMENT
/begin MEASUREMENT can_grb2_timeout "Getriebe2-Timeout [RAM name from V530, interpolated]" UBYTE M_FORMULA_0461 0 0 0 25.5 ECU_ADDRESS 0x3FCC8E /end MEASUREMENT
/begin MEASUREMENT can_fst_reserve "Reservelampe [RAM name from V530, interpolated]" UBYTE NO_COMPU_METHOD 0 0 0 255 ECU_ADDRESS 0x3FCC9E FORMAT "%.4g" /end MEASUREMENT
/begin MEASUREMENT can_fgr_idx "Index FGR-Geschwindigkeit [RAM name from V530, interpolated]" UBYTE M_FORMULA_0003 0 0 0 255 ECU_ADDRESS 0x3FCCB8 /end MEASUREMENT
/begin MEASUREMENT diag_st_atic39_EV2 "Diagnosestatus ATIC39 Treiber Queue INJ [RAM name from V530, interpolated]" UBYTE NO_COMPU_METHOD 0 0 0 255 ECU_ADDRESS 0x3FCDC4 FORMAT "%.4g" /end MEASUREMENT
/begin MEASUREMENT diag_st_atic39_EV3 "Diagnosestatus ATIC39 Treiber Queue INJ [RAM name from V530, interpolated]" UBYTE NO_COMPU_METHOD 0 0 0 255 ECU_ADDRESS 0x3FCDC5 FORMAT "%.4g" /end MEASUREMENT
/begin MEASUREMENT diag_st_atic39_EV4 "Diagnosestatus ATIC39 Treiber Queue INJ [RAM name from V530, interpolated]" UBYTE NO_COMPU_METHOD 0 0 0 255 ECU_ADDRESS 0x3FCDC6 FORMAT "%.4g" /end MEASUREMENT
/begin MEASUREMENT diag_st_atic39_EV6 "Diagnosestatus ATIC39 Treiber Queue INJ [RAM name from V530, interpolated]" UBYTE NO_COMPU_METHOD 0 0 0 255 ECU_ADDRESS 0x3FCDC8 FORMAT "%.4g" /end MEASUREMENT
/begin MEASUREMENT diag_st_atic39_IGC11 "Diagnosestatus ATIC39 Treiber Queue INJ [RAM name from V530, interpolated]" UBYTE NO_COMPU_METHOD 0 0 0 255 ECU_ADDRESS 0x3FCDCE FORMAT "%.4g" /end MEASUREMENT
/begin MEASUREMENT diag_st_atic39_EV10 "Diagnosestatus ATIC39 Treiber Queue INJ [RAM name from V530, interpolated]" UBYTE NO_COMPU_METHOD 0 0 0 255 ECU_ADDRESS 0x3FCDD6 FORMAT "%.4g" /end MEASUREMENT
/begin MEASUREMENT diag_st_atic39_EV7 "Diagnosestatus ATIC39 Treiber Queue INJ [RAM name from V530, interpolated]" UBYTE NO_COMPU_METHOD 0 0 0 255 ECU_ADDRESS 0x3FCDD3 FORMAT "%.4g" /end MEASUREMENT
/begin MEASUREMENT diag_st_atic39_EV8 "Diagnosestatus ATIC39 Treiber Queue INJ [RAM name from V530, interpolated]" UBYTE NO_COMPU_METHOD 0 0 0 255 ECU_ADDRESS 0x3FCDD4 FORMAT "%.4g" /end MEASUREMENT
/begin MEASUREMENT diag_st_atic39_EV9 "Diagnosestatus ATIC39 Treiber Queue INJ [RAM name from V530, interpolated]" UBYTE NO_COMPU_METHOD 0 0 0 255 ECU_ADDRESS 0x3FCDD5 FORMAT "%.4g" /end MEASUREMENT
/begin MEASUREMENT diag_st_atic39_SERVO1 "Diagnosestatus ATIC39 Treiber Queue INJ [RAM name from V530, interpolated]" UBYTE NO_COMPU_METHOD 0 0 0 255 ECU_ADDRESS 0x3FCDD7 FORMAT "%.4g" /end MEASUREMENT
/begin MEASUREMENT diag_st_atic39_SERVO2 "Diagnosestatus ATIC39 Treiber Queue INJ [RAM name from V530, interpolated]" UBYTE NO_COMPU_METHOD 0 0 0 255 ECU_ADDRESS 0x3FCDD8 FORMAT "%.4g" /end MEASUREMENT
/begin MEASUREMENT diag_st_atic39_LHN1 "Diagnosestatus ATIC39 Treiber Queue INJ [RAM name from V530, interpolated]" UBYTE NO_COMPU_METHOD 0 0 0 255 ECU_ADDRESS 0x3FCDE1 FORMAT "%.4g" /end MEASUREMENT
/begin MEASUREMENT diag_st_atic39_LHN2 "Diagnosestatus ATIC39 Treiber Queue INJ [RAM name from V530, interpolated]" UBYTE NO_COMPU_METHOD 0 0 0 255 ECU_ADDRESS 0x3FCDE2 FORMAT "%.4g" /end MEASUREMENT
/begin MEASUREMENT diag_st_atic39_LLFSO "Diagnosestatus ATIC39 Treiber Queue INJ [RAM name from V530, interpolated]" UBYTE NO_COMPU_METHOD 0 0 0 255 ECU_ADDRESS 0x3FCDE7 FORMAT "%.4g" /end MEASUREMENT
/begin MEASUREMENT diag_st_atic39_LLFSS "Diagnosestatus ATIC39 Treiber Queue INJ [RAM name from V530, interpolated]" UBYTE NO_COMPU_METHOD 0 0 0 255 ECU_ADDRESS 0x3FCDE8 FORMAT "%.4g" /end MEASUREMENT
/begin MEASUREMENT diag_st_atic39_SLV "Diagnosestatus ATIC39 Treiber Queue INJ [RAM name from V530, interpolated]" UBYTE NO_COMPU_METHOD 0 0 0 255 ECU_ADDRESS 0x3FCDE5 FORMAT "%.4g" /end MEASUREMENT
/begin MEASUREMENT diag_st_atic39_SLV_ "Diagnosestatus ATIC39 Treiber Queue INJ [RAM name from V530, interpolated]" UBYTE NO_COMPU_METHOD 0 0 0 255 ECU_ADDRESS 0x3FCDE6 FORMAT "%.4g" /end MEASUREMENT
/begin MEASUREMENT diag_st_atic39_TEV1 "Diagnosestatus ATIC39 Treiber Queue INJ [RAM name from V530, interpolated]" UBYTE NO_COMPU_METHOD 0 0 0 255 ECU_ADDRESS 0x3FCDE3 FORMAT "%.4g" /end MEASUREMENT
/begin MEASUREMENT diag_st_atic39_TEV2 "Diagnosestatus ATIC39 Treiber Queue INJ [RAM name from V530, interpolated]" UBYTE NO_COMPU_METHOD 0 0 0 255 ECU_ADDRESS 0x3FCDE4 FORMAT "%.4g" /end MEASUREMENT
/begin MEASUREMENT diag_st_atic39_RLU87 "Diagnosestatus ATIC39 Treiber Queue INJ [RAM name from V530, interpolated]" UBYTE NO_COMPU_METHOD 0 0 0 255 ECU_ADDRESS 0x3FCDEA FORMAT "%.4g" /end MEASUREMENT
/begin MEASUREMENT diag_st_atic39_DMTLP "Diagnosestatus ATIC39 Treiber Queue INJ [RAM name from V530, interpolated]" UBYTE NO_COMPU_METHOD 0 0 0 255 ECU_ADDRESS 0x3FCDF0 FORMAT "%.4g" /end MEASUREMENT
/begin MEASUREMENT diag_st_atic35_NWE1 "Diagnosestatus ATIC35 Treiber Queue INJ [RAM name from V530, interpolated]" UBYTE NO_COMPU_METHOD 0 0 0 255 ECU_ADDRESS 0x3FCDF2 FORMAT "%.4g" /end MEASUREMENT
/begin MEASUREMENT diag_st_atic35_AKL "Diagnosestatus ATIC35 Treiber Queue INJ [RAM name from V530, interpolated]" UBYTE NO_COMPU_METHOD 0 0 0 255 ECU_ADDRESS 0x3FCDF5 FORMAT "%.4g" /end MEASUREMENT
/begin MEASUREMENT diag_st_atic35_EVAP2 "Diagnosestatus ATIC35 Treiber Queue INJ [RAM name from V530, interpolated]" UBYTE NO_COMPU_METHOD 0 0 0 255 ECU_ADDRESS 0x3FCDF8 FORMAT "%.4g" /end MEASUREMENT
/begin MEASUREMENT diag_st_atic35_NWA2 "Diagnosestatus ATIC35 Treiber Queue INJ [RAM name from V530, interpolated]" UBYTE NO_COMPU_METHOD 0 0 0 255 ECU_ADDRESS 0x3FCDF7 FORMAT "%.4g" /end MEASUREMENT
/begin MEASUREMENT diag_st_atic35_SERVO_EVAP1 "Diagnosestatus ATIC35 Treiber Queue INJ [RAM name from V530, interpolated]" UBYTE NO_COMPU_METHOD 0 0 0 255 ECU_ADDRESS 0x3FCDF9 FORMAT "%.4g" /end MEASUREMENT
/begin MEASUREMENT diag_st_atic35_KLIMA "Diagnosestatus ATIC35 Treiber Queue INJ [RAM name from V530, interpolated]" UBYTE NO_COMPU_METHOD 0 0 0 255 ECU_ADDRESS 0x3FCDFD FORMAT "%.4g" /end MEASUREMENT
/begin MEASUREMENT diag_st_atic35_SPORTLED "Diagnosestatus ATIC35 Treiber Queue INJ [RAM name from V530, interpolated]" UBYTE NO_COMPU_METHOD 0 0 0 255 ECU_ADDRESS 0x3FCDFC FORMAT "%.4g" /end MEASUREMENT
/begin MEASUREMENT St_dibs1 "Statuswort [RAM name from V530, interpolated]" UBYTE M_FORMULA_0003 0 0 0 255 ECU_ADDRESS 0x3FCE00 /end MEASUREMENT
/begin MEASUREMENT St_dibs1.B_ifbsak "BSD Kommunikation zum IBS gestoert [RAM name from V530, interpolated]" UBYTE NO_COMPU_METHOD 0 0 0 255 ECU_ADDRESS 0x3FCE00 FORMAT "%.4g" /end MEASUREMENT
/begin MEASUREMENT St_dibs1.B_ifebsak "Fehler erweiterte BSD Kommunikation zum IBS [RAM name from V530, interpolated]" UBYTE NO_COMPU_METHOD 0 0 0 255 ECU_ADDRESS 0x3FCE00 FORMAT "%.4g" /end MEASUREMENT
/begin MEASUREMENT St_dibs1.B_ifuplak "Fehler IBS Version unplausibel [RAM name from V530, interpolated]" UBYTE NO_COMPU_METHOD 0 0 0 255 ECU_ADDRESS 0x3FCE00 FORMAT "%.4g" /end MEASUREMENT
/begin MEASUREMENT Ibs1_errstat "Ibs1_errstat [RAM name from V530, interpolated]" UWORD M_FORMULA_0010 0 0 0 65535 ECU_ADDRESS 0x3FCE02 /end MEASUREMENT
/begin MEASUREMENT Ibs2_errstat "Ibs2_errstat [RAM name from V530, interpolated]" UWORD M_FORMULA_0010 0 0 0 65535 ECU_ADDRESS 0x3FCE04 /end MEASUREMENT
/begin MEASUREMENT dmtl_exd_p_st "Status externe Pumpen-Ansteuerung [RAM name from V530, interpolated]" UBYTE NO_COMPU_METHOD 0 0 0 255 ECU_ADDRESS 0x3FCE10 FORMAT "%.4g" /end MEASUREMENT
/begin MEASUREMENT dmtl_exd_v_st "Status externe Ventil-Ansteuerung [RAM name from V530, interpolated]" UBYTE NO_COMPU_METHOD 0 0 0 255 ECU_ADDRESS 0x3FCE12 FORMAT "%.4g" /end MEASUREMENT
/begin MEASUREMENT dmtl_exd_h_st "Status externe Heizungs-Ansteuerung [RAM name from V530, interpolated]" UBYTE NO_COMPU_METHOD 0 0 0 255 ECU_ADDRESS 0x3FCE14 FORMAT "%.4g" /end MEASUREMENT
/begin MEASUREMENT dmtl_i_filt_tank.rest "DMTL Strom korr. Filter-Rest fuer Betankung [RAM name from V530, interpolated]" UWORD M_FORMULA_0639 0 0 0 2.249965668 ECU_ADDRESS 0x3FCE24 /end MEASUREMENT
/begin MEASUREMENT dmtl_t_i_filt_beg "Timer fuer schnelle Stromfilterung nach Ventil schalten [RAM name from V530, interpolated]" UBYTE M_FORMULA_0461 0 0 0 25.5 ECU_ADDRESS 0x3FCE40 /end MEASUREMENT
/begin MEASUREMENT dwf_shli_dn "gefilt. Gradient [RAM name from V530, interpolated]" SWORD M_FORMULA_0105 0 0 -32768 32767 ECU_ADDRESS 0x3FCE62 /end MEASUREMENT
/begin MEASUREMENT dwf_shli_n "gefilt. Drehzahl [RAM name from V530, interpolated]" SWORD M_FORMULA_0006 0 0 -32768 32767 ECU_ADDRESS 0x3FCE64 /end MEASUREMENT
/begin MEASUREMENT dwf_shli_seg "angezeigte Segmente [RAM name from V530, interpolated]" UBYTE M_FORMULA_0656 0 0 0 255 ECU_ADDRESS 0x3FCE61 /end MEASUREMENT
/begin MEASUREMENT dwf_shli_tbegr "Zeit bis zum Begrenzer [RAM name from V530, interpolated]" UWORD M_FORMULA_0021 0 0 0 655.35 ECU_ADDRESS 0x3FCE66 /end MEASUREMENT
/begin MEASUREMENT elu_dreh "geforderte, v-korrigierte E-Luefterdrehzahl in % [RAM name from V530, interpolated]" UBYTE M_FORMULA_0032 0 0 0 255 ECU_ADDRESS 0x3FCE9D /end MEASUREMENT
/begin MEASUREMENT elu_dreh_sch "Schleppzeiger gefilterte ELU-Drehzahl [RAM name from V530, interpolated]" UBYTE M_FORMULA_0032 0 0 0 255 ECU_ADDRESS 0x3FCE9F /end MEASUREMENT
/begin MEASUREMENT elu_min_hys "minimale ELU-Hysterese [RAM name from V530, interpolated]" UBYTE M_FORMULA_0032 0 0 0 255 ECU_ADDRESS 0x3FCE9E /end MEASUREMENT
/begin MEASUREMENT elu_pwm_ml "berechnetes PWM-Signal bei ML [RAM name from V530, interpolated]" UBYTE M_FORMULA_0032 0 0 0 255 ECU_ADDRESS 0x3FCEA0 /end MEASUREMENT
/begin MEASUREMENT kats_ausloeser_b2 "Temperatur die den Kats ausgeloest hat [RAM name from V530, interpolated]" UBYTE NO_COMPU_METHOD 0 0 0 255 ECU_ADDRESS 0x3FD0FF FORMAT "%.4g" /end MEASUREMENT
/begin MEASUREMENT kats_lam_p_b2 "P-Anteil Katschutz [RAM name from V530, interpolated]" SWORD M_FORMULA_0025 0 0 -2 1.999938965 ECU_ADDRESS 0x3FD102 /end MEASUREMENT
/begin MEASUREMENT kats_lam_i_b2 "I-Anteil Katschutz [RAM name from V530, interpolated]" SWORD M_FORMULA_0199 0 0 -2 1.999938965 ECU_ADDRESS 0x3FD106 /end MEASUREMENT
/begin MEASUREMENT Ibs_reg5 "IBS Register 5 Var.not used: now St_ibsreg5 [RAM name from V530, interpolated]" UBYTE M_FORMULA_0003 0 0 0 255 ECU_ADDRESS 0x3FD127 /end MEASUREMENT
/begin MEASUREMENT Ibsbclctri "IBS Fehlerz???hler [RAM name from V530, interpolated]" UBYTE M_FORMULA_0003 0 0 0 255 ECU_ADDRESS 0x3FD13F /end MEASUREMENT
/begin MEASUREMENT Ibsiicctri "IBS Fehlerz???hler [RAM name from V530, interpolated]" UBYTE M_FORMULA_0003 0 0 0 255 ECU_ADDRESS 0x3FD13E /end MEASUREMENT
/begin MEASUREMENT Ibsborctr "IBS Fehlerz???hler [RAM name from V530, interpolated]" UWORD M_FORMULA_0010 0 0 0 65535 ECU_ADDRESS 0x3FD152 /end MEASUREMENT
/begin MEASUREMENT U_batt "Batteriespannung von IBS gemessen [RAM name from V530, interpolated]" UWORD M_FORMULA_0501 0 0 6 22.38375 ECU_ADDRESS 0x3FD150 /end MEASUREMENT
/begin MEASUREMENT Qelad "Delta Batterieentladung [RAM name from V530, interpolated]" UWORD M_FORMULA_0498 0 0 0 1192.750253 ECU_ADDRESS 0x3FD15C /end MEASUREMENT
/begin MEASUREMENT U_tnstart "Spannung im Start [RAM name from V530, interpolated]" UWORD M_FORMULA_0501 0 0 6 22.38375 ECU_ADDRESS 0x3FD174 /end MEASUREMENT
/begin MEASUREMENT T1histiruh "Ruhestromhistogramm Klasse 1 [RAM name from V530, interpolated]" UWORD M_FORMULA_0010 0 0 0 65535 ECU_ADDRESS 0x3FD17A /end MEASUREMENT
/begin MEASUREMENT T2histiruh "Ruhestromhistogramm Klasse 2 [RAM name from V530, interpolated]" UWORD M_FORMULA_0010 0 0 0 65535 ECU_ADDRESS 0x3FD17C /end MEASUREMENT
/begin MEASUREMENT T3histiruh "Ruhestromhistogramm Klasse 3 [RAM name from V530, interpolated]" UWORD M_FORMULA_0010 0 0 0 65535 ECU_ADDRESS 0x3FD17E /end MEASUREMENT
/begin MEASUREMENT T4histiruh "Ruhestromhistogramm Klasse 4 [RAM name from V530, interpolated]" UWORD M_FORMULA_0010 0 0 0 65535 ECU_ADDRESS 0x3FD180 /end MEASUREMENT
/begin MEASUREMENT la_trim_zust_ad_erm_b2 "AD-Wert Ermittlung [RAM name from V530, interpolated]" UWORD NO_COMPU_METHOD 0 0 0 65535 ECU_ADDRESS 0x3FD31A FORMAT "%.4g" /end MEASUREMENT
/begin MEASUREMENT la_trim_zust_b2 "LA-Trimmregelung-interner Zustand [RAM name from V530, interpolated]" UWORD M_FORMULA_0080 0 0 0 65535 ECU_ADDRESS 0x3FD31A /end MEASUREMENT
/begin MEASUREMENT la_trim_zust_i_ad_max_b2 "AD-Anteil - MAX-Begrenzung [RAM name from V530, interpolated]" UWORD NO_COMPU_METHOD 0 0 0 65535 ECU_ADDRESS 0x3FD31A FORMAT "%.4g" /end MEASUREMENT
/begin MEASUREMENT la_trim_zust_i_ad_min_b2 "AD-Anteil - MIN-Begrenzung [RAM name from V530, interpolated]" UWORD NO_COMPU_METHOD 0 0 0 65535 ECU_ADDRESS 0x3FD31A FORMAT "%.4g" /end MEASUREMENT
/begin MEASUREMENT la_trim_zust_i_b2 "I-Anteil-Verzoegerungzeit [RAM name from V530, interpolated]" UWORD NO_COMPU_METHOD 0 0 0 65535 ECU_ADDRESS 0x3FD31A FORMAT "%.4g" /end MEASUREMENT
/begin MEASUREMENT la_trim_zust_i_gmw_aktiv_b2 "Ermittlung GMW-I-Anteil [RAM name from V530, interpolated]" UWORD NO_COMPU_METHOD 0 0 0 65535 ECU_ADDRESS 0x3FD31A FORMAT "%.4g" /end MEASUREMENT
/begin MEASUREMENT la_trim_zust_i_init_gmw_b2 "I-Anteil vorbelegen [RAM name from V530, interpolated]" UWORD NO_COMPU_METHOD 0 0 0 65535 ECU_ADDRESS 0x3FD31A FORMAT "%.4g" /end MEASUREMENT
/begin MEASUREMENT la_trim_zust_i_max_b2 "Diagnose I-Anteil - MAX-Begrenzung [RAM name from V530, interpolated]" UWORD NO_COMPU_METHOD 0 0 0 65535 ECU_ADDRESS 0x3FD31A FORMAT "%.4g" /end MEASUREMENT
/begin MEASUREMENT la_trim_zust_i_min_b2 "Diagnose I-Anteil - MIN-Begrenzung [RAM name from V530, interpolated]" UWORD NO_COMPU_METHOD 0 0 0 65535 ECU_ADDRESS 0x3FD31A FORMAT "%.4g" /end MEASUREMENT
/begin MEASUREMENT la_trim_zust_p_abger_b2 "P-Anteil ist abgeregelt [RAM name from V530, interpolated]" UWORD NO_COMPU_METHOD 0 0 0 65535 ECU_ADDRESS 0x3FD31A FORMAT "%.4g" /end MEASUREMENT
/begin MEASUREMENT la_trim_zust_p_b2 "P-Anteil Ermittlung abgeschlossen [RAM name from V530, interpolated]" UWORD NO_COMPU_METHOD 0 0 0 65535 ECU_ADDRESS 0x3FD31A FORMAT "%.4g" /end MEASUREMENT
/begin MEASUREMENT la_trim_zust_us_o2_b2 "O2-Beladung freigeben - ueber Trimmregelung [RAM name from V530, interpolated]" UWORD NO_COMPU_METHOD 0 0 0 65535 ECU_ADDRESS 0x3FD31A FORMAT "%.4g" /end MEASUREMENT
/begin MEASUREMENT la_trim_us_diff_b1 "Diff. NKAT-Spannung IST zu SOLL [RAM name from V530, interpolated]" SWORD M_FORMULA_0536 0 0 -160000 159995.1172 ECU_ADDRESS 0x3FD320 /end MEASUREMENT
/begin MEASUREMENT la_trim_us_diff_b2 "Diff. NKAT-Spannung IST zu SOLL [RAM name from V530, interpolated]" SWORD M_FORMULA_0536 0 0 -160000 159995.1172 ECU_ADDRESS 0x3FD322 /end MEASUREMENT
/begin MEASUREMENT la_trim_usn_aebg_b1 "aebg. SOLL-NKAT-Spannung [RAM name from V530, interpolated]" UWORD M_FORMULA_0536 0 0 0 319995.1172 ECU_ADDRESS 0x3FD324 /end MEASUREMENT
/begin MEASUREMENT la_trim_usn_aebg_b2 "aebg. SOLL-NKAT-Spannung [RAM name from V530, interpolated]" UWORD M_FORMULA_0536 0 0 0 319995.1172 ECU_ADDRESS 0x3FD326 /end MEASUREMENT
/begin MEASUREMENT la_trim_usn_soll_b2 "SOLL-NKAT-Spannung [RAM name from V530, interpolated]" UWORD M_FORMULA_0536 0 0 0 319995.1172 ECU_ADDRESS 0x3FD31E /end MEASUREMENT
/begin MEASUREMENT la_trim_p_anz_b1 "Anzahl der P-Anteil Triggerungen [RAM name from V530, interpolated]" UWORD M_FORMULA_0010 0 0 0 65535 ECU_ADDRESS 0x3FD32C /end MEASUREMENT
/begin MEASUREMENT la_trim_p_anz_b2 "Anzahl der P-Anteil Triggerungen [RAM name from V530, interpolated]" UWORD M_FORMULA_0010 0 0 0 65535 ECU_ADDRESS 0x3FD32E /end MEASUREMENT
/begin MEASUREMENT la_trim_p_f_b1 "P-Anteil - Trimmregelung [RAM name from V530, interpolated]" UWORD M_FORMULA_0025 0 0 0 3.999938965 ECU_ADDRESS 0x3FD330 /end MEASUREMENT
/begin MEASUREMENT la_trim_p_f_b2 "P-Anteil - Trimmregelung [RAM name from V530, interpolated]" UWORD M_FORMULA_0025 0 0 0 3.999938965 ECU_ADDRESS 0x3FD332 /end MEASUREMENT
/begin MEASUREMENT la_trim_p_fak_obd_b2 "Faktor P-Anteil aus KAT-Alterung [RAM name from V530, interpolated]" UWORD M_FORMULA_0073 0 0 0 63.99902344 ECU_ADDRESS 0x3FD32A /end MEASUREMENT
/begin MEASUREMENT la_trim_i_f_b2 "I-Anteil - Trimmregelung [RAM name from V530, interpolated]" UWORD M_FORMULA_0908 0 0 0 819.1875 ECU_ADDRESS 0x3FD336 /end MEASUREMENT
/begin MEASUREMENT la_trim_i_inc_b2 "Integratorwert auf wirkenden I-Anteil [RAM name from V530, interpolated]" SWORD M_FORMULA_0199 0 0 -2 1.999938965 ECU_ADDRESS 0x3FD33A /end MEASUREMENT
/begin MEASUREMENT la_trim_i_b1 "wirkender I-Anteil [RAM name from V530, interpolated]" SWORD M_FORMULA_0025 0 0 -2 1.999938965 ECU_ADDRESS 0x3FD340 /end MEASUREMENT
/begin MEASUREMENT la_trim_i_b2 "wirkender I-Anteil [RAM name from V530, interpolated]" SWORD M_FORMULA_0025 0 0 -2 1.999938965 ECU_ADDRESS 0x3FD342 /end MEASUREMENT
/begin MEASUREMENT la_trim_p_b2 "wirkender P-Anteil [RAM name from V530, interpolated]" SWORD M_FORMULA_0025 0 0 -2 1.999938965 ECU_ADDRESS 0x3FD33E /end MEASUREMENT
/begin MEASUREMENT la_trim_i_gmw_b2 "wirkender I-Anteil - gemittelt [RAM name from V530, interpolated]" SWORD M_FORMULA_0025 0 0 -2 1.999938965 ECU_ADDRESS 0x3FD346 /end MEASUREMENT
/begin MEASUREMENT la_trim_lam_soll_b1 "LAM-SOLL-OFFSET der Trimmregelung [RAM name from V530, interpolated]" SWORD M_FORMULA_0025 0 0 -2 1.999938965 ECU_ADDRESS 0x3FD348 /end MEASUREMENT
/begin MEASUREMENT la_trim_lam_soll_b2 "LAM-SOLL-OFFSET der Trimmregelung [RAM name from V530, interpolated]" SWORD M_FORMULA_0025 0 0 -2 1.999938965 ECU_ADDRESS 0x3FD34A /end MEASUREMENT
/begin MEASUREMENT la_trim_i_fak_obd_b2 "Faktor I-Anteil aus KAT-Alterung [RAM name from V530, interpolated]" UWORD M_FORMULA_0073 0 0 0 63.99902344 ECU_ADDRESS 0x3FD34E /end MEASUREMENT
/begin MEASUREMENT la_trim_p_dly_b1 "Haltezeit f???r P-Anteil [RAM name from V530, interpolated]" UWORD M_FORMULA_0021 0 0 0 655.35 ECU_ADDRESS 0x3FD350 /end MEASUREMENT
/begin MEASUREMENT la_trim_p_dly_b2 "Haltezeit f???r P-Anteil [RAM name from V530, interpolated]" UWORD M_FORMULA_0021 0 0 0 655.35 ECU_ADDRESS 0x3FD352 /end MEASUREMENT
/begin MEASUREMENT la_trim_i_dly_b1 "Haltezeit f???r I-Anteil [RAM name from V530, interpolated]" UWORD M_FORMULA_0021 0 0 0 655.35 ECU_ADDRESS 0x3FD358 /end MEASUREMENT
/begin MEASUREMENT la_trim_i_dly_b2 "Haltezeit f???r I-Anteil [RAM name from V530, interpolated]" UWORD M_FORMULA_0021 0 0 0 655.35 ECU_ADDRESS 0x3FD35A /end MEASUREMENT
/begin MEASUREMENT la_trim_p_abr_b1 "Abregelungszeit P-Anteil [RAM name from V530, interpolated]" UWORD M_FORMULA_0021 0 0 0 655.35 ECU_ADDRESS 0x3FD35C /end MEASUREMENT
/begin MEASUREMENT la_trim_p_abr_b2 "Abregelungszeit P-Anteil [RAM name from V530, interpolated]" UWORD M_FORMULA_0021 0 0 0 655.35 ECU_ADDRESS 0x3FD35E /end MEASUREMENT
/begin MEASUREMENT la_trim_p_wait_b2 "Wartezeit f???r weiteren P-Anteil [RAM name from V530, interpolated]" UWORD M_FORMULA_0021 0 0 0 655.35 ECU_ADDRESS 0x3FD356 /end MEASUREMENT
/begin MEASUREMENT la_trim_diag_p_cnt_b1 "Anzahl P-Anteil-Fkt.-Durchlaeufe [RAM name from V530, interpolated]" UWORD M_FORMULA_0010 0 0 0 65535 ECU_ADDRESS 0x3FD368 /end MEASUREMENT
/begin MEASUREMENT la_trim_diag_p_cnt_b2 "Anzahl P-Anteil-Fkt.-Durchlaeufe [RAM name from V530, interpolated]" UWORD M_FORMULA_0010 0 0 0 65535 ECU_ADDRESS 0x3FD36A /end MEASUREMENT
/begin MEASUREMENT la_trim_p_dez_b2 "Abregelungswert P-Anteil [RAM name from V530, interpolated]" SLONG M_FORMULA_0909 0 0 -131072 131071.9999 ECU_ADDRESS 0x3FD364 /end MEASUREMENT
/begin MEASUREMENT la_trim_diag_i_ed_f_b2 "Aufweitungsfaktor auf d. I-Anteils-Bereichsgrenzen [RAM name from V530, interpolated]" UWORD M_FORMULA_0073 0 0 0 63.99902344 ECU_ADDRESS 0x3FD36E /end MEASUREMENT
/begin MEASUREMENT la_trim_diag_i_min_cnt_b2 "Anzahl I-Anteil min. Begrenzung [RAM name from V530, interpolated]" UWORD M_FORMULA_0010 0 0 0 65535 ECU_ADDRESS 0x3FD372 /end MEASUREMENT
/begin MEASUREMENT lam_b1.ip_gain "Pumpstromverstaerkung [RAM name from V530, interpolated]" UWORD M_FORMULA_0010 0 0 0 65535 ECU_ADDRESS 0x3FD40C /end MEASUREMENT
/begin MEASUREMENT lam_b1.ist_ad "LAM-IST aus Kennlinie [RAM name from V530, interpolated]" UWORD M_FORMULA_0025 0 0 0 3.999938965 ECU_ADDRESS 0x3FD416 /end MEASUREMENT
/begin MEASUREMENT lam_b1.ist_mw_grad "Gradient d. LA-IST-MW [RAM name from V530, interpolated]" SWORD M_FORMULA_0751 0 0 -0.002 0.001999938965 ECU_ADDRESS 0x3FD41A /end MEASUREMENT
/begin MEASUREMENT lam_b1.lavk_ad_korr "korrigierter AD-Wert. [RAM name from V530, interpolated]" SWORD M_FORMULA_0536 0 0 -160000 159995.1172 ECU_ADDRESS 0x3FD406 /end MEASUREMENT
/begin MEASUREMENT lam_b1.lavk_ad_mw "AD-Wert d. Sondensignals - 1kHz-Abtastung [RAM name from V530, interpolated]" UWORD M_FORMULA_0536 0 0 0 319995.1172 ECU_ADDRESS 0x3FD404 /end MEASUREMENT
/begin MEASUREMENT lam_b1.lavk_ad_mw_korr "korrigierter AD-Wert. - 1kHz-Abtastung [RAM name from V530, interpolated]" SWORD M_FORMULA_0536 0 0 -160000 159995.1172 ECU_ADDRESS 0x3FD408 /end MEASUREMENT
/begin MEASUREMENT lam_b1.lavk_ip "Pumpsptrom [RAM name from V530, interpolated]" SWORD M_FORMULA_0750 0 0 -10 9.999694824 ECU_ADDRESS 0x3FD40E /end MEASUREMENT
/begin MEASUREMENT lam_b1.lavk_ip_korr "korrigierter Pumpsptrom [RAM name from V530, interpolated]" SWORD M_FORMULA_0750 0 0 -10 9.999694824 ECU_ADDRESS 0x3FD412 /end MEASUREMENT
/begin MEASUREMENT lam_b1.lavk_ip_mw "Pumpsptrom - 1kHz-Abtastung [RAM name from V530, interpolated]" SWORD M_FORMULA_0750 0 0 -10 9.999694824 ECU_ADDRESS 0x3FD410 /end MEASUREMENT
/begin MEASUREMENT lam_b1.lavk_ip_mw_korr "korrigierter Pumpsptrom - 1kHz-Abtastung [RAM name from V530, interpolated]" SWORD M_FORMULA_0750 0 0 -10 9.999694824 ECU_ADDRESS 0x3FD414 /end MEASUREMENT
/begin MEASUREMENT lam_b1.lavk_korr_f "Ip-Korrekturfaktor [RAM name from V530, interpolated]" UWORD M_FORMULA_0073 0 0 0 63.99902344 ECU_ADDRESS 0x3FD40A /end MEASUREMENT
/begin MEASUREMENT lam_b1.zahn_nr "aktueller KW-Zahn [RAM name from V530, interpolated]" UWORD M_FORMULA_0010 0 0 0 65535 ECU_ADDRESS 0x3FD41C /end MEASUREMENT
/begin MEASUREMENT lam_b1.laa_ml_f "Ermittlung Luftmassenfaktor [RAM name from V530, interpolated]" UWORD M_FORMULA_0024 0 0 0 1.999969482 ECU_ADDRESS 0x3FD43A /end MEASUREMENT
/begin MEASUREMENT lam_b1.laa_ml_offs "Ermittlung Luftmassenoffset [RAM name from V530, interpolated]" SWORD M_FORMULA_0535 0 0 -512 511.984375 ECU_ADDRESS 0x3FD438 /end MEASUREMENT
/begin MEASUREMENT lam_b1.laa_f_te_grad_neg "Abregelwert fuer Vergessen des LAA-Faktor ueber TE [RAM name from V530, interpolated]" UWORD M_FORMULA_0024 0 0 0 1.999969482 ECU_ADDRESS 0x3FD440 /end MEASUREMENT
/begin MEASUREMENT lam_b1.laa_ml_f_te "Ermittlung TE-Luftmassenfaktor [RAM name from V530, interpolated]" UWORD M_FORMULA_0024 0 0 0 1.999969482 ECU_ADDRESS 0x3FD442 /end MEASUREMENT
/begin MEASUREMENT lam_b1.lavk_filt_konst "IST-LA-Filterkonstante [RAM name from V530, interpolated]" UWORD M_FORMULA_0762 0 0 0 7.99987793 ECU_ADDRESS 0x3FD448 /end MEASUREMENT
/begin MEASUREMENT lam_b1.lavk_tau1 "TAU1 - IST-LA-Filter [RAM name from V530, interpolated]" UWORD M_FORMULA_0761 0 0 0 2097.12 ECU_ADDRESS 0x3FD444 /end MEASUREMENT
/begin MEASUREMENT lam.atic42_ip_gain_b2 "ATIC42 IP-GAIN [RAM name from V530, interpolated]" UWORD NO_COMPU_METHOD 0 0 0 65535 ECU_ADDRESS 0x3FD44C FORMAT "%.4g" /end MEASUREMENT
/begin MEASUREMENT lam.lavk_status_b2 "Sonden-Status [RAM name from V530, interpolated]" UWORD NO_COMPU_METHOD 0 0 0 65535 ECU_ADDRESS 0x3FD44C FORMAT "%.4g" /end MEASUREMENT
/begin MEASUREMENT lam_b2.lavk_st "Sonden-Status [RAM name from V530, interpolated]" UWORD M_FORMULA_0080 0 0 0 65535 ECU_ADDRESS 0x3FD44C /end MEASUREMENT
/begin MEASUREMENT lam_b2.ip_gain "Pumpstromverstaerkung [RAM name from V530, interpolated]" UWORD M_FORMULA_0010 0 0 0 65535 ECU_ADDRESS 0x3FD458 /end MEASUREMENT
/begin MEASUREMENT lam_b2.ist_ad "LAM-IST aus Kennlinie [RAM name from V530, interpolated]" UWORD M_FORMULA_0025 0 0 0 3.999938965 ECU_ADDRESS 0x3FD462 /end MEASUREMENT
/begin MEASUREMENT lam_b2.ist_mw_grad "Gradient d. LA-IST-MW [RAM name from V530, interpolated]" SWORD M_FORMULA_0751 0 0 -0.002 0.001999938965 ECU_ADDRESS 0x3FD466 /end MEASUREMENT
/begin MEASUREMENT lam_b2.lavk_ad "AD-Wert d. Sondensignals [RAM name from V530, interpolated]" UWORD M_FORMULA_0536 0 0 0 319995.1172 ECU_ADDRESS 0x3FD44E /end MEASUREMENT
/begin MEASUREMENT lam_b2.lavk_ad_korr "korrigierter AD-Wert. [RAM name from V530, interpolated]" SWORD M_FORMULA_0536 0 0 -160000 159995.1172 ECU_ADDRESS 0x3FD452 /end MEASUREMENT
/begin MEASUREMENT lam_b2.lavk_ad_mw "AD-Wert d. Sondensignals - 1kHz-Abtastung [RAM name from V530, interpolated]" UWORD M_FORMULA_0536 0 0 0 319995.1172 ECU_ADDRESS 0x3FD450 /end MEASUREMENT
/begin MEASUREMENT lam_b2.lavk_ad_mw_korr "korrigierter AD-Wert. - 1kHz-Abtastung [RAM name from V530, interpolated]" SWORD M_FORMULA_0536 0 0 -160000 159995.1172 ECU_ADDRESS 0x3FD454 /end MEASUREMENT
/begin MEASUREMENT lam_b2.lavk_ip "Pumpsptrom [RAM name from V530, interpolated]" SWORD M_FORMULA_0750 0 0 -10 9.999694824 ECU_ADDRESS 0x3FD45A /end MEASUREMENT
/begin MEASUREMENT lam_b2.lavk_ip_korr "korrigierter Pumpsptrom [RAM name from V530, interpolated]" SWORD M_FORMULA_0750 0 0 -10 9.999694824 ECU_ADDRESS 0x3FD45E /end MEASUREMENT
/begin MEASUREMENT lam_b2.lavk_ip_mw "Pumpsptrom - 1kHz-Abtastung [RAM name from V530, interpolated]" SWORD M_FORMULA_0750 0 0 -10 9.999694824 ECU_ADDRESS 0x3FD45C /end MEASUREMENT
/begin MEASUREMENT lam_b2.lavk_ip_mw_korr "korrigierter Pumpsptrom - 1kHz-Abtastung [RAM name from V530, interpolated]" SWORD M_FORMULA_0750 0 0 -10 9.999694824 ECU_ADDRESS 0x3FD460 /end MEASUREMENT
/begin MEASUREMENT lam_b2.lavk_korr_f "Ip-Korrekturfaktor [RAM name from V530, interpolated]" UWORD M_FORMULA_0073 0 0 0 63.99902344 ECU_ADDRESS 0x3FD456 /end MEASUREMENT
/begin MEASUREMENT lam_b2.zahn_nr "aktueller KW-Zahn [RAM name from V530, interpolated]" UWORD M_FORMULA_0010 0 0 0 65535 ECU_ADDRESS 0x3FD468 /end MEASUREMENT
/begin MEASUREMENT lam_reg_f_min_b2 "min. Regeleingriff [RAM name from V530, interpolated]" UWORD M_FORMULA_0024 0 0 0 1.999969482 ECU_ADDRESS 0x3FD4A4 /end MEASUREMENT
/begin MEASUREMENT lam_reg_f_max_b2 "max. Regeleingriff [RAM name from V530, interpolated]" UWORD M_FORMULA_0024 0 0 0 1.999969482 ECU_ADDRESS 0x3FD4A8 /end MEASUREMENT
/begin MEASUREMENT laa_offs_mw_t_b1 "Zeitzaehler f. Mittelwertbildung [RAM name from V530, interpolated]" UWORD M_FORMULA_0763 0 0 0 65535 ECU_ADDRESS 0x3FD4B2 /end MEASUREMENT
/begin MEASUREMENT laa_offs_mw_t_b2 "Zeitzaehler f. Mittelwertbildung [RAM name from V530, interpolated]" UWORD M_FORMULA_0763 0 0 0 65535 ECU_ADDRESS 0x3FD4B4 /end MEASUREMENT
/begin MEASUREMENT laa_f_mw_t_b2 "Zeitzaehler f. Mittelwertbildung [RAM name from V530, interpolated]" UWORD M_FORMULA_0763 0 0 0 65535 ECU_ADDRESS 0x3FD4B8 /end MEASUREMENT
/begin MEASUREMENT laa_f_te_mw_t_b1 "Zeitzaehler f. Mittelwertbildung [RAM name from V530, interpolated]" UWORD M_FORMULA_0763 0 0 0 65535 ECU_ADDRESS 0x3FD4BA /end MEASUREMENT
/begin MEASUREMENT laa_f_te_mw_t_b2 "Zeitzaehler f. Mittelwertbildung [RAM name from V530, interpolated]" UWORD M_FORMULA_0763 0 0 0 65535 ECU_ADDRESS 0x3FD4BC /end MEASUREMENT
/begin MEASUREMENT laa_offs_mw_cnt_b1 "Zaehlervariable f. Mittelwertbildung [RAM name from V530, interpolated]" UWORD M_FORMULA_0010 0 0 0 65535 ECU_ADDRESS 0x3FD4BE /end MEASUREMENT
/begin MEASUREMENT laa_offs_mw_cnt_b2 "Zaehlervariable f. Mittelwertbildung [RAM name from V530, interpolated]" UWORD M_FORMULA_0010 0 0 0 65535 ECU_ADDRESS 0x3FD4C0 /end MEASUREMENT
/begin MEASUREMENT laa_f_mw_cnt_b2 "Zaehlervariable f. Mittelwertbildung [RAM name from V530, interpolated]" UWORD M_FORMULA_0010 0 0 0 65535 ECU_ADDRESS 0x3FD4C4 /end MEASUREMENT
/begin MEASUREMENT laa_f_te_mw_cnt_b1 "Zaehlervariable f. Mittelwertbildung [RAM name from V530, interpolated]" UWORD M_FORMULA_0010 0 0 0 65535 ECU_ADDRESS 0x3FD4C6 /end MEASUREMENT
/begin MEASUREMENT laa_f_te_mw_cnt_b2 "Zaehlervariable f. Mittelwertbildung [RAM name from V530, interpolated]" UWORD M_FORMULA_0010 0 0 0 65535 ECU_ADDRESS 0x3FD4C8 /end MEASUREMENT
/begin MEASUREMENT lavk_ad_gain_delta_t_b2 "Delta-Zeit zwischen 2 GAIN-Adaptionen [RAM name from V530, interpolated]" ULONG M_FORMULA_0147 0 0 0 42949672.95 ECU_ADDRESS 0x3FD520 /end MEASUREMENT
/begin MEASUREMENT lavk_ad_offs_delta_t_b2 "Delta-Zeit zwischen 2 OFFSET-Adaptionen [RAM name from V530, interpolated]" ULONG M_FORMULA_0147 0 0 0 42949672.95 ECU_ADDRESS 0x3FD528 /end MEASUREMENT
/begin MEASUREMENT lam_diag_la_adapt_scdn_b2 "Diagnose LAA-Adaption - SCDN [RAM name from V530, interpolated]" UWORD NO_COMPU_METHOD 0 0 0 65535 ECU_ADDRESS 0x3FD52E FORMAT "%.4g" /end MEASUREMENT
/begin MEASUREMENT lam_diag_laa_f_max_aktiv_b2 "oberer LAA-Faktor-Anschlag [RAM name from V530, interpolated]" UWORD NO_COMPU_METHOD 0 0 0 65535 ECU_ADDRESS 0x3FD52E FORMAT "%.4g" /end MEASUREMENT
/begin MEASUREMENT lam_diag_laa_f_min_aktiv_b2 "unterer LAA-Faktor-Anschlag [RAM name from V530, interpolated]" UWORD NO_COMPU_METHOD 0 0 0 65535 ECU_ADDRESS 0x3FD52E FORMAT "%.4g" /end MEASUREMENT
/begin MEASUREMENT lam_diag_laa_offs_max_aktiv_b2 "oberer LAA-Offset-Anschlag [RAM name from V530, interpolated]" UWORD NO_COMPU_METHOD 0 0 0 65535 ECU_ADDRESS 0x3FD52E FORMAT "%.4g" /end MEASUREMENT
/begin MEASUREMENT lam_diag_laa_offs_min_aktiv_b2 "unterer LAA-Offset-Anschlag [RAM name from V530, interpolated]" UWORD NO_COMPU_METHOD 0 0 0 65535 ECU_ADDRESS 0x3FD52E FORMAT "%.4g" /end MEASUREMENT
/begin MEASUREMENT lam_diag_lam_reg_scdn_b2 "Diagnose LA-Regler - SCDN [RAM name from V530, interpolated]" UWORD NO_COMPU_METHOD 0 0 0 65535 ECU_ADDRESS 0x3FD52E FORMAT "%.4g" /end MEASUREMENT
/begin MEASUREMENT lam_diag_reg_max_aktiv_b2 "oberer LA-Regler-Anschlag [RAM name from V530, interpolated]" UWORD NO_COMPU_METHOD 0 0 0 65535 ECU_ADDRESS 0x3FD52E FORMAT "%.4g" /end MEASUREMENT
/begin MEASUREMENT lam_diag_reg_min_aktiv_b2 "unterer LA-Regler-Anschlag [RAM name from V530, interpolated]" UWORD NO_COMPU_METHOD 0 0 0 65535 ECU_ADDRESS 0x3FD52E FORMAT "%.4g" /end MEASUREMENT
/begin MEASUREMENT lam_diag_st_b2 "Status LA-Anschlagsdiagnose [RAM name from V530, interpolated]" UWORD M_FORMULA_0080 0 0 0 65535 ECU_ADDRESS 0x3FD52E /end MEASUREMENT
/begin MEASUREMENT lam_diag_reg_t_b2 "LA-Regleranschlag - Start [RAM name from V530, interpolated]" UWORD M_FORMULA_0010 0 0 0 65535 ECU_ADDRESS 0x3FD532 /end MEASUREMENT
/begin MEASUREMENT lam_diag_laa_f_t_b1 "LAA-Faktoranschlagszeit [RAM name from V530, interpolated]" UWORD M_FORMULA_0071 0 0 0 6553.5 ECU_ADDRESS 0x3FD538 /end MEASUREMENT
/begin MEASUREMENT lam_diag_laa_f_t_b2 "LAA-Faktoranschlagszeit [RAM name from V530, interpolated]" UWORD M_FORMULA_0071 0 0 0 6553.5 ECU_ADDRESS 0x3FD53A /end MEASUREMENT
/begin MEASUREMENT lam_diag_reg_io_t_b2 "LA-Regleranschlag - Heilung [RAM name from V530, interpolated]" UWORD M_FORMULA_0010 0 0 0 65535 ECU_ADDRESS 0x3FD536 /end MEASUREMENT
/begin MEASUREMENT lam_diag_laa_io_t_b2 "LAA-Aanschlag - Heilung [RAM name from V530, interpolated]" UWORD M_FORMULA_0010 0 0 0 65535 ECU_ADDRESS 0x3FD53E /end MEASUREMENT
/begin MEASUREMENT lam_diag_laa_f_cnt_b2 "Zahler fuer LAA-Faktoranschlagszeit [RAM name from V530, interpolated]" UWORD M_FORMULA_0010 0 0 0 65535 ECU_ADDRESS 0x3FD546 /end MEASUREMENT
/begin MEASUREMENT lam_diag_laa_offs_cnt_b2 "Zeit fuer LAA-Offsetanschlagszeit [RAM name from V530, interpolated]" UWORD M_FORMULA_0010 0 0 0 65535 ECU_ADDRESS 0x3FD54A /end MEASUREMENT
/begin MEASUREMENT lam_w_b1.soll_add_konv "Pulshub - Konvertierung [RAM name from V530, interpolated]" SWORD M_FORMULA_0025 0 0 -2 1.999938965 ECU_ADDRESS 0x3FD562 /end MEASUREMENT
/begin MEASUREMENT lam_w_b1.soll_add_temp "additiver Pulshub - vor AEBG [RAM name from V530, interpolated]" SWORD M_FORMULA_0025 0 0 -2 1.999938965 ECU_ADDRESS 0x3FD568 /end MEASUREMENT
/begin MEASUREMENT lam_w_b1.soll_bas "gewuenschtes SOLL-Lambda [RAM name from V530, interpolated]" UWORD M_FORMULA_0025 0 0 0 3.999938965 ECU_ADDRESS 0x3FD556 /end MEASUREMENT
/begin MEASUREMENT lam_w_b1.soll_bas_diff "lam_soll_bas-lam_soll_bas_lim [RAM name from V530, interpolated]" SWORD M_FORMULA_0025 0 0 -2 1.999938965 ECU_ADDRESS 0x3FD55A /end MEASUREMENT
/begin MEASUREMENT lam_w_b1.soll_bas_lim "aenderungsbegr. SOLL-Lambda [RAM name from V530, interpolated]" UWORD M_FORMULA_0025 0 0 0 3.999938965 ECU_ADDRESS 0x3FD558 /end MEASUREMENT
/begin MEASUREMENT lam_w_b1.soll_delta_neg "neg. Aenderungsbegrenzung [RAM name from V530, interpolated]" SWORD M_FORMULA_0025 0 0 -2 1.999938965 ECU_ADDRESS 0x3FD560 /end MEASUREMENT
/begin MEASUREMENT lam_w_b1.soll_delta_pos "pos. Aenderungsbegrenzung [RAM name from V530, interpolated]" SWORD M_FORMULA_0025 0 0 -2 1.999938965 ECU_ADDRESS 0x3FD55E /end MEASUREMENT
/begin MEASUREMENT lam_w_b1.soll_filt "gefiltertes LAM_SOLL [RAM name from V530, interpolated]" UWORD M_FORMULA_0025 0 0 0 3.999938965 ECU_ADDRESS 0x3FD56A /end MEASUREMENT
/begin MEASUREMENT lam_w_b1.soll_ms_kat_delta "zugefuehrte Sauerstoffmasse im KAT/ASP [RAM name from V530, interpolated]" SWORD M_FORMULA_0796 0 0 -819.2 819.175 ECU_ADDRESS 0x3FD564 /end MEASUREMENT
/begin MEASUREMENT lam_w_b1.soll_ms_kat_init "Ausgangspunkt f. Sauerstoffmassenintegration im KAT [RAM name from V530, interpolated]" SWORD M_FORMULA_0090 0 0 -3276.8 3276.7 ECU_ADDRESS 0x3FD566 /end MEASUREMENT
/begin MEASUREMENT lam_w_b1.soll_vl_bezug "Bezugswert f. Ermittlung VL-SOLL-Lambda [RAM name from V530, interpolated]" UWORD M_FORMULA_0025 0 0 0 3.999938965 ECU_ADDRESS 0x3FD55C /end MEASUREMENT
/begin MEASUREMENT lam_w_b1.ml_zyl_filt "gefilterte zyl. Luftmasse in mg/ASP [RAM name from V530, interpolated]" SWORD M_FORMULA_0090 0 0 -3276.8 3276.7 ECU_ADDRESS 0x3FD570 /end MEASUREMENT
/begin MEASUREMENT lam_w_b1.soll_filt_konst "SOLL-Filterkonstante [RAM name from V530, interpolated]" UWORD M_FORMULA_0762 0 0 0 7.99987793 ECU_ADDRESS 0x3FD56E /end MEASUREMENT
/begin MEASUREMENT lam_w_b1.tz_offs_kats "TZ-OFFSET aus KR [RAM name from V530, interpolated]" SWORD M_FORMULA_0102 0 0 -3276.8 3276.7 ECU_ADDRESS 0x3FD578 /end MEASUREMENT
/begin MEASUREMENT lam_w_b2.ml_zyl_filt "gefilterte zyl. Luftmasse in mg/ASP [RAM name from V530, interpolated]" SWORD M_FORMULA_0090 0 0 -3276.8 3276.7 ECU_ADDRESS 0x3FD5A6 /end MEASUREMENT
/begin MEASUREMENT lam_w_b2.soll_add_konv "Pulshub - Konvertierung [RAM name from V530, interpolated]" SWORD M_FORMULA_0025 0 0 -2 1.999938965 ECU_ADDRESS 0x3FD598 /end MEASUREMENT
/begin MEASUREMENT lam_w_b2.soll_add_temp "additiver Pulshub - vor AEBG [RAM name from V530, interpolated]" SWORD M_FORMULA_0025 0 0 -2 1.999938965 ECU_ADDRESS 0x3FD59E /end MEASUREMENT
/begin MEASUREMENT lam_w_b2.soll_bas "gewuenschtes SOLL-Lambda [RAM name from V530, interpolated]" UWORD M_FORMULA_0025 0 0 0 3.999938965 ECU_ADDRESS 0x3FD58C /end MEASUREMENT
/begin MEASUREMENT lam_w_b2.soll_bas_diff "lam_soll_bas-lam_soll_bas_lim [RAM name from V530, interpolated]" SWORD M_FORMULA_0025 0 0 -2 1.999938965 ECU_ADDRESS 0x3FD590 /end MEASUREMENT
/begin MEASUREMENT lam_w_b2.soll_bas_lim "aenderungsbegr. SOLL-Lambda [RAM name from V530, interpolated]" UWORD M_FORMULA_0025 0 0 0 3.999938965 ECU_ADDRESS 0x3FD58E /end MEASUREMENT
/begin MEASUREMENT lam_w_b2.soll_delta_neg "neg. Aenderungsbegrenzung [RAM name from V530, interpolated]" SWORD M_FORMULA_0025 0 0 -2 1.999938965 ECU_ADDRESS 0x3FD596 /end MEASUREMENT
/begin MEASUREMENT lam_w_b2.soll_delta_pos "pos. Aenderungsbegrenzung [RAM name from V530, interpolated]" SWORD M_FORMULA_0025 0 0 -2 1.999938965 ECU_ADDRESS 0x3FD594 /end MEASUREMENT
/begin MEASUREMENT lam_w_b2.soll_filt "gefiltertes LAM_SOLL [RAM name from V530, interpolated]" UWORD M_FORMULA_0025 0 0 0 3.999938965 ECU_ADDRESS 0x3FD5A0 /end MEASUREMENT
/begin MEASUREMENT lam_w_b2.soll_filt_konst "SOLL-Filterkonstante [RAM name from V530, interpolated]" UWORD M_FORMULA_0762 0 0 0 7.99987793 ECU_ADDRESS 0x3FD5A4 /end MEASUREMENT
/begin MEASUREMENT lam_w_b2.soll_ms_kat_delta "zugefuehrte Sauerstoffmasse im KAT/ASP [RAM name from V530, interpolated]" SWORD M_FORMULA_0796 0 0 -819.2 819.175 ECU_ADDRESS 0x3FD59A /end MEASUREMENT
/begin MEASUREMENT lam_w_b2.soll_ms_kat_init "Ausgangspunkt f. Sauerstoffmassenintegration im KAT [RAM name from V530, interpolated]" SWORD M_FORMULA_0090 0 0 -3276.8 3276.7 ECU_ADDRESS 0x3FD59C /end MEASUREMENT
/begin MEASUREMENT lam_w_b2.soll_stat "SOLL-Lambda entsprechend dem LAM_SOLL-Zustand [RAM name from V530, interpolated]" UWORD M_FORMULA_0025 0 0 0 3.999938965 ECU_ADDRESS 0x3FD58A /end MEASUREMENT
/begin MEASUREMENT lam_w_b2.soll_tau1 "TAU1 - SOLL-Filter [RAM name from V530, interpolated]" UWORD M_FORMULA_0761 0 0 0 2097.12 ECU_ADDRESS 0x3FD5A2 /end MEASUREMENT
/begin MEASUREMENT lam_w_b2.soll_vl_bezug "Bezugswert f. Ermittlung VL-SOLL-Lambda [RAM name from V530, interpolated]" UWORD M_FORMULA_0025 0 0 0 3.999938965 ECU_ADDRESS 0x3FD592 /end MEASUREMENT
/begin MEASUREMENT lam_w_b2.tz_offs_kats "TZ-OFFSET aus KR [RAM name from V530, interpolated]" SWORD M_FORMULA_0102 0 0 -3276.8 3276.7 ECU_ADDRESS 0x3FD5AE /end MEASUREMENT
/begin MEASUREMENT lam_soll_bz_md "md f. Uebergang TL -> VL [RAM name from V530, interpolated]" SWORD M_FORMULA_0001 0 0 -3276.8 3276.7 ECU_ADDRESS 0x3FD5D0 /end MEASUREMENT
/begin MEASUREMENT lam_soll_norm_b1 "SOLL-Lambda - Bezugsgroesse Lambda-SOLL [RAM name from V530, interpolated]" UWORD M_FORMULA_0025 0 0 0 3.999938965 ECU_ADDRESS 0x3FD5E8 /end MEASUREMENT
/begin MEASUREMENT lam_soll_norm_b2 "SOLL-Lambda - Bezugsgroesse Lambda-SOLL [RAM name from V530, interpolated]" UWORD M_FORMULA_0025 0 0 0 3.999938965 ECU_ADDRESS 0x3FD5EA /end MEASUREMENT
/begin MEASUREMENT lam_ist_mw_korr_b1 "korrigierter Mittelwert IST-Lambda [RAM name from V530, interpolated]" UWORD M_FORMULA_0025 0 0 0 3.999938965 ECU_ADDRESS 0x3FD5FC /end MEASUREMENT
/begin MEASUREMENT lam_ist_mw_korr_b2 "korrigierter Mittelwert IST-Lambda [RAM name from V530, interpolated]" UWORD M_FORMULA_0025 0 0 0 3.999938965 ECU_ADDRESS 0x3FD5FE /end MEASUREMENT
/begin MEASUREMENT lam_soll_add_kat_alt_f_b1 "Wichtungsfaktor ueber KAT-Alterung [RAM name from V530, interpolated]" UWORD M_FORMULA_0073 0 0 0 63.99902344 ECU_ADDRESS 0x3FD604 /end MEASUREMENT
/begin MEASUREMENT lam_soll_add_kat_alt_f_b2 "Wichtungsfaktor ueber KAT-Alterung [RAM name from V530, interpolated]" UWORD M_FORMULA_0073 0 0 0 63.99902344 ECU_ADDRESS 0x3FD606 /end MEASUREMENT
/begin MEASUREMENT lam_soll_vl_norm_b2 "Uebergang nach Vollast [RAM name from V530, interpolated]" UBYTE NO_COMPU_METHOD 0 0 0 255 ECU_ADDRESS 0x3FD619 FORMAT "%.4g" /end MEASUREMENT
/begin MEASUREMENT lank_us_filt_b2 "gefiltertes NKAT-Signal f. NKAT-Regler [RAM name from V530, interpolated]" UWORD M_FORMULA_0536 0 0 0 319995.1172 ECU_ADDRESS 0x3FD690 /end MEASUREMENT
/begin MEASUREMENT lank_sgn_b2 "NKAT-Signallage [RAM name from V530, interpolated]" UBYTE NO_COMPU_METHOD 0 0 0 255 ECU_ADDRESS 0x3FD693 FORMAT "%.4g" /end MEASUREMENT
/begin MEASUREMENT lavk_obd_plau_oszi_off_b2 "Ausschaltzeit des ATIC42-Oszi f. UN-OL-Diag. [RAM name from V530, interpolated]" UWORD M_FORMULA_0071 0 0 0 6553.5 ECU_ADDRESS 0x3FD740 /end MEASUREMENT
/begin MEASUREMENT lavk_obd_plau_t_b2 "Verzoegerungszeit Plausi-Diag. [RAM name from V530, interpolated]" UWORD M_FORMULA_0071 0 0 0 6553.5 ECU_ADDRESS 0x3FD744 /end MEASUREMENT
/begin MEASUREMENT lavk_obd_plau_f_cnt_b2 "Fehlerzaehler FETT-Plausi [RAM name from V530, interpolated]" UWORD M_FORMULA_0010 0 0 0 65535 ECU_ADDRESS 0x3FD748 /end MEASUREMENT
/begin MEASUREMENT lavk_obd_plau_m_cnt_b2 "Fehlerzaehler MAGER-Plausi [RAM name from V530, interpolated]" UWORD M_FORMULA_0010 0 0 0 65535 ECU_ADDRESS 0x3FD74C /end MEASUREMENT
/begin MEASUREMENT lavk_obd_plau_ol_cnt_b2 "Fehlerzaehler OL-Diag IP/VM [RAM name from V530, interpolated]" UWORD M_FORMULA_0010 0 0 0 65535 ECU_ADDRESS 0x3FD750 /end MEASUREMENT
/begin MEASUREMENT lavk_obd_plau_ip_stabil_t_b2 "min. Zeit auf Erkennung DYNAMIK [RAM name from V530, interpolated]" UWORD M_FORMULA_0668 0 0 0 6553500 ECU_ADDRESS 0x3FD754 /end MEASUREMENT
/begin MEASUREMENT lavk_obd_sa_st_b2 "Status OBD-LAVK-SA-Pruefung [RAM name from V530, interpolated]" UWORD NO_COMPU_METHOD 0 0 0 65535 ECU_ADDRESS 0x3FD758 FORMAT "%.4g" /end MEASUREMENT
/begin MEASUREMENT lavk_obd_sa_cnt_b1 "Fehlerzaehler SA-Pruefung [RAM name from V530, interpolated]" UWORD M_FORMULA_0010 0 0 0 65535 ECU_ADDRESS 0x3FD75E /end MEASUREMENT
/begin MEASUREMENT lavk_obd_sa_cnt_b2 "Fehlerzaehler SA-Pruefung [RAM name from V530, interpolated]" UWORD M_FORMULA_0010 0 0 0 65535 ECU_ADDRESS 0x3FD760 /end MEASUREMENT
/begin MEASUREMENT lavk_obd_sa_t_b2 "Verzoegerungszeit SA-Diag. [RAM name from V530, interpolated]" UWORD M_FORMULA_0071 0 0 0 6553.5 ECU_ADDRESS 0x3FD75C /end MEASUREMENT
/begin MEASUREMENT lavk_obd_tl_st_b2 "Status OBD-LAVK-Plausibilisierung [RAM name from V530, interpolated]" UWORD NO_COMPU_METHOD 0 0 0 65535 ECU_ADDRESS 0x3FD764 FORMAT "%.4g" /end MEASUREMENT
/begin MEASUREMENT lavk_obd_tl_cnt_b1 "Fehlerzaehler TL/VL-Diagnose [RAM name from V530, interpolated]" UWORD M_FORMULA_0010 0 0 0 65535 ECU_ADDRESS 0x3FD76A /end MEASUREMENT
/begin MEASUREMENT lavk_obd_tl_cnt_b2 "Fehlerzaehler TL/VL-Diagnose [RAM name from V530, interpolated]" UWORD M_FORMULA_0010 0 0 0 65535 ECU_ADDRESS 0x3FD76C /end MEASUREMENT
/begin MEASUREMENT lavk_obd_tl_t_b2 "Verzoegerungszeit TL/VL-Diag. [RAM name from V530, interpolated]" UWORD M_FORMULA_0071 0 0 0 6553.5 ECU_ADDRESS 0x3FD768 /end MEASUREMENT
/begin MEASUREMENT lavk_obd_act_verz_t_b1 "Verzoegerungszeit [RAM name from V530, interpolated]" UWORD M_FORMULA_0071 0 0 0 6553.5 ECU_ADDRESS 0x3FD772 /end MEASUREMENT
/begin MEASUREMENT lavk_obd_act_nk_m_cnt_b1 "Zaehler NKAT - Diagnose MAGER [RAM name from V530, interpolated]" UWORD M_FORMULA_0010 0 0 0 65535 ECU_ADDRESS 0x3FD77A /end MEASUREMENT
/begin MEASUREMENT lavk_obd_act_nk_f_cnt_b1 "Zaehler VKAT - Diagnose FETT [RAM name from V530, interpolated]" UWORD M_FORMULA_0010 0 0 0 65535 ECU_ADDRESS 0x3FD77E /end MEASUREMENT
/begin MEASUREMENT lavk_atic42_mode_b2 "SPI Mode ATIC42 [RAM name from V530, interpolated]" UBYTE NO_COMPU_METHOD 0 0 0 255 ECU_ADDRESS 0x3FD795 FORMAT "%.4g" /end MEASUREMENT
/begin MEASUREMENT lavk_atic42_cnt_b2 "Ablaufzaeker SPI ATIC42 [RAM name from V530, interpolated]" UBYTE M_FORMULA_0003 0 0 0 255 ECU_ADDRESS 0x3FD797 /end MEASUREMENT
/begin MEASUREMENT lavk_atic42_ri_range_b2 "ATIC42 Innenwiderstands Messbereich [RAM name from V530, interpolated]" UBYTE NO_COMPU_METHOD 0 0 0 255 ECU_ADDRESS 0x3FD7A9 FORMAT "%.4g" /end MEASUREMENT
/begin MEASUREMENT lavk_atic42_icp_value_b1 "ATIC42 ICP Wert [RAM name from V530, interpolated]" UWORD M_FORMULA_0875 0 0 5.15 337510.4 ECU_ADDRESS 0x3FD7AE /end MEASUREMENT
/begin MEASUREMENT lavk_atic42_icp_value_b2 "ATIC42 ICP Wert [RAM name from V530, interpolated]" UWORD M_FORMULA_0875 0 0 5.15 337510.4 ECU_ADDRESS 0x3FD7B0 /end MEASUREMENT
/begin MEASUREMENT lavk_atic42_ip_loop_enable_b2 "ATIC42 Pumpstrom Regelung [RAM name from V530, interpolated]" UBYTE NO_COMPU_METHOD 0 0 0 255 ECU_ADDRESS 0x3FD7AB FORMAT "%.4g" /end MEASUREMENT
/begin MEASUREMENT lavk_atic42_pin_b1 "Pin-Freigabe [RAM name from V530, interpolated]" UBYTE NO_COMPU_METHOD 0 0 0 255 ECU_ADDRESS 0x3FD7AC FORMAT "%.4g" /end MEASUREMENT
/begin MEASUREMENT lavk_atic42_pin_b2 "Pin-Freigabe [RAM name from V530, interpolated]" UBYTE NO_COMPU_METHOD 0 0 0 255 ECU_ADDRESS 0x3FD7AD FORMAT "%.4g" /end MEASUREMENT
/begin MEASUREMENT lavk_atic42_protec_time_b1 "ATIC42 Zeit in der der Sensor nach einem Fehler getrennt wird [RAM name from V530, interpolated]" UWORD M_FORMULA_0876 0 0 0.8 6554.3 ECU_ADDRESS 0x3FD7B2 /end MEASUREMENT
/begin MEASUREMENT lavk_atic42_protec_time_b2 "ATIC42 Zeit in der der Sensor nach einem Fehler getrennt wird [RAM name from V530, interpolated]" UWORD M_FORMULA_0876 0 0 0.8 6554.3 ECU_ADDRESS 0x3FD7B4 /end MEASUREMENT
/begin MEASUREMENT lavk_atic42_ri_freq_b1 "ATIC42 Frequenz der Oszillators zur Innenwiderstandsmessung [RAM name from V530, interpolated]" UWORD M_FORMULA_0877 0 0 1.9531 7997.2231 ECU_ADDRESS 0x3FD7B6 /end MEASUREMENT
/begin MEASUREMENT lavk_atic42_ri_freq_b2 "ATIC42 Frequenz der Oszillators zur Innenwiderstandsmessung [RAM name from V530, interpolated]" UWORD M_FORMULA_0877 0 0 1.9531 7997.2231 ECU_ADDRESS 0x3FD7B8 /end MEASUREMENT
/begin MEASUREMENT lavk_atic42_pin_diag_b2 "ATIC42 - Pin Diagnose [RAM name from V530, interpolated]" UBYTE M_FORMULA_0003 0 0 0 255 ECU_ADDRESS 0x3FD7BB /end MEASUREMENT
/begin MEASUREMENT lavk_atic42_diag_byte_b2 "ATIC42 - Diagnose Byte [RAM name from V530, interpolated]" UBYTE M_FORMULA_0003 0 0 0 255 ECU_ADDRESS 0x3FD7BD /end MEASUREMENT
/begin MEASUREMENT lavk_atic42_identity_b2 "lavk_atic42_identity_b2 [RAM name from V530, interpolated]" UWORD M_FORMULA_0010 0 0 0 65535 ECU_ADDRESS 0x3FD7C0 /end MEASUREMENT
/begin MEASUREMENT lshnk_b1.temp "Sondentemperatur NKAT [RAM name from V530, interpolated]" SWORD M_FORMULA_0023 0 0 -3550 3003.5 ECU_ADDRESS 0x3FD830 /end MEASUREMENT
/begin MEASUREMENT lshnk_b2.temp "Sondentemperatur NKAT [RAM name from V530, interpolated]" SWORD M_FORMULA_0023 0 0 -3550 3003.5 ECU_ADDRESS 0x3FD836 /end MEASUREMENT
/begin MEASUREMENT lshnk_exd_timeout_b2 "KWP-Ansteuerzeit [RAM name from V530, interpolated]" UWORD M_FORMULA_0921 0 0 0 655.35 ECU_ADDRESS 0x3FD83A /end MEASUREMENT
/begin MEASUREMENT lshnk_diag_b1.i_cnt "Summen-Diag.Zaehler NKAT [RAM name from V530, interpolated]" UWORD M_FORMULA_0010 0 0 0 65535 ECU_ADDRESS 0x3FD840 /end MEASUREMENT
/begin MEASUREMENT lshnk_diag_b1.i_sum "Summe d. Heizerstroms NKAT [RAM name from V530, interpolated]" UWORD M_FORMULA_0925 0 0 0 304.8139535 ECU_ADDRESS 0x3FD842 /end MEASUREMENT
/begin MEASUREMENT lshnk_diag_b1.i_wert "gemittelter Heizerstrom NKAT [RAM name from V530, interpolated]" UWORD M_FORMULA_0925 0 0 0 304.8139535 ECU_ADDRESS 0x3FD844 /end MEASUREMENT
/begin MEASUREMENT lshnk_diag_b1.r "Heizerwiderstand NKAT [RAM name from V530, interpolated]" UWORD M_FORMULA_0541 0 0 0 6553.5 ECU_ADDRESS 0x3FD846 /end MEASUREMENT
/begin MEASUREMENT lshnk_diag_b2.i_cnt "Summen-Diag.Zaehler NKAT [RAM name from V530, interpolated]" UWORD M_FORMULA_0010 0 0 0 65535 ECU_ADDRESS 0x3FD84E /end MEASUREMENT
/begin MEASUREMENT lshnk_diag_b2.i_sum "Summe d. Heizerstroms NKAT [RAM name from V530, interpolated]" UWORD M_FORMULA_0925 0 0 0 304.8139535 ECU_ADDRESS 0x3FD850 /end MEASUREMENT
/begin MEASUREMENT lshnk_diag_b2.i_wert "gemittelter Heizerstrom NKAT [RAM name from V530, interpolated]" UWORD M_FORMULA_0925 0 0 0 304.8139535 ECU_ADDRESS 0x3FD852 /end MEASUREMENT
/begin MEASUREMENT lshnk_diag_b2.r "Heizerwiderstand NKAT [RAM name from V530, interpolated]" UWORD M_FORMULA_0541 0 0 0 6553.5 ECU_ADDRESS 0x3FD854 /end MEASUREMENT
/begin MEASUREMENT lshnk_rf_aus "Ausschaltschwelle RF fuer LSHN [RAM name from V530, interpolated]" SWORD M_FORMULA_0007 0 0 -3.2768 3.2767 ECU_ADDRESS 0x3FD858 /end MEASUREMENT
/begin MEASUREMENT lshvk_b1.tv_add "Additiver Anteil des Tastverhaeltnisses [RAM name from V530, interpolated]" UWORD M_FORMULA_0935 0 0 0 3199.951172 ECU_ADDRESS 0x3FD8A2 /end MEASUREMENT
/begin MEASUREMENT lshvk_b1.tv_begr "TV-Wert aus Aenderungsbegr. [RAM name from V530, interpolated]" UWORD M_FORMULA_0935 0 0 0 3199.951172 ECU_ADDRESS 0x3FD89C /end MEASUREMENT
/begin MEASUREMENT lshvk_b1.tv_eff_max "max. eff. Heizerspannung [RAM name from V530, interpolated]" UWORD M_FORMULA_0935 0 0 0 3199.951172 ECU_ADDRESS 0x3FD89E /end MEASUREMENT
/begin MEASUREMENT lshvk_b1.tv_korr "korr. Tastverhaeltnis VKAT [RAM name from V530, interpolated]" UWORD M_FORMULA_0935 0 0 0 3199.951172 ECU_ADDRESS 0x3FD89A /end MEASUREMENT
/begin MEASUREMENT lshvk_b1.tv_korr_max "Anteil des Tastverhaeltnisses ueber Aengerungsbegr. [RAM name from V530, interpolated]" SWORD M_FORMULA_0935 0 0 -1600 1599.951172 ECU_ADDRESS 0x3FD8A0 /end MEASUREMENT
/begin MEASUREMENT lshvk_b1.reg_t_max "Heizungsregleranschlagszeit [RAM name from V530, interpolated]" UWORD M_FORMULA_0593 0 0 0 65535 ECU_ADDRESS 0x3FD8AA /end MEASUREMENT
/begin MEASUREMENT lshvk_b1.tv_grad "pos. Aenderungsbegrenzung [RAM name from V530, interpolated]" SWORD M_FORMULA_0936 0 0 -1600 1599.951172 ECU_ADDRESS 0x3FD8A6 /end MEASUREMENT
/begin MEASUREMENT lshvk_b2.temp_heiz "IST-Temp. VKAT - Heizleistung [RAM name from V530, interpolated]" SWORD M_FORMULA_0023 0 0 -3550 3003.5 ECU_ADDRESS 0x3FD8B2 /end MEASUREMENT
/begin MEASUREMENT lshvk_b2.tv_add "Additiver Anteil des Tastverhaeltnisses [RAM name from V530, interpolated]" UWORD M_FORMULA_0935 0 0 0 3199.951172 ECU_ADDRESS 0x3FD8C8 /end MEASUREMENT
/begin MEASUREMENT lshvk_b2.tv_begr "TV-Wert aus Aenderungsbegr. [RAM name from V530, interpolated]" UWORD M_FORMULA_0935 0 0 0 3199.951172 ECU_ADDRESS 0x3FD8C2 /end MEASUREMENT
/begin MEASUREMENT lshvk_b2.tv_eff_max "max. eff. Heizerspannung [RAM name from V530, interpolated]" UWORD M_FORMULA_0935 0 0 0 3199.951172 ECU_ADDRESS 0x3FD8C4 /end MEASUREMENT
/begin MEASUREMENT lshvk_b2.tv_korr "korr. Tastverhaeltnis VKAT [RAM name from V530, interpolated]" UWORD M_FORMULA_0935 0 0 0 3199.951172 ECU_ADDRESS 0x3FD8C0 /end MEASUREMENT
/begin MEASUREMENT lshvk_b2.tv_korr_max "Anteil des Tastverhaeltnisses ueber Aengerungsbegr. [RAM name from V530, interpolated]" SWORD M_FORMULA_0935 0 0 -1600 1599.951172 ECU_ADDRESS 0x3FD8C6 /end MEASUREMENT
/begin MEASUREMENT lshvk_b2.reg_t_max "Heizungsregleranschlagszeit [RAM name from V530, interpolated]" UWORD M_FORMULA_0593 0 0 0 65535 ECU_ADDRESS 0x3FD8D0 /end MEASUREMENT
/begin MEASUREMENT lshvk_b2.tv_grad "pos. Aenderungsbegrenzung [RAM name from V530, interpolated]" SWORD M_FORMULA_0936 0 0 -1600 1599.951172 ECU_ADDRESS 0x3FD8CC /end MEASUREMENT
/begin MEASUREMENT lshvk_exd_timeout_b2 "KWP-Ansteuerzeit [RAM name from V530, interpolated]" UBYTE M_FORMULA_0937 0 0 0 25.5 ECU_ADDRESS 0x3FD8D9 /end MEASUREMENT
/begin MEASUREMENT lshvk_diag_r_b2 "Heizerwiderstand VKAT [RAM name from V530, interpolated]" UWORD M_FORMULA_0541 0 0 0 6553.5 ECU_ADDRESS 0x3FD8E0 /end MEASUREMENT
/begin MEASUREMENT lshvk_diag_mess_cnt_b2 "Anzahl gueltiger VKAT-R-Messungen [RAM name from V530, interpolated]" UWORD M_FORMULA_0010 0 0 0 65535 ECU_ADDRESS 0x3FD8E4 /end MEASUREMENT
/begin MEASUREMENT lsrvk_obd_ref_cnt_b2 "Anzahl erfolgter LA-Ri-GAIN-Ermittlungen [RAM name from V530, interpolated]" UWORD M_FORMULA_0010 0 0 0 65535 ECU_ADDRESS 0x3FD8EE /end MEASUREMENT
/begin MEASUREMENT lshvk_r_ad_gain_delta_b1 "Delta-Sonden-Ri-Adaption [RAM name from V530, interpolated]" UWORD M_FORMULA_0073 0 0 0 63.99902344 ECU_ADDRESS 0x3FD908 /end MEASUREMENT
/begin MEASUREMENT lshvk_r_ad_gain_delta_b2 "Delta-Sonden-Ri-Adaption [RAM name from V530, interpolated]" UWORD M_FORMULA_0073 0 0 0 63.99902344 ECU_ADDRESS 0x3FD90A /end MEASUREMENT
/begin MEASUREMENT lshvk_r_ad_gain_delta_t_b1 "Delta-Zeit zwischen 2 GAIN-Adaptionen [RAM name from V530, interpolated]" ULONG M_FORMULA_0147 0 0 0 42949672.95 ECU_ADDRESS 0x3FD90C /end MEASUREMENT
/begin MEASUREMENT lshvk_r_ad_gain_delta_t_b2 "Delta-Zeit zwischen 2 GAIN-Adaptionen [RAM name from V530, interpolated]" ULONG M_FORMULA_0147 0 0 0 42949672.95 ECU_ADDRESS 0x3FD910 /end MEASUREMENT
/begin MEASUREMENT lshvk_r_ad_offs_delta_t_b2 "Delta-Zeit zwischen 2 OFFSET-Adaptionen [RAM name from V530, interpolated]" ULONG M_FORMULA_0147 0 0 0 42949672.95 ECU_ADDRESS 0x3FD918 /end MEASUREMENT
/begin MEASUREMENT msg_timer "Timer Meldung [RAM name from V530, interpolated]" UBYTE M_FORMULA_0461 0 0 0 25.5 ECU_ADDRESS 0x3FD944 /end MEASUREMENT
/begin MEASUREMENT mvac_pdiff_sr "Differenzdruck(Modell) Saugrohr/Mastervac mit Hysterese [RAM name from V530, interpolated]" SWORD M_FORMULA_0075 0 0 -2048 2047.9375 ECU_ADDRESS 0x3FD996 /end MEASUREMENT
/begin MEASUREMENT mvac_ml_sr_rsv_roh "Luftmassenstromrohwert(Modell) Saugrohr/Mvac [RAM name from V530, interpolated]" SWORD M_FORMULA_0103 0 0 -3276.8 3276.7 ECU_ADDRESS 0x3FD99A /end MEASUREMENT
/begin MEASUREMENT mvac_aq_bre_sa "AQ-Offset LL-Steller Bank 2 bei SA [RAM name from V530, interpolated]" UWORD M_FORMULA_0143 0 0 0 6553.5 ECU_ADDRESS 0x3FD9DE /end MEASUREMENT
/begin MEASUREMENT n_timer_stoerung_b "Zeitzaehler fuer Freeze Drehzahlerfassung [RAM name from V530, interpolated]" SBYTE M_FORMULA_0306 0 0 -1.28 1.27 ECU_ADDRESS 0x3FDA53 /end MEASUREMENT
/begin MEASUREMENT n_zahn_b "Drehzahl aus Zahnabstand [RAM name from V530, interpolated]" SWORD M_FORMULA_0006 0 0 -32768 32767 ECU_ADDRESS 0x3FDA58 /end MEASUREMENT
/begin MEASUREMENT n_t_segm_b "Segmentzeit. [RAM name from V530, interpolated]" UWORD M_FORMULA_0354 0 0 0 104.856 ECU_ADDRESS 0x3FDA60 /end MEASUREMENT
/begin MEASUREMENT n_begr_toel_kalt "Drehzahlbegrenzung bei kaltem Oel [RAM name from V530, interpolated]" SWORD M_FORMULA_0006 0 0 -32768 32767 ECU_ADDRESS 0x3FDAA8 /end MEASUREMENT
/begin MEASUREMENT o2_lam_soll_fett_hub_b2 "FETT-HUB [RAM name from V530, interpolated]" UWORD NO_COMPU_METHOD 0 0 0 65535 ECU_ADDRESS 0x3FDB2A FORMAT "%.4g" /end MEASUREMENT
/begin MEASUREMENT o2_lam_soll_fett_hub_trig_b2 "FETT-HUB nach Adaption [RAM name from V530, interpolated]" UWORD NO_COMPU_METHOD 0 0 0 65535 ECU_ADDRESS 0x3FDB2A FORMAT "%.4g" /end MEASUREMENT
/begin MEASUREMENT o2_lam_soll_fett_ukp_b2 "Umkehrpunkt im FETT-Hub [RAM name from V530, interpolated]" UWORD NO_COMPU_METHOD 0 0 0 65535 ECU_ADDRESS 0x3FDB2A FORMAT "%.4g" /end MEASUREMENT
/begin MEASUREMENT o2_lam_soll_mager_hub_b2 "MAGER-HUB [RAM name from V530, interpolated]" UWORD NO_COMPU_METHOD 0 0 0 65535 ECU_ADDRESS 0x3FDB2A FORMAT "%.4g" /end MEASUREMENT
/begin MEASUREMENT o2_lam_soll_mager_hub_trig_b2 "MAGER-HUB nach Adaption [RAM name from V530, interpolated]" UWORD NO_COMPU_METHOD 0 0 0 65535 ECU_ADDRESS 0x3FDB2A FORMAT "%.4g" /end MEASUREMENT
/begin MEASUREMENT o2_lam_soll_mager_per_b2 "Periodendauerberechnung auf MAGER-HUB [RAM name from V530, interpolated]" UWORD NO_COMPU_METHOD 0 0 0 65535 ECU_ADDRESS 0x3FDB2A FORMAT "%.4g" /end MEASUREMENT
/begin MEASUREMENT o2_lam_soll_mager_ukp_b2 "Umkehrpunkt im MAGER-Hub [RAM name from V530, interpolated]" UWORD NO_COMPU_METHOD 0 0 0 65535 ECU_ADDRESS 0x3FDB2A FORMAT "%.4g" /end MEASUREMENT
/begin MEASUREMENT o2_lam_soll_pus_b2 "Aktivierung Pulsgenerator [RAM name from V530, interpolated]" UWORD NO_COMPU_METHOD 0 0 0 65535 ECU_ADDRESS 0x3FDB2A FORMAT "%.4g" /end MEASUREMENT
/begin MEASUREMENT o2_obd_dyn_t_verz_b2 "Verzoegerungszeit nach Dynamik [RAM name from V530, interpolated]" UWORD NO_COMPU_METHOD 0 0 0 65535 ECU_ADDRESS 0x3FDB2A FORMAT "%.4g" /end MEASUREMENT
/begin MEASUREMENT o2_obd_rf_min_schwelle_b2 "RF-MIN-Schwelle [RAM name from V530, interpolated]" UWORD NO_COMPU_METHOD 0 0 0 65535 ECU_ADDRESS 0x3FDB2A FORMAT "%.4g" /end MEASUREMENT
/begin MEASUREMENT o2_obd_st_b2 "O2-OBD-Status [RAM name from V530, interpolated]" UWORD M_FORMULA_0080 0 0 0 65535 ECU_ADDRESS 0x3FDB2A /end MEASUREMENT
/begin MEASUREMENT o2_obd_tkat_min_b2 "TKAT-MIN-Schwelle [RAM name from V530, interpolated]" UWORD NO_COMPU_METHOD 0 0 0 65535 ECU_ADDRESS 0x3FDB2A FORMAT "%.4g" /end MEASUREMENT
/begin MEASUREMENT o2_obd_t_sum_b2 "Periodendauer d. Zwangsanregung [RAM name from V530, interpolated]" UWORD M_FORMULA_0763 0 0 0 65535 ECU_ADDRESS 0x3FDB2E /end MEASUREMENT
/begin MEASUREMENT o2_obd_t_mager_b2 "Zeit der MAGER-Beladung [RAM name from V530, interpolated]" UWORD M_FORMULA_0763 0 0 0 65535 ECU_ADDRESS 0x3FDB32 /end MEASUREMENT
/begin MEASUREMENT o2_obd_t_fett_b2 "Zeit der FETT-Beladung [RAM name from V530, interpolated]" UWORD M_FORMULA_0763 0 0 0 65535 ECU_ADDRESS 0x3FDB36 /end MEASUREMENT
/begin MEASUREMENT o2_obd_period_cnt_b2 "Anzahl d. durchgefuehrten Zwangsperioden [RAM name from V530, interpolated]" UWORD M_FORMULA_0010 0 0 0 65535 ECU_ADDRESS 0x3FDB3A /end MEASUREMENT
/begin MEASUREMENT o2_obd_dyn_t_b1 "Verzoegerungszeit bei Dynamik [RAM name from V530, interpolated]" UWORD M_FORMULA_0763 0 0 0 65535 ECU_ADDRESS 0x3FDB40 /end MEASUREMENT
/begin MEASUREMENT o2_obd_dyn_t_b2 "Verzoegerungszeit bei Dynamik [RAM name from V530, interpolated]" UWORD M_FORMULA_0763 0 0 0 65535 ECU_ADDRESS 0x3FDB42 /end MEASUREMENT
/begin MEASUREMENT o2_rf_min_schw_t_b2 "Verzoegerungszeit bei RF-MIN-Verletzung [RAM name from V530, interpolated]" UWORD M_FORMULA_0763 0 0 0 65535 ECU_ADDRESS 0x3FDB3E /end MEASUREMENT
/begin MEASUREMENT kat_o2_per_cnt_passiv_b2 "akt, Zahl d. Zwangsperioden in PASSIV [RAM name from V530, interpolated]" UWORD M_FORMULA_0010 0 0 0 65535 ECU_ADDRESS 0x3FDB52 /end MEASUREMENT
/begin MEASUREMENT kat_obd_zykl_cnt_b1 "Anzahl d. gueltigen Zyklen [RAM name from V530, interpolated]" UWORD M_FORMULA_0010 0 0 0 65535 ECU_ADDRESS 0x3FDB54 /end MEASUREMENT
/begin MEASUREMENT kat_obd_zykl_cnt_b2 "Anzahl d. gueltigen Zyklen [RAM name from V530, interpolated]" UWORD M_FORMULA_0010 0 0 0 65535 ECU_ADDRESS 0x3FDB56 /end MEASUREMENT
/begin MEASUREMENT kat_obd_lank_sum_b2 "aufsummierter NKAT-LA-Wert [RAM name from V530, interpolated]" ULONG M_FORMULA_1016 0 0 0 262143.9999 ECU_ADDRESS 0x3FDB5C /end MEASUREMENT
/begin MEASUREMENT kat_obd_t_cnt_b2 "Zaehler - aufsummierten NKAT-LA-Werte [RAM name from V530, interpolated]" UWORD M_FORMULA_0010 0 0 0 65535 ECU_ADDRESS 0x3FDB62 /end MEASUREMENT
/begin MEASUREMENT kat_obd_lank_diff_b2 "Abweichung des akt. LANK-LA-Werts zum Mittelwert [RAM name from V530, interpolated]" UWORD M_FORMULA_0025 0 0 0 3.999938965 ECU_ADDRESS 0x3FDB6A /end MEASUREMENT
/begin MEASUREMENT kat_obd_lank_diff_sum_b2 "aufsummierte Abweichung d. akt. Werts zum Mittelwert [RAM name from V530, interpolated]" ULONG M_FORMULA_1016 0 0 0 262143.9999 ECU_ADDRESS 0x3FDB70 /end MEASUREMENT
/begin MEASUREMENT kat_obd_lank_diff_sum_f_b2 "aufsummierte Abweichung zum MW - Zyklus FETT [RAM name from V530, interpolated]" ULONG M_FORMULA_1016 0 0 0 262143.9999 ECU_ADDRESS 0x3FDB78 /end MEASUREMENT
/begin MEASUREMENT kat_obd_lank_diff_sum_m_b1 "aufsummierte Abweichung zum MW - Zyklus MAGER [RAM name from V530, interpolated]" ULONG M_FORMULA_1016 0 0 0 262143.9999 ECU_ADDRESS 0x3FDB7C /end MEASUREMENT
/begin MEASUREMENT kat_obd_lank_diff_sum_m_b2 "aufsummierte Abweichung zum MW - Zyklus MAGER [RAM name from V530, interpolated]" ULONG M_FORMULA_1016 0 0 0 262143.9999 ECU_ADDRESS 0x3FDB80 /end MEASUREMENT
/begin MEASUREMENT kat_obd_int_b2 "gemittelte Abweichung zum Mittelwert [RAM name from V530, interpolated]" UWORD M_FORMULA_0025 0 0 0 3.999938965 ECU_ADDRESS 0x3FDB86 /end MEASUREMENT
/begin MEASUREMENT kat_obd_wicht_b1 "gewichtete gem. Abweichung zum Mittelwert [RAM name from V530, interpolated]" UWORD M_FORMULA_0025 0 0 0 3.999938965 ECU_ADDRESS 0x3FDB88 /end MEASUREMENT
/begin MEASUREMENT kat_obd_verh_b1 "Wichtungsverhaeltnis - Diag.Wert [RAM name from V530, interpolated]" UWORD M_FORMULA_0073 0 0 0 63.99902344 ECU_ADDRESS 0x3FDB94 /end MEASUREMENT
/begin MEASUREMENT kat_obd_wicht_sum_b2 "aufsum. gewichtete gem. Abweichung z. MW [RAM name from V530, interpolated]" ULONG M_FORMULA_1016 0 0 0 262143.9999 ECU_ADDRESS 0x3FDB90 /end MEASUREMENT
/begin MEASUREMENT kat_obd_verh_cnt_b1 "Zaehler - verworfene Messungen [RAM name from V530, interpolated]" UWORD M_FORMULA_0010 0 0 0 65535 ECU_ADDRESS 0x3FDB98 /end MEASUREMENT
/begin MEASUREMENT kat_obd_verh_cnt_b2 "Zaehler - verworfene Messungen [RAM name from V530, interpolated]" UWORD M_FORMULA_0010 0 0 0 65535 ECU_ADDRESS 0x3FDB9A /end MEASUREMENT
/begin MEASUREMENT lavk_obd_dyn_ampl_max_b1 "max. zulaessige Amplitude [RAM name from V530, interpolated]" UWORD M_FORMULA_0025 0 0 0 3.999938965 ECU_ADDRESS 0x3FDBE8 /end MEASUREMENT
/begin MEASUREMENT lavk_obd_dyn_ampl_max_b2 "max. zulaessige Amplitude [RAM name from V530, interpolated]" UWORD M_FORMULA_0025 0 0 0 3.999938965 ECU_ADDRESS 0x3FDBEA /end MEASUREMENT
/begin MEASUREMENT lavk_obd_dyn_ampl_min_b1 "min. zulaessige Amplitude [RAM name from V530, interpolated]" UWORD M_FORMULA_0025 0 0 0 3.999938965 ECU_ADDRESS 0x3FDBEC /end MEASUREMENT
/begin MEASUREMENT lavk_obd_dyn_ampl_min_b2 "min. zulaessige Amplitude [RAM name from V530, interpolated]" UWORD M_FORMULA_0025 0 0 0 3.999938965 ECU_ADDRESS 0x3FDBEE /end MEASUREMENT
/begin MEASUREMENT lavk_obd_dyn_ampl_mw_b2 "gemittelte Amplitude [RAM name from V530, interpolated]" UWORD M_FORMULA_0025 0 0 0 3.999938965 ECU_ADDRESS 0x3FDBE6 /end MEASUREMENT
/begin MEASUREMENT lavk_obd_dyn_ampl_max_mw_b2 "gem. max. Amplitude [RAM name from V530, interpolated]" UWORD M_FORMULA_0025 0 0 0 3.999938965 ECU_ADDRESS 0x3FDBF2 /end MEASUREMENT
/begin MEASUREMENT lavk_obd_dyn_ampl_cnt_b1 "Zaehler - gueltige Perioden [RAM name from V530, interpolated]" UWORD M_FORMULA_0010 0 0 0 65535 ECU_ADDRESS 0x3FDC08 /end MEASUREMENT
/begin MEASUREMENT lavk_obd_dyn_ampl_cnt_b2 "Zaehler - gueltige Perioden [RAM name from V530, interpolated]" UWORD M_FORMULA_0010 0 0 0 65535 ECU_ADDRESS 0x3FDC0A /end MEASUREMENT
/begin MEASUREMENT lavk_obd_dyn_ampl_sum_b2 "aufsummierte Amplitude [RAM name from V530, interpolated]" ULONG M_FORMULA_1016 0 0 0 262143.9999 ECU_ADDRESS 0x3FDBFC /end MEASUREMENT
/begin MEASUREMENT lavk_obd_dyn_norm_cnt_b1 "Zaehler - gueltige Diagnosezyklen [RAM name from V530, interpolated]" UWORD M_FORMULA_0010 0 0 0 65535 ECU_ADDRESS 0x3FDC0C /end MEASUREMENT
/begin MEASUREMENT lavk_obd_dyn_norm_cnt_b2 "Zaehler - gueltige Diagnosezyklen [RAM name from V530, interpolated]" UWORD M_FORMULA_0010 0 0 0 65535 ECU_ADDRESS 0x3FDC0E /end MEASUREMENT
/begin MEASUREMENT lavk_obd_dyn_norm_sum_b1 "aufsummierte normierte Amplitude [RAM name from V530, interpolated]" ULONG M_FORMULA_1016 0 0 0 262143.9999 ECU_ADDRESS 0x3FDC00 /end MEASUREMENT
/begin MEASUREMENT lavk_obd_dyn_norm_sum_b2 "aufsummierte normierte Amplitude [RAM name from V530, interpolated]" ULONG M_FORMULA_1016 0 0 0 262143.9999 ECU_ADDRESS 0x3FDC04 /end MEASUREMENT
/begin MEASUREMENT lavk_obd_dyn_rf_min "min. relative F???llung f. dyn. Sondendiag. [RAM name from V530, interpolated]" SWORD M_FORMULA_0007 0 0 -3.2768 3.2767 ECU_ADDRESS 0x3FDC20 /end MEASUREMENT
/begin MEASUREMENT os_err.id.task "OS-Err: ID [RAM name from V530, interpolated]" UBYTE NO_COMPU_METHOD 0 0 0 255 ECU_ADDRESS 0x3FDC8D FORMAT "%.4g" /end MEASUREMENT
/begin MEASUREMENT os_err.limit.task "OS-Err: Limit [RAM name from V530, interpolated]" UBYTE NO_COMPU_METHOD 0 0 0 255 ECU_ADDRESS 0x3FDC8F FORMAT "%.4g" /end MEASUREMENT
/begin MEASUREMENT os_err.no_fnc.cnt "OS-Err: No Fkt [RAM name from V530, interpolated]" UBYTE M_FORMULA_0003 0 0 0 255 ECU_ADDRESS 0x3FDC92 /end MEASUREMENT
/begin MEASUREMENT os_err.no_fnc.task "OS-Err: No Fkt [RAM name from V530, interpolated]" UBYTE NO_COMPU_METHOD 0 0 0 255 ECU_ADDRESS 0x3FDC93 FORMAT "%.4g" /end MEASUREMENT
/begin MEASUREMENT os_err.tt_act.task "OS-Err: TT aktiv [RAM name from V530, interpolated]" UBYTE NO_COMPU_METHOD 0 0 0 255 ECU_ADDRESS 0x3FDC91 FORMAT "%.4g" /end MEASUREMENT
/begin MEASUREMENT os_err.tt_miss.task "OS-Err: TT missing [RAM name from V530, interpolated]" UBYTE NO_COMPU_METHOD 0 0 0 255 ECU_ADDRESS 0x3FDC95 FORMAT "%.4g" /end MEASUREMENT
/begin MEASUREMENT os_err.fifo.cnt "OS-Err: FIFO full [RAM name from V530, interpolated]" UBYTE M_FORMULA_0003 0 0 0 255 ECU_ADDRESS 0x3FDC98 /end MEASUREMENT
/begin MEASUREMENT os_err.fifo.task "OS-Err: FIFO full [RAM name from V530, interpolated]" UBYTE NO_COMPU_METHOD 0 0 0 255 ECU_ADDRESS 0x3FDC99 FORMAT "%.4g" /end MEASUREMENT
/begin MEASUREMENT os_err.stack.task "OS-Err: Stack [RAM name from V530, interpolated]" UBYTE NO_COMPU_METHOD 0 0 0 255 ECU_ADDRESS 0x3FDC97 FORMAT "%.4g" /end MEASUREMENT
/begin MEASUREMENT os_err.value.cnt "OS-Err: Value [RAM name from V530, interpolated]" UBYTE M_FORMULA_0003 0 0 0 255 ECU_ADDRESS 0x3FDC9A /end MEASUREMENT
/begin MEASUREMENT os_err.value.task "OS-Err: Value [RAM name from V530, interpolated]" UBYTE NO_COMPU_METHOD 0 0 0 255 ECU_ADDRESS 0x3FDC9B FORMAT "%.4g" /end MEASUREMENT
/begin MEASUREMENT os_err.deadline.task "OS-Err: Deadline [RAM name from V530, interpolated]" UBYTE NO_COMPU_METHOD 0 0 0 255 ECU_ADDRESS 0x3FDC9D FORMAT "%.4g" /end MEASUREMENT
/begin MEASUREMENT Oz_nivnfm "Nachf???llmenge [RAM name from V530, interpolated]" UBYTE M_FORMULA_0439 0 0 0 7.96875 ECU_ADDRESS 0x3FDCC5 /end MEASUREMENT
/begin MEASUREMENT pabg_b1.stat_roh "Abgasgegendruck ungefiltert [RAM name from V530, interpolated]" SWORD M_FORMULA_0075 0 0 -2048 2047.9375 ECU_ADDRESS 0x3FDCCE /end MEASUREMENT
/begin MEASUREMENT pabg_b1.pabg_10ms "Abgasgegendruck mit 10ms Filter berechnet [RAM name from V530, interpolated]" SWORD M_FORMULA_0075 0 0 -2048 2047.9375 ECU_ADDRESS 0x3FDCD4 /end MEASUREMENT
/begin MEASUREMENT pabg_b1.tau "Filtertaukonstante [RAM name from V530, interpolated]" UWORD M_FORMULA_1024 0 0 -1e+12 1e+12 ECU_ADDRESS 0x3FDCD2 /end MEASUREMENT
/begin MEASUREMENT pabg_b2.stat_roh "Abgasgegendruck ungefiltert [RAM name from V530, interpolated]" SWORD M_FORMULA_0075 0 0 -2048 2047.9375 ECU_ADDRESS 0x3FDCD8 /end MEASUREMENT
/begin MEASUREMENT pabg_b2.pabg_10ms "Abgasgegendruck mit 10ms Filter berechnet [RAM name from V530, interpolated]" SWORD M_FORMULA_0075 0 0 -2048 2047.9375 ECU_ADDRESS 0x3FDCDE /end MEASUREMENT
/begin MEASUREMENT pabg_b2.tau "Filtertaukonstante [RAM name from V530, interpolated]" UWORD M_FORMULA_1024 0 0 -1e+12 1e+12 ECU_ADDRESS 0x3FDCDC /end MEASUREMENT
/begin MEASUREMENT pks_soll_dyn_delta "Sollwert Kraftstoffdruck, Filter-Abweichung [RAM name from V530, interpolated]" SWORD M_FORMULA_0110 0 0 -32.768 32.767 ECU_ADDRESS 0x3FDD6E /end MEASUREMENT
/begin MEASUREMENT pksr_ekp2_enable1 "Zuschaltbedingung1 f. EKP2 [RAM name from V530, interpolated]" SWORD NO_COMPU_METHOD 0 0 -32768 32767 ECU_ADDRESS 0x3FDD90 FORMAT "%.4g" /end MEASUREMENT
/begin MEASUREMENT T_histsum "Txhistiruh Summe [RAM name from V530, interpolated]" UWORD M_FORMULA_0492 0 0 0 3669960 ECU_ADDRESS 0x3FDE60 /end MEASUREMENT
/begin MEASUREMENT T_histsummin "Summe der Txhistiruh in Minuten [RAM name from V530, interpolated]" UWORD M_FORMULA_0493 0 0 0 61166 ECU_ADDRESS 0x3FDE62 /end MEASUREMENT
/begin MEASUREMENT T2hist "T2histitruh in sek. [RAM name from V530, interpolated]" UWORD M_FORMULA_0494 0 0 0 917490 ECU_ADDRESS 0x3FDE64 /end MEASUREMENT
/begin MEASUREMENT T3hist "T3histiruh in Sek [RAM name from V530, interpolated]" UWORD M_FORMULA_0494 0 0 0 917490 ECU_ADDRESS 0x3FDE66 /end MEASUREMENT
/begin MEASUREMENT T4hist "T4histiruh in Sek [RAM name from V530, interpolated]" UWORD M_FORMULA_0494 0 0 0 917490 ECU_ADDRESS 0x3FDE68 /end MEASUREMENT
/begin MEASUREMENT Codiercnt "Internet Zaehler fuer Anfrage Codierung [RAM name from V530, interpolated]" UBYTE M_FORMULA_0461 0 0 0 25.5 ECU_ADDRESS 0x3FDE6C /end MEASUREMENT
/begin MEASUREMENT Priopizw1 "Pi-Regler zw1 [RAM name from V530, interpolated]" SLONG M_FORMULA_0504 0 0 -16777216 16777215.99 ECU_ADDRESS 0x3FDF08 /end MEASUREMENT
/begin MEASUREMENT All2ptc "Gesamtgewichtung f???r PTC-Ansteuerung [RAM name from V530, interpolated]" SWORD M_FORMULA_0505 0 0 -8192 8191.75 ECU_ADDRESS 0x3FDF18 /end MEASUREMENT
/begin MEASUREMENT Df2pi "DF-Gewichtung auf Prios [RAM name from V530, interpolated]" SWORD M_FORMULA_0505 0 0 -8192 8191.75 ECU_ADDRESS 0x3FDF1A /end MEASUREMENT
/begin MEASUREMENT Dfall2pi "Gesamtgewichtung auf Prios [RAM name from V530, interpolated]" SWORD M_FORMULA_0505 0 0 -8192 8191.75 ECU_ADDRESS 0x3FDF1C /end MEASUREMENT
/begin MEASUREMENT Ptcpizw1 "PTC PI Regler zw1 [RAM name from V530, interpolated]" SLONG M_FORMULA_0504 0 0 -16777216 16777215.99 ECU_ADDRESS 0x3FDF10 /end MEASUREMENT
/begin MEASUREMENT Ptcpizw2 "PTC PI zw2 [RAM name from V530, interpolated]" SLONG M_FORMULA_0504 0 0 -16777216 16777215.99 ECU_ADDRESS 0x3FDF14 /end MEASUREMENT
/begin MEASUREMENT Dfpt1_2ptc "gefiltertes dffgen Gewichtung auf PTC-Ansteuerung [RAM name from V530, interpolated]" SWORD M_FORMULA_0505 0 0 -8192 8191.75 ECU_ADDRESS 0x3FDF20 /end MEASUREMENT
/begin MEASUREMENT Ctrpwrcos7 "lokales ctrpwrcos [RAM name from V530, interpolated]" UWORD M_FORMULA_0010 0 0 0 65535 ECU_ADDRESS 0x3FDF2E /end MEASUREMENT
/begin MEASUREMENT Ctrpwrdf "df-Teil von ctrpwrcos [RAM name from V530, interpolated]" UWORD M_FORMULA_0010 0 0 0 65535 ECU_ADDRESS 0x3FDF30 /end MEASUREMENT
/begin MEASUREMENT Dfallpi "PI-Geregelte Gesamtgewichtung auf Prios [RAM name from V530, interpolated]" UWORD M_FORMULA_0507 0 0 0 16383.75 ECU_ADDRESS 0x3FDF34 /end MEASUREMENT
/begin MEASUREMENT Ctrcbr7 "lokales ctrcbr [RAM name from V530, interpolated]" UBYTE M_FORMULA_0003 0 0 0 255 ECU_ADDRESS 0x3FDF4B /end MEASUREMENT
/begin MEASUREMENT Ctrpriocfm "altes ctrpriocf [RAM name from V530, interpolated]" UBYTE M_FORMULA_0003 0 0 0 255 ECU_ADDRESS 0x3FDF53 /end MEASUREMENT
/begin MEASUREMENT Dfpt1filt "Wert nach DF-Tiefpass Prio [RAM name from V530, interpolated]" UBYTE M_FORMULA_0475 0 0 0 99.609375 ECU_ADDRESS 0x3FDF58 /end MEASUREMENT
/begin MEASUREMENT Ptc_pwr "Maximale Leistung, die der PTC einstellen darf. [RAM name from V530, interpolated]" UBYTE M_FORMULA_0510 0 0 0 127.5 ECU_ADDRESS 0x3FDF5D /end MEASUREMENT
/begin MEASUREMENT Rqpcos7 "lokales rqpcos [RAM name from V530, interpolated]" UBYTE M_FORMULA_0003 0 0 0 255 ECU_ADDRESS 0x3FDF61 /end MEASUREMENT
/begin MEASUREMENT Stpcosmem "altes stpcos [RAM name from V530, interpolated]" UBYTE M_FORMULA_0003 0 0 0 255 ECU_ADDRESS 0x3FDF66 /end MEASUREMENT
/begin MEASUREMENT Ulev "Spannungsebene [RAM name from V530, interpolated]" UBYTE M_FORMULA_0003 0 0 0 255 ECU_ADDRESS 0x3FDF67 /end MEASUREMENT
/begin MEASUREMENT Ulevmem "altes ulev [RAM name from V530, interpolated]" UBYTE M_FORMULA_0003 0 0 0 255 ECU_ADDRESS 0x3FDF68 /end MEASUREMENT
/begin MEASUREMENT kbmcount "Counter, gesetzt von KBMCNT_APP [RAM name from V530, interpolated]" UBYTE M_FORMULA_0461 0 0 0 25.5 ECU_ADDRESS 0x3FDF6B /end MEASUREMENT
/begin MEASUREMENT qadc_lavk_wrp "Write Pointer in der Qadc-Queue [RAM name from V530, interpolated]" UBYTE M_FORMULA_0003 0 0 0 255 ECU_ADDRESS 0x3FE107 /end MEASUREMENT
/begin MEASUREMENT qadc_sync_hfm_zz_upd "Zahnzaehler bei letztem sync queue update HFM [RAM name from V530, interpolated]" UBYTE M_FORMULA_1057 0 0 0 255 ECU_ADDRESS 0x3FE106 /end MEASUREMENT
/begin MEASUREMENT sa_t_sa_trig "Verweilzeit im Zustand SA-Trigger [RAM name from V530, interpolated]" UWORD M_FORMULA_0109 0 0 0 327.675 ECU_ADDRESS 0x3FE270 /end MEASUREMENT
/begin MEASUREMENT schalter_bls_ad_inj "Eingelesener Spannungswert Bremslichtschalter [RAM name from V530, interpolated]" SWORD M_FORMULA_0114 0 0 -32768 32767 ECU_ADDRESS 0x3FE27C /end MEASUREMENT
/begin MEASUREMENT schalter_poel_ad "Eingelesener Spannungswert vom Oeldruckschalter [RAM name from V530, interpolated]" SWORD M_FORMULA_0114 0 0 -32768 32767 ECU_ADDRESS 0x3FE280 /end MEASUREMENT
/begin MEASUREMENT schalter_sport_ad "Eingelesener Spannungswert vom Sporttaster [RAM name from V530, interpolated]" SWORD M_FORMULA_0114 0 0 -32768 32767 ECU_ADDRESS 0x3FE27E /end MEASUREMENT
/begin MEASUREMENT schalter_wakeup_ad_inj "Eingelesener Spannungswert Wakeup [RAM name from V530, interpolated]" SWORD M_FORMULA_0114 0 0 -32768 32767 ECU_ADDRESS 0x3FE27A /end MEASUREMENT
/begin MEASUREMENT schalter_diag_poel_n_delay "Delay fuer n == 0 bei S_POEL-Diagnose [RAM name from V530, interpolated]" UWORD M_FORMULA_0668 0 0 0 6553500 ECU_ADDRESS 0x3FE284 /end MEASUREMENT
/begin MEASUREMENT schalter_getr "nullpunktadaptierter Spannungswert vom Getriebeschalter [RAM name from V530, interpolated]" SWORD M_FORMULA_0114 0 0 -32768 32767 ECU_ADDRESS 0x3FE28C /end MEASUREMENT
/begin MEASUREMENT schalter_getr_a0 "Nullpunktadaptionswert vom Getriebeschalter [RAM name from V530, interpolated]" SWORD M_FORMULA_0114 0 0 -32768 32767 ECU_ADDRESS 0x3FE28A /end MEASUREMENT
/begin MEASUREMENT schalter_getr_ad "Eingelesener Spannungswert vom Getriebeschalter [RAM name from V530, interpolated]" SWORD M_FORMULA_0114 0 0 -32768 32767 ECU_ADDRESS 0x3FE286 /end MEASUREMENT
/begin MEASUREMENT schalter_getr_fil "gefilterter Spannungswert vom Getriebeschalter [RAM name from V530, interpolated]" SWORD M_FORMULA_0114 0 0 -32768 32767 ECU_ADDRESS 0x3FE288 /end MEASUREMENT
/begin MEASUREMENT schalter_getr_diag_timer "Diagnosetimer Getriebeleergassenschalter [RAM name from V530, interpolated]" UWORD M_FORMULA_0071 0 0 0 6553.5 ECU_ADDRESS 0x3FE290 /end MEASUREMENT
/begin MEASUREMENT schalter_kupp_ad "Eingelesener Spannungswert vom Kupplungsschalter [RAM name from V530, interpolated]" SWORD M_FORMULA_0114 0 0 -32768 32767 ECU_ADDRESS 0x3FE292 /end MEASUREMENT
/begin MEASUREMENT schalter_ks_alt "alter Schalterzustand Kraftschluss [RAM name from V530, interpolated]" UWORD NO_COMPU_METHOD 0 0 0 65535 ECU_ADDRESS 0x3FE29C FORMAT "%.4g" /end MEASUREMENT
/begin MEASUREMENT schalter_ks_dn "Delta Motordrehzahl [RAM name from V530, interpolated]" SWORD M_FORMULA_0006 0 0 -32768 32767 ECU_ADDRESS 0x3FE2A0 /end MEASUREMENT
/begin MEASUREMENT schalter_ks_n_diff "Drehzahldifferenz Motor - Getriebeeingang [RAM name from V530, interpolated]" SWORD M_FORMULA_0006 0 0 -32768 32767 ECU_ADDRESS 0x3FE2A6 /end MEASUREMENT
/begin MEASUREMENT schalter_ks_n_diff_timer "Timer Drehzahldifferenz Kraftschluss [RAM name from V530, interpolated]" UWORD M_FORMULA_0021 0 0 0 655.35 ECU_ADDRESS 0x3FE2A8 /end MEASUREMENT
/begin MEASUREMENT schalter_ks_schalt_timer "Timer Schaltung [RAM name from V530, interpolated]" UWORD M_FORMULA_0021 0 0 0 655.35 ECU_ADDRESS 0x3FE2AC /end MEASUREMENT
/begin MEASUREMENT servo_abschalt_inj "Notabschaltung Servotronic [RAM name from V530, interpolated]" UBYTE NO_COMPU_METHOD 0 0 0 255 ECU_ADDRESS 0x3FE2AE FORMAT "%.4g" /end MEASUREMENT
/begin MEASUREMENT sk_fm_ti "Eingang TI-Matrix [RAM name from V530, interpolated]" UBYTE NO_COMPU_METHOD 0 0 0 255 ECU_ADDRESS 0x3FE2B3 FORMAT "%.4g" /end MEASUREMENT
/begin MEASUREMENT sk_fm_lam "Eingang LAM-Matrix [RAM name from V530, interpolated]" UBYTE NO_COMPU_METHOD 0 0 0 255 ECU_ADDRESS 0x3FE2B9 FORMAT "%.4g" /end MEASUREMENT
/begin MEASUREMENT sk_t_reset_delay_os "Timer fuer Verzoegerung sk_reset bei OS Fehlern [RAM name from V530, interpolated]" UWORD M_FORMULA_0021 0 0 0 655.35 ECU_ADDRESS 0x3FE2C6 /end MEASUREMENT
/begin MEASUREMENT tanzyl_abreg "Abregung ueber Zeit [RAM name from V530, interpolated]" UWORD M_FORMULA_0199 0 0 0 3.999938965 ECU_ADDRESS 0x3FE4AC /end MEASUREMENT
/begin MEASUREMENT tanzyl_loc "Lokale Ansaugtemperatur im Zylinder Modell gefiltert [RAM name from V530, interpolated]" SWORD M_FORMULA_0023 0 0 -3550 3003.5 ECU_ADDRESS 0x3FE4A2 /end MEASUREMENT
/begin MEASUREMENT tanzyl_ml_ges_tau "Temperatur tau TANZYL-Modell [RAM name from V530, interpolated]" UWORD M_FORMULA_1052 0 0 -1e+12 1e+12 ECU_ADDRESS 0x3FE4A4 /end MEASUREMENT
/begin MEASUREMENT tanzyl_mr "Temperatur Motorraum TANZYL-Modell [RAM name from V530, interpolated]" SWORD M_FORMULA_0023 0 0 -3550 3003.5 ECU_ADDRESS 0x3FE49C /end MEASUREMENT
/begin MEASUREMENT tanzyl_mr_abreg "Abregung ueber Temperatur Motorraum [RAM name from V530, interpolated]" UWORD M_FORMULA_0199 0 0 0 3.999938965 ECU_ADDRESS 0x3FE4AA /end MEASUREMENT
/begin MEASUREMENT tanzyl_mr_off "Offset Motorraumtemperatur bei Start [RAM name from V530, interpolated]" SWORD M_FORMULA_0074 0 0 -3276.8 3276.7 ECU_ADDRESS 0x3FE4B2 /end MEASUREMENT
/begin MEASUREMENT tanzyl_mr_stat "Motorraumtemperatur Zielwert [RAM name from V530, interpolated]" SWORD M_FORMULA_0023 0 0 -3550 3003.5 ECU_ADDRESS 0x3FE4B0 /end MEASUREMENT
/begin MEASUREMENT tanzyl_mr_tumg_delta "Temperaturdifferenz Motorraum zu Umgebung [RAM name from V530, interpolated]" SWORD M_FORMULA_0023 0 0 -3550 3003.5 ECU_ADDRESS 0x3FE49E /end MEASUREMENT
/begin MEASUREMENT tanzyl_mr_tumg_kal "Wichtung von Differenz tm - tumg [RAM name from V530, interpolated]" UWORD M_FORMULA_0199 0 0 0 3.999938965 ECU_ADDRESS 0x3FE4A8 /end MEASUREMENT
/begin MEASUREMENT tanzyl_ratio "Faktor Luftmassenstrom fuer TANZYL-Modell [RAM name from V530, interpolated]" UWORD M_FORMULA_0199 0 0 0 3.999938965 ECU_ADDRESS 0x3FE4A6 /end MEASUREMENT
/begin MEASUREMENT tanzyl_raw "Ansaugtemperatur im Zylinder Modell ungefiltert [RAM name from V530, interpolated]" SWORD M_FORMULA_0023 0 0 -3550 3003.5 ECU_ADDRESS 0x3FE4A0 /end MEASUREMENT
/begin MEASUREMENT tanzyl_st "Status Modell Ansaugtemperatur im Zylinder [RAM name from V530, interpolated]" UBYTE NO_COMPU_METHOD 0 0 0 255 ECU_ADDRESS 0x3FE4AE FORMAT "%.4g" /end MEASUREMENT
/begin MEASUREMENT te_ml_min_b2 "min. angesaugte Gesamtluft / Anzahl TEV [RAM name from V530, interpolated]" UWORD M_FORMULA_0103 0 0 0 6553.5 ECU_ADDRESS 0x3FE504 /end MEASUREMENT
/begin MEASUREMENT te_ml_soll_b2 "SOLL-Massenstrom je TEV auf Luft normiert [RAM name from V530, interpolated]" UWORD M_FORMULA_0563 0 0 0 65.535 ECU_ADDRESS 0x3FE50A /end MEASUREMENT
/begin MEASUREMENT te_mks_xsi_b1 "Ausflusskoeffizient - MKS [RAM name from V530, interpolated]" UWORD M_FORMULA_0073 0 0 0 63.99902344 ECU_ADDRESS 0x3FE51A /end MEASUREMENT
/begin MEASUREMENT te_mks_xsi_b2 "Ausflusskoeffizient - MKS [RAM name from V530, interpolated]" UWORD M_FORMULA_0073 0 0 0 63.99902344 ECU_ADDRESS 0x3FE51C /end MEASUREMENT
/begin MEASUREMENT te_ml_xsi_b1 "Ausflusskoeffizient - Luft [RAM name from V530, interpolated]" UWORD M_FORMULA_0073 0 0 0 63.99902344 ECU_ADDRESS 0x3FE520 /end MEASUREMENT
/begin MEASUREMENT te_ml_xsi_b2 "Ausflusskoeffizient - Luft [RAM name from V530, interpolated]" UWORD M_FORMULA_0073 0 0 0 63.99902344 ECU_ADDRESS 0x3FE522 /end MEASUREMENT
/begin MEASUREMENT te_mzyl_ohne_b2 "adaptierter angesaugter Luftmassenstrom ohne TE [RAM name from V530, interpolated]" UWORD M_FORMULA_0111 0 0 0 1023.984375 ECU_ADDRESS 0x3FE528 /end MEASUREMENT
/begin MEASUREMENT te_ml_zyl_real_b2 "mzyl aus TI berechnet [RAM name from V530, interpolated]" UWORD M_FORMULA_0111 0 0 0 1023.984375 ECU_ADDRESS 0x3FE52C /end MEASUREMENT
/begin MEASUREMENT te_mks_f_b1 "Faktor auf Kraftstoffmasse aus TE [RAM name from V530, interpolated]" UWORD M_FORMULA_0024 0 0 0 1.999969482 ECU_ADDRESS 0x3FE532 /end MEASUREMENT
/begin MEASUREMENT te_mks_f_b2 "Faktor auf Kraftstoffmasse aus TE [RAM name from V530, interpolated]" UWORD M_FORMULA_0024 0 0 0 1.999969482 ECU_ADDRESS 0x3FE534 /end MEASUREMENT
/begin MEASUREMENT te_mzyl_diff_b2 "Differenz te_mzyl_ohne - te_ml_zyl_real [RAM name from V530, interpolated]" UWORD M_FORMULA_0111 0 0 0 1023.984375 ECU_ADDRESS 0x3FE530 /end MEASUREMENT
/begin MEASUREMENT te_vol_b1 "aktueller Volumenstrom je TEV [RAM name from V530, interpolated]" UWORD M_FORMULA_1151 0 0 0 131.07 ECU_ADDRESS 0x3FE574 /end MEASUREMENT
/begin MEASUREMENT te_vol_b2 "aktueller Volumenstrom je TEV [RAM name from V530, interpolated]" UWORD M_FORMULA_1151 0 0 0 131.07 ECU_ADDRESS 0x3FE576 /end MEASUREMENT
/begin MEASUREMENT te_vol_max_b1 "max. Volumenstrom je TEV bei 100% tv [RAM name from V530, interpolated]" UWORD M_FORMULA_1151 0 0 0 131.07 ECU_ADDRESS 0x3FE578 /end MEASUREMENT
/begin MEASUREMENT te_vol_max_b2 "max. Volumenstrom je TEV bei 100% tv [RAM name from V530, interpolated]" UWORD M_FORMULA_1151 0 0 0 131.07 ECU_ADDRESS 0x3FE57A /end MEASUREMENT
/begin MEASUREMENT te_x_mks_b1 "Soll-MKS-Anteil aus n und psau [RAM name from V530, interpolated]" UWORD M_FORMULA_0024 0 0 0 1.999969482 ECU_ADDRESS 0x3FE580 /end MEASUREMENT
/begin MEASUREMENT te_x_mks_b2 "Soll-MKS-Anteil aus n und psau [RAM name from V530, interpolated]" UWORD M_FORMULA_0024 0 0 0 1.999969482 ECU_ADDRESS 0x3FE582 /end MEASUREMENT
/begin MEASUREMENT te_x_mks_betrieb_b2 "MKS-Anteil auf Luft-Anteil norm, mit ti_min-Begr. [RAM name from V530, interpolated]" UWORD M_FORMULA_0024 0 0 0 1.999969482 ECU_ADDRESS 0x3FE586 /end MEASUREMENT
/begin MEASUREMENT te_x_ml_betrieb_b1 "moeglicher Luftmassenanteil bei 100% tv [RAM name from V530, interpolated]" UWORD M_FORMULA_0024 0 0 0 1.999969482 ECU_ADDRESS 0x3FE588 /end MEASUREMENT
/begin MEASUREMENT te_x_ml_betrieb_b2 "moeglicher Luftmassenanteil bei 100% tv [RAM name from V530, interpolated]" UWORD M_FORMULA_0024 0 0 0 1.999969482 ECU_ADDRESS 0x3FE58A /end MEASUREMENT
/begin MEASUREMENT te_x_ml_gw_neg_b1 "Abregelzeit [RAM name from V530, interpolated]" UWORD M_FORMULA_0071 0 0 0 6553.5 ECU_ADDRESS 0x3FE58C /end MEASUREMENT
/begin MEASUREMENT te_x_ml_gw_neg_b2 "Abregelzeit [RAM name from V530, interpolated]" UWORD M_FORMULA_0071 0 0 0 6553.5 ECU_ADDRESS 0x3FE58E /end MEASUREMENT
/begin MEASUREMENT te_x_ml_gw_pos_b1 "Aufregelzeit [RAM name from V530, interpolated]" UWORD M_FORMULA_0071 0 0 0 6553.5 ECU_ADDRESS 0x3FE590 /end MEASUREMENT
/begin MEASUREMENT te_x_ml_gw_pos_b2 "Aufregelzeit [RAM name from V530, interpolated]" UWORD M_FORMULA_0071 0 0 0 6553.5 ECU_ADDRESS 0x3FE592 /end MEASUREMENT
/begin MEASUREMENT te_x_ml_max_b2 "max. zulaessiger Spuelluftanteil [RAM name from V530, interpolated]" UWORD M_FORMULA_0024 0 0 0 1.999969482 ECU_ADDRESS 0x3FE596 /end MEASUREMENT
/begin MEASUREMENT te_x_ml_min_b1 "min. Auswahl des zulaessigen Spuelluftanteils [RAM name from V530, interpolated]" UWORD M_FORMULA_0024 0 0 0 1.999969482 ECU_ADDRESS 0x3FE598 /end MEASUREMENT
/begin MEASUREMENT te_x_ml_min_b2 "min. Auswahl des zulaessigen Spuelluftanteils [RAM name from V530, interpolated]" UWORD M_FORMULA_0024 0 0 0 1.999969482 ECU_ADDRESS 0x3FE59A /end MEASUREMENT
/begin MEASUREMENT te_x_ml_n_psau_b1 "Soll-Luftmassenanteil aus n und psau [RAM name from V530, interpolated]" UWORD M_FORMULA_0024 0 0 0 1.999969482 ECU_ADDRESS 0x3FE59C /end MEASUREMENT
/begin MEASUREMENT te_x_ml_n_psau_b2 "Soll-Luftmassenanteil aus n und psau [RAM name from V530, interpolated]" UWORD M_FORMULA_0024 0 0 0 1.999969482 ECU_ADDRESS 0x3FE59E /end MEASUREMENT
/begin MEASUREMENT te_x_ml_soll_aebg_b1 "Aenderungsbegr. Soll-Spuelluftanteil [RAM name from V530, interpolated]" UWORD M_FORMULA_0024 0 0 0 1.999969482 ECU_ADDRESS 0x3FE5A0 /end MEASUREMENT
/begin MEASUREMENT te_x_ml_soll_aebg_b2 "Aenderungsbegr. Soll-Spuelluftanteil [RAM name from V530, interpolated]" UWORD M_FORMULA_0024 0 0 0 1.999969482 ECU_ADDRESS 0x3FE5A2 /end MEASUREMENT
/begin MEASUREMENT te_obd_auss_delta_b2 "Auss-Integral Reaktion [RAM name from V530, interpolated]" SWORD M_FORMULA_0706 0 0 -327.68 327.67 ECU_ADDRESS 0x3FE5AC /end MEASUREMENT
/begin MEASUREMENT te_obd_auss_filt_b2 "gefilt. Auss-Integral-Leitwert [RAM name from V530, interpolated]" SWORD M_FORMULA_1161 0 0 -19.98848 19.98787 ECU_ADDRESS 0x3FE5B0 /end MEASUREMENT
/begin MEASUREMENT te_obd_auss_ok_b1 "Anzahl der Integrale OK-Erkennungen [RAM name from V530, interpolated]" UBYTE M_FORMULA_0003 0 0 0 255 ECU_ADDRESS 0x3FE5B2 /end MEASUREMENT
/begin MEASUREMENT te_obd_auss_ok_b2 "Anzahl der Integrale OK-Erkennungen [RAM name from V530, interpolated]" UBYTE M_FORMULA_0003 0 0 0 255 ECU_ADDRESS 0x3FE5B3 /end MEASUREMENT
/begin MEASUREMENT te_obd_lam_max_b1 "Maximalwert Lambda bei Messung [RAM name from V530, interpolated]" UWORD M_FORMULA_0025 0 0 0 3.999938965 ECU_ADDRESS 0x3FE5BE /end MEASUREMENT
/begin MEASUREMENT te_obd_lam_min_b2 "Minimalwert Lambda bei Messung [RAM name from V530, interpolated]" UWORD M_FORMULA_0025 0 0 0 3.999938965 ECU_ADDRESS 0x3FE5BC /end MEASUREMENT
/begin MEASUREMENT te_obd_lam_ok_b1 "Anzahl der Lambda OK-Erkennungen [RAM name from V530, interpolated]" UBYTE M_FORMULA_0003 0 0 0 255 ECU_ADDRESS 0x3FE5C2 /end MEASUREMENT
/begin MEASUREMENT te_obd_lam_ok_b2 "Anzahl der Lambda OK-Erkennungen [RAM name from V530, interpolated]" UBYTE M_FORMULA_0003 0 0 0 255 ECU_ADDRESS 0x3FE5C3 /end MEASUREMENT
/begin MEASUREMENT te_obd_result_b2 "Ergebnis TEV Funktions-Check [RAM name from V530, interpolated]" UBYTE NO_COMPU_METHOD 0 0 0 255 ECU_ADDRESS 0x3FE5DD FORMAT "%.4g" /end MEASUREMENT
/begin MEASUREMENT te_obd_tv_b2 "Tastverhaeltnis vom Funktions-Check [RAM name from V530, interpolated]" UWORD M_FORMULA_0107 0 0 0 6399.902344 ECU_ADDRESS 0x3FE5E6 /end MEASUREMENT
/begin MEASUREMENT ti_b1.qstat_f "proportionaler Ventilparameter [RAM name from V530, interpolated]" UWORD M_FORMULA_1170 0 0 0 63.99902344 ECU_ADDRESS 0x3FE5F8 /end MEASUREMENT
/begin MEASUREMENT ti_b1.rho_f "Kompensationsfak. Kraftsoffdichte [RAM name from V530, interpolated]" UWORD M_FORMULA_0806 0 0 0 511.9921875 ECU_ADDRESS 0x3FE5F6 /end MEASUREMENT
/begin MEASUREMENT ti_b1.laa_offs_wicht_f "Korrekturfaktor - Lambdaadaptionsoffset [RAM name from V530, interpolated]" UWORD M_FORMULA_0073 0 0 0 63.99902344 ECU_ADDRESS 0x3FE5FE /end MEASUREMENT
/begin MEASUREMENT ti_b1.t_korr_f "saugrohrwandtemperaturabh. Faktor [RAM name from V530, interpolated]" UWORD M_FORMULA_0073 0 0 0 63.99902344 ECU_ADDRESS 0x3FE5FC /end MEASUREMENT
/begin MEASUREMENT ti_b1.ml_mg_la "Luftmasse/Zyl incl. LA-Einfl. [RAM name from V530, interpolated]" UWORD M_FORMULA_0111 0 0 0 1023.984375 ECU_ADDRESS 0x3FE604 /end MEASUREMENT
/begin MEASUREMENT ti_b1.ml_mg_la_f "Luftmasse/Zyl nur mit LA-F-Einfl. [RAM name from V530, interpolated]" SWORD M_FORMULA_1171 0 0 -1024 1023.96875 ECU_ADDRESS 0x3FE606 /end MEASUREMENT
/begin MEASUREMENT ti_b1.ml_mg_zyl "zyl. Luftmasse in mg/ASP [RAM name from V530, interpolated]" SWORD M_FORMULA_0090 0 0 -3276.8 3276.7 ECU_ADDRESS 0x3FE602 /end MEASUREMENT
/begin MEASUREMENT ti_b1.phi_ende "Einspritzendewinkel [RAM name from V530, interpolated]" SWORD M_FORMULA_0102 0 0 -3276.8 3276.7 ECU_ADDRESS 0x3FE60E /end MEASUREMENT
/begin MEASUREMENT ti_b1.phi_ende_flug "Flugwinkel Kraftstoff [RAM name from V530, interpolated]" SWORD M_FORMULA_0102 0 0 -3276.8 3276.7 ECU_ADDRESS 0x3FE616 /end MEASUREMENT
/begin MEASUREMENT ti_b1.phi_ende_grad "Gradient fuer Aenderungsbegr. [RAM name from V530, interpolated]" SWORD M_FORMULA_0102 0 0 -3276.8 3276.7 ECU_ADDRESS 0x3FE60A /end MEASUREMENT
/begin MEASUREMENT ti_b1.phi_ende_grund "Vorlagerungsgrundwinkel [RAM name from V530, interpolated]" SWORD M_FORMULA_0102 0 0 -3276.8 3276.7 ECU_ADDRESS 0x3FE610 /end MEASUREMENT
/begin MEASUREMENT ti_b1.phi_ende_roh "Einspritzendewinkel vor Aenderungsbegr. [RAM name from V530, interpolated]" SWORD M_FORMULA_0102 0 0 -3276.8 3276.7 ECU_ADDRESS 0x3FE60C /end MEASUREMENT
/begin MEASUREMENT ti_b1.phi_ev_v "Fluggeschwindigkeit Kraftstoff [RAM name from V530, interpolated]" SWORD M_FORMULA_1172 0 0 -3276.8 3276.7 ECU_ADDRESS 0x3FE612 /end MEASUREMENT
/begin MEASUREMENT ti_b1.phi_ks_v "Fluggeschwindigkeit Kraftstoff [RAM name from V530, interpolated]" SWORD M_FORMULA_1172 0 0 -3276.8 3276.7 ECU_ADDRESS 0x3FE614 /end MEASUREMENT
/begin MEASUREMENT ti_b1.mks_max "max. MKS fuer TI [RAM name from V530, interpolated]" UWORD M_FORMULA_0111 0 0 0 1023.984375 ECU_ADDRESS 0x3FE61A /end MEASUREMENT
/begin MEASUREMENT ti_b2.laa_offs_wicht_f "Korrekturfaktor - Lambdaadaptionsoffset [RAM name from V530, interpolated]" UWORD M_FORMULA_0073 0 0 0 63.99902344 ECU_ADDRESS 0x3FE62A /end MEASUREMENT
/begin MEASUREMENT ti_b2.qstat_f "proportionaler Ventilparameter [RAM name from V530, interpolated]" UWORD M_FORMULA_1170 0 0 0 63.99902344 ECU_ADDRESS 0x3FE624 /end MEASUREMENT
/begin MEASUREMENT ti_b2.rho_f "Kompensationsfak. Kraftsoffdichte [RAM name from V530, interpolated]" UWORD M_FORMULA_0806 0 0 0 511.9921875 ECU_ADDRESS 0x3FE622 /end MEASUREMENT
/begin MEASUREMENT ti_b2.t_korr_f "saugrohrwandtemperaturabh. Faktor [RAM name from V530, interpolated]" UWORD M_FORMULA_0073 0 0 0 63.99902344 ECU_ADDRESS 0x3FE628 /end MEASUREMENT
/begin MEASUREMENT ti_b2.ub_offs "UB-abhaengiger TI-Offset [RAM name from V530, interpolated]" UWORD M_FORMULA_0786 0 0 0 65.535 ECU_ADDRESS 0x3FE626 /end MEASUREMENT
/begin MEASUREMENT ti_b2.ml_mg_la "Luftmasse/Zyl incl. LA-Einfl. [RAM name from V530, interpolated]" UWORD M_FORMULA_0111 0 0 0 1023.984375 ECU_ADDRESS 0x3FE630 /end MEASUREMENT
/begin MEASUREMENT ti_b2.ml_mg_la_f "Luftmasse/Zyl nur mit LA-F-Einfl. [RAM name from V530, interpolated]" SWORD M_FORMULA_1171 0 0 -1024 1023.96875 ECU_ADDRESS 0x3FE632 /end MEASUREMENT
/begin MEASUREMENT ti_b2.ml_mg_zyl "zyl. Luftmasse in mg/ASP [RAM name from V530, interpolated]" SWORD M_FORMULA_0090 0 0 -3276.8 3276.7 ECU_ADDRESS 0x3FE62E /end MEASUREMENT
/begin MEASUREMENT ti_b2.phi_ende "Einspritzendewinkel [RAM name from V530, interpolated]" SWORD M_FORMULA_0102 0 0 -3276.8 3276.7 ECU_ADDRESS 0x3FE63A /end MEASUREMENT
/begin MEASUREMENT ti_b2.phi_ende_flug "Flugwinkel Kraftstoff [RAM name from V530, interpolated]" SWORD M_FORMULA_0102 0 0 -3276.8 3276.7 ECU_ADDRESS 0x3FE642 /end MEASUREMENT
/begin MEASUREMENT ti_b2.phi_ende_grad "Gradient fuer Aenderungsbegr. [RAM name from V530, interpolated]" SWORD M_FORMULA_0102 0 0 -3276.8 3276.7 ECU_ADDRESS 0x3FE636 /end MEASUREMENT
/begin MEASUREMENT ti_b2.phi_ende_grund "Vorlagerungsgrundwinkel [RAM name from V530, interpolated]" SWORD M_FORMULA_0102 0 0 -3276.8 3276.7 ECU_ADDRESS 0x3FE63C /end MEASUREMENT
/begin MEASUREMENT ti_b2.phi_ende_roh "Einspritzendewinkel vor Aenderungsbegr. [RAM name from V530, interpolated]" SWORD M_FORMULA_0102 0 0 -3276.8 3276.7 ECU_ADDRESS 0x3FE638 /end MEASUREMENT
/begin MEASUREMENT ti_b2.phi_ev_v "Fluggeschwindigkeit Kraftstoff [RAM name from V530, interpolated]" SWORD M_FORMULA_1172 0 0 -3276.8 3276.7 ECU_ADDRESS 0x3FE63E /end MEASUREMENT
/begin MEASUREMENT ti_b2.phi_ks_v "Fluggeschwindigkeit Kraftstoff [RAM name from V530, interpolated]" SWORD M_FORMULA_1172 0 0 -3276.8 3276.7 ECU_ADDRESS 0x3FE640 /end MEASUREMENT
/begin MEASUREMENT ti_b2.mks_max "max. MKS fuer TI [RAM name from V530, interpolated]" UWORD M_FORMULA_0111 0 0 0 1023.984375 ECU_ADDRESS 0x3FE646 /end MEASUREMENT
/begin MEASUREMENT ti_lin_offs_zyl10 "Kompensationsoffset [RAM name from V530, interpolated]" SWORD M_FORMULA_0786 0 0 -32.768 32.767 ECU_ADDRESS 0x3FE668 /end MEASUREMENT
/begin MEASUREMENT ti_lin_offs_zyl2 "Kompensationsoffset [RAM name from V530, interpolated]" SWORD M_FORMULA_0786 0 0 -32.768 32.767 ECU_ADDRESS 0x3FE658 /end MEASUREMENT
/begin MEASUREMENT ti_lin_offs_zyl3 "Kompensationsoffset [RAM name from V530, interpolated]" SWORD M_FORMULA_0786 0 0 -32.768 32.767 ECU_ADDRESS 0x3FE65A /end MEASUREMENT
/begin MEASUREMENT ti_lin_offs_zyl4 "Kompensationsoffset [RAM name from V530, interpolated]" SWORD M_FORMULA_0786 0 0 -32.768 32.767 ECU_ADDRESS 0x3FE65C /end MEASUREMENT
/begin MEASUREMENT ti_lin_offs_zyl5 "Kompensationsoffset [RAM name from V530, interpolated]" SWORD M_FORMULA_0786 0 0 -32.768 32.767 ECU_ADDRESS 0x3FE65E /end MEASUREMENT
/begin MEASUREMENT ti_lin_offs_zyl6 "Kompensationsoffset [RAM name from V530, interpolated]" SWORD M_FORMULA_0786 0 0 -32.768 32.767 ECU_ADDRESS 0x3FE660 /end MEASUREMENT
/begin MEASUREMENT ti_lin_offs_zyl7 "Kompensationsoffset [RAM name from V530, interpolated]" SWORD M_FORMULA_0786 0 0 -32.768 32.767 ECU_ADDRESS 0x3FE662 /end MEASUREMENT
/begin MEASUREMENT ti_lin_offs_zyl8 "Kompensationsoffset [RAM name from V530, interpolated]" SWORD M_FORMULA_0786 0 0 -32.768 32.767 ECU_ADDRESS 0x3FE664 /end MEASUREMENT
/begin MEASUREMENT ti_lin_offs_zyl9 "Kompensationsoffset [RAM name from V530, interpolated]" SWORD M_FORMULA_0786 0 0 -32.768 32.767 ECU_ADDRESS 0x3FE666 /end MEASUREMENT
/begin MEASUREMENT ti_mks_start_korr "druckkorr. START-Grundkennfeldwert [RAM name from V530, interpolated]" UWORD M_FORMULA_0111 0 0 0 1023.984375 ECU_ADDRESS 0x3FE66C /end MEASUREMENT
/begin MEASUREMENT ti_mks_start_roh "START-Grundkennfeldwert [RAM name from V530, interpolated]" UWORD M_FORMULA_0111 0 0 0 1023.984375 ECU_ADDRESS 0x3FE66A /end MEASUREMENT
/begin MEASUREMENT ti_start_pumg_f "Umgebungsdruckwichtung im START [RAM name from V530, interpolated]" UWORD M_FORMULA_0073 0 0 0 63.99902344 ECU_ADDRESS 0x3FE670 /end MEASUREMENT
/begin MEASUREMENT ti_out_zyl10 "Ausgegebene Einspritzzeit im letzten Arbeitsspiel. [RAM name from V530, interpolated]" ULONG M_FORMULA_0363 0 0 0 4294967.295 ECU_ADDRESS 0x3FE764 /end MEASUREMENT
/begin MEASUREMENT ti_out_zyl2 "Ausgegebene Einspritzzeit im letzten Arbeitsspiel. [RAM name from V530, interpolated]" ULONG M_FORMULA_0363 0 0 0 4294967.295 ECU_ADDRESS 0x3FE744 /end MEASUREMENT
/begin MEASUREMENT ti_out_zyl3 "Ausgegebene Einspritzzeit im letzten Arbeitsspiel. [RAM name from V530, interpolated]" ULONG M_FORMULA_0363 0 0 0 4294967.295 ECU_ADDRESS 0x3FE748 /end MEASUREMENT
/begin MEASUREMENT ti_out_zyl4 "Ausgegebene Einspritzzeit im letzten Arbeitsspiel. [RAM name from V530, interpolated]" ULONG M_FORMULA_0363 0 0 0 4294967.295 ECU_ADDRESS 0x3FE74C /end MEASUREMENT
/begin MEASUREMENT ti_out_zyl5 "Ausgegebene Einspritzzeit im letzten Arbeitsspiel. [RAM name from V530, interpolated]" ULONG M_FORMULA_0363 0 0 0 4294967.295 ECU_ADDRESS 0x3FE750 /end MEASUREMENT
/begin MEASUREMENT ti_out_zyl6 "Ausgegebene Einspritzzeit im letzten Arbeitsspiel. [RAM name from V530, interpolated]" ULONG M_FORMULA_0363 0 0 0 4294967.295 ECU_ADDRESS 0x3FE754 /end MEASUREMENT
/begin MEASUREMENT ti_out_zyl7 "Ausgegebene Einspritzzeit im letzten Arbeitsspiel. [RAM name from V530, interpolated]" ULONG M_FORMULA_0363 0 0 0 4294967.295 ECU_ADDRESS 0x3FE758 /end MEASUREMENT
/begin MEASUREMENT ti_out_zyl8 "Ausgegebene Einspritzzeit im letzten Arbeitsspiel. [RAM name from V530, interpolated]" ULONG M_FORMULA_0363 0 0 0 4294967.295 ECU_ADDRESS 0x3FE75C /end MEASUREMENT
/begin MEASUREMENT ti_out_zyl9 "Ausgegebene Einspritzzeit im letzten Arbeitsspiel. [RAM name from V530, interpolated]" ULONG M_FORMULA_0363 0 0 0 4294967.295 ECU_ADDRESS 0x3FE760 /end MEASUREMENT
/begin MEASUREMENT ti_asp_cnt_zyl10 "Arbeitsspielzaehler der Einspritzkanaele. [RAM name from V530, interpolated]" UBYTE M_FORMULA_0003 0 0 0 255 ECU_ADDRESS 0x3FE771 /end MEASUREMENT
/begin MEASUREMENT ti_asp_cnt_zyl2 "Arbeitsspielzaehler der Einspritzkanaele. [RAM name from V530, interpolated]" UBYTE M_FORMULA_0003 0 0 0 255 ECU_ADDRESS 0x3FE769 /end MEASUREMENT
/begin MEASUREMENT ti_asp_cnt_zyl3 "Arbeitsspielzaehler der Einspritzkanaele. [RAM name from V530, interpolated]" UBYTE M_FORMULA_0003 0 0 0 255 ECU_ADDRESS 0x3FE76A /end MEASUREMENT
/begin MEASUREMENT ti_asp_cnt_zyl4 "Arbeitsspielzaehler der Einspritzkanaele. [RAM name from V530, interpolated]" UBYTE M_FORMULA_0003 0 0 0 255 ECU_ADDRESS 0x3FE76B /end MEASUREMENT
/begin MEASUREMENT ti_asp_cnt_zyl5 "Arbeitsspielzaehler der Einspritzkanaele. [RAM name from V530, interpolated]" UBYTE M_FORMULA_0003 0 0 0 255 ECU_ADDRESS 0x3FE76C /end MEASUREMENT
/begin MEASUREMENT ti_asp_cnt_zyl6 "Arbeitsspielzaehler der Einspritzkanaele. [RAM name from V530, interpolated]" UBYTE M_FORMULA_0003 0 0 0 255 ECU_ADDRESS 0x3FE76D /end MEASUREMENT
/begin MEASUREMENT ti_asp_cnt_zyl7 "Arbeitsspielzaehler der Einspritzkanaele. [RAM name from V530, interpolated]" UBYTE M_FORMULA_0003 0 0 0 255 ECU_ADDRESS 0x3FE76E /end MEASUREMENT
/begin MEASUREMENT ti_asp_cnt_zyl8 "Arbeitsspielzaehler der Einspritzkanaele. [RAM name from V530, interpolated]" UBYTE M_FORMULA_0003 0 0 0 255 ECU_ADDRESS 0x3FE76F /end MEASUREMENT
/begin MEASUREMENT ti_asp_cnt_zyl9 "Arbeitsspielzaehler der Einspritzkanaele. [RAM name from V530, interpolated]" UBYTE M_FORMULA_0003 0 0 0 255 ECU_ADDRESS 0x3FE770 /end MEASUREMENT
/begin MEASUREMENT ti_wl_f_roh_b1 "ROH-Warmlauffaktor auf TI [RAM name from V530, interpolated]" UWORD M_FORMULA_0073 0 0 0 63.99902344 ECU_ADDRESS 0x3FE774 /end MEASUREMENT
/begin MEASUREMENT ti_wl_f_roh_b2 "ROH-Warmlauffaktor auf TI [RAM name from V530, interpolated]" UWORD M_FORMULA_0073 0 0 0 63.99902344 ECU_ADDRESS 0x3FE776 /end MEASUREMENT
/begin MEASUREMENT van_exd_anschl_max_A1 "Pr???flauf Max-Anschlag [RAM name from V530, interpolated]" SWORD M_FORMULA_0102 0 0 -3276.8 3276.7 ECU_ADDRESS 0x3FE7E8 /end MEASUREMENT
/begin MEASUREMENT van_exd_anschl_max_A2 "Pr???flauf Max-Anschlag [RAM name from V530, interpolated]" SWORD M_FORMULA_0102 0 0 -3276.8 3276.7 ECU_ADDRESS 0x3FE7EC /end MEASUREMENT
/begin MEASUREMENT van_exd_anschl_max_E2 "Pr???flauf Max-Anschlag [RAM name from V530, interpolated]" SWORD M_FORMULA_0102 0 0 -3276.8 3276.7 ECU_ADDRESS 0x3FE7EA /end MEASUREMENT
/begin MEASUREMENT van_exd_anschl_min_A1 "Pr???flauf Min-Anschlag [RAM name from V530, interpolated]" SWORD M_FORMULA_0102 0 0 -3276.8 3276.7 ECU_ADDRESS 0x3FE7F0 /end MEASUREMENT
/begin MEASUREMENT van_exd_anschl_min_A2 "Pr???flauf Min-Anschlag [RAM name from V530, interpolated]" SWORD M_FORMULA_0102 0 0 -3276.8 3276.7 ECU_ADDRESS 0x3FE7F4 /end MEASUREMENT
/begin MEASUREMENT van_exd_anschl_min_E2 "Pr???flauf Min-Anschlag [RAM name from V530, interpolated]" SWORD M_FORMULA_0102 0 0 -3276.8 3276.7 ECU_ADDRESS 0x3FE7F2 /end MEASUREMENT
/begin MEASUREMENT van_exd_frequ_A1 "PWM-Frequenz vom Tester [RAM name from V530, interpolated]" UWORD M_FORMULA_1202 0 0 -1e+12 1e+12 ECU_ADDRESS 0x3FE7F8 /end MEASUREMENT
/begin MEASUREMENT van_exd_frequ_A2 "PWM-Frequenz vom Tester [RAM name from V530, interpolated]" UWORD M_FORMULA_1202 0 0 -1e+12 1e+12 ECU_ADDRESS 0x3FE7FC /end MEASUREMENT
/begin MEASUREMENT van_exd_frequ_E2 "PWM-Frequenz vom Tester [RAM name from V530, interpolated]" UWORD M_FORMULA_1202 0 0 -1e+12 1e+12 ECU_ADDRESS 0x3FE7FA /end MEASUREMENT
/begin MEASUREMENT van_exd_tv_A1 "Ventil Tastverhaeltnis vom Tester [RAM name from V530, interpolated]" SWORD M_FORMULA_0107 0 0 -3200 3199.902344 ECU_ADDRESS 0x3FE812 /end MEASUREMENT
/begin MEASUREMENT van_exd_tv_A2 "Ventil Tastverhaeltnis vom Tester [RAM name from V530, interpolated]" SWORD M_FORMULA_0107 0 0 -3200 3199.902344 ECU_ADDRESS 0x3FE816 /end MEASUREMENT
/begin MEASUREMENT van_exd_tv_E2 "Ventil Tastverhaeltnis vom Tester [RAM name from V530, interpolated]" SWORD M_FORMULA_0107 0 0 -3200 3199.902344 ECU_ADDRESS 0x3FE814 /end MEASUREMENT
/begin MEASUREMENT van_exd_tv_timeout_A1 "Tastverhaeltnis vom Tester [RAM name from V530, interpolated]" UBYTE M_FORMULA_0461 0 0 0 25.5 ECU_ADDRESS 0x3FE819 /end MEASUREMENT
/begin MEASUREMENT van_exd_tv_timeout_A2 "Tastverhaeltnis vom Tester [RAM name from V530, interpolated]" UBYTE M_FORMULA_0461 0 0 0 25.5 ECU_ADDRESS 0x3FE81B /end MEASUREMENT
/begin MEASUREMENT van_exd_tv_timeout_E2 "Tastverhaeltnis vom Tester [RAM name from V530, interpolated]" UBYTE M_FORMULA_0461 0 0 0 25.5 ECU_ADDRESS 0x3FE81A /end MEASUREMENT
/begin MEASUREMENT van_ist_schl_A1 "Ventil Schliessen vor ZOT [RAM name from V530, interpolated]" SWORD M_FORMULA_0102 0 0 -3276.8 3276.7 ECU_ADDRESS 0x3FE8B4 /end MEASUREMENT
/begin MEASUREMENT van_ist_schl_A2 "Ventil Schliessen vor ZOT [RAM name from V530, interpolated]" SWORD M_FORMULA_0102 0 0 -3276.8 3276.7 ECU_ADDRESS 0x3FE8B8 /end MEASUREMENT
/begin MEASUREMENT van_ist_schl_E2 "Ventil Schliessen vor ZOT [RAM name from V530, interpolated]" SWORD M_FORMULA_0102 0 0 -3276.8 3276.7 ECU_ADDRESS 0x3FE8B6 /end MEASUREMENT
/begin MEASUREMENT van_kd_Auslass "Vanos-Regler d-Faktor [RAM name from V530, interpolated]" SWORD M_FORMULA_1209 0 0 -32 31.99902344 ECU_ADDRESS 0x3FE8C4 /end MEASUREMENT
/begin MEASUREMENT van_kd_Einlass "Vanos-Regler d-Faktor [RAM name from V530, interpolated]" SWORD M_FORMULA_1209 0 0 -32 31.99902344 ECU_ADDRESS 0x3FE8C2 /end MEASUREMENT
/begin MEASUREMENT van_kh_soll_A1 "Kennfeld Katheiz Soll [RAM name from V530, interpolated]" SWORD M_FORMULA_0102 0 0 -3276.8 3276.7 ECU_ADDRESS 0x3FE8BC /end MEASUREMENT
/begin MEASUREMENT van_kh_soll_A2 "Kennfeld Katheiz Soll [RAM name from V530, interpolated]" SWORD M_FORMULA_0102 0 0 -3276.8 3276.7 ECU_ADDRESS 0x3FE8C0 /end MEASUREMENT
/begin MEASUREMENT van_kh_soll_E1 "Kennfeld Katheiz Soll [RAM name from V530, interpolated]" SWORD M_FORMULA_0102 0 0 -3276.8 3276.7 ECU_ADDRESS 0x3FE8BA /end MEASUREMENT
/begin MEASUREMENT van_kh_soll_E2 "Kennfeld Katheiz Soll [RAM name from V530, interpolated]" SWORD M_FORMULA_0102 0 0 -3276.8 3276.7 ECU_ADDRESS 0x3FE8BE /end MEASUREMENT
/begin MEASUREMENT van_ki_A1 "Vanos-Regler I-Faktor [RAM name from V530, interpolated]" SWORD M_FORMULA_1210 0 0 -500 499.9847412 ECU_ADDRESS 0x3FE8C8 /end MEASUREMENT
/begin MEASUREMENT van_ki_A2 "Vanos-Regler I-Faktor [RAM name from V530, interpolated]" SWORD M_FORMULA_1210 0 0 -500 499.9847412 ECU_ADDRESS 0x3FE8CC /end MEASUREMENT
/begin MEASUREMENT van_ki_E1 "Vanos-Regler I-Faktor [RAM name from V530, interpolated]" SWORD M_FORMULA_1210 0 0 -500 499.9847412 ECU_ADDRESS 0x3FE8C6 /end MEASUREMENT
/begin MEASUREMENT van_ki_E2 "Vanos-Regler I-Faktor [RAM name from V530, interpolated]" SWORD M_FORMULA_1210 0 0 -500 499.9847412 ECU_ADDRESS 0x3FE8CA /end MEASUREMENT
/begin MEASUREMENT van_kp_Auslass "Vanos-Regler P-Faktor [RAM name from V530, interpolated]" SWORD M_FORMULA_1211 0 0 -1280 1279.960938 ECU_ADDRESS 0x3FE8D0 /end MEASUREMENT
/begin MEASUREMENT van_kp_Einlass "Vanos-Regler P-Faktor [RAM name from V530, interpolated]" SWORD M_FORMULA_1211 0 0 -1280 1279.960938 ECU_ADDRESS 0x3FE8CE /end MEASUREMENT
/begin MEASUREMENT van_n_korr_a_b1 "n * tabg_lw_verh_wurzel [RAM name from V530, interpolated]" SWORD M_FORMULA_0006 0 0 -32768 32767 ECU_ADDRESS 0x3FE8D2 /end MEASUREMENT
/begin MEASUREMENT van_n_korr_a_b2 "n * tabg_lw_verh_wurzel [RAM name from V530, interpolated]" SWORD M_FORMULA_0006 0 0 -32768 32767 ECU_ADDRESS 0x3FE8D4 /end MEASUREMENT
/begin MEASUREMENT B_VAN_ANSCHL_ANF_A1 "Anschlag anfahren [RAM name from V530, interpolated]" UBYTE NO_COMPU_METHOD 0 0 0 255 ECU_ADDRESS 0x3FE903 FORMAT "%.4g" /end MEASUREMENT
/begin MEASUREMENT B_VAN_ANSCHL_DC_A1 "Anschlag im DrivingCycle gelernt [RAM name from V530, interpolated]" UBYTE NO_COMPU_METHOD 0 0 0 255 ECU_ADDRESS 0x3FE903 FORMAT "%.4g" /end MEASUREMENT
/begin MEASUREMENT B_VAN_DRUCK_SPAET_A1 "Druckerkennung Sollwert spaet [RAM name from V530, interpolated]" UBYTE NO_COMPU_METHOD 0 0 0 255 ECU_ADDRESS 0x3FE903 FORMAT "%.4g" /end MEASUREMENT
/begin MEASUREMENT B_VAN_EXD_PRUEF_I_A1 "Stromvorgabe ueber Diagnose [RAM name from V530, interpolated]" UBYTE NO_COMPU_METHOD 0 0 0 255 ECU_ADDRESS 0x3FE903 FORMAT "%.4g" /end MEASUREMENT
/begin MEASUREMENT B_VAN_FILTR_A1 "Filtration erkannt [RAM name from V530, interpolated]" UBYTE NO_COMPU_METHOD 0 0 0 255 ECU_ADDRESS 0x3FE903 FORMAT "%.4g" /end MEASUREMENT
/begin MEASUREMENT B_VAN_KS_AUS_A1 "Ventil Kurzschlussabschaltung [RAM name from V530, interpolated]" UBYTE NO_COMPU_METHOD 0 0 0 255 ECU_ADDRESS 0x3FE903 FORMAT "%.4g" /end MEASUREMENT
/begin MEASUREMENT B_VAN_REG_FREI_A1 "Lageregler Freigabe [RAM name from V530, interpolated]" UBYTE NO_COMPU_METHOD 0 0 0 255 ECU_ADDRESS 0x3FE903 FORMAT "%.4g" /end MEASUREMENT
/begin MEASUREMENT van_st_A1 "Status Vanos [RAM name from V530, interpolated]" UBYTE M_FORMULA_0003 0 0 0 255 ECU_ADDRESS 0x3FE903 /end MEASUREMENT
/begin MEASUREMENT B_VAN_ANSCHL_ANF_A2 "Anschlag anfahren [RAM name from V530, interpolated]" UBYTE NO_COMPU_METHOD 0 0 0 255 ECU_ADDRESS 0x3FE905 FORMAT "%.4g" /end MEASUREMENT
/begin MEASUREMENT B_VAN_ANSCHL_DC_A2 "Anschlag im DrivingCycle gelernt [RAM name from V530, interpolated]" UBYTE NO_COMPU_METHOD 0 0 0 255 ECU_ADDRESS 0x3FE905 FORMAT "%.4g" /end MEASUREMENT
/begin MEASUREMENT B_VAN_DRUCK_SPAET_A2 "Druckerkennung Sollwert spaet [RAM name from V530, interpolated]" UBYTE NO_COMPU_METHOD 0 0 0 255 ECU_ADDRESS 0x3FE905 FORMAT "%.4g" /end MEASUREMENT
/begin MEASUREMENT B_VAN_EXD_PRUEF_I_A2 "Stromvorgabe ueber Diagnose [RAM name from V530, interpolated]" UBYTE NO_COMPU_METHOD 0 0 0 255 ECU_ADDRESS 0x3FE905 FORMAT "%.4g" /end MEASUREMENT
/begin MEASUREMENT B_VAN_FILTR_A2 "Filtration erkannt [RAM name from V530, interpolated]" UBYTE NO_COMPU_METHOD 0 0 0 255 ECU_ADDRESS 0x3FE905 FORMAT "%.4g" /end MEASUREMENT
/begin MEASUREMENT B_VAN_KS_AUS_A2 "Ventil Kurzschlussabschaltung [RAM name from V530, interpolated]" UBYTE NO_COMPU_METHOD 0 0 0 255 ECU_ADDRESS 0x3FE905 FORMAT "%.4g" /end MEASUREMENT
/begin MEASUREMENT B_VAN_REG_FREI_A2 "Lageregler Freigabe [RAM name from V530, interpolated]" UBYTE NO_COMPU_METHOD 0 0 0 255 ECU_ADDRESS 0x3FE905 FORMAT "%.4g" /end MEASUREMENT
/begin MEASUREMENT van_st_A2 "Status Vanos [RAM name from V530, interpolated]" UBYTE M_FORMULA_0003 0 0 0 255 ECU_ADDRESS 0x3FE905 /end MEASUREMENT
/begin MEASUREMENT B_VAN_ANSCHL_ANF_E2 "Anschlag anfahren [RAM name from V530, interpolated]" UBYTE NO_COMPU_METHOD 0 0 0 255 ECU_ADDRESS 0x3FE904 FORMAT "%.4g" /end MEASUREMENT
/begin MEASUREMENT B_VAN_ANSCHL_DC_E2 "Anschlag im DrivingCycle gelernt [RAM name from V530, interpolated]" UBYTE NO_COMPU_METHOD 0 0 0 255 ECU_ADDRESS 0x3FE904 FORMAT "%.4g" /end MEASUREMENT
/begin MEASUREMENT B_VAN_DRUCK_SPAET_E2 "Druckerkennung Sollwert spaet [RAM name from V530, interpolated]" UBYTE NO_COMPU_METHOD 0 0 0 255 ECU_ADDRESS 0x3FE904 FORMAT "%.4g" /end MEASUREMENT
/begin MEASUREMENT B_VAN_EXD_PRUEF_I_E2 "Stromvorgabe ueber Diagnose [RAM name from V530, interpolated]" UBYTE NO_COMPU_METHOD 0 0 0 255 ECU_ADDRESS 0x3FE904 FORMAT "%.4g" /end MEASUREMENT
/begin MEASUREMENT B_VAN_FILTR_E2 "Filtration erkannt [RAM name from V530, interpolated]" UBYTE NO_COMPU_METHOD 0 0 0 255 ECU_ADDRESS 0x3FE904 FORMAT "%.4g" /end MEASUREMENT
/begin MEASUREMENT B_VAN_KS_AUS_E2 "Ventil Kurzschlussabschaltung [RAM name from V530, interpolated]" UBYTE NO_COMPU_METHOD 0 0 0 255 ECU_ADDRESS 0x3FE904 FORMAT "%.4g" /end MEASUREMENT
/begin MEASUREMENT B_VAN_REG_FREI_E2 "Lageregler Freigabe [RAM name from V530, interpolated]" UBYTE NO_COMPU_METHOD 0 0 0 255 ECU_ADDRESS 0x3FE904 FORMAT "%.4g" /end MEASUREMENT
/begin MEASUREMENT van_st_E2 "Status Vanos [RAM name from V530, interpolated]" UBYTE M_FORMULA_0003 0 0 0 255 ECU_ADDRESS 0x3FE904 /end MEASUREMENT
/begin MEASUREMENT van_zahn_cnt_b2 "Zahnzaehler fuer n-Messung [RAM name from V530, interpolated]" SBYTE M_FORMULA_0003 0 0 -128 127 ECU_ADDRESS 0x3FE98F /end MEASUREMENT
/begin MEASUREMENT van_zahn_ctr5ms_b2 "5ms-Ctr fuer n-Messung [RAM name from V530, interpolated]" SWORD M_FORMULA_0010 0 0 -32768 32767 ECU_ADDRESS 0x3FE992 /end MEASUREMENT
/begin MEASUREMENT wf_mks_begr_zyl10 "begr. wf_mks_roh [RAM name from V530, interpolated]" SWORD M_FORMULA_0534 0 0 -1024 1023.96875 ECU_ADDRESS 0x3FEA7E /end MEASUREMENT
/begin MEASUREMENT wf_mks_begr_zyl2 "begr. wf_mks_roh [RAM name from V530, interpolated]" SWORD M_FORMULA_0534 0 0 -1024 1023.96875 ECU_ADDRESS 0x3FEA6E /end MEASUREMENT
/begin MEASUREMENT wf_mks_begr_zyl3 "begr. wf_mks_roh [RAM name from V530, interpolated]" SWORD M_FORMULA_0534 0 0 -1024 1023.96875 ECU_ADDRESS 0x3FEA70 /end MEASUREMENT
/begin MEASUREMENT wf_mks_begr_zyl4 "begr. wf_mks_roh [RAM name from V530, interpolated]" SWORD M_FORMULA_0534 0 0 -1024 1023.96875 ECU_ADDRESS 0x3FEA72 /end MEASUREMENT
/begin MEASUREMENT wf_mks_begr_zyl5 "begr. wf_mks_roh [RAM name from V530, interpolated]" SWORD M_FORMULA_0534 0 0 -1024 1023.96875 ECU_ADDRESS 0x3FEA74 /end MEASUREMENT
/begin MEASUREMENT wf_mks_begr_zyl6 "begr. wf_mks_roh [RAM name from V530, interpolated]" SWORD M_FORMULA_0534 0 0 -1024 1023.96875 ECU_ADDRESS 0x3FEA76 /end MEASUREMENT
/begin MEASUREMENT wf_mks_begr_zyl7 "begr. wf_mks_roh [RAM name from V530, interpolated]" SWORD M_FORMULA_0534 0 0 -1024 1023.96875 ECU_ADDRESS 0x3FEA78 /end MEASUREMENT
/begin MEASUREMENT wf_mks_begr_zyl8 "begr. wf_mks_roh [RAM name from V530, interpolated]" SWORD M_FORMULA_0534 0 0 -1024 1023.96875 ECU_ADDRESS 0x3FEA7A /end MEASUREMENT
/begin MEASUREMENT wf_mks_begr_zyl9 "begr. wf_mks_roh [RAM name from V530, interpolated]" SWORD M_FORMULA_0534 0 0 -1024 1023.96875 ECU_ADDRESS 0x3FEA7C /end MEASUREMENT
/begin MEASUREMENT wf_mks_zyl1 "MKS aus Wandfilmmodell [RAM name from V530, interpolated]" SWORD M_FORMULA_0111 0 0 -512 511.984375 ECU_ADDRESS 0x3FEA80 /end MEASUREMENT
/begin MEASUREMENT wf_mks_zyl10 "MKS aus Wandfilmmodell [RAM name from V530, interpolated]" SWORD M_FORMULA_0111 0 0 -512 511.984375 ECU_ADDRESS 0x3FEA92 /end MEASUREMENT
/begin MEASUREMENT wf_mks_zyl2 "MKS aus Wandfilmmodell [RAM name from V530, interpolated]" SWORD M_FORMULA_0111 0 0 -512 511.984375 ECU_ADDRESS 0x3FEA82 /end MEASUREMENT
/begin MEASUREMENT wf_mks_zyl3 "MKS aus Wandfilmmodell [RAM name from V530, interpolated]" SWORD M_FORMULA_0111 0 0 -512 511.984375 ECU_ADDRESS 0x3FEA84 /end MEASUREMENT
/begin MEASUREMENT wf_mks_zyl4 "MKS aus Wandfilmmodell [RAM name from V530, interpolated]" SWORD M_FORMULA_0111 0 0 -512 511.984375 ECU_ADDRESS 0x3FEA86 /end MEASUREMENT
/begin MEASUREMENT wf_mks_zyl5 "MKS aus Wandfilmmodell [RAM name from V530, interpolated]" SWORD M_FORMULA_0111 0 0 -512 511.984375 ECU_ADDRESS 0x3FEA88 /end MEASUREMENT
/begin MEASUREMENT wf_mks_zyl6 "MKS aus Wandfilmmodell [RAM name from V530, interpolated]" SWORD M_FORMULA_0111 0 0 -512 511.984375 ECU_ADDRESS 0x3FEA8A /end MEASUREMENT
/begin MEASUREMENT wf_mks_zyl7 "MKS aus Wandfilmmodell [RAM name from V530, interpolated]" SWORD M_FORMULA_0111 0 0 -512 511.984375 ECU_ADDRESS 0x3FEA8C /end MEASUREMENT
/begin MEASUREMENT wf_mks_zyl8 "MKS aus Wandfilmmodell [RAM name from V530, interpolated]" SWORD M_FORMULA_0111 0 0 -512 511.984375 ECU_ADDRESS 0x3FEA8E /end MEASUREMENT
/begin MEASUREMENT wf_mks_zyl9 "MKS aus Wandfilmmodell [RAM name from V530, interpolated]" SWORD M_FORMULA_0111 0 0 -512 511.984375 ECU_ADDRESS 0x3FEA90 /end MEASUREMENT
/begin MEASUREMENT wf_mks_begr_neg_b2 "min. Schwelle fuer Wandfilmbegrenzung [RAM name from V530, interpolated]" SWORD M_FORMULA_0534 0 0 -1024 1023.96875 ECU_ADDRESS 0x3FEAA2 /end MEASUREMENT
/begin MEASUREMENT sk_md_begr_ni "SK-Begrenzungsstufe - no Init [RAM name from V530, interpolated]" UBYTE NO_COMPU_METHOD 0 0 0 255 ECU_ADDRESS 0x3FEFB5 FORMAT "%.4g" /end MEASUREMENT
/begin COMPU_METHOD M_FORMULA_0001 "V530 FORMULA_0001" RAT_FUNC "%.4g" "%" COEFFS 0 10 0 0 0 1 /end COMPU_METHOD
/begin COMPU_METHOD M_FORMULA_0003 "V530 FORMULA_0003" RAT_FUNC "%.4g" "-" COEFFS 0 1 0 0 0 1 /end COMPU_METHOD
/begin COMPU_METHOD M_FORMULA_0006 "V530 FORMULA_0006" RAT_FUNC "%.4g" "Upm" COEFFS 0 1 0 0 0 1 /end COMPU_METHOD
/begin COMPU_METHOD M_FORMULA_0007 "V530 FORMULA_0007" RAT_FUNC "%.4g" "-" COEFFS 0 10000 0 0 0 1 /end COMPU_METHOD
/begin COMPU_METHOD M_FORMULA_0010 "V530 FORMULA_0010" RAT_FUNC "%.4g" "-" COEFFS 0 1 0 0 0 1 /end COMPU_METHOD
/begin COMPU_METHOD M_FORMULA_0021 "V530 FORMULA_0021" RAT_FUNC "%.4g" "s" COEFFS 0 100 0 0 0 1 /end COMPU_METHOD
/begin COMPU_METHOD M_FORMULA_0023 "V530 FORMULA_0023" RAT_FUNC "%.4g" "???C" COEFFS 0 10 2732 0 0 1 /end COMPU_METHOD
/begin COMPU_METHOD M_FORMULA_0024 "V530 FORMULA_0024" RAT_FUNC "%.4g" "-" COEFFS 0 32768 0 0 0 1 /end COMPU_METHOD
/begin COMPU_METHOD M_FORMULA_0025 "V530 FORMULA_0025" RAT_FUNC "%.4g" "-" COEFFS 0 16384 0 0 0 1 /end COMPU_METHOD
/begin COMPU_METHOD M_FORMULA_0032 "V530 FORMULA_0032" RAT_FUNC "%.4g" "%" COEFFS 0 1 0 0 0 1 /end COMPU_METHOD
/begin COMPU_METHOD M_FORMULA_0071 "V530 FORMULA_0071" RAT_FUNC "%.4g" "s" COEFFS 0 10 0 0 0 1 /end COMPU_METHOD
/begin COMPU_METHOD M_FORMULA_0073 "V530 FORMULA_0073" RAT_FUNC "%.4g" "-" COEFFS 0 1024 0 0 0 1 /end COMPU_METHOD
/begin COMPU_METHOD M_FORMULA_0074 "V530 FORMULA_0074" RAT_FUNC "%.4g" "Kelvin" COEFFS 0 10 0 0 0 1 /end COMPU_METHOD
/begin COMPU_METHOD M_FORMULA_0075 "V530 FORMULA_0075" RAT_FUNC "%.4g" "mbar" COEFFS 0 16 0 0 0 1 /end COMPU_METHOD
/begin COMPU_METHOD M_FORMULA_0080 "V530 FORMULA_0080" RAT_FUNC "%.4g" "-" COEFFS 0 1 0 0 0 1 /end COMPU_METHOD
/begin COMPU_METHOD M_FORMULA_0090 "V530 FORMULA_0090" RAT_FUNC "%.4g" "mg" COEFFS 0 10 0 0 0 1 /end COMPU_METHOD
/begin COMPU_METHOD M_FORMULA_0102 "V530 FORMULA_0102" RAT_FUNC "%.4g" "???KW" COEFFS 0 10 0 0 0 1 /end COMPU_METHOD
/begin COMPU_METHOD M_FORMULA_0103 "V530 FORMULA_0103" RAT_FUNC "%.4g" "kg/h" COEFFS 0 10 0 0 0 1 /end COMPU_METHOD
/begin COMPU_METHOD M_FORMULA_0105 "V530 FORMULA_0105" RAT_FUNC "%.4g" "Upm/s" COEFFS 0 1 0 0 0 1 /end COMPU_METHOD
/begin COMPU_METHOD M_FORMULA_0107 "V530 FORMULA_0107" RAT_FUNC "%.4g" "%" COEFFS 0 10.24 0 0 0 1 /end COMPU_METHOD
/begin COMPU_METHOD M_FORMULA_0109 "V530 FORMULA_0109" RAT_FUNC "%.4g" "s" COEFFS 0 200 0 0 0 1 /end COMPU_METHOD
/begin COMPU_METHOD M_FORMULA_0110 "V530 FORMULA_0110" RAT_FUNC "%.4g" "bar" COEFFS 0 1000 0 0 0 1 /end COMPU_METHOD
/begin COMPU_METHOD M_FORMULA_0111 "V530 FORMULA_0111" RAT_FUNC "%.4g" "mg" COEFFS 0 64 0 0 0 1 /end COMPU_METHOD
/begin COMPU_METHOD M_FORMULA_0114 "V530 FORMULA_0114" RAT_FUNC "%.4g" "digit" COEFFS 0 1 0 0 0 1 /end COMPU_METHOD
/begin COMPU_METHOD M_FORMULA_0143 "V530 FORMULA_0143" RAT_FUNC "%.4g" "qmm" COEFFS 0 10 0 0 0 1 /end COMPU_METHOD
/begin COMPU_METHOD M_FORMULA_0147 "V530 FORMULA_0147" RAT_FUNC "%.4g" "s" COEFFS 0 100 0 0 0 1 /end COMPU_METHOD
/begin COMPU_METHOD M_FORMULA_0199 "V530 FORMULA_0199" RAT_FUNC "%.4g" "-" COEFFS 0 16384 0 0 0 1 /end COMPU_METHOD
/begin COMPU_METHOD M_FORMULA_0306 "V530 FORMULA_0306" RAT_FUNC "%.4g" "s" COEFFS 0 100 0 0 0 1 /end COMPU_METHOD
/begin COMPU_METHOD M_FORMULA_0354 "V530 FORMULA_0354" RAT_FUNC "%.4g" "ms" COEFFS 0 625 0 0 0 1 /end COMPU_METHOD
/begin COMPU_METHOD M_FORMULA_0363 "V530 FORMULA_0363" RAT_FUNC "%.4g" "ms" COEFFS 0 1000 0 0 0 1 /end COMPU_METHOD
/begin COMPU_METHOD M_FORMULA_0431 "V530 FORMULA_0431" RAT_FUNC "%.4g" "???C" COEFFS 0 10 0 0 0 1 /end COMPU_METHOD
/begin COMPU_METHOD M_FORMULA_0436 "V530 FORMULA_0436" RAT_FUNC "%.4g" "mm" COEFFS 0 3.413333333 0 0 0 1 /end COMPU_METHOD
/begin COMPU_METHOD M_FORMULA_0439 "V530 FORMULA_0439" RAT_FUNC "%.4g" "mm" COEFFS 0 32 0 0 0 1 /end COMPU_METHOD
/begin COMPU_METHOD M_FORMULA_0461 "V530 FORMULA_0461" RAT_FUNC "%.4g" "s" COEFFS 0 10 0 0 0 1 /end COMPU_METHOD
/begin COMPU_METHOD M_FORMULA_0475 "V530 FORMULA_0475" RAT_FUNC "%.4g" "%" COEFFS 0 2.56 0 0 0 1 /end COMPU_METHOD
/begin COMPU_METHOD M_FORMULA_0492 "V530 FORMULA_0492" RAT_FUNC "%.4g" "s" COEFFS 0 0.01785714286 0 0 0 1 /end COMPU_METHOD
/begin COMPU_METHOD M_FORMULA_0493 "V530 FORMULA_0493" RAT_FUNC "%.4g" "min" COEFFS 0 1.071428571 0 0 0 1 /end COMPU_METHOD
/begin COMPU_METHOD M_FORMULA_0494 "V530 FORMULA_0494" RAT_FUNC "%.4g" "s" COEFFS 0 0.07142857143 0 0 0 1 /end COMPU_METHOD
/begin COMPU_METHOD M_FORMULA_0498 "V530 FORMULA_0498" RAT_FUNC "%.4g" "Ah" COEFFS 0 54.94444444 0 0 0 1 /end COMPU_METHOD
/begin COMPU_METHOD M_FORMULA_0501 "V530 FORMULA_0501" RAT_FUNC "%.4g" "" COEFFS 0 4000 -24000 0 0 1 /end COMPU_METHOD
/begin COMPU_METHOD M_FORMULA_0504 "V530 FORMULA_0504" RAT_FUNC "%.4g" "" COEFFS 0 128 0 0 0 1 /end COMPU_METHOD
/begin COMPU_METHOD M_FORMULA_0505 "V530 FORMULA_0505" RAT_FUNC "%.4g" "" COEFFS 0 4 0 0 0 1 /end COMPU_METHOD
/begin COMPU_METHOD M_FORMULA_0507 "V530 FORMULA_0507" RAT_FUNC "%.4g" "" COEFFS 0 4 0 0 0 1 /end COMPU_METHOD
/begin COMPU_METHOD M_FORMULA_0510 "V530 FORMULA_0510" RAT_FUNC "%.4g" "%" COEFFS 0 2 0 0 0 1 /end COMPU_METHOD
/begin COMPU_METHOD M_FORMULA_0534 "V530 FORMULA_0534" RAT_FUNC "%.4g" "mg" COEFFS 0 32 0 0 0 1 /end COMPU_METHOD
/begin COMPU_METHOD M_FORMULA_0535 "V530 FORMULA_0535" RAT_FUNC "%.4g" "mg/ASP" COEFFS 0 64 0 0 0 1 /end COMPU_METHOD
/begin COMPU_METHOD M_FORMULA_0536 "V530 FORMULA_0536" RAT_FUNC "%.4g" "mV" COEFFS 0 0.2048 0 0 0 1 /end COMPU_METHOD
/begin COMPU_METHOD M_FORMULA_0541 "V530 FORMULA_0541" RAT_FUNC "%.4g" "Ohm" COEFFS 0 10 0 0 0 1 /end COMPU_METHOD
/begin COMPU_METHOD M_FORMULA_0553 "V530 FORMULA_0553" RAT_FUNC "%.4g" "mA" COEFFS 0 444.4444444 0 0 0 1 /end COMPU_METHOD
/begin COMPU_METHOD M_FORMULA_0554 "V530 FORMULA_0554" RAT_FUNC "%.4g" "uA" COEFFS 0 7281.777778 0 0 0 1 /end COMPU_METHOD
/begin COMPU_METHOD M_FORMULA_0559 "V530 FORMULA_0559" RAT_FUNC "%.4g" "l" COEFFS 0 2 0 0 0 1 /end COMPU_METHOD
/begin COMPU_METHOD M_FORMULA_0560 "V530 FORMULA_0560" RAT_FUNC "%.4g" "l" COEFFS 0 512 0 0 0 1 /end COMPU_METHOD
/begin COMPU_METHOD M_FORMULA_0561 "V530 FORMULA_0561" RAT_FUNC "%.4g" "L" COEFFS 0 976.5625 0 0 0 1 /end COMPU_METHOD
/begin COMPU_METHOD M_FORMULA_0563 "V530 FORMULA_0563" RAT_FUNC "%.4g" "kg/h" COEFFS 0 1000 0 0 0 1 /end COMPU_METHOD
/begin COMPU_METHOD M_FORMULA_0593 "V530 FORMULA_0593" RAT_FUNC "%.4g" "s" COEFFS 0 1 0 0 0 1 /end COMPU_METHOD
/begin COMPU_METHOD M_FORMULA_0639 "V530 FORMULA_0639" RAT_FUNC "%.4g" "uA" COEFFS 0 29127.11111 0 0 0 1 /end COMPU_METHOD
/begin COMPU_METHOD M_FORMULA_0656 "V530 FORMULA_0656" RAT_FUNC "%.4g" "Segmente" COEFFS 0 1 0 0 0 1 /end COMPU_METHOD
/begin COMPU_METHOD M_FORMULA_0668 "V530 FORMULA_0668" RAT_FUNC "%.4g" "ms" COEFFS 0 0.01 0 0 0 1 /end COMPU_METHOD
/begin COMPU_METHOD M_FORMULA_0706 "V530 FORMULA_0706" RAT_FUNC "%.4g" "%" COEFFS 0 100 0 0 0 1 /end COMPU_METHOD
/begin COMPU_METHOD M_FORMULA_0750 "V530 FORMULA_0750" RAT_FUNC "%.4g" "mA" COEFFS 0 3276.8 0 0 0 1 /end COMPU_METHOD
/begin COMPU_METHOD M_FORMULA_0751 "V530 FORMULA_0751" RAT_FUNC "%.4g" "1/ms" COEFFS 0 16384000 0 0 0 1 /end COMPU_METHOD
/begin COMPU_METHOD M_FORMULA_0761 "V530 FORMULA_0761" RAT_FUNC "%.4g" "ms" COEFFS 0 31.25 0 0 0 1 /end COMPU_METHOD
/begin COMPU_METHOD M_FORMULA_0762 "V530 FORMULA_0762" RAT_FUNC "%.4g" "-" COEFFS 0 8192 0 0 0 1 /end COMPU_METHOD
/begin COMPU_METHOD M_FORMULA_0763 "V530 FORMULA_0763" RAT_FUNC "%.4g" "ms" COEFFS 0 1 0 0 0 1 /end COMPU_METHOD
/begin COMPU_METHOD M_FORMULA_0786 "V530 FORMULA_0786" RAT_FUNC "%.4g" "ms" COEFFS 0 1000 0 0 0 1 /end COMPU_METHOD
/begin COMPU_METHOD M_FORMULA_0796 "V530 FORMULA_0796" RAT_FUNC "%.4g" "mg" COEFFS 0 40 0 0 0 1 /end COMPU_METHOD
/begin COMPU_METHOD M_FORMULA_0806 "V530 FORMULA_0806" RAT_FUNC "%.4g" "-" COEFFS 0 128 0 0 0 1 /end COMPU_METHOD
/begin COMPU_METHOD M_FORMULA_0875 "V530 FORMULA_0875" RAT_FUNC "%.4g" "uA" COEFFS 0 0.1941747573 -1 0 0 1 /end COMPU_METHOD
/begin COMPU_METHOD M_FORMULA_0876 "V530 FORMULA_0876" RAT_FUNC "%.4g" "ms" COEFFS 0 10 -8 0 0 1 /end COMPU_METHOD
/begin COMPU_METHOD M_FORMULA_0877 "V530 FORMULA_0877" RAT_FUNC "%.4g" "kHz" COEFFS 0 8.196721311 -16.00901639 0 0 1 /end COMPU_METHOD
/begin COMPU_METHOD M_FORMULA_0908 "V530 FORMULA_0908" RAT_FUNC "%.4g" "10exp-3 -/mV" COEFFS 0 80 0 0 0 1 /end COMPU_METHOD
/begin COMPU_METHOD M_FORMULA_0909 "V530 FORMULA_0909" RAT_FUNC "%.4g" "-/s" COEFFS 0 16384 0 0 0 1 /end COMPU_METHOD
/begin COMPU_METHOD M_FORMULA_0921 "V530 FORMULA_0921" RAT_FUNC "%.4g" "s" COEFFS 0 100 0 0 0 1 /end COMPU_METHOD
/begin COMPU_METHOD M_FORMULA_0925 "V530 FORMULA_0925" RAT_FUNC "%.4g" "A" COEFFS 0 215 0 0 0 1 /end COMPU_METHOD
/begin COMPU_METHOD M_FORMULA_0935 "V530 FORMULA_0935" RAT_FUNC "%.4g" "%" COEFFS 0 20.48 0 0 0 1 /end COMPU_METHOD
/begin COMPU_METHOD M_FORMULA_0936 "V530 FORMULA_0936" RAT_FUNC "%.4g" "%/s" COEFFS 0 20.48 0 0 0 1 /end COMPU_METHOD
/begin COMPU_METHOD M_FORMULA_0937 "V530 FORMULA_0937" RAT_FUNC "%.4g" "s" COEFFS 0 10 0 0 0 1 /end COMPU_METHOD
/begin COMPU_METHOD M_FORMULA_1016 "V530 FORMULA_1016" RAT_FUNC "%.4g" "-" COEFFS 0 16384 0 0 0 1 /end COMPU_METHOD
/begin COMPU_METHOD M_FORMULA_1024 "V530 FORMULA_1024" RAT_FUNC "%.4g" "s" COEFFS 0 0 25.6 0 1 0 /end COMPU_METHOD
/begin COMPU_METHOD M_FORMULA_1052 "V530 FORMULA_1052" RAT_FUNC "%.4g" "s" COEFFS 0 0 6553.5 0 1 0 /end COMPU_METHOD
/begin COMPU_METHOD M_FORMULA_1057 "V530 FORMULA_1057" RAT_FUNC "%.4g" "z/asp" COEFFS 0 1 0 0 0 1 /end COMPU_METHOD
/begin COMPU_METHOD M_FORMULA_1151 "V530 FORMULA_1151" RAT_FUNC "%.4g" "l/min" COEFFS 0 500 0 0 0 1 /end COMPU_METHOD
/begin COMPU_METHOD M_FORMULA_1161 "V530 FORMULA_1161" RAT_FUNC "%.4g" "nSs" COEFFS 0 1639.344262 0 0 0 1 /end COMPU_METHOD
/begin COMPU_METHOD M_FORMULA_1170 "V530 FORMULA_1170" RAT_FUNC "%.4g" "mg/ms" COEFFS 0 1024 0 0 0 1 /end COMPU_METHOD
/begin COMPU_METHOD M_FORMULA_1171 "V530 FORMULA_1171" RAT_FUNC "%.4g" "mg/ASP" COEFFS 0 32 0 0 0 1 /end COMPU_METHOD
/begin COMPU_METHOD M_FORMULA_1172 "V530 FORMULA_1172" RAT_FUNC "%.4g" "m/s" COEFFS 0 10 0 0 0 1 /end COMPU_METHOD
/begin COMPU_METHOD M_FORMULA_1202 "V530 FORMULA_1202" RAT_FUNC "%.4g" "Hz" COEFFS 0 0 1000000 0 1 0 /end COMPU_METHOD
/begin COMPU_METHOD M_FORMULA_1209 "V530 FORMULA_1209" RAT_FUNC "%.4g" "mA*s/???KW" COEFFS 0 1024 0 0 0 1 /end COMPU_METHOD
/begin COMPU_METHOD M_FORMULA_1210 "V530 FORMULA_1210" RAT_FUNC "%.4g" "mA/???KW*s" COEFFS 0 65.536 0 0 0 1 /end COMPU_METHOD
/begin COMPU_METHOD M_FORMULA_1211 "V530 FORMULA_1211" RAT_FUNC "%.4g" "mA/???KW" COEFFS 0 25.6 0 0 0 1 /end COMPU_METHOD
/begin COMPU_METHOD CM_0388 "X*0.0001" RAT_FUNC "%.4g" "m???" COEFFS 0 1 0 0 0 0.0001 /end COMPU_METHOD
/begin COMPU_METHOD CM_0389 "X*0.0001" RAT_FUNC "%.4g" "Wh/Km???km" COEFFS 0 1 0 0 0 0.0001 /end COMPU_METHOD
/begin COMPU_METHOD CM_0390 "X*0.25-273.15" RAT_FUNC "%.4g" "???C/s" COEFFS 0 1 273.15 0 0 0.25 /end COMPU_METHOD
/begin COMPU_METHOD CM_0391 "X*0.00390625" RAT_FUNC "%.4g" "-/segment" COEFFS 0 1 0 0 0 0.00390625 /end COMPU_METHOD
/begin COMPU_METHOD CM_0425 "X/100" RAT_FUNC "%.4g" "OFF_T" COEFFS 0 100 0 0 0 1 /end COMPU_METHOD
/begin COMPU_METHOD CM_0426 "X*10" RAT_FUNC "%.4g" "%/s" COEFFS 0 1 0 0 0 10 /end COMPU_METHOD
/begin COMPU_METHOD CM_0427 "X/10" RAT_FUNC "%.4g" "kg" COEFFS 0 10 0 0 0 1 /end COMPU_METHOD
/begin COMPU_METHOD CM_0429 "X/10" RAT_FUNC "%.4g" "qmm" COEFFS 0 10 0 0 0 1 /end COMPU_METHOD
/begin COMPU_METHOD CM_0430 "X/1024" RAT_FUNC "%.4g" "0p" COEFFS 0 1024 0 0 0 1 /end COMPU_METHOD
/begin COMPU_METHOD CM_0431 "X+1" RAT_FUNC "%.4g" "0" COEFFS 0 1 -1 0 0 1 /end COMPU_METHOD
/begin COMPU_METHOD CM_0438 "X*20" RAT_FUNC "%.4g" "Upm/s" COEFFS 0 1 0 0 0 20 /end COMPU_METHOD
/begin COMPU_METHOD CM_0439 "X" RAT_FUNC "%.4g" "Bitcodiert" COEFFS 0 1 0 0 0 1 /end COMPU_METHOD
/begin COMPU_METHOD CM_0440 "X/5" RAT_FUNC "%.4g" "Nm/s" COEFFS 0 5 0 0 0 1 /end COMPU_METHOD
/begin COMPU_METHOD CM_0441 "X/1000" RAT_FUNC "%.4g" "l" COEFFS 0 1000 0 0 0 1 /end COMPU_METHOD
/begin COMPU_METHOD CM_0442 "X/50" RAT_FUNC "%.4g" "1/s" COEFFS 0 50 0 0 0 1 /end COMPU_METHOD
/begin COMPU_METHOD CM_0443 "X+1" RAT_FUNC "%.4g" "seg" COEFFS 0 1 -1 0 0 1 /end COMPU_METHOD
/begin COMPU_METHOD CM_0444 "X/10" RAT_FUNC "%.4g" "?KW/seg" COEFFS 0 10 0 0 0 1 /end COMPU_METHOD
/begin COMPU_METHOD CM_0445 "X" RAT_FUNC "%.4g" "seg" COEFFS 0 1 0 0 0 1 /end COMPU_METHOD
/begin COMPU_METHOD CM_0446 "X/10" RAT_FUNC "%.4g" "?/5ms" COEFFS 0 10 0 0 0 1 /end COMPU_METHOD
/begin COMPU_METHOD CM_0447 "X/8" RAT_FUNC "%.4g" "-" COEFFS 0 8 0 0 0 1 /end COMPU_METHOD
/begin COMPU_METHOD CM_0448 "X/20" RAT_FUNC "%.4g" "K/100ms" COEFFS 0 20 0 0 0 1 /end COMPU_METHOD
/begin COMPU_METHOD CM_0449 "X/16" RAT_FUNC "%.4g" "K/s" COEFFS 0 16 0 0 0 1 /end COMPU_METHOD
/begin COMPU_METHOD CM_0450 "X/10000" RAT_FUNC "%.4g" "Wh/Km?km" COEFFS 0 10000 0 0 0 1 /end COMPU_METHOD
/begin COMPU_METHOD CM_0451 "X*100/32768" RAT_FUNC "%.4g" "%/5ms" COEFFS 0 8192 0 0 0 25 /end COMPU_METHOD
/begin COMPU_METHOD CM_0452 "X*100/32768" RAT_FUNC "%.4g" "DIFF_LIM" COEFFS 0 8192 0 0 0 25 /end COMPU_METHOD
/begin COMPU_METHOD CM_0453 "X" RAT_FUNC "%.4g" "[-]" COEFFS 0 1 0 0 0 1 /end COMPU_METHOD
/begin COMPU_METHOD CM_0459 "X/10" RAT_FUNC "%.4g" "Nm/s" COEFFS 0 10 0 0 0 1 /end COMPU_METHOD
/begin COMPU_METHOD CM_0460 "X/16" RAT_FUNC "%.4g" "Km/h" COEFFS 0 16 0 0 0 1 /end COMPU_METHOD
/begin COMPU_METHOD CM_0461 "X" RAT_FUNC "%.4g" "kl_spa_soll_n_getr_a" COEFFS 0 1 0 0 0 1 /end COMPU_METHOD
/begin COMPU_METHOD CM_0462 "X*0.12104034423828125" RAT_FUNC "%.4g" "nS" COEFFS 0 1 0 0 0 0.1210403442 /end COMPU_METHOD
/begin COMPU_METHOD CM_0463 "X*100/16384" RAT_FUNC "%.4g" "%" COEFFS 0 4096 0 0 0 25 /end COMPU_METHOD
/begin RECORD_LAYOUT RL_AXP_UB NO_AXIS_PTS_X 1 UBYTE RESERVED 2 BYTE AXIS_PTS_X 3 UBYTE INDEX_INCR DIRECT /end RECORD_LAYOUT
/begin RECORD_LAYOUT RL_BLK_F32 FNC_VALUES 1 FLOAT32_IEEE ROW_DIR DIRECT /end RECORD_LAYOUT
/begin RECORD_LAYOUT RL_BLK_SW FNC_VALUES 1 SWORD ROW_DIR DIRECT /end RECORD_LAYOUT
/begin RECORD_LAYOUT RL_CUR_SB_UB FNC_VALUES 4 UBYTE COLUMN_DIR DIRECT AXIS_PTS_X 3 SBYTE INDEX_INCR DIRECT NO_AXIS_PTS_X 1 UBYTE RESERVED 2 BYTE /end RECORD_LAYOUT
/begin RECORD_LAYOUT RL_GRP_SW_C FNC_VALUES 1 SWORD COLUMN_DIR DIRECT /end RECORD_LAYOUT
/begin RECORD_LAYOUT RL_MAP_SW_UW_UW FNC_VALUES 5 UWORD COLUMN_DIR DIRECT AXIS_PTS_X 3 SWORD INDEX_INCR DIRECT AXIS_PTS_Y 4 UWORD INDEX_INCR DIRECT NO_AXIS_PTS_X 1 UBYTE NO_AXIS_PTS_Y 2 UBYTE /end RECORD_LAYOUT
/begin RECORD_LAYOUT RL_MAP_UB_UB_UB FNC_VALUES 5 UBYTE COLUMN_DIR DIRECT AXIS_PTS_X 3 UBYTE INDEX_INCR DIRECT AXIS_PTS_Y 4 UBYTE INDEX_INCR DIRECT NO_AXIS_PTS_X 1 UBYTE NO_AXIS_PTS_Y 2 UBYTE /end RECORD_LAYOUT
/begin RECORD_LAYOUT RL_VAL_F32 FNC_VALUES 1 FLOAT32_IEEE COLUMN_DIR DIRECT /end RECORD_LAYOUT
/end MODULE
/end PROJECT
