ASAP2_VERSION 1 60
/begin PROJECT MSS60_V762_INJ "MSS60 (S65) V762 INJ CPU - generated 04.11.2026 from the reverse-engineered XDF"
/begin HEADER "Calibration description (characteristics from the XDF; measurements = V530 RAM names transferred to V762 addresses, confidence in each long identifier). Status tag in every long identifier: verified (checked against the code) / A2L-ref (placed from the V530 A2L) / EST (estimated) / unassigned (UNK placeholder)." VERSION "V762-RE-04112026" /end HEADER
/begin MODULE INJ "MSS60 V762 INJ"
/begin MOD_COMMON "" BYTE_ORDER MSB_FIRST ALIGNMENT_BYTE 1 ALIGNMENT_WORD 2 ALIGNMENT_LONG 4 /end MOD_COMMON
/begin MEASUREMENT debug_rw_result "Result Read/-Write Operation [RAM name from V530, voted 2]" ULONG M_FORMULA_0000 0 0 0 4294967295 ECU_ADDRESS 0x3FCD9C /end MEASUREMENT
/begin MEASUREMENT St_dgen0 "Statuswort [RAM name from V530, voted 7]" UBYTE M_FORMULA_0003 0 0 0 255 ECU_ADDRESS 0x3FCDA0 /end MEASUREMENT
/begin MEASUREMENT St_dgen0.B_1stbsder "St_dgen0.B_1stbsder [RAM name from V530, voted 7]" UBYTE NO_COMPU_METHOD 0 0 0 255 ECU_ADDRESS 0x3FCDA0 FORMAT "%.4g" /end MEASUREMENT
/begin MEASUREMENT St_dgen0.B_genfprl "Bedingung Generatorfehler entprellt [RAM name from V530, voted 7]" UBYTE NO_COMPU_METHOD 0 0 0 255 ECU_ADDRESS 0x3FCDA0 FORMAT "%.4g" /end MEASUREMENT
/begin MEASUREMENT St_dgen0.B_gfbsupak "Generator Typ unplausibel^aus Fehlerspeicher [RAM name from V530, voted 7]" UBYTE NO_COMPU_METHOD 0 0 0 255 ECU_ADDRESS 0x3FCDA0 FORMAT "%.4g" /end MEASUREMENT
/begin MEASUREMENT St_dgen0.B_gfelak "Generatorfehler elektrisch aus Fehlerspeicher [RAM name from V530, voted 7]" UBYTE NO_COMPU_METHOD 0 0 0 255 ECU_ADDRESS 0x3FCDA0 FORMAT "%.4g" /end MEASUREMENT
/begin MEASUREMENT St_dgen0.B_gfhtak "Generatorfehler Uebertemperatur aus Fehlerspeicher [RAM name from V530, voted 7]" UBYTE NO_COMPU_METHOD 0 0 0 255 ECU_ADDRESS 0x3FCDA0 FORMAT "%.4g" /end MEASUREMENT
/begin MEASUREMENT St_dgen0.B_gfmeak "Generatorfehler mechanisch aus Fehlerspeicher [RAM name from V530, voted 7]" UBYTE NO_COMPU_METHOD 0 0 0 255 ECU_ADDRESS 0x3FCDA0 FORMAT "%.4g" /end MEASUREMENT
/begin MEASUREMENT St_dgen0.B_gfnobsak "Generator BSD Kommunikationsverlust aus Fehlerspeicher [RAM name from V530, voted 7]" UBYTE NO_COMPU_METHOD 0 0 0 255 ECU_ADDRESS 0x3FCDA0 FORMAT "%.4g" /end MEASUREMENT
/begin MEASUREMENT St_dgen0.B_kl61 "Bedingung Ladekontroll Laempchen an [RAM name from V530, voted 7]" UBYTE NO_COMPU_METHOD 0 0 0 255 ECU_ADDRESS 0x3FCDA0 FORMAT "%.4g" /end MEASUREMENT
/begin MEASUREMENT diag_tr_atic35_tx_cnt "Checkbyte fuer die Queue [RAM name from V530, voted 4]" UBYTE M_FORMULA_0037 0 0 0 255 ECU_ADDRESS 0x3FCDBC /end MEASUREMENT
/begin MEASUREMENT diag_tr_atic35_error "Error Zaheler Atic35 [RAM name from V530, voted 7]" UBYTE M_FORMULA_0037 0 0 0 255 ECU_ADDRESS 0x3FCDBD /end MEASUREMENT
/begin MEASUREMENT diag_tr_atic39_tx_cnt "Checkbyte fuer die Queue [RAM name from V530, voted 11]" UBYTE M_FORMULA_0037 0 0 0 255 ECU_ADDRESS 0x3FCDBE /end MEASUREMENT
/begin MEASUREMENT diag_tr_atic39_error "Error Zaheler Atic39 [RAM name from V530, voted 6]" UBYTE M_FORMULA_0037 0 0 0 255 ECU_ADDRESS 0x3FCDBF /end MEASUREMENT
/begin MEASUREMENT diag_st_atic39_nn "Diagnosestatus ATIC39 Treiber Queue INJ [RAM name from V530, voted 23]" UBYTE NO_COMPU_METHOD 0 0 0 255 ECU_ADDRESS 0x3FCDC0 FORMAT "%.4g" /end MEASUREMENT
/begin MEASUREMENT diag_st_atic39_LHV1 "Diagnosestatus ATIC39 Treiber Queue INJ [RAM name from V530, voted 2]" UBYTE NO_COMPU_METHOD 0 0 0 255 ECU_ADDRESS 0x3FCDC1 FORMAT "%.4g" /end MEASUREMENT
/begin MEASUREMENT diag_st_atic39_LHV1_ "Diagnosestatus ATIC39 Treiber Queue INJ [RAM name from V530, voted 2]" UBYTE NO_COMPU_METHOD 0 0 0 255 ECU_ADDRESS 0x3FCDC2 FORMAT "%.4g" /end MEASUREMENT
/begin MEASUREMENT diag_st_atic39_EV1 "Diagnosestatus ATIC39 Treiber Queue INJ [RAM name from V530, voted 1]" UBYTE NO_COMPU_METHOD 0 0 0 255 ECU_ADDRESS 0x3FCDC3 FORMAT "%.4g" /end MEASUREMENT
/begin MEASUREMENT diag_st_atic39_EV5 "Diagnosestatus ATIC39 Treiber Queue INJ [RAM name from V530, voted 1]" UBYTE NO_COMPU_METHOD 0 0 0 255 ECU_ADDRESS 0x3FCDC7 FORMAT "%.4g" /end MEASUREMENT
/begin MEASUREMENT diag_st_atic39_IGC1 "Diagnosestatus ATIC39 Treiber Queue INJ [RAM name from V530, voted 1]" UBYTE NO_COMPU_METHOD 0 0 0 255 ECU_ADDRESS 0x3FCDC9 FORMAT "%.4g" /end MEASUREMENT
/begin MEASUREMENT diag_st_atic39_IGC2 "Diagnosestatus ATIC39 Treiber Queue INJ [RAM name from V530, voted 1]" UBYTE NO_COMPU_METHOD 0 0 0 255 ECU_ADDRESS 0x3FCDCA FORMAT "%.4g" /end MEASUREMENT
/begin MEASUREMENT diag_st_atic39_IGC3 "Diagnosestatus ATIC39 Treiber Queue INJ [RAM name from V530, voted 1]" UBYTE NO_COMPU_METHOD 0 0 0 255 ECU_ADDRESS 0x3FCDCB FORMAT "%.4g" /end MEASUREMENT
/begin MEASUREMENT diag_st_atic39_IGC4 "Diagnosestatus ATIC39 Treiber Queue INJ [RAM name from V530, voted 1]" UBYTE NO_COMPU_METHOD 0 0 0 255 ECU_ADDRESS 0x3FCDCC FORMAT "%.4g" /end MEASUREMENT
/begin MEASUREMENT diag_st_atic39_DMTLH "Diagnosestatus ATIC39 Treiber Queue INJ [RAM name from V530, voted 4]" UBYTE NO_COMPU_METHOD 0 0 0 255 ECU_ADDRESS 0x3FCDCD FORMAT "%.4g" /end MEASUREMENT
/begin MEASUREMENT diag_st_atic39_DMTLV "Diagnosestatus ATIC39 Treiber Queue INJ [RAM name from V530, voted 3]" UBYTE NO_COMPU_METHOD 0 0 0 255 ECU_ADDRESS 0x3FCDCF FORMAT "%.4g" /end MEASUREMENT
/begin MEASUREMENT diag_st_atic39_IGC5 "Diagnosestatus ATIC39 Treiber Queue INJ [RAM name from V530, voted 1]" UBYTE NO_COMPU_METHOD 0 0 0 255 ECU_ADDRESS 0x3FCDD0 FORMAT "%.4g" /end MEASUREMENT
/begin MEASUREMENT diag_st_atic39_LHV2 "Diagnosestatus ATIC39 Treiber Queue INJ [RAM name from V530, voted 2]" UBYTE NO_COMPU_METHOD 0 0 0 255 ECU_ADDRESS 0x3FCDD1 FORMAT "%.4g" /end MEASUREMENT
/begin MEASUREMENT diag_st_atic39_LHV2_ "Diagnosestatus ATIC39 Treiber Queue INJ [RAM name from V530, voted 2]" UBYTE NO_COMPU_METHOD 0 0 0 255 ECU_ADDRESS 0x3FCDD2 FORMAT "%.4g" /end MEASUREMENT
/begin MEASUREMENT diag_st_atic39_IGC6 "Diagnosestatus ATIC39 Treiber Queue INJ [RAM name from V530, voted 1]" UBYTE NO_COMPU_METHOD 0 0 0 255 ECU_ADDRESS 0x3FCDD9 FORMAT "%.4g" /end MEASUREMENT
/begin MEASUREMENT diag_st_atic39_IGC7 "Diagnosestatus ATIC39 Treiber Queue INJ [RAM name from V530, voted 1]" UBYTE NO_COMPU_METHOD 0 0 0 255 ECU_ADDRESS 0x3FCDDA FORMAT "%.4g" /end MEASUREMENT
/begin MEASUREMENT diag_st_atic39_IGC8 "Diagnosestatus ATIC39 Treiber Queue INJ [RAM name from V530, voted 1]" UBYTE NO_COMPU_METHOD 0 0 0 255 ECU_ADDRESS 0x3FCDDB FORMAT "%.4g" /end MEASUREMENT
/begin MEASUREMENT diag_st_atic39_IGC9 "Diagnosestatus ATIC39 Treiber Queue INJ [RAM name from V530, voted 1]" UBYTE NO_COMPU_METHOD 0 0 0 255 ECU_ADDRESS 0x3FCDDC FORMAT "%.4g" /end MEASUREMENT
/begin MEASUREMENT diag_st_atic39_ELUP1 "Diagnosestatus ATIC39 Treiber Queue INJ [RAM name from V530, voted 4]" UBYTE NO_COMPU_METHOD 0 0 0 255 ECU_ADDRESS 0x3FCDDD FORMAT "%.4g" /end MEASUREMENT
/begin MEASUREMENT diag_st_atic39_ELUP2 "Diagnosestatus ATIC39 Treiber Queue INJ [RAM name from V530, voted 4]" UBYTE NO_COMPU_METHOD 0 0 0 255 ECU_ADDRESS 0x3FCDDE FORMAT "%.4g" /end MEASUREMENT
/begin MEASUREMENT diag_st_atic39_ELUP3 "Diagnosestatus ATIC39 Treiber Queue INJ [RAM name from V530, voted 4]" UBYTE NO_COMPU_METHOD 0 0 0 255 ECU_ADDRESS 0x3FCDDF FORMAT "%.4g" /end MEASUREMENT
/begin MEASUREMENT diag_st_atic39_IGC10 "Diagnosestatus ATIC39 Treiber Queue INJ [RAM name from V530, voted 1]" UBYTE NO_COMPU_METHOD 0 0 0 255 ECU_ADDRESS 0x3FCDE0 FORMAT "%.4g" /end MEASUREMENT
/begin MEASUREMENT diag_st_atic39_EBOXL "Diagnosestatus ATIC39 Treiber Queue INJ [RAM name from V530, voted 5]" UBYTE NO_COMPU_METHOD 0 0 0 255 ECU_ADDRESS 0x3FCDE9 FORMAT "%.4g" /end MEASUREMENT
/begin MEASUREMENT diag_st_atic39_DK1_ENABLE "Diagnosestatus ATIC39 Treiber Queue INJ [RAM name from V530, voted 1]" UBYTE NO_COMPU_METHOD 0 0 0 255 ECU_ADDRESS 0x3FCDEB FORMAT "%.4g" /end MEASUREMENT
/begin MEASUREMENT diag_st_atic39_DK2_ENABLE "Diagnosestatus ATIC39 Treiber Queue INJ [RAM name from V530, voted 1]" UBYTE NO_COMPU_METHOD 0 0 0 255 ECU_ADDRESS 0x3FCDEC FORMAT "%.4g" /end MEASUREMENT
/begin MEASUREMENT diag_st_atic39_RLSTART "Diagnosestatus ATIC39 Treiber Queue INJ [RAM name from V530, voted 2]" UBYTE NO_COMPU_METHOD 0 0 0 255 ECU_ADDRESS 0x3FCDED FORMAT "%.4g" /end MEASUREMENT
/begin MEASUREMENT diag_st_atic39_RLSLP "Diagnosestatus ATIC39 Treiber Queue INJ [RAM name from V530, voted 3]" UBYTE NO_COMPU_METHOD 0 0 0 255 ECU_ADDRESS 0x3FCDEE FORMAT "%.4g" /end MEASUREMENT
/begin MEASUREMENT diag_st_atic39_ELUE "Diagnosestatus ATIC39 Treiber Queue INJ [RAM name from V530, voted 1]" UBYTE NO_COMPU_METHOD 0 0 0 255 ECU_ADDRESS 0x3FCDEF FORMAT "%.4g" /end MEASUREMENT
/begin MEASUREMENT diag_st_atic35_nn "Diagnosestatus ATIC35 Treiber Queue INJ [RAM name from V530, voted 10]" UBYTE NO_COMPU_METHOD 0 0 0 255 ECU_ADDRESS 0x3FCDF1 FORMAT "%.4g" /end MEASUREMENT
/begin MEASUREMENT diag_st_atic35_NWA1 "Diagnosestatus ATIC35 Treiber Queue INJ [RAM name from V530, voted 1]" UBYTE NO_COMPU_METHOD 0 0 0 255 ECU_ADDRESS 0x3FCDF3 FORMAT "%.4g" /end MEASUREMENT
/begin MEASUREMENT diag_st_atic35_VANOSDSV "Diagnosestatus ATIC35 Treiber Queue INJ [RAM name from V530, voted 2]" UBYTE NO_COMPU_METHOD 0 0 0 255 ECU_ADDRESS 0x3FCDF4 FORMAT "%.4g" /end MEASUREMENT
/begin MEASUREMENT diag_st_atic35_NWE2 "Diagnosestatus ATIC35 Treiber Queue INJ [RAM name from V530, voted 1]" UBYTE NO_COMPU_METHOD 0 0 0 255 ECU_ADDRESS 0x3FCDF6 FORMAT "%.4g" /end MEASUREMENT
/begin MEASUREMENT diag_st_atic35_EKP "Diagnosestatus ATIC35 Treiber Queue INJ [RAM name from V530, voted 3]" UBYTE NO_COMPU_METHOD 0 0 0 255 ECU_ADDRESS 0x3FCDFA FORMAT "%.4g" /end MEASUREMENT
/begin MEASUREMENT diag_st_atic35_TD "Diagnosestatus ATIC35 Treiber Queue INJ [RAM name from V530, voted 2]" UBYTE NO_COMPU_METHOD 0 0 0 255 ECU_ADDRESS 0x3FCDFB FORMAT "%.4g" /end MEASUREMENT
/begin MEASUREMENT diag_tr_atic39_st "Diagnosetreiberstatus [RAM name from V530, voted 2]" UBYTE NO_COMPU_METHOD 0 0 0 255 ECU_ADDRESS 0x3FCDFE FORMAT "%.4g" /end MEASUREMENT
/begin MEASUREMENT diag_tr_atic35_st "Diagnosetreiberstatus [RAM name from V530, voted 4]" UBYTE NO_COMPU_METHOD 0 0 0 255 ECU_ADDRESS 0x3FCDFF FORMAT "%.4g" /end MEASUREMENT
/begin MEASUREMENT St_dibs2 "Statuswort [RAM name from V530, voted 12]" UBYTE M_FORMULA_0003 0 0 0 255 ECU_ADDRESS 0x3FCE01 /end MEASUREMENT
/begin MEASUREMENT St_dibs2.B_ifisak "IBS Stromfehler [RAM name from V530, voted 12]" UBYTE NO_COMPU_METHOD 0 0 0 255 ECU_ADDRESS 0x3FCE01 FORMAT "%.4g" /end MEASUREMENT
/begin MEASUREMENT St_dibs2.B_ifsysak "St_dibs2.B_ifsysak [RAM name from V530, voted 12]" UBYTE NO_COMPU_METHOD 0 0 0 255 ECU_ADDRESS 0x3FCE01 FORMAT "%.4g" /end MEASUREMENT
/begin MEASUREMENT St_dibs2.B_iftempak "IBS Temperaturfehler [RAM name from V530, voted 12]" UBYTE NO_COMPU_METHOD 0 0 0 255 ECU_ADDRESS 0x3FCE01 FORMAT "%.4g" /end MEASUREMENT
/begin MEASUREMENT St_dibs2.B_ifusak "IBS Spannungsfehler [RAM name from V530, voted 12]" UBYTE NO_COMPU_METHOD 0 0 0 255 ECU_ADDRESS 0x3FCE01 FORMAT "%.4g" /end MEASUREMENT
/begin MEASUREMENT St_dibs2.B_ifwugdak "IBS KL15 Masseschluss [RAM name from V530, voted 12]" UBYTE NO_COMPU_METHOD 0 0 0 255 ECU_ADDRESS 0x3FCE01 FORMAT "%.4g" /end MEASUREMENT
/begin MEASUREMENT St_dibs2.B_ifwuplak "St_dibs2.B_ifwuplak [RAM name from V530, voted 12]" UBYTE NO_COMPU_METHOD 0 0 0 255 ECU_ADDRESS 0x3FCE01 FORMAT "%.4g" /end MEASUREMENT
/begin MEASUREMENT Ibs3_errstat "Ibs3_errstat [RAM name from V530, voted 1]" UWORD M_FORMULA_0010 0 0 0 65535 ECU_ADDRESS 0x3FCE06 /end MEASUREMENT
/begin MEASUREMENT T_count_dibs1 "T_count_dibs1 [RAM name from V530, voted 1]" UBYTE M_FORMULA_0463 0 0 0 255 ECU_ADDRESS 0x3FCE08 /end MEASUREMENT
/begin MEASUREMENT T_count_dibs2 "T_count_dibs2 [RAM name from V530, voted 3]" UBYTE M_FORMULA_0463 0 0 0 255 ECU_ADDRESS 0x3FCE09 /end MEASUREMENT
/begin MEASUREMENT T_count_dibs3 "T_count_dibs3 [RAM name from V530, voted 1]" UBYTE M_FORMULA_0487 0 0 0 255 ECU_ADDRESS 0x3FCE0A /end MEASUREMENT
/begin MEASUREMENT T_count_dibs4 "T_count_dibs4 [RAM name from V530, voted 3]" UBYTE M_FORMULA_0487 0 0 0 255 ECU_ADDRESS 0x3FCE0B /end MEASUREMENT
/begin MEASUREMENT dmtl_anz_deckel "Anzahl durchgefuehrter Deckeldiagnoseversuche [RAM name from V530, voted 8]" UBYTE M_FORMULA_0545 0 0 0 255 ECU_ADDRESS 0x3FCE0C /end MEASUREMENT
/begin MEASUREMENT dmtl_asc_ay "Querbeschleunigung bei KL15 aktiv [RAM name from V530, voted 2]" SWORD M_FORMULA_0123 0 0 -819.2 819.175 ECU_ADDRESS 0x3FCE0E /end MEASUREMENT
/begin MEASUREMENT dmtl_exd_p_timeout "externe Pumpen-Ansteuerung Timeout [RAM name from V530, voted 6]" UBYTE M_FORMULA_0461 0 0 0 25.5 ECU_ADDRESS 0x3FCE11 /end MEASUREMENT
/begin MEASUREMENT dmtl_exd_v_timeout "externe Ventil-Ansteuerung Timeout [RAM name from V530, voted 7]" UBYTE M_FORMULA_0461 0 0 0 25.5 ECU_ADDRESS 0x3FCE13 /end MEASUREMENT
/begin MEASUREMENT dmtl_exd_h_timeout "externe Heizungs-Ansteuerung Timeout [RAM name from V530, voted 5]" UBYTE M_FORMULA_0461 0 0 0 25.5 ECU_ADDRESS 0x3FCE15 /end MEASUREMENT
/begin MEASUREMENT B_DMTL_EXD_START "Anforderung von Diagnosetester [RAM name from V530, voted 26]" UBYTE NO_COMPU_METHOD 0 0 0 255 ECU_ADDRESS 0x3FCE18 FORMAT "%.4g" /end MEASUREMENT
/begin MEASUREMENT B_DMTL_START_DECKEL "Anforderung fuer Deckelpruefung [RAM name from V530, voted 26]" UBYTE NO_COMPU_METHOD 0 0 0 255 ECU_ADDRESS 0x3FCE18 FORMAT "%.4g" /end MEASUREMENT
/begin MEASUREMENT B_DMTL_START_DECKEL_GROB "Anforderung Grobleckdia ohne OBD-Relevanz [RAM name from V530, voted 26]" UBYTE NO_COMPU_METHOD 0 0 0 255 ECU_ADDRESS 0x3FCE18 FORMAT "%.4g" /end MEASUREMENT
/begin MEASUREMENT B_DMTL_START_FEIN "Anforderung fuer Feinleckdiag [RAM name from V530, voted 26]" UBYTE NO_COMPU_METHOD 0 0 0 255 ECU_ADDRESS 0x3FCE18 FORMAT "%.4g" /end MEASUREMENT
/begin MEASUREMENT B_DMTL_START_GROB "Anforderung fuer Grobleckdiag [RAM name from V530, voted 26]" UBYTE NO_COMPU_METHOD 0 0 0 255 ECU_ADDRESS 0x3FCE18 FORMAT "%.4g" /end MEASUREMENT
/begin MEASUREMENT dmtl_flags_start "Startbedingungen der DMTL [RAM name from V530, voted 26]" UBYTE M_FORMULA_0003 0 0 0 255 ECU_ADDRESS 0x3FCE18 /end MEASUREMENT
/begin MEASUREMENT dmtl_fst "Verwendeter Fuellstand fuer Diagnose [RAM name from V530, voted 6]" UBYTE M_FORMULA_0559 0 0 0 127.5 ECU_ADDRESS 0x3FCE19 /end MEASUREMENT
/begin MEASUREMENT dmtl_fst_max "Max. zul. Fuellstand fuer Diagnose [RAM name from V530, voted 1]" UBYTE M_FORMULA_0559 0 0 0 127.5 ECU_ADDRESS 0x3FCE1A /end MEASUREMENT
/begin MEASUREMENT dmtl_i "DMTL Strom korrigiert [RAM name from V530, voted 2]" UWORD M_FORMULA_0553 0 0 0 147.45375 ECU_ADDRESS 0x3FCE1C /end MEASUREMENT
/begin MEASUREMENT dmtl_i_deckel "DMTL korrigierter Strom Deckeldia [RAM name from V530, voted 2]" UWORD M_FORMULA_0553 0 0 0 147.45375 ECU_ADDRESS 0x3FCE1E /end MEASUREMENT
/begin MEASUREMENT dmtl_i_fakt_fein "DMTL Faktor Referenzstrom fuer Feinleck [RAM name from V530, voted 3]" UBYTE M_FORMULA_0638 0 0 0 1.9921875 ECU_ADDRESS 0x3FCE20 /end MEASUREMENT
/begin MEASUREMENT dmtl_i_filt_tank "DMTL Strom korr. und gefiltert fuer Betankung [RAM name from V530, voted 5]" UWORD M_FORMULA_0553 0 0 0 147.45375 ECU_ADDRESS 0x3FCE22 /end MEASUREMENT
/begin MEASUREMENT dmtl_i_grob "DMTL korrigierter Strom Grobleckdia [RAM name from V530, voted 3]" UWORD M_FORMULA_0553 0 0 0 147.45375 ECU_ADDRESS 0x3FCE26 /end MEASUREMENT
/begin MEASUREMENT dmtl_i_max "DMTL Strom Maximalwert [RAM name from V530, voted 4]" UWORD M_FORMULA_0553 0 0 0 147.45375 ECU_ADDRESS 0x3FCE28 /end MEASUREMENT
/begin MEASUREMENT dmtl_i_ref2 "DMTL Strom Referenzleck [RAM name from V530, voted 4]" UWORD M_FORMULA_0553 0 0 0 147.45375 ECU_ADDRESS 0x3FCE2A /end MEASUREMENT
/begin MEASUREMENT dmtl_i_ref_korr "DMTL korrigierter Strom Referenzleck [RAM name from V530, voted 4]" UWORD M_FORMULA_0553 0 0 0 147.45375 ECU_ADDRESS 0x3FCE2C /end MEASUREMENT
/begin MEASUREMENT dmtl_i_roh "DMTL Strom roh [RAM name from V530, voted 6]" UWORD M_FORMULA_0553 0 0 0 147.45375 ECU_ADDRESS 0x3FCE2E /end MEASUREMENT
/begin MEASUREMENT dmtl_i_stabil "DMTL stabiler Strom [RAM name from V530, voted 1]" UWORD M_FORMULA_0553 0 0 0 147.45375 ECU_ADDRESS 0x3FCE30 /end MEASUREMENT
/begin MEASUREMENT dmtl_korr_fakt "Korrekturfaktor Strom ueber Spannung [RAM name from V530, voted 3]" UWORD M_FORMULA_0073 0 0 0 63.99902344 ECU_ADDRESS 0x3FCE32 /end MEASUREMENT
/begin MEASUREMENT dmtl_st "Betriebszustand [RAM name from V530, voted 46]" UBYTE NO_COMPU_METHOD 0 0 0 255 ECU_ADDRESS 0x3FCE34 FORMAT "%.4g" /end MEASUREMENT
/begin MEASUREMENT dmtl_t_cc_dauer "Dauer Deckelmeldung seit Losfahren [RAM name from V530, voted 5]" UWORD M_FORMULA_0071 0 0 0 6553.5 ECU_ADDRESS 0x3FCE36 /end MEASUREMENT
/begin MEASUREMENT dmtl_t_grob "DMTL Grobleckdauer [RAM name from V530, voted 2]" UWORD M_FORMULA_0071 0 0 0 6553.5 ECU_ADDRESS 0x3FCE38 /end MEASUREMENT
/begin MEASUREMENT dmtl_t_deckel "DMTL Deckelmessdauer [RAM name from V530, voted 2]" UWORD M_FORMULA_0071 0 0 0 6553.5 ECU_ADDRESS 0x3FCE3A /end MEASUREMENT
/begin MEASUREMENT dmtl_t_fein_min "DMTL min. Feinleckdauer [RAM name from V530, voted 1]" UWORD M_FORMULA_0071 0 0 0 6553.5 ECU_ADDRESS 0x3FCE3C /end MEASUREMENT
/begin MEASUREMENT dmtl_t_feucht_dly "DMTL Startverzoegerung nach Feuchteabbruch [RAM name from V530, voted 3]" UWORD M_FORMULA_0071 0 0 0 6553.5 ECU_ADDRESS 0x3FCE3E /end MEASUREMENT
/begin MEASUREMENT dmtl_t_ks "DMTL Kurzschlusszeit [RAM name from V530, voted 6]" UBYTE M_FORMULA_0640 0 0 0 127.5 ECU_ADDRESS 0x3FCE41 /end MEASUREMENT
/begin MEASUREMENT dmtl_t_ref "DMTL aktuelle Referenzme???dauer [RAM name from V530, voted 6]" UBYTE M_FORMULA_0461 0 0 0 25.5 ECU_ADDRESS 0x3FCE42 /end MEASUREMENT
/begin MEASUREMENT dmtl_t_stabil "DMTL Zeit seit Strom stabil [RAM name from V530, voted 1]" UWORD M_FORMULA_0071 0 0 0 6553.5 ECU_ADDRESS 0x3FCE44 /end MEASUREMENT
/begin MEASUREMENT dmtl_t_stabil_max "max. DMTL Zeit fuer Strom stabil [RAM name from V530, voted 1]" UWORD M_FORMULA_0071 0 0 0 6553.5 ECU_ADDRESS 0x3FCE46 /end MEASUREMENT
/begin MEASUREMENT dmtl_t_start_dly "DMTL Startverzoegerung nach KLA [RAM name from V530, voted 5]" UBYTE M_FORMULA_0461 0 0 0 25.5 ECU_ADDRESS 0x3FCE48 /end MEASUREMENT
/begin MEASUREMENT dmtl_ub_filt "DMTL Gefilterte UB [RAM name from V530, voted 6]" SWORD M_FORMULA_0261 0 0 -51.08269056 51.08113164 ECU_ADDRESS 0x3FCE4A /end MEASUREMENT
/begin MEASUREMENT dmtl_ub_ref "DMTL Gefilterte UB bei Referenzmessung [RAM name from V530, voted 4]" SWORD M_FORMULA_0008 0 0 -3276.8 3276.7 ECU_ADDRESS 0x3FCE4C /end MEASUREMENT
/begin MEASUREMENT St_dqlt0 "Statuswort [RAM name from V530, voted 11]" UBYTE M_FORMULA_0003 0 0 0 255 ECU_ADDRESS 0x3FCE59 /end MEASUREMENT
/begin MEASUREMENT St_dqlt0.B_ozdiagnmotok "Motordrehzahl ok f???r die Diagnose [RAM name from V530, voted 11]" UBYTE NO_COMPU_METHOD 0 0 0 255 ECU_ADDRESS 0x3FCE59 FORMAT "%.4g" /end MEASUREMENT
/begin MEASUREMENT St_dqlt0.B_ozerrbsd "BSD global Fehler [RAM name from V530, voted 11]" UBYTE NO_COMPU_METHOD 0 0 0 255 ECU_ADDRESS 0x3FCE59 FORMAT "%.4g" /end MEASUREMENT
/begin MEASUREMENT St_dqlt0.B_ozkttoens "T???ns-Sensor verbaut [RAM name from V530, voted 11]" UBYTE NO_COMPU_METHOD 0 0 0 255 ECU_ADDRESS 0x3FCE59 FORMAT "%.4g" /end MEASUREMENT
/begin MEASUREMENT St_dqlt0.B_ozlerr "Messfehler ???lniveau [RAM name from V530, voted 11]" UBYTE NO_COMPU_METHOD 0 0 0 255 ECU_ADDRESS 0x3FCE59 FORMAT "%.4g" /end MEASUREMENT
/begin MEASUREMENT St_dqlt0.B_ozqerr "Messfehler ???lzustand [RAM name from V530, voted 11]" UBYTE NO_COMPU_METHOD 0 0 0 255 ECU_ADDRESS 0x3FCE59 FORMAT "%.4g" /end MEASUREMENT
/begin MEASUREMENT St_dqlt0.B_ozterr "Messfehler ???ltemperatur [RAM name from V530, voted 11]" UBYTE NO_COMPU_METHOD 0 0 0 255 ECU_ADDRESS 0x3FCE59 FORMAT "%.4g" /end MEASUREMENT
/begin MEASUREMENT St_dqlt0.B_td_ogerr "St_dqlt0.B_td_ogerr [RAM name from V530, voted 11]" UBYTE NO_COMPU_METHOD 0 0 0 255 ECU_ADDRESS 0x3FCE59 FORMAT "%.4g" /end MEASUREMENT
/begin MEASUREMENT St_dqlt0.B_td_ogupl "St_dqlt0.B_td_ogupl [RAM name from V530, voted 11]" UBYTE NO_COMPU_METHOD 0 0 0 255 ECU_ADDRESS 0x3FCE59 FORMAT "%.4g" /end MEASUREMENT
/begin MEASUREMENT St_dqlt1 "Statuswort [RAM name from V530, voted 3]" UBYTE M_FORMULA_0003 0 0 0 255 ECU_ADDRESS 0x3FCE5A /end MEASUREMENT
/begin MEASUREMENT St_dqlt1.B_ozerr "Sensorfehler in FS eingetragen [RAM name from V530, voted 3]" UBYTE NO_COMPU_METHOD 0 0 0 255 ECU_ADDRESS 0x3FCE5A FORMAT "%.4g" /end MEASUREMENT
/begin MEASUREMENT St_dqlt1.B_ozfbsd2 "BSD Sensor Fehler von FI_BSD_4 [RAM name from V530, voted 3]" UBYTE NO_COMPU_METHOD 0 0 0 255 ECU_ADDRESS 0x3FCE5A FORMAT "%.4g" /end MEASUREMENT
/begin MEASUREMENT St_dqlt1.B_oztemppl "QLT Temperatur unplausibel [RAM name from V530, voted 3]" UBYTE NO_COMPU_METHOD 0 0 0 255 ECU_ADDRESS 0x3FCE5A FORMAT "%.4g" /end MEASUREMENT
/begin MEASUREMENT St_oz_o "Statuswort [RAM name from V530, voted 6]" UBYTE M_FORMULA_0003 0 0 0 255 ECU_ADDRESS 0x3FCE5B /end MEASUREMENT
/begin MEASUREMENT St_oz_o.B_mol_sf "Sensorfehler in FS eingetragen f???r CC-Meldung [RAM name from V530, voted 6]" UBYTE NO_COMPU_METHOD 0 0 0 255 ECU_ADDRESS 0x3FCE5B FORMAT "%.4g" /end MEASUREMENT
/begin MEASUREMENT St_oz_o.B_oztemic "QLT-Temic verbaut [RAM name from V530, voted 6]" UBYTE NO_COMPU_METHOD 0 0 0 255 ECU_ADDRESS 0x3FCE5B FORMAT "%.4g" /end MEASUREMENT
/begin MEASUREMENT dwf_n_max "Maxwert von KL_N_BEGR_GANG [RAM name from V530, voted 3]" SWORD M_FORMULA_0006 0 0 -32768 32767 ECU_ADDRESS 0x3FCE5C /end MEASUREMENT
/begin MEASUREMENT dwf_n_rot "roter Drehzahlbereich [RAM name from V530, voted 1]" UBYTE M_FORMULA_0166 0 0 0 12750 ECU_ADDRESS 0x3FCE5E /end MEASUREMENT
/begin MEASUREMENT dwf_repeat "Wiederholzaehler [RAM name from V530, voted 2]" UBYTE M_FORMULA_0003 0 0 0 255 ECU_ADDRESS 0x3FCE5F /end MEASUREMENT
/begin MEASUREMENT dwf_shli_st "Status Shiftlights [RAM name from V530, voted 1]" UBYTE M_FORMULA_0003 0 0 0 255 ECU_ADDRESS 0x3FCE60 /end MEASUREMENT
/begin MEASUREMENT dwf_shli_st_bl "Shiftlights Blinken [RAM name from V530, voted 1]" UBYTE NO_COMPU_METHOD 0 0 0 255 ECU_ADDRESS 0x3FCE60 FORMAT "%.4g" /end MEASUREMENT
/begin MEASUREMENT dwf_shli_st_fls "Shiftlights Flash Ein [RAM name from V530, voted 1]" UBYTE NO_COMPU_METHOD 0 0 0 255 ECU_ADDRESS 0x3FCE60 FORMAT "%.4g" /end MEASUREMENT
/begin MEASUREMENT dwf_shli_st_on "Shiftlights Ein [RAM name from V530, voted 1]" UBYTE NO_COMPU_METHOD 0 0 0 255 ECU_ADDRESS 0x3FCE60 FORMAT "%.4g" /end MEASUREMENT
/begin MEASUREMENT dwf_shli_tseg "Zeit fuer ein Segment [RAM name from V530, voted 1]" UWORD M_FORMULA_0021 0 0 0 655.35 ECU_ADDRESS 0x3FCE68 /end MEASUREMENT
/begin MEASUREMENT ebox_elu_st "Status der E-Box E-Luefteransteuerung [RAM name from V530, voted 21]" UBYTE NO_COMPU_METHOD 0 0 0 255 ECU_ADDRESS 0x3FCE6C FORMAT "%.4g" /end MEASUREMENT
/begin MEASUREMENT ebox_elu_exd_timeout "KWP-Ansteuerzeit [RAM name from V530, voted 5]" UBYTE M_FORMULA_0461 0 0 0 25.5 ECU_ADDRESS 0x3FCE6D /end MEASUREMENT
/begin MEASUREMENT ed_debug_laufzeit "Laufzeitmessung [RAM name from V530, voted 4]" ULONG M_FORMULA_0072 0 0 0 4294967295 ECU_ADDRESS 0x3FCE7C /end MEASUREMENT
/begin MEASUREMENT eeprom_seite_lesen "Wo wurde der letzte Datensatz gefunden [RAM name from V530, voted 14]" UBYTE NO_COMPU_METHOD 0 0 0 255 ECU_ADDRESS 0x3FCE80 FORMAT "%.4g" /end MEASUREMENT
/begin MEASUREMENT eeprom_seite_lesen_hdw "Wo wurde der letzte HDW-Datensatz gefunden [RAM name from V530, voted 8]" UBYTE NO_COMPU_METHOD 0 0 0 255 ECU_ADDRESS 0x3FCE81 FORMAT "%.4g" /end MEASUREMENT
/begin MEASUREMENT eeprom_seite_schreiben "Wo hin soll der naechste Datensatz geschrieben werden [RAM name from V530, voted 34]" UBYTE NO_COMPU_METHOD 0 0 0 255 ECU_ADDRESS 0x3FCE82 FORMAT "%.4g" /end MEASUREMENT
/begin MEASUREMENT eeprom_st "Status der EEPROM-Emulation [RAM name from V530, voted 35]" UBYTE NO_COMPU_METHOD 0 0 0 255 ECU_ADDRESS 0x3FCE83 FORMAT "%.4g" /end MEASUREMENT
/begin MEASUREMENT elu_st "Status ELU-Ansteuerung [RAM name from V530, voted 5]" UBYTE NO_COMPU_METHOD 0 0 0 255 ECU_ADDRESS 0x3FCE9C FORMAT "%.4g" /end MEASUREMENT
/begin MEASUREMENT elu_pwm_ml_filt "gefiltertes Tastverhaeltnis des PWM-Signals [RAM name from V530, voted 4]" UWORD M_FORMULA_0665 0 0 0 127.9980469 ECU_ADDRESS 0x3FCEA2 /end MEASUREMENT
/begin MEASUREMENT elu_pwm_ms "berechnetes PWM-Signal bei MS [RAM name from V530, voted 5]" UBYTE M_FORMULA_0032 0 0 0 255 ECU_ADDRESS 0x3FCEA1 /end MEASUREMENT
/begin MEASUREMENT elu_pwm "ausgegebenes PWM-Signal [RAM name from V530, voted 7]" UBYTE M_FORMULA_0032 0 0 0 255 ECU_ADDRESS 0x3FCEA4 /end MEASUREMENT
/begin MEASUREMENT elu_exd_timeout "KWP-Ansteuerzeit [RAM name from V530, voted 3]" UBYTE M_FORMULA_0461 0 0 0 25.5 ECU_ADDRESS 0x3FCEA5 /end MEASUREMENT
/begin MEASUREMENT elu_fkt_st "ELU-Funktionsstatus [RAM name from V530, voted 2]" UBYTE NO_COMPU_METHOD 0 0 0 255 ECU_ADDRESS 0x3FCEA8 FORMAT "%.4g" /end MEASUREMENT
/begin MEASUREMENT elu_ed_fart_merker "ELU-Fehlerartmerker fuer nachfolgenden elu_ed-Zyklus [RAM name from V530, voted 16]" UBYTE NO_COMPU_METHOD 0 0 0 255 ECU_ADDRESS 0x3FCEC0 FORMAT "%.4g" /end MEASUREMENT
/begin MEASUREMENT elu_ed_error_cycle_time "Zeitdauer des ELU-ED-Zyklus [RAM name from V530, voted 5]" UWORD M_FORMULA_0668 0 0 0 6553500 ECU_ADDRESS 0x3FCEAA /end MEASUREMENT
/begin MEASUREMENT elu_ed_sh_to_ub_off_timer "Timer fuer Endstufe OFF bei SH_TO_UB [RAM name from V530, voted 3]" UWORD M_FORMULA_0668 0 0 0 6553500 ECU_ADDRESS 0x3FCEAE /end MEASUREMENT
/begin MEASUREMENT elu_ed_sh_to_ub_delay "Timer zur Entprellung von SH_TO_UB [RAM name from V530, voted 6]" UWORD M_FORMULA_0668 0 0 0 6553500 ECU_ADDRESS 0x3FCEB2 /end MEASUREMENT
/begin MEASUREMENT elu_ed_blockiert_timer "Timer zur Entprellung der ELU-Fehlermeldung [RAM name from V530, voted 1]" UWORD M_FORMULA_0668 0 0 0 6553500 ECU_ADDRESS 0x3FCEBA /end MEASUREMENT
/begin MEASUREMENT elu_ed_blockiert_zyklus_delay "Delay bis zur Wiederholung der ELU-Fehlermeldung [RAM name from V530, voted 6]" UWORD M_FORMULA_0668 0 0 0 6553500 ECU_ADDRESS 0x3FCEBE /end MEASUREMENT
/begin MEASUREMENT elu_ed_sh_to_gnd_cnt "Counter zur Entprellung eines SH_TO_GND-Fehlers [RAM name from V530, voted 6]" UBYTE M_FORMULA_0003 0 0 0 255 ECU_ADDRESS 0x3FCEC1 /end MEASUREMENT
/begin MEASUREMENT elu_ed_openload_cnt "Counter zur Entprellung eines OPENLOAD-Fehlers [RAM name from V530, voted 6]" UBYTE M_FORMULA_0003 0 0 0 255 ECU_ADDRESS 0x3FCEC2 /end MEASUREMENT
/begin MEASUREMENT elu_ed_blockiert_cnt "Counter zur Entprellung eines ELU_BLOCKIERT-Fehlers [RAM name from V530, voted 3]" UBYTE M_FORMULA_0003 0 0 0 255 ECU_ADDRESS 0x3FCEC3 /end MEASUREMENT
/begin MEASUREMENT elup_interlock_time "Timer Schaltverriegelung fuer AN/AUS [RAM name from V530, voted 10]" UWORD M_FORMULA_0021 0 0 0 655.35 ECU_ADDRESS 0x3FCEC4 /end MEASUREMENT
/begin MEASUREMENT elup_exd_timeout "KWP-Ansteuerzeit [RAM name from V530, voted 11]" UWORD M_FORMULA_0021 0 0 0 655.35 ECU_ADDRESS 0x3FCEC6 /end MEASUREMENT
/begin MEASUREMENT elup_sw_ein "ermittelte ELUP-Einschaltschwelle [RAM name from V530, voted 3]" SWORD M_FORMULA_0075 0 0 -2048 2047.9375 ECU_ADDRESS 0x3FCEC8 /end MEASUREMENT
/begin MEASUREMENT elup_sw_aus "ermittelte ELUP-Ausschaltschwelle [RAM name from V530, voted 3]" SWORD M_FORMULA_0075 0 0 -2048 2047.9375 ECU_ADDRESS 0x3FCECA /end MEASUREMENT
/begin MEASUREMENT elup_v_offs "Offset auf ELUP-Schaltschwelle durch v_vorne [RAM name from V530, voted 3]" SWORD M_FORMULA_0075 0 0 -2048 2047.9375 ECU_ADDRESS 0x3FCECC /end MEASUREMENT
/begin MEASUREMENT elup_ed_mvacp_old "gemessener Differenzdruck aus vorherigem Diagnosezyklus [RAM name from V530, voted 1]" SWORD M_FORMULA_0075 0 0 -2048 2047.9375 ECU_ADDRESS 0x3FCECE /end MEASUREMENT
/begin MEASUREMENT elup_ed_mvacp_grad "Differenzdruckgradient [RAM name from V530, voted 3]" SWORD M_FORMULA_0674 0 0 -2048 2047.9375 ECU_ADDRESS 0x3FCED0 /end MEASUREMENT
/begin MEASUREMENT elup_ed_brp_grad "PT1-gefilterter Bremsdruckgradient [RAM name from V530, voted 4]" SWORD M_FORMULA_0675 0 0 -102400 102396.875 ECU_ADDRESS 0x3FCED2 /end MEASUREMENT
/begin MEASUREMENT elup_ed_del "Verzoegerung ELUP_ED UNPLAUSIBEL durch Druckgradient [RAM name from V530, voted 3]" UBYTE M_FORMULA_0461 0 0 0 25.5 ECU_ADDRESS 0x3FCED4 /end MEASUREMENT
/begin MEASUREMENT elup_ed_abs_del "Verzoegerung ELUP_ED UNPLAUSIBEL durch Einschaltschwelle [RAM name from V530, voted 1]" UBYTE M_FORMULA_0461 0 0 0 25.5 ECU_ADDRESS 0x3FCED5 /end MEASUREMENT
/begin MEASUREMENT elup_ein_v_del "Einschaltverzoegerung durch v_vorne [RAM name from V530, voted 4]" UWORD M_FORMULA_0021 0 0 0 655.35 ECU_ADDRESS 0x3FCED6 /end MEASUREMENT
/begin MEASUREMENT elup_ed_aktiv "Diagnosebedingung fuer ELUP-Funktion [RAM name from V530, voted 4]" UBYTE NO_COMPU_METHOD 0 0 0 255 ECU_ADDRESS 0x3FCED8 FORMAT "%.4g" /end MEASUREMENT
/begin MEASUREMENT elup_pl_st "Prueflaufstatus ELUP [RAM name from V530, voted 11]" UBYTE NO_COMPU_METHOD 0 0 0 255 ECU_ADDRESS 0x3FCED9 FORMAT "%.4g" /end MEASUREMENT
/begin MEASUREMENT elup_pl_mvac_p_start "mvac_p zu Beginn des ELUP-Prueflaufs [RAM name from V530, voted 1]" SWORD M_FORMULA_0075 0 0 -2048 2047.9375 ECU_ADDRESS 0x3FCEDA /end MEASUREMENT
/begin MEASUREMENT elup_pl_mvac_p_ende "mvac_p am Ende des ELUP-Prueflaufs [RAM name from V530, voted 2]" SWORD M_FORMULA_0075 0 0 -2048 2047.9375 ECU_ADDRESS 0x3FCEDC /end MEASUREMENT
/begin MEASUREMENT ews_st "Status EWS [RAM name from V530, voted 22]" UBYTE NO_COMPU_METHOD 0 0 0 255 ECU_ADDRESS 0x3FCEE0 FORMAT "%.4g" /end MEASUREMENT
/begin MEASUREMENT ews_stw_st "EWS-STW-Status [RAM name from V530, voted 6]" UBYTE NO_COMPU_METHOD 0 0 0 255 ECU_ADDRESS 0x3FCEE1 FORMAT "%.4g" /end MEASUREMENT
/begin MEASUREMENT B_FST_CAN_FEHLERKENNUNG "Fehlerkennzeichnung = el. Fehler [RAM name from V530, voted 10]" UBYTE NO_COMPU_METHOD 0 0 0 255 ECU_ADDRESS 0x3F90BD FORMAT "%.4g" /end MEASUREMENT
/begin MEASUREMENT B_FST_CAN_INIT "fst_li/re ist initialisiert [RAM name from V530, voted 10]" UBYTE NO_COMPU_METHOD 0 0 0 255 ECU_ADDRESS 0x3F90BD FORMAT "%.4g" /end MEASUREMENT
/begin MEASUREMENT B_FST_KEIN_CAN "Kein CAN-Telegramm [RAM name from V530, voted 10]" UBYTE NO_COMPU_METHOD 0 0 0 255 ECU_ADDRESS 0x3F90BD FORMAT "%.4g" /end MEASUREMENT
/begin MEASUREMENT B_FST_NACHTANK "Nachtanken erkannt fuer DMTL [RAM name from V530, voted 10]" UBYTE NO_COMPU_METHOD 0 0 0 255 ECU_ADDRESS 0x3F90BD FORMAT "%.4g" /end MEASUREMENT
/begin MEASUREMENT B_FST_NACHTANK_LA "Nachtanken erkannt fuer LA-Diag [RAM name from V530, voted 10]" UBYTE NO_COMPU_METHOD 0 0 0 255 ECU_ADDRESS 0x3F90BD FORMAT "%.4g" /end MEASUREMENT
/begin MEASUREMENT B_FST_UNPLAUSIBEL "Fuellstand unplausibel [RAM name from V530, voted 10]" UBYTE NO_COMPU_METHOD 0 0 0 255 ECU_ADDRESS 0x3F90BD FORMAT "%.4g" /end MEASUREMENT
/begin MEASUREMENT fst_st "Status Tankfuellstand [RAM name from V530, voted 10]" UBYTE NO_COMPU_METHOD 0 0 0 255 ECU_ADDRESS 0x3F90BD FORMAT "%.4g" /end MEASUREMENT
/begin MEASUREMENT fst_tank_leer_st_inj "Fehlerstatus Tank leer Fehler [RAM name from V530, voted 7]" ULONG M_FORMULA_0044 0 0 0 4294967295 ECU_ADDRESS 0x3FCFAC /end MEASUREMENT
/begin MEASUREMENT fst_tank_leer_st_ign "Fehlerstatus Tank leer Fehler [RAM name from V530, voted 7]" ULONG M_FORMULA_0044 0 0 0 4294967295 ECU_ADDRESS 0x3FCFB0 /end MEASUREMENT
/begin MEASUREMENT kats_st_b1 "Katschutz-Status [RAM name from V530, voted 12]" UBYTE NO_COMPU_METHOD 0 0 0 255 ECU_ADDRESS 0x3F907A FORMAT "%.4g" /end MEASUREMENT
/begin MEASUREMENT kats_st_b2 "Katschutz-Status [RAM name from V530, voted 2]" UBYTE NO_COMPU_METHOD 0 0 0 255 ECU_ADDRESS 0x3F907B FORMAT "%.4g" /end MEASUREMENT
/begin MEASUREMENT kats_ausloeser_b1 "Temperatur die den Kats ausgeloest hat [RAM name from V530, voted 1]" UBYTE NO_COMPU_METHOD 0 0 0 255 ECU_ADDRESS 0x3FD0FE FORMAT "%.4g" /end MEASUREMENT
/begin MEASUREMENT kats_lam_p_b1 "P-Anteil Katschutz [RAM name from V530, voted 4]" SWORD M_FORMULA_0025 0 0 -2 1.999938965 ECU_ADDRESS 0x3FD100 /end MEASUREMENT
/begin MEASUREMENT kats_lam_i_b1 "I-Anteil Katschutz [RAM name from V530, voted 3]" SWORD M_FORMULA_0199 0 0 -2 1.999938965 ECU_ADDRESS 0x3FD104 /end MEASUREMENT
/begin MEASUREMENT kats_lam_p_delta_max_b1 "Gradient des P-Anteils [RAM name from V530, voted 2]" SWORD M_FORMULA_0199 0 0 -2 1.999938965 ECU_ADDRESS 0x3FD108 /end MEASUREMENT
/begin MEASUREMENT St_sleep "Statuswort Einschlafverhalten [RAM name from V530, voted 4]" UBYTE M_FORMULA_0037 0 0 0 255 ECU_ADDRESS 0x3FD124 /end MEASUREMENT
/begin MEASUREMENT St_sleep.B_sleepwait "Signal Verzoegerung Sleep Indication [RAM name from V530, voted 4]" UBYTE NO_COMPU_METHOD 0 0 0 255 ECU_ADDRESS 0x3FD124 FORMAT "%.4g" /end MEASUREMENT
/begin MEASUREMENT St_ibsreg4 "St_ibsreg4 [RAM name from V530, voted 5]" UBYTE M_FORMULA_0003 0 0 0 255 ECU_ADDRESS 0x3FD125 /end MEASUREMENT
/begin MEASUREMENT St_ibsreg4.B_ibspwf "Bedingung IBS powerfail erkannt [RAM name from V530, voted 5]" UBYTE NO_COMPU_METHOD 0 0 0 255 ECU_ADDRESS 0x3FD125 FORMAT "%.4g" /end MEASUREMENT
/begin MEASUREMENT St_ibsreg4.B_ibsweck "Bedingung IBS hat geweckt [RAM name from V530, voted 5]" UBYTE NO_COMPU_METHOD 0 0 0 255 ECU_ADDRESS 0x3FD125 FORMAT "%.4g" /end MEASUREMENT
/begin MEASUREMENT St_ibsreg4.B_startfgk "Bedingung Startf???higkeit gef???hrdet [RAM name from V530, voted 5]" UBYTE NO_COMPU_METHOD 0 0 0 255 ECU_ADDRESS 0x3FD125 FORMAT "%.4g" /end MEASUREMENT
/begin MEASUREMENT St_ibsreg4.B_strtaw "Bedingung Startauswertung gerechnet [RAM name from V530, voted 5]" UBYTE NO_COMPU_METHOD 0 0 0 255 ECU_ADDRESS 0x3FD125 FORMAT "%.4g" /end MEASUREMENT
/begin MEASUREMENT St_ibsreg4.B_tiefset "Bedingung Tiefentladung [RAM name from V530, voted 5]" UBYTE NO_COMPU_METHOD 0 0 0 255 ECU_ADDRESS 0x3FD125 FORMAT "%.4g" /end MEASUREMENT
/begin MEASUREMENT St_ibsreg5 "Statuswort ibsreg5 [RAM name from V530, voted 7]" UBYTE M_FORMULA_0003 0 0 0 255 ECU_ADDRESS 0x3FD126 /end MEASUREMENT
/begin MEASUREMENT St_ibsreg5.B_fsclr "Bedingung IBS interne Fehler loeschen [RAM name from V530, voted 7]" UBYTE NO_COMPU_METHOD 0 0 0 255 ECU_ADDRESS 0x3FD126 FORMAT "%.4g" /end MEASUREMENT
/begin MEASUREMENT Ibs_errors "Fehler Reg. aus IBS gelesen [RAM name from V530, voted 7]" UBYTE M_FORMULA_0003 0 0 0 255 ECU_ADDRESS 0x3FD128 /end MEASUREMENT
/begin MEASUREMENT Ibs_msgind "Index auf EBSD Botschaft [RAM name from V530, voted 40]" UBYTE M_FORMULA_0003 0 0 0 255 ECU_ADDRESS 0x3FD129 /end MEASUREMENT
/begin MEASUREMENT Ibs_msgsta "EBSD Fehler Status [RAM name from V530, voted 14]" UBYTE M_FORMULA_0003 0 0 0 255 ECU_ADDRESS 0x3FD12A /end MEASUREMENT
/begin MEASUREMENT Kt_ibsstatus "Status BSD Statemachine [RAM name from V530, voted 12]" UBYTE M_FORMULA_0003 0 0 0 255 ECU_ADDRESS 0x3FD12B /end MEASUREMENT
/begin MEASUREMENT Ibs_start "Status Statemachine Startup Kommunikation [RAM name from V530, voted 12]" UBYTE M_FORMULA_0003 0 0 0 255 ECU_ADDRESS 0x3FD12C /end MEASUREMENT
/begin MEASUREMENT Comcontrol "Kontrolle Diagnose Modul DIBS [RAM name from V530, voted 8]" UBYTE M_FORMULA_0003 0 0 0 255 ECU_ADDRESS 0x3FD12E /end MEASUREMENT
/begin MEASUREMENT St_ibebsd1 "St_ibebsd1 [RAM name from V530, voted 52]" UBYTE M_FORMULA_0003 0 0 0 255 ECU_ADDRESS 0x3FD12F /end MEASUREMENT
/begin MEASUREMENT St_ibebsd1.B_eb_busy "Bedingung EBSD ???bertragungsrichtung schreiben [RAM name from V530, voted 52]" UBYTE NO_COMPU_METHOD 0 0 0 255 ECU_ADDRESS 0x3FD12F FORMAT "%.4g" /end MEASUREMENT
/begin MEASUREMENT St_ibebsd1.B_eb_txok "Bedingung EBSD ???bertragungsrichtung schreiben [RAM name from V530, voted 52]" UBYTE NO_COMPU_METHOD 0 0 0 255 ECU_ADDRESS 0x3FD12F FORMAT "%.4g" /end MEASUREMENT
/begin MEASUREMENT St_ibebsd1.B_ibs_msgrdy "Bedingung EBSD Botschaft von IBS empfangen [RAM name from V530, voted 52]" UBYTE NO_COMPU_METHOD 0 0 0 255 ECU_ADDRESS 0x3FD12F FORMAT "%.4g" /end MEASUREMENT
/begin MEASUREMENT St_ibebsd1.B_ibs_msgwri "Bedingung EBSD ???bertragungsrichtung schreiben [RAM name from V530, voted 52]" UBYTE NO_COMPU_METHOD 0 0 0 255 ECU_ADDRESS 0x3FD12F FORMAT "%.4g" /end MEASUREMENT
/begin MEASUREMENT St_ibserr "Statuswort ibserr [RAM name from V530, voted 35]" UBYTE M_FORMULA_0003 0 0 0 255 ECU_ADDRESS 0x3FD130 /end MEASUREMENT
/begin MEASUREMENT St_ibserr.B_ibfbsd "Bedingung BSD Fehler [RAM name from V530, voted 35]" UBYTE NO_COMPU_METHOD 0 0 0 255 ECU_ADDRESS 0x3FD130 FORMAT "%.4g" /end MEASUREMENT
/begin MEASUREMENT St_ibserr.B_ibfebsd "Bedingung EBSD Fehler [RAM name from V530, voted 35]" UBYTE NO_COMPU_METHOD 0 0 0 255 ECU_ADDRESS 0x3FD130 FORMAT "%.4g" /end MEASUREMENT
/begin MEASUREMENT St_ibserr.B_ibunplau "Bedingung IBS Version unplausibel [RAM name from V530, voted 35]" UBYTE NO_COMPU_METHOD 0 0 0 255 ECU_ADDRESS 0x3FD130 FORMAT "%.4g" /end MEASUREMENT
/begin MEASUREMENT St_ibmix "Statuswort ibmix [RAM name from V530, voted 10]" UBYTE M_FORMULA_0003 0 0 0 255 ECU_ADDRESS 0x3FD131 /end MEASUREMENT
/begin MEASUREMENT St_ibmix.B_ibrhilo "toggle Bit Register0/ 1 hi- od. lo byte [RAM name from V530, voted 10]" UBYTE NO_COMPU_METHOD 0 0 0 255 ECU_ADDRESS 0x3FD131 FORMAT "%.4g" /end MEASUREMENT
/begin MEASUREMENT St_ibmix.B_ibttog "global toggle bit [RAM name from V530, voted 10]" UBYTE NO_COMPU_METHOD 0 0 0 255 ECU_ADDRESS 0x3FD131 FORMAT "%.4g" /end MEASUREMENT
/begin MEASUREMENT Ibswbase "IBS Software Baseline [RAM name from V530, voted 1]" UBYTE M_FORMULA_0003 0 0 0 255 ECU_ADDRESS 0x3FD13A /end MEASUREMENT
/begin MEASUREMENT Ibswchang "IBS Software ???nderungs Status [RAM name from V530, voted 1]" UBYTE M_FORMULA_0003 0 0 0 255 ECU_ADDRESS 0x3FD13B /end MEASUREMENT
/begin MEASUREMENT Ibhwversi "IBS Hardware Version [RAM name from V530, voted 1]" UBYTE M_FORMULA_0003 0 0 0 255 ECU_ADDRESS 0x3FD13C /end MEASUREMENT
/begin MEASUREMENT Ib_parlen "L???nge IBS Parameterliste [RAM name from V530, voted 1]" UBYTE M_FORMULA_0003 0 0 0 255 ECU_ADDRESS 0x3FD13D /end MEASUREMENT
/begin MEASUREMENT Ibseromctr "IBS Fehlerz???hler [RAM name from V530, voted 1]" UBYTE M_FORMULA_0003 0 0 0 255 ECU_ADDRESS 0x3FD140 /end MEASUREMENT
/begin MEASUREMENT Ibsramctr "IBS Fehlerz???hler [RAM name from V530, voted 1]" UBYTE M_FORMULA_0003 0 0 0 255 ECU_ADDRESS 0x3FD141 /end MEASUREMENT
/begin MEASUREMENT Ibspromctr "IBS Fehlerz???hler [RAM name from V530, voted 1]" UBYTE M_FORMULA_0003 0 0 0 255 ECU_ADDRESS 0x3FD142 /end MEASUREMENT
/begin MEASUREMENT Ibsdncsctr "IBS Fehlerz???hler download checksum [RAM name from V530, voted 1]" UBYTE M_FORMULA_0003 0 0 0 255 ECU_ADDRESS 0x3FD143 /end MEASUREMENT
/begin MEASUREMENT T_battsoci "T_battsoc0, Rohwert aus IBS [RAM name from V530, voted 1]" UBYTE M_FORMULA_0003 0 0 0 255 ECU_ADDRESS 0x3FD144 /end MEASUREMENT
/begin MEASUREMENT Tbatt_maxi "T_batt_max, Rohwert aus IBS [RAM name from V530, voted 4]" UBYTE M_FORMULA_0003 0 0 0 255 ECU_ADDRESS 0x3FD145 /end MEASUREMENT
/begin MEASUREMENT Tbatt_mini "T_batt_min, Rohwert aus IBS [RAM name from V530, voted 4]" UBYTE M_FORMULA_0003 0 0 0 255 ECU_ADDRESS 0x3FD146 /end MEASUREMENT
/begin MEASUREMENT I_batt "Batteriestrom von IBS gemessen [RAM name from V530, voted 3]" UWORD M_FORMULA_0508 0 0 -200 5042.8 ECU_ADDRESS 0x3FD14E /end MEASUREMENT
/begin MEASUREMENT Ibswdtctr "IBS Fehlerz???hler watchdog [RAM name from V530, voted 1]" UWORD M_FORMULA_0010 0 0 0 65535 ECU_ADDRESS 0x3FD154 /end MEASUREMENT
/begin MEASUREMENT Ibsporctr "IBS Fehlerz???hler power on [RAM name from V530, voted 1]" UWORD M_FORMULA_0010 0 0 0 65535 ECU_ADDRESS 0x3FD156 /end MEASUREMENT
/begin MEASUREMENT Ibsptyctr "IBS Fehlerz???hler BSD parity [RAM name from V530, voted 1]" UWORD M_FORMULA_0010 0 0 0 65535 ECU_ADDRESS 0x3FD158 /end MEASUREMENT
/begin MEASUREMENT Qlad "Delta Batterieladung [RAM name from V530, voted 1]" UWORD M_FORMULA_0498 0 0 0 1192.750253 ECU_ADDRESS 0x3FD15A /end MEASUREMENT
/begin MEASUREMENT I_soc0 "Strom bei Ruhespannungsmessung [RAM name from V530, voted 4]" SWORD M_FORMULA_0511 0 0 -655.36 655.34 ECU_ADDRESS 0x3FD15E /end MEASUREMENT
/begin MEASUREMENT T_battsoc0 "Batterietemperatur bei Ruhespannungsmessung [RAM name from V530, voted 2]" SWORD M_FORMULA_0431 0 0 -3276.8 3276.7 ECU_ADDRESS 0x3FD160 /end MEASUREMENT
/begin MEASUREMENT U1soc0 "Ruhespannung 1 [RAM name from V530, voted 3]" UWORD M_FORMULA_0501 0 0 6 22.38375 ECU_ADDRESS 0x3FD162 /end MEASUREMENT
/begin MEASUREMENT U2soc0 "Ruhespannung 1 [RAM name from V530, voted 3]" UWORD M_FORMULA_0501 0 0 6 22.38375 ECU_ADDRESS 0x3FD164 /end MEASUREMENT
/begin MEASUREMENT U3soc0 "Ruhespannung 1 [RAM name from V530, voted 2]" UWORD M_FORMULA_0501 0 0 6 22.38375 ECU_ADDRESS 0x3FD166 /end MEASUREMENT
/begin MEASUREMENT Qladsoc0 "Ladung bei Ruhespannungsmessung [RAM name from V530, voted 1]" UWORD M_FORMULA_0498 0 0 0 1192.750253 ECU_ADDRESS 0x3FD16E /end MEASUREMENT
/begin MEASUREMENT Qeladsoc0 "Entladung bei Ruhespannungsmessung [RAM name from V530, voted 1]" UWORD M_FORMULA_0498 0 0 0 1192.750253 ECU_ADDRESS 0x3FD170 /end MEASUREMENT
/begin MEASUREMENT U_vorstart "Spannung vor Start [RAM name from V530, voted 2]" UWORD M_FORMULA_0501 0 0 6 22.38375 ECU_ADDRESS 0x3FD172 /end MEASUREMENT
/begin MEASUREMENT I_vorstart "Batteriestrom vor Start [RAM name from V530, voted 1]" UWORD M_FORMULA_0732 0 0 -200 1110.7 ECU_ADDRESS 0x3FD176 /end MEASUREMENT
/begin MEASUREMENT I_tnstart "Batteriestrom im Start [RAM name from V530, voted 1]" UWORD M_FORMULA_0515 0 0 0 1310.7 ECU_ADDRESS 0x3FD178 /end MEASUREMENT
/begin MEASUREMENT T_batt_ibs "Batterietemperatur [RAM name from V530, voted 1]" SWORD M_FORMULA_0431 0 0 -3276.8 3276.7 ECU_ADDRESS 0x3FD182 /end MEASUREMENT
/begin MEASUREMENT T_batt_max "Maximale Batt. Temperatur bei Stillstand [RAM name from V530, voted 2]" SWORD M_FORMULA_0431 0 0 -3276.8 3276.7 ECU_ADDRESS 0x3FD184 /end MEASUREMENT
/begin MEASUREMENT T_batt_min "Minimale Batt. Temperatur bei Stillstand [RAM name from V530, voted 2]" SWORD M_FORMULA_0431 0 0 -3276.8 3276.7 ECU_ADDRESS 0x3FD186 /end MEASUREMENT
/begin MEASUREMENT kw_ed_delta_n_rate "Aktuelle Fehlerrate Startversuch. [RAM name from V530, voted 3]" UWORD M_FORMULA_0010 0 0 0 65535 ECU_ADDRESS 0x3FD2CC /end MEASUREMENT
/begin MEASUREMENT kw_ed_n_drop_rate "Aktuelle Fehlerrate Abriss. [RAM name from V530, voted 5]" UWORD M_FORMULA_0010 0 0 0 65535 ECU_ADDRESS 0x3FD2CE /end MEASUREMENT
/begin MEASUREMENT kw_ed_sh_to_ub_rate "Aktuelle Fehlerrate Kurzschluss nach Ub. [RAM name from V530, voted 7]" UWORD M_FORMULA_0010 0 0 0 65535 ECU_ADDRESS 0x3FD2D0 /end MEASUREMENT
/begin MEASUREMENT kw_ed_sh_to_gnd_rate "Aktuelle Fehlerrate Kurzschluss nach Masse. [RAM name from V530, voted 6]" UWORD M_FORMULA_0010 0 0 0 65535 ECU_ADDRESS 0x3FD2D2 /end MEASUREMENT
/begin MEASUREMENT la_trim_st_b1 "LA-Trimmregelung-Status [RAM name from V530, voted 4]" UWORD M_FORMULA_0080 0 0 0 65535 ECU_ADDRESS 0x3FD314 /end MEASUREMENT
/begin MEASUREMENT la_trim_st_cfg_b1 "Allgemeine Freigabe [RAM name from V530, voted 4]" UWORD NO_COMPU_METHOD 0 0 0 65535 ECU_ADDRESS 0x3FD314 FORMAT "%.4g" /end MEASUREMENT
/begin MEASUREMENT la_trim_st_error_b1 "Fehlerbedingungen [RAM name from V530, voted 4]" UWORD NO_COMPU_METHOD 0 0 0 65535 ECU_ADDRESS 0x3FD314 FORMAT "%.4g" /end MEASUREMENT
/begin MEASUREMENT la_trim_st_kats_b1 "KAT-Schutz [RAM name from V530, voted 4]" UWORD NO_COMPU_METHOD 0 0 0 65535 ECU_ADDRESS 0x3FD314 FORMAT "%.4g" /end MEASUREMENT
/begin MEASUREMENT la_trim_st_kh_b1 "KAT-Heizen [RAM name from V530, voted 4]" UWORD NO_COMPU_METHOD 0 0 0 65535 ECU_ADDRESS 0x3FD314 FORMAT "%.4g" /end MEASUREMENT
/begin MEASUREMENT la_trim_st_laa_lim_b1 "Kraftstoffsystem [RAM name from V530, voted 4]" UWORD NO_COMPU_METHOD 0 0 0 65535 ECU_ADDRESS 0x3FD314 FORMAT "%.4g" /end MEASUREMENT
/begin MEASUREMENT la_trim_st_nkat_verf_b1 "NKAT-Sonden Verfuegbarkeit [RAM name from V530, voted 4]" UWORD NO_COMPU_METHOD 0 0 0 65535 ECU_ADDRESS 0x3FD314 FORMAT "%.4g" /end MEASUREMENT
/begin MEASUREMENT la_trim_st_rf_b1 "RF-Schwellen [RAM name from V530, voted 4]" UWORD NO_COMPU_METHOD 0 0 0 65535 ECU_ADDRESS 0x3FD314 FORMAT "%.4g" /end MEASUREMENT
/begin MEASUREMENT la_trim_st_sk_b1 "SK-Manger [RAM name from V530, voted 4]" UWORD NO_COMPU_METHOD 0 0 0 65535 ECU_ADDRESS 0x3FD314 FORMAT "%.4g" /end MEASUREMENT
/begin MEASUREMENT la_trim_st_slp_b1 "Sekundaerluftbetrieb [RAM name from V530, voted 4]" UWORD NO_COMPU_METHOD 0 0 0 65535 ECU_ADDRESS 0x3FD314 FORMAT "%.4g" /end MEASUREMENT
/begin MEASUREMENT la_trim_st_soll_add_b1 "LAM-SOLL Aktivitaeten [RAM name from V530, voted 4]" UWORD NO_COMPU_METHOD 0 0 0 65535 ECU_ADDRESS 0x3FD314 FORMAT "%.4g" /end MEASUREMENT
/begin MEASUREMENT la_trim_st_soll_norm_b1 "LAM-SOLL-NORM & LA-Regler [RAM name from V530, voted 4]" UWORD NO_COMPU_METHOD 0 0 0 65535 ECU_ADDRESS 0x3FD314 FORMAT "%.4g" /end MEASUREMENT
/begin MEASUREMENT la_trim_st_te_b1 "TE-AKF-Beladung/TEFC aktiv [RAM name from V530, voted 4]" UWORD NO_COMPU_METHOD 0 0 0 65535 ECU_ADDRESS 0x3FD314 FORMAT "%.4g" /end MEASUREMENT
/begin MEASUREMENT la_trim_st_temperatur_b1 "Abgastemp./Ansaugtemp.Schwellen [RAM name from V530, voted 4]" UWORD NO_COMPU_METHOD 0 0 0 65535 ECU_ADDRESS 0x3FD314 FORMAT "%.4g" /end MEASUREMENT
/begin MEASUREMENT la_trim_st_v_b1 "V-Schwelle [RAM name from V530, voted 4]" UWORD NO_COMPU_METHOD 0 0 0 65535 ECU_ADDRESS 0x3FD314 FORMAT "%.4g" /end MEASUREMENT
/begin MEASUREMENT la_trim_st_b2 "LA-Trimmregelung-Status [RAM name from V530, voted 1]" UWORD M_FORMULA_0080 0 0 0 65535 ECU_ADDRESS 0x3FD316 /end MEASUREMENT
/begin MEASUREMENT la_trim_st_cfg_b2 "Allgemeine Freigabe [RAM name from V530, voted 1]" UWORD NO_COMPU_METHOD 0 0 0 65535 ECU_ADDRESS 0x3FD316 FORMAT "%.4g" /end MEASUREMENT
/begin MEASUREMENT la_trim_st_error_b2 "Fehlerbedingungen [RAM name from V530, voted 1]" UWORD NO_COMPU_METHOD 0 0 0 65535 ECU_ADDRESS 0x3FD316 FORMAT "%.4g" /end MEASUREMENT
/begin MEASUREMENT la_trim_st_kats_b2 "KAT-Schutz [RAM name from V530, voted 1]" UWORD NO_COMPU_METHOD 0 0 0 65535 ECU_ADDRESS 0x3FD316 FORMAT "%.4g" /end MEASUREMENT
/begin MEASUREMENT la_trim_st_kh_b2 "KAT-Heizen [RAM name from V530, voted 1]" UWORD NO_COMPU_METHOD 0 0 0 65535 ECU_ADDRESS 0x3FD316 FORMAT "%.4g" /end MEASUREMENT
/begin MEASUREMENT la_trim_st_laa_lim_b2 "Kraftstoffsystem [RAM name from V530, voted 1]" UWORD NO_COMPU_METHOD 0 0 0 65535 ECU_ADDRESS 0x3FD316 FORMAT "%.4g" /end MEASUREMENT
/begin MEASUREMENT la_trim_st_nkat_verf_b2 "NKAT-Sonden Verfuegbarkeit [RAM name from V530, voted 1]" UWORD NO_COMPU_METHOD 0 0 0 65535 ECU_ADDRESS 0x3FD316 FORMAT "%.4g" /end MEASUREMENT
/begin MEASUREMENT la_trim_st_rf_b2 "RF-Schwellen [RAM name from V530, voted 1]" UWORD NO_COMPU_METHOD 0 0 0 65535 ECU_ADDRESS 0x3FD316 FORMAT "%.4g" /end MEASUREMENT
/begin MEASUREMENT la_trim_st_sk_b2 "SK-Manger [RAM name from V530, voted 1]" UWORD NO_COMPU_METHOD 0 0 0 65535 ECU_ADDRESS 0x3FD316 FORMAT "%.4g" /end MEASUREMENT
/begin MEASUREMENT la_trim_st_slp_b2 "Sekundaerluftbetrieb [RAM name from V530, voted 1]" UWORD NO_COMPU_METHOD 0 0 0 65535 ECU_ADDRESS 0x3FD316 FORMAT "%.4g" /end MEASUREMENT
/begin MEASUREMENT la_trim_st_soll_add_b2 "LAM-SOLL Aktivitaeten [RAM name from V530, voted 1]" UWORD NO_COMPU_METHOD 0 0 0 65535 ECU_ADDRESS 0x3FD316 FORMAT "%.4g" /end MEASUREMENT
/begin MEASUREMENT la_trim_st_soll_norm_b2 "LAM-SOLL-NORM & LA-Regler [RAM name from V530, voted 1]" UWORD NO_COMPU_METHOD 0 0 0 65535 ECU_ADDRESS 0x3FD316 FORMAT "%.4g" /end MEASUREMENT
/begin MEASUREMENT la_trim_st_te_b2 "TE-AKF-Beladung/TEFC aktiv [RAM name from V530, voted 1]" UWORD NO_COMPU_METHOD 0 0 0 65535 ECU_ADDRESS 0x3FD316 FORMAT "%.4g" /end MEASUREMENT
/begin MEASUREMENT la_trim_st_temperatur_b2 "Abgastemp./Ansaugtemp.Schwellen [RAM name from V530, voted 1]" UWORD NO_COMPU_METHOD 0 0 0 65535 ECU_ADDRESS 0x3FD316 FORMAT "%.4g" /end MEASUREMENT
/begin MEASUREMENT la_trim_st_v_b2 "V-Schwelle [RAM name from V530, voted 1]" UWORD NO_COMPU_METHOD 0 0 0 65535 ECU_ADDRESS 0x3FD316 FORMAT "%.4g" /end MEASUREMENT
/begin MEASUREMENT la_trim_zust_ad_erm_b1 "AD-Wert Ermittlung [RAM name from V530, voted 6]" UWORD NO_COMPU_METHOD 0 0 0 65535 ECU_ADDRESS 0x3FD318 FORMAT "%.4g" /end MEASUREMENT
/begin MEASUREMENT la_trim_zust_b1 "LA-Trimmregelung-interner Zustand [RAM name from V530, voted 6]" UWORD M_FORMULA_0080 0 0 0 65535 ECU_ADDRESS 0x3FD318 /end MEASUREMENT
/begin MEASUREMENT la_trim_zust_i_ad_max_b1 "AD-Anteil - MAX-Begrenzung [RAM name from V530, voted 6]" UWORD NO_COMPU_METHOD 0 0 0 65535 ECU_ADDRESS 0x3FD318 FORMAT "%.4g" /end MEASUREMENT
/begin MEASUREMENT la_trim_zust_i_ad_min_b1 "AD-Anteil - MIN-Begrenzung [RAM name from V530, voted 6]" UWORD NO_COMPU_METHOD 0 0 0 65535 ECU_ADDRESS 0x3FD318 FORMAT "%.4g" /end MEASUREMENT
/begin MEASUREMENT la_trim_zust_i_b1 "I-Anteil-Verzoegerungzeit [RAM name from V530, voted 6]" UWORD NO_COMPU_METHOD 0 0 0 65535 ECU_ADDRESS 0x3FD318 FORMAT "%.4g" /end MEASUREMENT
/begin MEASUREMENT la_trim_zust_i_gmw_aktiv_b1 "Ermittlung GMW-I-Anteil [RAM name from V530, voted 6]" UWORD NO_COMPU_METHOD 0 0 0 65535 ECU_ADDRESS 0x3FD318 FORMAT "%.4g" /end MEASUREMENT
/begin MEASUREMENT la_trim_zust_i_init_gmw_b1 "I-Anteil vorbelegen [RAM name from V530, voted 6]" UWORD NO_COMPU_METHOD 0 0 0 65535 ECU_ADDRESS 0x3FD318 FORMAT "%.4g" /end MEASUREMENT
/begin MEASUREMENT la_trim_zust_i_max_b1 "Diagnose I-Anteil - MAX-Begrenzung [RAM name from V530, voted 6]" UWORD NO_COMPU_METHOD 0 0 0 65535 ECU_ADDRESS 0x3FD318 FORMAT "%.4g" /end MEASUREMENT
/begin MEASUREMENT la_trim_zust_i_min_b1 "Diagnose I-Anteil - MIN-Begrenzung [RAM name from V530, voted 6]" UWORD NO_COMPU_METHOD 0 0 0 65535 ECU_ADDRESS 0x3FD318 FORMAT "%.4g" /end MEASUREMENT
/begin MEASUREMENT la_trim_zust_p_abger_b1 "P-Anteil ist abgeregelt [RAM name from V530, voted 6]" UWORD NO_COMPU_METHOD 0 0 0 65535 ECU_ADDRESS 0x3FD318 FORMAT "%.4g" /end MEASUREMENT
/begin MEASUREMENT la_trim_zust_p_b1 "P-Anteil Ermittlung abgeschlossen [RAM name from V530, voted 6]" UWORD NO_COMPU_METHOD 0 0 0 65535 ECU_ADDRESS 0x3FD318 FORMAT "%.4g" /end MEASUREMENT
/begin MEASUREMENT la_trim_zust_us_o2_b1 "O2-Beladung freigeben - ueber Trimmregelung [RAM name from V530, voted 6]" UWORD NO_COMPU_METHOD 0 0 0 65535 ECU_ADDRESS 0x3FD318 FORMAT "%.4g" /end MEASUREMENT
/begin MEASUREMENT la_trim_usn_soll_b1 "SOLL-NKAT-Spannung [RAM name from V530, voted 3]" UWORD M_FORMULA_0536 0 0 0 319995.1172 ECU_ADDRESS 0x3FD31C /end MEASUREMENT
/begin MEASUREMENT la_trim_p_fak_obd_b1 "Faktor P-Anteil aus KAT-Alterung [RAM name from V530, voted 1]" UWORD M_FORMULA_0073 0 0 0 63.99902344 ECU_ADDRESS 0x3FD328 /end MEASUREMENT
/begin MEASUREMENT la_trim_i_f_b1 "I-Anteil - Trimmregelung [RAM name from V530, voted 1]" UWORD M_FORMULA_0908 0 0 0 819.1875 ECU_ADDRESS 0x3FD334 /end MEASUREMENT
/begin MEASUREMENT la_trim_i_inc_b1 "Integratorwert auf wirkenden I-Anteil [RAM name from V530, voted 1]" SWORD M_FORMULA_0199 0 0 -2 1.999938965 ECU_ADDRESS 0x3FD338 /end MEASUREMENT
/begin MEASUREMENT la_trim_p_b1 "wirkender P-Anteil [RAM name from V530, voted 4]" SWORD M_FORMULA_0025 0 0 -2 1.999938965 ECU_ADDRESS 0x3FD33C /end MEASUREMENT
/begin MEASUREMENT la_trim_i_gmw_b1 "wirkender I-Anteil - gemittelt [RAM name from V530, voted 3]" SWORD M_FORMULA_0025 0 0 -2 1.999938965 ECU_ADDRESS 0x3FD344 /end MEASUREMENT
/begin MEASUREMENT la_trim_i_fak_obd_b1 "Faktor I-Anteil aus KAT-Alterung [RAM name from V530, voted 1]" UWORD M_FORMULA_0073 0 0 0 63.99902344 ECU_ADDRESS 0x3FD34C /end MEASUREMENT
/begin MEASUREMENT la_trim_p_wait_b1 "Wartezeit f???r weiteren P-Anteil [RAM name from V530, voted 1]" UWORD M_FORMULA_0021 0 0 0 655.35 ECU_ADDRESS 0x3FD354 /end MEASUREMENT
/begin MEASUREMENT la_trim_p_dez_b1 "Abregelungswert P-Anteil [RAM name from V530, voted 1]" SLONG M_FORMULA_0909 0 0 -131072 131071.9999 ECU_ADDRESS 0x3FD360 /end MEASUREMENT
/begin MEASUREMENT la_trim_diag_i_ed_f_b1 "Aufweitungsfaktor auf d. I-Anteils-Bereichsgrenzen [RAM name from V530, voted 2]" UWORD M_FORMULA_0073 0 0 0 63.99902344 ECU_ADDRESS 0x3FD36C /end MEASUREMENT
/begin MEASUREMENT la_trim_diag_i_min_cnt_b1 "Anzahl I-Anteil min. Begrenzung [RAM name from V530, voted 3]" UWORD M_FORMULA_0010 0 0 0 65535 ECU_ADDRESS 0x3FD370 /end MEASUREMENT
/begin MEASUREMENT la_trim_diag_i_max_cnt_b1 "Anzahl I-Anteil max. Begrenzung [RAM name from V530, voted 3]" UWORD M_FORMULA_0010 0 0 0 65535 ECU_ADDRESS 0x3FD374 /end MEASUREMENT
/begin MEASUREMENT lam.atic42_ip_gain_b1 "ATIC42 IP-GAIN [RAM name from V530, voted 25]" UWORD NO_COMPU_METHOD 0 0 0 65535 ECU_ADDRESS 0x3FD400 FORMAT "%.4g" /end MEASUREMENT
/begin MEASUREMENT lam.lavk_status_b1 "Sonden-Status [RAM name from V530, voted 25]" UWORD NO_COMPU_METHOD 0 0 0 65535 ECU_ADDRESS 0x3FD400 FORMAT "%.4g" /end MEASUREMENT
/begin MEASUREMENT lam_b1.lavk_st "Sonden-Status [RAM name from V530, voted 25]" UWORD M_FORMULA_0080 0 0 0 65535 ECU_ADDRESS 0x3FD400 /end MEASUREMENT
/begin MEASUREMENT lam_b1.lavk_ad "AD-Wert d. Sondensignals [RAM name from V530, voted 1]" UWORD M_FORMULA_0536 0 0 0 319995.1172 ECU_ADDRESS 0x3FD402 /end MEASUREMENT
/begin MEASUREMENT lam_b1.ad_offs_cnt "Zahler fuer Glaettungszeit [RAM name from V530, voted 1]" UWORD M_FORMULA_0010 0 0 0 65535 ECU_ADDRESS 0x3FD41E /end MEASUREMENT
/begin MEASUREMENT lam_b1.ad_gain_cnt "Zahler fuer Glaettungszeit [RAM name from V530, voted 2]" UWORD M_FORMULA_0010 0 0 0 65535 ECU_ADDRESS 0x3FD420 /end MEASUREMENT
/begin MEASUREMENT lam_b1.lavk_ad_offs_filt "gem. AD-Wert f. OFFSET-Sondenadapt. [RAM name from V530, voted 1]" UWORD M_FORMULA_0536 0 0 0 319995.1172 ECU_ADDRESS 0x3FD422 /end MEASUREMENT
/begin MEASUREMENT lam.laa_f_begr_b1 "LAA-F-Begr. [RAM name from V530, voted 6]" UWORD NO_COMPU_METHOD 0 0 0 65535 ECU_ADDRESS 0x3FD436 FORMAT "%.4g" /end MEASUREMENT
/begin MEASUREMENT lam.laa_f_te_begr_b1 "LAA-F-TE-Begr. [RAM name from V530, voted 6]" UWORD NO_COMPU_METHOD 0 0 0 65535 ECU_ADDRESS 0x3FD436 FORMAT "%.4g" /end MEASUREMENT
/begin MEASUREMENT lam.laa_offs_begr_b1 "LAA-OFFS-Begr. [RAM name from V530, voted 6]" UWORD NO_COMPU_METHOD 0 0 0 65535 ECU_ADDRESS 0x3FD436 FORMAT "%.4g" /end MEASUREMENT
/begin MEASUREMENT lam.laa_stat_b1 "LAA-Stationaer [RAM name from V530, voted 6]" UWORD NO_COMPU_METHOD 0 0 0 65535 ECU_ADDRESS 0x3FD436 FORMAT "%.4g" /end MEASUREMENT
/begin MEASUREMENT lam.laa_status_b1 "LA-Adaption-Status [RAM name from V530, voted 6]" UWORD NO_COMPU_METHOD 0 0 0 65535 ECU_ADDRESS 0x3FD436 FORMAT "%.4g" /end MEASUREMENT
/begin MEASUREMENT lam.laa_ti_ist_b1 "TI_IST-Schwelle [RAM name from V530, voted 6]" UWORD NO_COMPU_METHOD 0 0 0 65535 ECU_ADDRESS 0x3FD436 FORMAT "%.4g" /end MEASUREMENT
/begin MEASUREMENT lam_b1.laa_st "LA-Adaption-Status [RAM name from V530, voted 6]" UWORD M_FORMULA_0080 0 0 0 65535 ECU_ADDRESS 0x3FD436 /end MEASUREMENT
/begin MEASUREMENT lam_b1.laa_f_te "Offset auf LAA-Faktor ueber TE [RAM name from V530, voted 1]" SWORD M_FORMULA_0024 0 0 -1 0.9999694824 ECU_ADDRESS 0x3FD43C /end MEASUREMENT
/begin MEASUREMENT lam_b2.ad_offs_cnt "Zahler fuer Glaettungszeit [RAM name from V530, voted 1]" UWORD M_FORMULA_0010 0 0 0 65535 ECU_ADDRESS 0x3FD46A /end MEASUREMENT
/begin MEASUREMENT lam_b2.ad_gain_cnt "Zahler fuer Glaettungszeit [RAM name from V530, voted 1]" UWORD M_FORMULA_0010 0 0 0 65535 ECU_ADDRESS 0x3FD46C /end MEASUREMENT
/begin MEASUREMENT lam_b2.lavk_ad_offs_filt "gem. AD-Wert f. OFFSET-Sondenadapt. [RAM name from V530, voted 1]" UWORD M_FORMULA_0536 0 0 0 319995.1172 ECU_ADDRESS 0x3FD46E /end MEASUREMENT
/begin MEASUREMENT lam.laa_f_begr_b2 "LAA-F-Begr. [RAM name from V530, voted 4]" UWORD NO_COMPU_METHOD 0 0 0 65535 ECU_ADDRESS 0x3FD482 FORMAT "%.4g" /end MEASUREMENT
/begin MEASUREMENT lam.laa_f_te_begr_b2 "LAA-F-TE-Begr. [RAM name from V530, voted 4]" UWORD NO_COMPU_METHOD 0 0 0 65535 ECU_ADDRESS 0x3FD482 FORMAT "%.4g" /end MEASUREMENT
/begin MEASUREMENT lam.laa_offs_begr_b2 "LAA-OFFS-Begr. [RAM name from V530, voted 4]" UWORD NO_COMPU_METHOD 0 0 0 65535 ECU_ADDRESS 0x3FD482 FORMAT "%.4g" /end MEASUREMENT
/begin MEASUREMENT lam.laa_stat_b2 "LAA-Stationaer [RAM name from V530, voted 4]" UWORD NO_COMPU_METHOD 0 0 0 65535 ECU_ADDRESS 0x3FD482 FORMAT "%.4g" /end MEASUREMENT
/begin MEASUREMENT lam.laa_status_b2 "LA-Adaption-Status [RAM name from V530, voted 4]" UWORD NO_COMPU_METHOD 0 0 0 65535 ECU_ADDRESS 0x3FD482 FORMAT "%.4g" /end MEASUREMENT
/begin MEASUREMENT lam.laa_ti_ist_b2 "TI_IST-Schwelle [RAM name from V530, voted 4]" UWORD NO_COMPU_METHOD 0 0 0 65535 ECU_ADDRESS 0x3FD482 FORMAT "%.4g" /end MEASUREMENT
/begin MEASUREMENT lam_b2.laa_st "LA-Adaption-Status [RAM name from V530, voted 4]" UWORD M_FORMULA_0080 0 0 0 65535 ECU_ADDRESS 0x3FD482 /end MEASUREMENT
/begin MEASUREMENT lam_reg_f_min_b1 "min. Regeleingriff [RAM name from V530, voted 3]" UWORD M_FORMULA_0024 0 0 0 1.999969482 ECU_ADDRESS 0x3FD4A2 /end MEASUREMENT
/begin MEASUREMENT lam_reg_f_max_b1 "max. Regeleingriff [RAM name from V530, voted 1]" UWORD M_FORMULA_0024 0 0 0 1.999969482 ECU_ADDRESS 0x3FD4A6 /end MEASUREMENT
/begin MEASUREMENT laa_f_b1 "Faktor-Lambdaadaption [RAM name from V530, voted 4]" UWORD M_FORMULA_0024 0 0 0 1.999969482 ECU_ADDRESS 0x3FD4AA /end MEASUREMENT
/begin MEASUREMENT laa_f_b2 "Faktor-Lambdaadaption [RAM name from V530, voted 1]" UWORD M_FORMULA_0024 0 0 0 1.999969482 ECU_ADDRESS 0x3FD4AC /end MEASUREMENT
/begin MEASUREMENT laa_offs_begr_b1 "Offset-Wert aus Aenderungsbegr. [RAM name from V530, voted 4]" SWORD M_FORMULA_0535 0 0 -512 511.984375 ECU_ADDRESS 0x3FD4AE /end MEASUREMENT
/begin MEASUREMENT laa_offs_begr_b2 "Offset-Wert aus Aenderungsbegr. [RAM name from V530, voted 1]" SWORD M_FORMULA_0535 0 0 -512 511.984375 ECU_ADDRESS 0x3FD4B0 /end MEASUREMENT
/begin MEASUREMENT laa_f_mw_t_b1 "Zeitzaehler f. Mittelwertbildung [RAM name from V530, voted 2]" UWORD M_FORMULA_0763 0 0 0 65535 ECU_ADDRESS 0x3FD4B6 /end MEASUREMENT
/begin MEASUREMENT laa_f_mw_cnt_b1 "Zaehlervariable f. Mittelwertbildung [RAM name from V530, voted 2]" UWORD M_FORMULA_0010 0 0 0 65535 ECU_ADDRESS 0x3FD4C2 /end MEASUREMENT
/begin MEASUREMENT lam_ist "Lambda Istwert [RAM name from V530, voted 4]" UWORD M_FORMULA_0025 0 0 0 3.999938965 ECU_ADDRESS 0x3FD4CA /end MEASUREMENT
/begin MEASUREMENT wf_mks_rel "relativer Eingriff WF-Modell [RAM name from V530, voted 1]" UWORD M_FORMULA_0073 0 0 0 63.99902344 ECU_ADDRESS 0x3FD4F6 /end MEASUREMENT
/begin MEASUREMENT lam_ml_delta_rel "relative Regelabweichung [RAM name from V530, voted 1]" SWORD M_FORMULA_0764 0 0 -1 0.9999694824 ECU_ADDRESS 0x3FD50A /end MEASUREMENT
/begin MEASUREMENT lavk_ad_gain_cnt_t_b1 "GAIN-Glaettungszeit [RAM name from V530, voted 22]" UWORD NO_COMPU_METHOD 0 0 0 65535 ECU_ADDRESS 0x3FD516 FORMAT "%.4g" /end MEASUREMENT
/begin MEASUREMENT lavk_ad_gain_freig_b1 "GAIN-Sondenadaption FREIGABE [RAM name from V530, voted 22]" UWORD NO_COMPU_METHOD 0 0 0 65535 ECU_ADDRESS 0x3FD516 FORMAT "%.4g" /end MEASUREMENT
/begin MEASUREMENT lavk_ad_gain_st_b1 "GAIN-Sondenadaption [RAM name from V530, voted 22]" UWORD NO_COMPU_METHOD 0 0 0 65535 ECU_ADDRESS 0x3FD516 FORMAT "%.4g" /end MEASUREMENT
/begin MEASUREMENT lavk_ad_offs_cnt_t_b1 "OFFSET-Glaettungszeit [RAM name from V530, voted 22]" UWORD NO_COMPU_METHOD 0 0 0 65535 ECU_ADDRESS 0x3FD516 FORMAT "%.4g" /end MEASUREMENT
/begin MEASUREMENT lavk_ad_offs_freig_b1 "OFFSET-Sondenadaption FREIGABE [RAM name from V530, voted 22]" UWORD NO_COMPU_METHOD 0 0 0 65535 ECU_ADDRESS 0x3FD516 FORMAT "%.4g" /end MEASUREMENT
/begin MEASUREMENT lavk_ad_offs_ml_b1 "OFFSET-Sondenadaption bei ML [RAM name from V530, voted 22]" UWORD NO_COMPU_METHOD 0 0 0 65535 ECU_ADDRESS 0x3FD516 FORMAT "%.4g" /end MEASUREMENT
/begin MEASUREMENT lavk_ad_offs_ms_b1 "OFFSET-Sondenadaption bei MS [RAM name from V530, voted 22]" UWORD NO_COMPU_METHOD 0 0 0 65535 ECU_ADDRESS 0x3FD516 FORMAT "%.4g" /end MEASUREMENT
/begin MEASUREMENT lavk_ad_offs_spi_b1 "OFFSET-Sondenadaption - ATIC42 [RAM name from V530, voted 22]" UWORD NO_COMPU_METHOD 0 0 0 65535 ECU_ADDRESS 0x3FD516 FORMAT "%.4g" /end MEASUREMENT
/begin MEASUREMENT lavk_ad_offs_st_b1 "OFFSET-Sondenadaption [RAM name from V530, voted 22]" UWORD NO_COMPU_METHOD 0 0 0 65535 ECU_ADDRESS 0x3FD516 FORMAT "%.4g" /end MEASUREMENT
/begin MEASUREMENT lavk_ad_st_b1 "Sondenadation-Status [RAM name from V530, voted 22]" UWORD M_FORMULA_0080 0 0 0 65535 ECU_ADDRESS 0x3FD516 /end MEASUREMENT
/begin MEASUREMENT lavk_ad_gain_cnt_t_b2 "GAIN-Glaettungszeit [RAM name from V530, voted 2]" UWORD NO_COMPU_METHOD 0 0 0 65535 ECU_ADDRESS 0x3FD518 FORMAT "%.4g" /end MEASUREMENT
/begin MEASUREMENT lavk_ad_gain_freig_b2 "GAIN-Sondenadaption FREIGABE [RAM name from V530, voted 2]" UWORD NO_COMPU_METHOD 0 0 0 65535 ECU_ADDRESS 0x3FD518 FORMAT "%.4g" /end MEASUREMENT
/begin MEASUREMENT lavk_ad_gain_st_b2 "GAIN-Sondenadaption [RAM name from V530, voted 2]" UWORD NO_COMPU_METHOD 0 0 0 65535 ECU_ADDRESS 0x3FD518 FORMAT "%.4g" /end MEASUREMENT
/begin MEASUREMENT lavk_ad_offs_cnt_t_b2 "OFFSET-Glaettungszeit [RAM name from V530, voted 2]" UWORD NO_COMPU_METHOD 0 0 0 65535 ECU_ADDRESS 0x3FD518 FORMAT "%.4g" /end MEASUREMENT
/begin MEASUREMENT lavk_ad_offs_freig_b2 "OFFSET-Sondenadaption FREIGABE [RAM name from V530, voted 2]" UWORD NO_COMPU_METHOD 0 0 0 65535 ECU_ADDRESS 0x3FD518 FORMAT "%.4g" /end MEASUREMENT
/begin MEASUREMENT lavk_ad_offs_ml_b2 "OFFSET-Sondenadaption bei ML [RAM name from V530, voted 2]" UWORD NO_COMPU_METHOD 0 0 0 65535 ECU_ADDRESS 0x3FD518 FORMAT "%.4g" /end MEASUREMENT
/begin MEASUREMENT lavk_ad_offs_ms_b2 "OFFSET-Sondenadaption bei MS [RAM name from V530, voted 2]" UWORD NO_COMPU_METHOD 0 0 0 65535 ECU_ADDRESS 0x3FD518 FORMAT "%.4g" /end MEASUREMENT
/begin MEASUREMENT lavk_ad_offs_spi_b2 "OFFSET-Sondenadaption - ATIC42 [RAM name from V530, voted 2]" UWORD NO_COMPU_METHOD 0 0 0 65535 ECU_ADDRESS 0x3FD518 FORMAT "%.4g" /end MEASUREMENT
/begin MEASUREMENT lavk_ad_offs_st_b2 "OFFSET-Sondenadaption [RAM name from V530, voted 2]" UWORD NO_COMPU_METHOD 0 0 0 65535 ECU_ADDRESS 0x3FD518 FORMAT "%.4g" /end MEASUREMENT
/begin MEASUREMENT lavk_ad_st_b2 "Sondenadation-Status [RAM name from V530, voted 2]" UWORD M_FORMULA_0080 0 0 0 65535 ECU_ADDRESS 0x3FD518 /end MEASUREMENT
/begin MEASUREMENT lavk_ad_gain_delta_t_b1 "Delta-Zeit zwischen 2 GAIN-Adaptionen [RAM name from V530, voted 1]" ULONG M_FORMULA_0147 0 0 0 42949672.95 ECU_ADDRESS 0x3FD51C /end MEASUREMENT
/begin MEASUREMENT lavk_ad_offs_delta_t_b1 "Delta-Zeit zwischen 2 OFFSET-Adaptionen [RAM name from V530, voted 1]" ULONG M_FORMULA_0147 0 0 0 42949672.95 ECU_ADDRESS 0x3FD524 /end MEASUREMENT
/begin MEASUREMENT lam_diag_la_adapt_scdn_b1 "Diagnose LAA-Adaption - SCDN [RAM name from V530, voted 10]" UWORD NO_COMPU_METHOD 0 0 0 65535 ECU_ADDRESS 0x3FD52C FORMAT "%.4g" /end MEASUREMENT
/begin MEASUREMENT lam_diag_laa_f_max_aktiv_b1 "oberer LAA-Faktor-Anschlag [RAM name from V530, voted 10]" UWORD NO_COMPU_METHOD 0 0 0 65535 ECU_ADDRESS 0x3FD52C FORMAT "%.4g" /end MEASUREMENT
/begin MEASUREMENT lam_diag_laa_f_min_aktiv_b1 "unterer LAA-Faktor-Anschlag [RAM name from V530, voted 10]" UWORD NO_COMPU_METHOD 0 0 0 65535 ECU_ADDRESS 0x3FD52C FORMAT "%.4g" /end MEASUREMENT
/begin MEASUREMENT lam_diag_laa_offs_max_aktiv_b1 "oberer LAA-Offset-Anschlag [RAM name from V530, voted 10]" UWORD NO_COMPU_METHOD 0 0 0 65535 ECU_ADDRESS 0x3FD52C FORMAT "%.4g" /end MEASUREMENT
/begin MEASUREMENT lam_diag_laa_offs_min_aktiv_b1 "unterer LAA-Offset-Anschlag [RAM name from V530, voted 10]" UWORD NO_COMPU_METHOD 0 0 0 65535 ECU_ADDRESS 0x3FD52C FORMAT "%.4g" /end MEASUREMENT
/begin MEASUREMENT lam_diag_lam_reg_scdn_b1 "Diagnose LA-Regler - SCDN [RAM name from V530, voted 10]" UWORD NO_COMPU_METHOD 0 0 0 65535 ECU_ADDRESS 0x3FD52C FORMAT "%.4g" /end MEASUREMENT
/begin MEASUREMENT lam_diag_reg_max_aktiv_b1 "oberer LA-Regler-Anschlag [RAM name from V530, voted 10]" UWORD NO_COMPU_METHOD 0 0 0 65535 ECU_ADDRESS 0x3FD52C FORMAT "%.4g" /end MEASUREMENT
/begin MEASUREMENT lam_diag_reg_min_aktiv_b1 "unterer LA-Regler-Anschlag [RAM name from V530, voted 10]" UWORD NO_COMPU_METHOD 0 0 0 65535 ECU_ADDRESS 0x3FD52C FORMAT "%.4g" /end MEASUREMENT
/begin MEASUREMENT lam_diag_st_b1 "Status LA-Anschlagsdiagnose [RAM name from V530, voted 10]" UWORD M_FORMULA_0080 0 0 0 65535 ECU_ADDRESS 0x3FD52C /end MEASUREMENT
/begin MEASUREMENT lam_diag_reg_t_b1 "LA-Regleranschlag - Start [RAM name from V530, voted 3]" UWORD M_FORMULA_0010 0 0 0 65535 ECU_ADDRESS 0x3FD530 /end MEASUREMENT
/begin MEASUREMENT lam_diag_reg_io_t_b1 "LA-Regleranschlag - Heilung [RAM name from V530, voted 3]" UWORD M_FORMULA_0010 0 0 0 65535 ECU_ADDRESS 0x3FD534 /end MEASUREMENT
/begin MEASUREMENT lam_diag_laa_io_t_b1 "LAA-Aanschlag - Heilung [RAM name from V530, voted 5]" UWORD M_FORMULA_0010 0 0 0 65535 ECU_ADDRESS 0x3FD53C /end MEASUREMENT
/begin MEASUREMENT lam_diag_laa_offs_t_b1 "LAA-Offsetanschlagszeit [RAM name from V530, voted 5]" UWORD M_FORMULA_0071 0 0 0 6553.5 ECU_ADDRESS 0x3FD540 /end MEASUREMENT
/begin MEASUREMENT lam_diag_laa_offs_t_b2 "LAA-Offsetanschlagszeit [RAM name from V530, voted 1]" UWORD M_FORMULA_0071 0 0 0 6553.5 ECU_ADDRESS 0x3FD542 /end MEASUREMENT
/begin MEASUREMENT lam_diag_laa_f_cnt_b1 "Zahler fuer LAA-Faktoranschlagszeit [RAM name from V530, voted 6]" UWORD M_FORMULA_0010 0 0 0 65535 ECU_ADDRESS 0x3FD544 /end MEASUREMENT
/begin MEASUREMENT lam_diag_laa_offs_cnt_b1 "Zeit fuer LAA-Offsetanschlagszeit [RAM name from V530, voted 6]" UWORD M_FORMULA_0010 0 0 0 65535 ECU_ADDRESS 0x3FD548 /end MEASUREMENT
/begin MEASUREMENT lam_w_b1.soll_zust_st "Zustandsautomat LAM_SOLL [RAM name from V530, voted 10]" UWORD NO_COMPU_METHOD 0 0 0 65535 ECU_ADDRESS 0x3FD550 FORMAT "%.4g" /end MEASUREMENT
/begin MEASUREMENT lam_w_b1.soll_st "LAM_SOLL-Status [RAM name from V530, voted 9]" UWORD NO_COMPU_METHOD 0 0 0 65535 ECU_ADDRESS 0x3FD552 FORMAT "%.4g" /end MEASUREMENT
/begin MEASUREMENT lam_w_b1.soll_stat "SOLL-Lambda entsprechend dem LAM_SOLL-Zustand [RAM name from V530, voted 2]" UWORD M_FORMULA_0025 0 0 0 3.999938965 ECU_ADDRESS 0x3FD554 /end MEASUREMENT
/begin MEASUREMENT lam_w_b1.soll_tau1 "TAU1 - SOLL-Filter [RAM name from V530, voted 1]" UWORD M_FORMULA_0761 0 0 0 2097.12 ECU_ADDRESS 0x3FD56C /end MEASUREMENT
/begin MEASUREMENT lam_w_b1.soll_kr_kats_offs "LAM-SOLL-OFFSET aus KR [RAM name from V530, voted 1]" SWORD M_FORMULA_0025 0 0 -2 1.999938965 ECU_ADDRESS 0x3FD57A /end MEASUREMENT
/begin MEASUREMENT lam_w_b2.soll_zust_st "Zustandsautomat LAM_SOLL [RAM name from V530, voted 2]" UWORD NO_COMPU_METHOD 0 0 0 65535 ECU_ADDRESS 0x3FD586 FORMAT "%.4g" /end MEASUREMENT
/begin MEASUREMENT lam_w_b2.soll_st "LAM_SOLL-Status [RAM name from V530, voted 2]" UWORD NO_COMPU_METHOD 0 0 0 65535 ECU_ADDRESS 0x3FD588 FORMAT "%.4g" /end MEASUREMENT
/begin MEASUREMENT lam_w_b2.soll_kr_kats_offs "LAM-SOLL-OFFSET aus KR [RAM name from V530, voted 1]" SWORD M_FORMULA_0025 0 0 -2 1.999938965 ECU_ADDRESS 0x3FD5B0 /end MEASUREMENT
/begin MEASUREMENT lam_soll_verz "verzoegertes SOLL-Lambda [RAM name from V530, voted 1]" UWORD M_FORMULA_0025 0 0 0 3.999938965 ECU_ADDRESS 0x3FD5BC /end MEASUREMENT
/begin MEASUREMENT lam_soll_tau1_abg "Zeitkonstante Abgassystem u. Sonde [RAM name from V530, voted 2]" UWORD M_FORMULA_0761 0 0 0 2097.12 ECU_ADDRESS 0x3FD5D2 /end MEASUREMENT
/begin MEASUREMENT ml_zyl_verz "verzoegerte zyl. Luftmasse in mg/ASP [RAM name from V530, voted 1]" SWORD M_FORMULA_0090 0 0 -3276.8 3276.7 ECU_ADDRESS 0x3FD5D4 /end MEASUREMENT
/begin MEASUREMENT lam_soll_start "SOLL-Lambda von START -> ML [RAM name from V530, voted 1]" UWORD M_FORMULA_0025 0 0 0 3.999938965 ECU_ADDRESS 0x3FD5EC /end MEASUREMENT
/begin MEASUREMENT lam_soll_wf_f "Korrekturfak. f. Zustand Warmlaufbetrieb [RAM name from V530, voted 2]" UWORD M_FORMULA_0073 0 0 0 63.99902344 ECU_ADDRESS 0x3FD5EE /end MEASUREMENT
/begin MEASUREMENT lam_soll_ms_kat_soll_max "max. gespeicherte Sauerstoffmasse im KAT [RAM name from V530, voted 1]" SWORD M_FORMULA_0090 0 0 -3276.8 3276.7 ECU_ADDRESS 0x3FD5F0 /end MEASUREMENT
/begin MEASUREMENT lam_soll_auss_f "Korrekturfak. f. Zustand Sicherheitskonzept [RAM name from V530, voted 2]" UWORD M_FORMULA_0073 0 0 0 63.99902344 ECU_ADDRESS 0x3FD608 /end MEASUREMENT
/begin MEASUREMENT lam_soll_auss_offs "OFFSET auf KATS-Lambda beim SK-Manager [RAM name from V530, voted 2]" UWORD M_FORMULA_0025 0 0 0 3.999938965 ECU_ADDRESS 0x3FD60A /end MEASUREMENT
/begin MEASUREMENT lam_soll_vl_norm_b1 "Uebergang nach Vollast [RAM name from V530, voted 3]" UBYTE NO_COMPU_METHOD 0 0 0 255 ECU_ADDRESS 0x3FD618 FORMAT "%.4g" /end MEASUREMENT
/begin MEASUREMENT lam_soll_ms_kat_trig_sa_b1 "Triggerung SA-Sauerstoffausrauemfunktion [RAM name from V530, voted 3]" UBYTE NO_COMPU_METHOD 0 0 0 255 ECU_ADDRESS 0x3FD61A FORMAT "%.4g" /end MEASUREMENT
/begin MEASUREMENT lank_ad_b1 "AD-Wert des NKAT-Signals [RAM name from V530, voted 2]" UWORD M_FORMULA_0536 0 0 0 319995.1172 ECU_ADDRESS 0x3FD686 /end MEASUREMENT
/begin MEASUREMENT lank_ad_b2 "AD-Wert des NKAT-Signals [RAM name from V530, voted 2]" UWORD M_FORMULA_0536 0 0 0 319995.1172 ECU_ADDRESS 0x3FD688 /end MEASUREMENT
/begin MEASUREMENT lank_us_b1 "NKAT-Sondensignal [RAM name from V530, voted 10]" UWORD M_FORMULA_0536 0 0 0 319995.1172 ECU_ADDRESS 0x3FD68A /end MEASUREMENT
/begin MEASUREMENT lank_us_b2 "NKAT-Sondensignal [RAM name from V530, voted 5]" UWORD M_FORMULA_0536 0 0 0 319995.1172 ECU_ADDRESS 0x3FD68C /end MEASUREMENT
/begin MEASUREMENT lank_us_filt_b1 "gefiltertes NKAT-Signal f. NKAT-Regler [RAM name from V530, voted 6]" UWORD M_FORMULA_0536 0 0 0 319995.1172 ECU_ADDRESS 0x3FD68E /end MEASUREMENT
/begin MEASUREMENT lank_sgn_b1 "NKAT-Signallage [RAM name from V530, voted 4]" UBYTE NO_COMPU_METHOD 0 0 0 255 ECU_ADDRESS 0x3FD692 FORMAT "%.4g" /end MEASUREMENT
/begin MEASUREMENT lank_lam_b1 "NKAT-Lambdawert [RAM name from V530, voted 8]" UWORD M_FORMULA_0025 0 0 0 3.999938965 ECU_ADDRESS 0x3FD694 /end MEASUREMENT
/begin MEASUREMENT lank_lam_b2 "NKAT-Lambdawert [RAM name from V530, voted 1]" UWORD M_FORMULA_0025 0 0 0 3.999938965 ECU_ADDRESS 0x3FD696 /end MEASUREMENT
/begin MEASUREMENT lank_st_ein_b1 "NKAT-Status EIN-Bedingungen [RAM name from V530, voted 12]" UWORD M_FORMULA_0080 0 0 0 65535 ECU_ADDRESS 0x3FD698 /end MEASUREMENT
/begin MEASUREMENT lank_st_sonde_b1 "Betriebsbereitschaft NKAT-Sonde [RAM name from V530, voted 12]" UWORD NO_COMPU_METHOD 0 0 0 65535 ECU_ADDRESS 0x3FD698 FORMAT "%.4g" /end MEASUREMENT
/begin MEASUREMENT lank_st_us_tau_t_b1 "Einschwingzeit fuer NKAT-Regler [RAM name from V530, voted 12]" UWORD NO_COMPU_METHOD 0 0 0 65535 ECU_ADDRESS 0x3FD698 FORMAT "%.4g" /end MEASUREMENT
/begin MEASUREMENT lank_st_ein_b2 "NKAT-Status EIN-Bedingungen [RAM name from V530, voted 1]" UWORD M_FORMULA_0080 0 0 0 65535 ECU_ADDRESS 0x3FD69A /end MEASUREMENT
/begin MEASUREMENT lank_st_sonde_b2 "Betriebsbereitschaft NKAT-Sonde [RAM name from V530, voted 1]" UWORD NO_COMPU_METHOD 0 0 0 65535 ECU_ADDRESS 0x3FD69A FORMAT "%.4g" /end MEASUREMENT
/begin MEASUREMENT lank_st_us_tau_t_b2 "Einschwingzeit fuer NKAT-Regler [RAM name from V530, voted 1]" UWORD NO_COMPU_METHOD 0 0 0 65535 ECU_ADDRESS 0x3FD69A FORMAT "%.4g" /end MEASUREMENT
/begin MEASUREMENT lank_st_aus_b1 "NKAT-Status AUS-Bedingungen [RAM name from V530, voted 9]" UWORD M_FORMULA_0080 0 0 0 65535 ECU_ADDRESS 0x3FD69C /end MEASUREMENT
/begin MEASUREMENT lank_st_aus_diag_b1 "Diag.Fehler vorhanden [RAM name from V530, voted 9]" UWORD NO_COMPU_METHOD 0 0 0 65535 ECU_ADDRESS 0x3FD69C FORMAT "%.4g" /end MEASUREMENT
/begin MEASUREMENT lank_st_aus_n_b1 "N-Schwelle verletzt [RAM name from V530, voted 9]" UWORD NO_COMPU_METHOD 0 0 0 65535 ECU_ADDRESS 0x3FD69C FORMAT "%.4g" /end MEASUREMENT
/begin MEASUREMENT lank_st_aus_rf_b1 "RF-Schwelle verletzt [RAM name from V530, voted 9]" UWORD NO_COMPU_METHOD 0 0 0 65535 ECU_ADDRESS 0x3FD69C FORMAT "%.4g" /end MEASUREMENT
/begin MEASUREMENT lank_st_aus_tkat_b1 "TKAT-Schwelle verletzt [RAM name from V530, voted 9]" UWORD NO_COMPU_METHOD 0 0 0 65535 ECU_ADDRESS 0x3FD69C FORMAT "%.4g" /end MEASUREMENT
/begin MEASUREMENT lavk_diag_ia_sa_openload_b1 "IA-OPENLOAD bei SA-Diag. [RAM name from V530, voted 8]" UWORD NO_COMPU_METHOD 0 0 0 65535 ECU_ADDRESS 0x3F9068 FORMAT "%.4g" /end MEASUREMENT
/begin MEASUREMENT lavk_diag_ip_dynamik_check_b1 "Dynamikdiagnose IP-OL ausserhalb Band. [RAM name from V530, voted 8]" UWORD NO_COMPU_METHOD 0 0 0 65535 ECU_ADDRESS 0x3F9068 FORMAT "%.4g" /end MEASUREMENT
/begin MEASUREMENT lavk_diag_ip_plau_openload_b1 "IP/VM-OPENLOAD bei Plau-Diag. [RAM name from V530, voted 8]" UWORD NO_COMPU_METHOD 0 0 0 65535 ECU_ADDRESS 0x3F9068 FORMAT "%.4g" /end MEASUREMENT
/begin MEASUREMENT lavk_diag_ip_sa_openload_b1 "IP/VM-OPENLOAD bei SA-Diag. [RAM name from V530, voted 8]" UWORD NO_COMPU_METHOD 0 0 0 65535 ECU_ADDRESS 0x3F9068 FORMAT "%.4g" /end MEASUREMENT
/begin MEASUREMENT lavk_diag_ip_vm_sa_openload_b1 "IP/VM-VERDACHT bei SA-Diag. [RAM name from V530, voted 8]" UWORD NO_COMPU_METHOD 0 0 0 65535 ECU_ADDRESS 0x3F9068 FORMAT "%.4g" /end MEASUREMENT
/begin MEASUREMENT lavk_diag_st_b1 "Status DIAG-LAVK-Plausibilisierung [RAM name from V530, voted 8]" UWORD M_FORMULA_0080 0 0 0 65535 ECU_ADDRESS 0x3F9068 /end MEASUREMENT
/begin MEASUREMENT lavk_diag_un_plau_openload_b1 "UN-OPENLOAD bei Plau-Diag. [RAM name from V530, voted 8]" UWORD NO_COMPU_METHOD 0 0 0 65535 ECU_ADDRESS 0x3F9068 FORMAT "%.4g" /end MEASUREMENT
/begin MEASUREMENT lavk_obd_plau_oszi_off_st_b1 "UN-OL - Abschalten des ATIC42-Oszi [RAM name from V530, voted 9]" UWORD NO_COMPU_METHOD 0 0 0 65535 ECU_ADDRESS 0x3FD73A FORMAT "%.4g" /end MEASUREMENT
/begin MEASUREMENT lavk_obd_plau_st_b1 "Status OBD-LAVK-Plausibilisierung [RAM name from V530, voted 9]" UWORD M_FORMULA_0080 0 0 0 65535 ECU_ADDRESS 0x3FD73A /end MEASUREMENT
/begin MEASUREMENT lavk_obd_plau_status_b1 "Plausi-Diagnose-Status [RAM name from V530, voted 9]" UWORD NO_COMPU_METHOD 0 0 0 65535 ECU_ADDRESS 0x3FD73A FORMAT "%.4g" /end MEASUREMENT
/begin MEASUREMENT lavk_obd_plau_un_ol_diag_b1 "UN-OL-Diagnose abgelaufen [RAM name from V530, voted 9]" UWORD NO_COMPU_METHOD 0 0 0 65535 ECU_ADDRESS 0x3FD73A FORMAT "%.4g" /end MEASUREMENT
/begin MEASUREMENT lavk_obd_plau_oszi_off_st_b2 "UN-OL - Abschalten des ATIC42-Oszi [RAM name from V530, voted 1]" UWORD NO_COMPU_METHOD 0 0 0 65535 ECU_ADDRESS 0x3FD73C FORMAT "%.4g" /end MEASUREMENT
/begin MEASUREMENT lavk_obd_plau_st_b2 "Status OBD-LAVK-Plausibilisierung [RAM name from V530, voted 1]" UWORD M_FORMULA_0080 0 0 0 65535 ECU_ADDRESS 0x3FD73C /end MEASUREMENT
/begin MEASUREMENT lavk_obd_plau_status_b2 "Plausi-Diagnose-Status [RAM name from V530, voted 1]" UWORD NO_COMPU_METHOD 0 0 0 65535 ECU_ADDRESS 0x3FD73C FORMAT "%.4g" /end MEASUREMENT
/begin MEASUREMENT lavk_obd_plau_un_ol_diag_b2 "UN-OL-Diagnose abgelaufen [RAM name from V530, voted 1]" UWORD NO_COMPU_METHOD 0 0 0 65535 ECU_ADDRESS 0x3FD73C FORMAT "%.4g" /end MEASUREMENT
/begin MEASUREMENT lavk_obd_plau_oszi_off_b1 "Ausschaltzeit des ATIC42-Oszi f. UN-OL-Diag. [RAM name from V530, voted 3]" UWORD M_FORMULA_0071 0 0 0 6553.5 ECU_ADDRESS 0x3FD73E /end MEASUREMENT
/begin MEASUREMENT lavk_obd_plau_t_b1 "Verzoegerungszeit Plausi-Diag. [RAM name from V530, voted 8]" UWORD M_FORMULA_0071 0 0 0 6553.5 ECU_ADDRESS 0x3FD742 /end MEASUREMENT
/begin MEASUREMENT lavk_obd_plau_f_cnt_b1 "Fehlerzaehler FETT-Plausi [RAM name from V530, voted 4]" UWORD M_FORMULA_0010 0 0 0 65535 ECU_ADDRESS 0x3FD746 /end MEASUREMENT
/begin MEASUREMENT lavk_obd_plau_m_cnt_b1 "Fehlerzaehler MAGER-Plausi [RAM name from V530, voted 5]" UWORD M_FORMULA_0010 0 0 0 65535 ECU_ADDRESS 0x3FD74A /end MEASUREMENT
/begin MEASUREMENT lavk_obd_plau_ol_cnt_b1 "Fehlerzaehler OL-Diag IP/VM [RAM name from V530, voted 4]" UWORD M_FORMULA_0010 0 0 0 65535 ECU_ADDRESS 0x3FD74E /end MEASUREMENT
/begin MEASUREMENT lavk_obd_plau_ip_stabil_t_b1 "min. Zeit auf Erkennung DYNAMIK [RAM name from V530, voted 4]" UWORD M_FORMULA_0668 0 0 0 6553500 ECU_ADDRESS 0x3FD752 /end MEASUREMENT
/begin MEASUREMENT lavk_obd_sa_st_b1 "Status OBD-LAVK-SA-Pruefung [RAM name from V530, voted 1]" UWORD NO_COMPU_METHOD 0 0 0 65535 ECU_ADDRESS 0x3FD756 FORMAT "%.4g" /end MEASUREMENT
/begin MEASUREMENT lavk_obd_sa_t_b1 "Verzoegerungszeit SA-Diag. [RAM name from V530, voted 1]" UWORD M_FORMULA_0071 0 0 0 6553.5 ECU_ADDRESS 0x3FD75A /end MEASUREMENT
/begin MEASUREMENT lavk_obd_tl_st_b1 "Status OBD-LAVK-Plausibilisierung [RAM name from V530, voted 2]" UWORD NO_COMPU_METHOD 0 0 0 65535 ECU_ADDRESS 0x3FD762 FORMAT "%.4g" /end MEASUREMENT
/begin MEASUREMENT lavk_obd_tl_t_b1 "Verzoegerungszeit TL/VL-Diag. [RAM name from V530, voted 2]" UWORD M_FORMULA_0071 0 0 0 6553.5 ECU_ADDRESS 0x3FD766 /end MEASUREMENT
/begin MEASUREMENT lavk_obd_act_aktiv_b1 "Aktivierung aktive Plausi-Diag. [RAM name from V530, voted 27]" UWORD NO_COMPU_METHOD 0 0 0 65535 ECU_ADDRESS 0x3FD76E FORMAT "%.4g" /end MEASUREMENT
/begin MEASUREMENT lavk_obd_act_anf_b1 "Anforderung aktive Plausi-Diag. [RAM name from V530, voted 27]" UWORD NO_COMPU_METHOD 0 0 0 65535 ECU_ADDRESS 0x3FD76E FORMAT "%.4g" /end MEASUREMENT
/begin MEASUREMENT lavk_obd_act_ende_b1 "NKAT-FETT-Diagnose abgelaufen [RAM name from V530, voted 27]" UWORD NO_COMPU_METHOD 0 0 0 65535 ECU_ADDRESS 0x3FD76E FORMAT "%.4g" /end MEASUREMENT
/begin MEASUREMENT lavk_obd_act_fett_anf_b1 "FETT-Diag.Anforderung nach Mager-Diag. [RAM name from V530, voted 27]" UWORD NO_COMPU_METHOD 0 0 0 65535 ECU_ADDRESS 0x3FD76E FORMAT "%.4g" /end MEASUREMENT
/begin MEASUREMENT lavk_obd_act_fett_b1 "FETT-Diagnose - aktive Plausi-Diag. [RAM name from V530, voted 27]" UWORD NO_COMPU_METHOD 0 0 0 65535 ECU_ADDRESS 0x3FD76E FORMAT "%.4g" /end MEASUREMENT
/begin MEASUREMENT lavk_obd_act_mager_anf_b1 "Mager-Diag.Anforderung nach FETT-Diag. [RAM name from V530, voted 27]" UWORD NO_COMPU_METHOD 0 0 0 65535 ECU_ADDRESS 0x3FD76E FORMAT "%.4g" /end MEASUREMENT
/begin MEASUREMENT lavk_obd_act_mager_b1 "Mager-Diagnose - aktive Plausi-Diag. [RAM name from V530, voted 27]" UWORD NO_COMPU_METHOD 0 0 0 65535 ECU_ADDRESS 0x3FD76E FORMAT "%.4g" /end MEASUREMENT
/begin MEASUREMENT lavk_obd_act_nkat_f_io_b1 "NKAT-FETT-Diagnose i.O. [RAM name from V530, voted 27]" UWORD NO_COMPU_METHOD 0 0 0 65535 ECU_ADDRESS 0x3FD76E FORMAT "%.4g" /end MEASUREMENT
/begin MEASUREMENT lavk_obd_act_nkat_f_nio_b1 "NKAT-FETT-Diagnose n.i.O. [RAM name from V530, voted 27]" UWORD NO_COMPU_METHOD 0 0 0 65535 ECU_ADDRESS 0x3FD76E FORMAT "%.4g" /end MEASUREMENT
/begin MEASUREMENT lavk_obd_act_nkat_m_io_b1 "NKAT-Mager-Diagnose i.O. [RAM name from V530, voted 27]" UWORD NO_COMPU_METHOD 0 0 0 65535 ECU_ADDRESS 0x3FD76E FORMAT "%.4g" /end MEASUREMENT
/begin MEASUREMENT lavk_obd_act_nkat_m_nio_b1 "NKAT-Mager-Diagnose n.i.O. [RAM name from V530, voted 27]" UWORD NO_COMPU_METHOD 0 0 0 65535 ECU_ADDRESS 0x3FD76E FORMAT "%.4g" /end MEASUREMENT
/begin MEASUREMENT lavk_obd_act_st_b1 "Status aktive Plausi.Diagnose [RAM name from V530, voted 27]" UWORD M_FORMULA_0080 0 0 0 65535 ECU_ADDRESS 0x3FD76E /end MEASUREMENT
/begin MEASUREMENT lavk_obd_act_vkat_f_io_b1 "VKAT-FETT-Diagnose i.O. [RAM name from V530, voted 27]" UWORD NO_COMPU_METHOD 0 0 0 65535 ECU_ADDRESS 0x3FD76E FORMAT "%.4g" /end MEASUREMENT
/begin MEASUREMENT lavk_obd_act_vkat_f_nio_b1 "VKAT-FETT-Diagnose n.i.O. [RAM name from V530, voted 27]" UWORD NO_COMPU_METHOD 0 0 0 65535 ECU_ADDRESS 0x3FD76E FORMAT "%.4g" /end MEASUREMENT
/begin MEASUREMENT lavk_obd_act_vkat_m_io_b1 "VKAT-Mager-Diagnose i.O. [RAM name from V530, voted 27]" UWORD NO_COMPU_METHOD 0 0 0 65535 ECU_ADDRESS 0x3FD76E FORMAT "%.4g" /end MEASUREMENT
/begin MEASUREMENT lavk_obd_act_vkat_m_nio_b1 "VKAT-Mager-Diagnose n.i.O. [RAM name from V530, voted 27]" UWORD NO_COMPU_METHOD 0 0 0 65535 ECU_ADDRESS 0x3FD76E FORMAT "%.4g" /end MEASUREMENT
/begin MEASUREMENT lavk_obd_act_aktiv_b2 "Aktivierung aktive Plausi-Diag. [RAM name from V530, voted 6]" UWORD NO_COMPU_METHOD 0 0 0 65535 ECU_ADDRESS 0x3FD770 FORMAT "%.4g" /end MEASUREMENT
/begin MEASUREMENT lavk_obd_act_anf_b2 "Anforderung aktive Plausi-Diag. [RAM name from V530, voted 6]" UWORD NO_COMPU_METHOD 0 0 0 65535 ECU_ADDRESS 0x3FD770 FORMAT "%.4g" /end MEASUREMENT
/begin MEASUREMENT lavk_obd_act_ende_b2 "NKAT-FETT-Diagnose abgelaufen [RAM name from V530, voted 6]" UWORD NO_COMPU_METHOD 0 0 0 65535 ECU_ADDRESS 0x3FD770 FORMAT "%.4g" /end MEASUREMENT
/begin MEASUREMENT lavk_obd_act_fett_anf_b2 "FETT-Diag.Anforderung nach Mager-Diag. [RAM name from V530, voted 6]" UWORD NO_COMPU_METHOD 0 0 0 65535 ECU_ADDRESS 0x3FD770 FORMAT "%.4g" /end MEASUREMENT
/begin MEASUREMENT lavk_obd_act_fett_b2 "FETT-Diagnose - aktive Plausi-Diag. [RAM name from V530, voted 6]" UWORD NO_COMPU_METHOD 0 0 0 65535 ECU_ADDRESS 0x3FD770 FORMAT "%.4g" /end MEASUREMENT
/begin MEASUREMENT lavk_obd_act_mager_anf_b2 "Mager-Diag.Anforderung nach FETT-Diag. [RAM name from V530, voted 6]" UWORD NO_COMPU_METHOD 0 0 0 65535 ECU_ADDRESS 0x3FD770 FORMAT "%.4g" /end MEASUREMENT
/begin MEASUREMENT lavk_obd_act_mager_b2 "Mager-Diagnose - aktive Plausi-Diag. [RAM name from V530, voted 6]" UWORD NO_COMPU_METHOD 0 0 0 65535 ECU_ADDRESS 0x3FD770 FORMAT "%.4g" /end MEASUREMENT
/begin MEASUREMENT lavk_obd_act_nkat_f_io_b2 "NKAT-FETT-Diagnose i.O. [RAM name from V530, voted 6]" UWORD NO_COMPU_METHOD 0 0 0 65535 ECU_ADDRESS 0x3FD770 FORMAT "%.4g" /end MEASUREMENT
/begin MEASUREMENT lavk_obd_act_nkat_f_nio_b2 "NKAT-FETT-Diagnose n.i.O. [RAM name from V530, voted 6]" UWORD NO_COMPU_METHOD 0 0 0 65535 ECU_ADDRESS 0x3FD770 FORMAT "%.4g" /end MEASUREMENT
/begin MEASUREMENT lavk_obd_act_nkat_m_io_b2 "NKAT-Mager-Diagnose i.O. [RAM name from V530, voted 6]" UWORD NO_COMPU_METHOD 0 0 0 65535 ECU_ADDRESS 0x3FD770 FORMAT "%.4g" /end MEASUREMENT
/begin MEASUREMENT lavk_obd_act_nkat_m_nio_b2 "NKAT-Mager-Diagnose n.i.O. [RAM name from V530, voted 6]" UWORD NO_COMPU_METHOD 0 0 0 65535 ECU_ADDRESS 0x3FD770 FORMAT "%.4g" /end MEASUREMENT
/begin MEASUREMENT lavk_obd_act_st_b2 "Status aktive Plausi.Diagnose [RAM name from V530, voted 6]" UWORD M_FORMULA_0080 0 0 0 65535 ECU_ADDRESS 0x3FD770 /end MEASUREMENT
/begin MEASUREMENT lavk_obd_act_vkat_f_io_b2 "VKAT-FETT-Diagnose i.O. [RAM name from V530, voted 6]" UWORD NO_COMPU_METHOD 0 0 0 65535 ECU_ADDRESS 0x3FD770 FORMAT "%.4g" /end MEASUREMENT
/begin MEASUREMENT lavk_obd_act_vkat_f_nio_b2 "VKAT-FETT-Diagnose n.i.O. [RAM name from V530, voted 6]" UWORD NO_COMPU_METHOD 0 0 0 65535 ECU_ADDRESS 0x3FD770 FORMAT "%.4g" /end MEASUREMENT
/begin MEASUREMENT lavk_obd_act_vkat_m_io_b2 "VKAT-Mager-Diagnose i.O. [RAM name from V530, voted 6]" UWORD NO_COMPU_METHOD 0 0 0 65535 ECU_ADDRESS 0x3FD770 FORMAT "%.4g" /end MEASUREMENT
/begin MEASUREMENT lavk_obd_act_vkat_m_nio_b2 "VKAT-Mager-Diagnose n.i.O. [RAM name from V530, voted 6]" UWORD NO_COMPU_METHOD 0 0 0 65535 ECU_ADDRESS 0x3FD770 FORMAT "%.4g" /end MEASUREMENT
/begin MEASUREMENT lavk_obd_act_verz_t_b2 "Verzoegerungszeit [RAM name from V530, voted 2]" UWORD M_FORMULA_0071 0 0 0 6553.5 ECU_ADDRESS 0x3FD774 /end MEASUREMENT
/begin MEASUREMENT lavk_obd_act_vk_m_cnt_b1 "Zaehler VKAT - Diagnose MAGER [RAM name from V530, voted 4]" UWORD M_FORMULA_0010 0 0 0 65535 ECU_ADDRESS 0x3FD776 /end MEASUREMENT
/begin MEASUREMENT lavk_obd_act_vk_m_cnt_b2 "Zaehler VKAT - Diagnose MAGER [RAM name from V530, voted 2]" UWORD M_FORMULA_0010 0 0 0 65535 ECU_ADDRESS 0x3FD778 /end MEASUREMENT
/begin MEASUREMENT lavk_obd_act_nk_m_cnt_b2 "Zaehler NKAT - Diagnose MAGER [RAM name from V530, voted 2]" UWORD M_FORMULA_0010 0 0 0 65535 ECU_ADDRESS 0x3FD77C /end MEASUREMENT
/begin MEASUREMENT lavk_obd_act_nk_f_cnt_b2 "Zaehler VKAT - Diagnose FETT [RAM name from V530, voted 2]" UWORD M_FORMULA_0010 0 0 0 65535 ECU_ADDRESS 0x3FD780 /end MEASUREMENT
/begin MEASUREMENT lavk_obd_act_vk_f_cnt_b1 "Zaehler NKAT - Diagnose FETT [RAM name from V530, voted 5]" UWORD M_FORMULA_0010 0 0 0 65535 ECU_ADDRESS 0x3FD782 /end MEASUREMENT
/begin MEASUREMENT lavk_obd_act_vk_f_cnt_b2 "Zaehler NKAT - Diagnose FETT [RAM name from V530, voted 2]" UWORD M_FORMULA_0010 0 0 0 65535 ECU_ADDRESS 0x3FD784 /end MEASUREMENT
/begin MEASUREMENT lavk_obd_act_exd_time_b1 "Prueflauf Freigabezeit [RAM name from V530, voted 9]" UWORD M_FORMULA_0854 0 0 0 6553.5 ECU_ADDRESS 0x3FD786 /end MEASUREMENT
/begin MEASUREMENT lavk_obd_act_exd_time_b2 "Prueflauf Freigabezeit [RAM name from V530, voted 3]" UWORD M_FORMULA_0854 0 0 0 6553.5 ECU_ADDRESS 0x3FD788 /end MEASUREMENT
/begin MEASUREMENT lavk_spi_buffer_ret "SPi-Antwortpuffer [RAM name from V530, voted 3]" UWORD M_FORMULA_0010 0 0 0 65535 ECU_ADDRESS 0x3FD792 /end MEASUREMENT
/begin MEASUREMENT lavk_atic42_mode_b1 "SPI Mode ATIC42 [RAM name from V530, voted 2]" UBYTE NO_COMPU_METHOD 0 0 0 255 ECU_ADDRESS 0x3FD794 FORMAT "%.4g" /end MEASUREMENT
/begin MEASUREMENT lavk_atic42_cnt_b1 "Ablaufzaeker SPI ATIC42 [RAM name from V530, voted 2]" UBYTE M_FORMULA_0003 0 0 0 255 ECU_ADDRESS 0x3FD796 /end MEASUREMENT
/begin MEASUREMENT lavk_atic42_icp_enable_b1 "ATIC42 ICP Einspeisung [RAM name from V530, voted 3]" UBYTE NO_COMPU_METHOD 0 0 0 255 ECU_ADDRESS 0x3FD798 FORMAT "%.4g" /end MEASUREMENT
/begin MEASUREMENT lavk_atic42_ip_gain_b1 "ATIC42 Pumpstromverstaerkung [RAM name from V530, voted 3]" UBYTE NO_COMPU_METHOD 0 0 0 255 ECU_ADDRESS 0x3FD798 FORMAT "%.4g" /end MEASUREMENT
/begin MEASUREMENT lavk_atic42_ip_loop_enable_spi_b1 "ATIC42 Pumpstrom Regelung [RAM name from V530, voted 3]" UBYTE NO_COMPU_METHOD 0 0 0 255 ECU_ADDRESS 0x3FD798 FORMAT "%.4g" /end MEASUREMENT
/begin MEASUREMENT lavk_atic42_ip_offset_meas_b1 "ATIC42 Pumpstromoffset-Messung [RAM name from V530, voted 3]" UBYTE NO_COMPU_METHOD 0 0 0 255 ECU_ADDRESS 0x3FD798 FORMAT "%.4g" /end MEASUREMENT
/begin MEASUREMENT lavk_atic42_ip_st_b1 "ATIC42-IP-Status [RAM name from V530, voted 3]" UBYTE M_FORMULA_0037 0 0 0 255 ECU_ADDRESS 0x3FD798 /end MEASUREMENT
/begin MEASUREMENT lavk_atic42_ri_range_b1 "ATIC42 Innenwiderstands Messbereich [RAM name from V530, voted 3]" UBYTE NO_COMPU_METHOD 0 0 0 255 ECU_ADDRESS 0x3FD7A8 FORMAT "%.4g" /end MEASUREMENT
/begin MEASUREMENT lavk_atic42_ip_loop_enable_b1 "ATIC42 Pumpstrom Regelung [RAM name from V530, voted 1]" UBYTE NO_COMPU_METHOD 0 0 0 255 ECU_ADDRESS 0x3FD7AA FORMAT "%.4g" /end MEASUREMENT
/begin MEASUREMENT lavk_atic42_pin_diag_b1 "ATIC42 - Pin Diagnose [RAM name from V530, voted 2]" UBYTE M_FORMULA_0003 0 0 0 255 ECU_ADDRESS 0x3FD7BA /end MEASUREMENT
/begin MEASUREMENT lavk_atic42_diag_byte_b1 "ATIC42 - Diagnose Byte [RAM name from V530, voted 2]" UBYTE M_FORMULA_0003 0 0 0 255 ECU_ADDRESS 0x3FD7BC /end MEASUREMENT
/begin MEASUREMENT lavk_atic42_identity_b1 "lavk_atic42_identity_b1 [RAM name from V530, voted 2]" UWORD M_FORMULA_0010 0 0 0 65535 ECU_ADDRESS 0x3FD7BE /end MEASUREMENT
/begin MEASUREMENT lavk_atic42_diag_st_b1 "lavk_atic42_diag_st_b1 [RAM name from V530, voted 2]" UBYTE NO_COMPU_METHOD 0 0 0 255 ECU_ADDRESS 0x3FD7C2 FORMAT "%.4g" /end MEASUREMENT
/begin MEASUREMENT lshnk.ein_b1 "NKAT-LSH-EIN [RAM name from V530, voted 9]" UWORD NO_COMPU_METHOD 0 0 0 65535 ECU_ADDRESS 0x3FD82C FORMAT "%.4g" /end MEASUREMENT
/begin MEASUREMENT lshnk.exd_aktiv_b1 "NKAT-LSH: Tester [RAM name from V530, voted 9]" UWORD NO_COMPU_METHOD 0 0 0 65535 ECU_ADDRESS 0x3FD82C FORMAT "%.4g" /end MEASUREMENT
/begin MEASUREMENT lshnk.taup_b1 "NKAT-LSH-TAUP [RAM name from V530, voted 9]" UWORD NO_COMPU_METHOD 0 0 0 65535 ECU_ADDRESS 0x3FD82C FORMAT "%.4g" /end MEASUREMENT
/begin MEASUREMENT lshnk_b1.st "NKAT-LSH-Status [RAM name from V530, voted 9]" UWORD M_FORMULA_0080 0 0 0 65535 ECU_ADDRESS 0x3FD82C /end MEASUREMENT
/begin MEASUREMENT lshnk_b1.ta "Ansteuertastverhaeltnis NKAT [RAM name from V530, voted 4]" UWORD M_FORMULA_0920 0 0 0 799.987793 ECU_ADDRESS 0x3FD82E /end MEASUREMENT
/begin MEASUREMENT lshnk.ein_b2 "NKAT-LSH-EIN [RAM name from V530, voted 2]" UWORD NO_COMPU_METHOD 0 0 0 65535 ECU_ADDRESS 0x3FD832 FORMAT "%.4g" /end MEASUREMENT
/begin MEASUREMENT lshnk.exd_aktiv_b2 "NKAT-LSH: Tester [RAM name from V530, voted 2]" UWORD NO_COMPU_METHOD 0 0 0 65535 ECU_ADDRESS 0x3FD832 FORMAT "%.4g" /end MEASUREMENT
/begin MEASUREMENT lshnk.taup_b2 "NKAT-LSH-TAUP [RAM name from V530, voted 2]" UWORD NO_COMPU_METHOD 0 0 0 65535 ECU_ADDRESS 0x3FD832 FORMAT "%.4g" /end MEASUREMENT
/begin MEASUREMENT lshnk_b2.st "NKAT-LSH-Status [RAM name from V530, voted 2]" UWORD M_FORMULA_0080 0 0 0 65535 ECU_ADDRESS 0x3FD832 /end MEASUREMENT
/begin MEASUREMENT lshnk_b2.ta "Ansteuertastverhaeltnis NKAT [RAM name from V530, voted 3]" UWORD M_FORMULA_0920 0 0 0 799.987793 ECU_ADDRESS 0x3FD834 /end MEASUREMENT
/begin MEASUREMENT lshnk_exd_timeout_b1 "KWP-Ansteuerzeit [RAM name from V530, voted 2]" UWORD M_FORMULA_0921 0 0 0 655.35 ECU_ADDRESS 0x3FD838 /end MEASUREMENT
/begin MEASUREMENT lshnk_diag.aktiv_b1 "NKAT-LSH-Diag-AKTIV [RAM name from V530, voted 11]" UWORD NO_COMPU_METHOD 0 0 0 65535 ECU_ADDRESS 0x3FD83C FORMAT "%.4g" /end MEASUREMENT
/begin MEASUREMENT lshnk_diag.info_b1 "NKAT-LSH-Diag-INFO [RAM name from V530, voted 11]" UWORD NO_COMPU_METHOD 0 0 0 65535 ECU_ADDRESS 0x3FD83C FORMAT "%.4g" /end MEASUREMENT
/begin MEASUREMENT lshnk_diag.sh_to_x_sperren_b1 "NKAT-LSH-Einschalten aufgrund elektr. Diag. sperren [RAM name from V530, voted 11]" UWORD NO_COMPU_METHOD 0 0 0 65535 ECU_ADDRESS 0x3FD83C FORMAT "%.4g" /end MEASUREMENT
/begin MEASUREMENT lshnk_diag_b1.st "NKAT-LSH-Diag.-Status [RAM name from V530, voted 11]" UWORD M_FORMULA_0080 0 0 0 65535 ECU_ADDRESS 0x3FD83C /end MEASUREMENT
/begin MEASUREMENT lshnk_diag_b1.i_ad "Heizerstrom NKAT [RAM name from V530, voted 1]" UWORD M_FORMULA_0925 0 0 0 304.8139535 ECU_ADDRESS 0x3FD83E /end MEASUREMENT
/begin MEASUREMENT lshnk_diag.aktiv_b2 "NKAT-LSH-Diag-AKTIV [RAM name from V530, voted 7]" UWORD NO_COMPU_METHOD 0 0 0 65535 ECU_ADDRESS 0x3FD84A FORMAT "%.4g" /end MEASUREMENT
/begin MEASUREMENT lshnk_diag.info_b2 "NKAT-LSH-Diag-INFO [RAM name from V530, voted 7]" UWORD NO_COMPU_METHOD 0 0 0 65535 ECU_ADDRESS 0x3FD84A FORMAT "%.4g" /end MEASUREMENT
/begin MEASUREMENT lshnk_diag.sh_to_x_sperren_b2 "NKAT-LSH-Einschalten aufgrund elektr. Diag. sperren [RAM name from V530, voted 7]" UWORD NO_COMPU_METHOD 0 0 0 65535 ECU_ADDRESS 0x3FD84A FORMAT "%.4g" /end MEASUREMENT
/begin MEASUREMENT lshnk_diag_b2.st "NKAT-LSH-Diag.-Status [RAM name from V530, voted 7]" UWORD M_FORMULA_0080 0 0 0 65535 ECU_ADDRESS 0x3FD84A /end MEASUREMENT
/begin MEASUREMENT lshnk_diag_b2.i_ad "Heizerstrom NKAT [RAM name from V530, voted 1]" UWORD M_FORMULA_0925 0 0 0 304.8139535 ECU_ADDRESS 0x3FD84C /end MEASUREMENT
/begin MEASUREMENT lshnk_t_ein "Verzoegerungszeit nach START [RAM name from V530, voted 2]" UWORD M_FORMULA_0593 0 0 0 65535 ECU_ADDRESS 0x3FD85A /end MEASUREMENT
/begin MEASUREMENT lshvk.begr_max_b1 "VKAT-LSH: MAX-Begrenzung [RAM name from V530, voted 10]" UWORD NO_COMPU_METHOD 0 0 0 65535 ECU_ADDRESS 0x3FD886 FORMAT "%.4g" /end MEASUREMENT
/begin MEASUREMENT lshvk.begr_min_b1 "VKAT-LSH: MIN-Begrenzung [RAM name from V530, voted 10]" UWORD NO_COMPU_METHOD 0 0 0 65535 ECU_ADDRESS 0x3FD886 FORMAT "%.4g" /end MEASUREMENT
/begin MEASUREMENT lshvk.exd_aktiv_b1 "VKAT-LSH: Tester [RAM name from V530, voted 10]" UWORD NO_COMPU_METHOD 0 0 0 65535 ECU_ADDRESS 0x3FD886 FORMAT "%.4g" /end MEASUREMENT
/begin MEASUREMENT lshvk.freig_b1 "VKAT-LSH_FREIG [RAM name from V530, voted 10]" UWORD NO_COMPU_METHOD 0 0 0 65535 ECU_ADDRESS 0x3FD886 FORMAT "%.4g" /end MEASUREMENT
/begin MEASUREMENT lshvk.max_temp_b1 "VKAT-LSH-MAX-TEMP [RAM name from V530, voted 10]" UWORD NO_COMPU_METHOD 0 0 0 65535 ECU_ADDRESS 0x3FD886 FORMAT "%.4g" /end MEASUREMENT
/begin MEASUREMENT lshvk.min_temp_b1 "VKAT-LSH-MIN-TEMP [RAM name from V530, voted 10]" UWORD NO_COMPU_METHOD 0 0 0 65535 ECU_ADDRESS 0x3FD886 FORMAT "%.4g" /end MEASUREMENT
/begin MEASUREMENT lshvk.reg_b1 "VKAT-LSH_REG [RAM name from V530, voted 10]" UWORD NO_COMPU_METHOD 0 0 0 65535 ECU_ADDRESS 0x3FD886 FORMAT "%.4g" /end MEASUREMENT
/begin MEASUREMENT lshvk.temp_b1 "VKAT-LSH-TEMP [RAM name from V530, voted 10]" UWORD NO_COMPU_METHOD 0 0 0 65535 ECU_ADDRESS 0x3FD886 FORMAT "%.4g" /end MEASUREMENT
/begin MEASUREMENT lshvk_b1.st "VKAT-LSH-Status [RAM name from V530, voted 10]" UWORD M_FORMULA_0080 0 0 0 65535 ECU_ADDRESS 0x3FD886 /end MEASUREMENT
/begin MEASUREMENT lshvk_b1.temp_ist_roh "ungefilterte IST-Temp. VKAT [RAM name from V530, voted 1]" SWORD M_FORMULA_0791 0 0 -32768 32767 ECU_ADDRESS 0x3FD888 /end MEASUREMENT
/begin MEASUREMENT lshvk_b1.temp_ist "IST-Temp. VKAT [RAM name from V530, voted 3]" SWORD M_FORMULA_0791 0 0 -32768 32767 ECU_ADDRESS 0x3FD88A /end MEASUREMENT
/begin MEASUREMENT lshvk_b1.temp_heiz "IST-Temp. VKAT - Heizleistung [RAM name from V530, voted 1]" SWORD M_FORMULA_0023 0 0 -3550 3003.5 ECU_ADDRESS 0x3FD88C /end MEASUREMENT
/begin MEASUREMENT lshvk_b1.r_mess "AD-Wert/Sondenwiderstand VKAT [RAM name from V530, voted 2]" UWORD M_FORMULA_0934 0 0 0 319995.1172 ECU_ADDRESS 0x3FD88E /end MEASUREMENT
/begin MEASUREMENT lshvk_b1.tv_reg "hochaufgeloestes TV VKAT [RAM name from V530, voted 1]" UWORD M_FORMULA_0935 0 0 0 3199.951172 ECU_ADDRESS 0x3FD898 /end MEASUREMENT
/begin MEASUREMENT lshvk_b1.tv_lim "aenderungsbegr. Tastverhaeltnis VKAT [RAM name from V530, voted 4]" UWORD M_FORMULA_0935 0 0 0 3199.951172 ECU_ADDRESS 0x3FD8A4 /end MEASUREMENT
/begin MEASUREMENT lshvk.begr_max_b2 "VKAT-LSH: MAX-Begrenzung [RAM name from V530, voted 4]" UWORD NO_COMPU_METHOD 0 0 0 65535 ECU_ADDRESS 0x3FD8AC FORMAT "%.4g" /end MEASUREMENT
/begin MEASUREMENT lshvk.begr_min_b2 "VKAT-LSH: MIN-Begrenzung [RAM name from V530, voted 4]" UWORD NO_COMPU_METHOD 0 0 0 65535 ECU_ADDRESS 0x3FD8AC FORMAT "%.4g" /end MEASUREMENT
/begin MEASUREMENT lshvk.exd_aktiv_b2 "VKAT-LSH: Tester [RAM name from V530, voted 4]" UWORD NO_COMPU_METHOD 0 0 0 65535 ECU_ADDRESS 0x3FD8AC FORMAT "%.4g" /end MEASUREMENT
/begin MEASUREMENT lshvk.freig_b2 "VKAT-LSH_FREIG [RAM name from V530, voted 4]" UWORD NO_COMPU_METHOD 0 0 0 65535 ECU_ADDRESS 0x3FD8AC FORMAT "%.4g" /end MEASUREMENT
/begin MEASUREMENT lshvk.max_temp_b2 "VKAT-LSH-MAX-TEMP [RAM name from V530, voted 4]" UWORD NO_COMPU_METHOD 0 0 0 65535 ECU_ADDRESS 0x3FD8AC FORMAT "%.4g" /end MEASUREMENT
/begin MEASUREMENT lshvk.min_temp_b2 "VKAT-LSH-MIN-TEMP [RAM name from V530, voted 4]" UWORD NO_COMPU_METHOD 0 0 0 65535 ECU_ADDRESS 0x3FD8AC FORMAT "%.4g" /end MEASUREMENT
/begin MEASUREMENT lshvk.reg_b2 "VKAT-LSH_REG [RAM name from V530, voted 4]" UWORD NO_COMPU_METHOD 0 0 0 65535 ECU_ADDRESS 0x3FD8AC FORMAT "%.4g" /end MEASUREMENT
/begin MEASUREMENT lshvk.temp_b2 "VKAT-LSH-TEMP [RAM name from V530, voted 4]" UWORD NO_COMPU_METHOD 0 0 0 65535 ECU_ADDRESS 0x3FD8AC FORMAT "%.4g" /end MEASUREMENT
/begin MEASUREMENT lshvk_b2.st "VKAT-LSH-Status [RAM name from V530, voted 4]" UWORD M_FORMULA_0080 0 0 0 65535 ECU_ADDRESS 0x3FD8AC /end MEASUREMENT
/begin MEASUREMENT lshvk_b2.temp_ist_roh "ungefilterte IST-Temp. VKAT [RAM name from V530, voted 1]" SWORD M_FORMULA_0791 0 0 -32768 32767 ECU_ADDRESS 0x3FD8AE /end MEASUREMENT
/begin MEASUREMENT lshvk_b2.temp_ist "IST-Temp. VKAT [RAM name from V530, voted 1]" SWORD M_FORMULA_0791 0 0 -32768 32767 ECU_ADDRESS 0x3FD8B0 /end MEASUREMENT
/begin MEASUREMENT lshvk_b2.r_mess "AD-Wert/Sondenwiderstand VKAT [RAM name from V530, voted 2]" UWORD M_FORMULA_0934 0 0 0 319995.1172 ECU_ADDRESS 0x3FD8B4 /end MEASUREMENT
/begin MEASUREMENT lshvk_b2.tv_reg "hochaufgeloestes TV VKAT [RAM name from V530, voted 1]" UWORD M_FORMULA_0935 0 0 0 3199.951172 ECU_ADDRESS 0x3FD8BE /end MEASUREMENT
/begin MEASUREMENT lshvk_b2.tv_lim "aenderungsbegr. Tastverhaeltnis VKAT [RAM name from V530, voted 4]" UWORD M_FORMULA_0935 0 0 0 3199.951172 ECU_ADDRESS 0x3FD8CA /end MEASUREMENT
/begin MEASUREMENT lshvk_status "VKAT-LSH-Zusatzstatus [RAM name from V530, voted 6]" UBYTE M_FORMULA_0003 0 0 0 255 ECU_ADDRESS 0x3FD8D2 /end MEASUREMENT
/begin MEASUREMENT lshvk_exd_timeout_b1 "KWP-Ansteuerzeit [RAM name from V530, voted 1]" UBYTE M_FORMULA_0937 0 0 0 25.5 ECU_ADDRESS 0x3FD8D8 /end MEASUREMENT
/begin MEASUREMENT lshvk_diag_i_ad_b1 "Heizerstrom VKAT [RAM name from V530, voted 2]" UWORD M_FORMULA_0925 0 0 0 304.8139535 ECU_ADDRESS 0x3FD8DA /end MEASUREMENT
/begin MEASUREMENT lshvk_diag_i_ad_b2 "Heizerstrom VKAT [RAM name from V530, voted 1]" UWORD M_FORMULA_0925 0 0 0 304.8139535 ECU_ADDRESS 0x3FD8DC /end MEASUREMENT
/begin MEASUREMENT lshvk_diag_r_b1 "Heizerwiderstand VKAT [RAM name from V530, voted 1]" UWORD M_FORMULA_0541 0 0 0 6553.5 ECU_ADDRESS 0x3FD8DE /end MEASUREMENT
/begin MEASUREMENT lshvk_diag_mess_cnt_b1 "Anzahl gueltiger VKAT-R-Messungen [RAM name from V530, voted 3]" UWORD M_FORMULA_0010 0 0 0 65535 ECU_ADDRESS 0x3FD8E2 /end MEASUREMENT
/begin MEASUREMENT lshvk_diag_time_ml "Verzoegerungszeit - Ermittlung Heizerwiderstand [RAM name from V530, voted 1]" UWORD M_FORMULA_0021 0 0 0 655.35 ECU_ADDRESS 0x3FD8E6 /end MEASUREMENT
/begin MEASUREMENT lsrvk_obd_ref_cnt_b1 "Anzahl erfolgter LA-Ri-GAIN-Ermittlungen [RAM name from V530, voted 4]" UWORD M_FORMULA_0010 0 0 0 65535 ECU_ADDRESS 0x3FD8EC /end MEASUREMENT
/begin MEASUREMENT lsrvk_obd_ref_offs_cnt_b1 "Anzahl erfolgter LA-Ri-OFFSET-Ermittlungen [RAM name from V530, voted 5]" UWORD M_FORMULA_0010 0 0 0 65535 ECU_ADDRESS 0x3FD8F0 /end MEASUREMENT
/begin MEASUREMENT lsrvk_obd_ref_offs_cnt_b2 "Anzahl erfolgter LA-Ri-OFFSET-Ermittlungen [RAM name from V530, voted 1]" UWORD M_FORMULA_0010 0 0 0 65535 ECU_ADDRESS 0x3FD8F2 /end MEASUREMENT
/begin MEASUREMENT lshvk_r_ad_gain_erfolgt_b1 "Erfolgte GAIN-Ri-Adaption [RAM name from V530, voted 7]" UWORD NO_COMPU_METHOD 0 0 0 65535 ECU_ADDRESS 0x3FD8F4 FORMAT "%.4g" /end MEASUREMENT
/begin MEASUREMENT lshvk_r_ad_gain_filt_st_b1 "GAIN-Ri-Filterung [RAM name from V530, voted 7]" UWORD NO_COMPU_METHOD 0 0 0 65535 ECU_ADDRESS 0x3FD8F4 FORMAT "%.4g" /end MEASUREMENT
/begin MEASUREMENT lshvk_r_ad_gain_freig_b1 "GAIN-Sonden-Ri-Adaption FREIGABE [RAM name from V530, voted 7]" UWORD NO_COMPU_METHOD 0 0 0 65535 ECU_ADDRESS 0x3FD8F4 FORMAT "%.4g" /end MEASUREMENT
/begin MEASUREMENT lshvk_r_ad_gain_st_b1 "GAIN-Sonden-Ri-Adaption [RAM name from V530, voted 7]" UWORD NO_COMPU_METHOD 0 0 0 65535 ECU_ADDRESS 0x3FD8F4 FORMAT "%.4g" /end MEASUREMENT
/begin MEASUREMENT lshvk_r_ad_offs_erfolgt_b1 "Erfolgte OFFSET-Ri-Adaption [RAM name from V530, voted 7]" UWORD NO_COMPU_METHOD 0 0 0 65535 ECU_ADDRESS 0x3FD8F4 FORMAT "%.4g" /end MEASUREMENT
/begin MEASUREMENT lshvk_r_ad_offs_filt_st_b1 "OFFSET-Ri-Filterung [RAM name from V530, voted 7]" UWORD NO_COMPU_METHOD 0 0 0 65535 ECU_ADDRESS 0x3FD8F4 FORMAT "%.4g" /end MEASUREMENT
/begin MEASUREMENT lshvk_r_ad_offs_freig_b1 "OFFSET-Sonden-Ri-Adaption FREIGABE [RAM name from V530, voted 7]" UWORD NO_COMPU_METHOD 0 0 0 65535 ECU_ADDRESS 0x3FD8F4 FORMAT "%.4g" /end MEASUREMENT
/begin MEASUREMENT lshvk_r_ad_offs_st_b1 "OFFSET-Sonden-Ri-Adaption [RAM name from V530, voted 7]" UWORD NO_COMPU_METHOD 0 0 0 65535 ECU_ADDRESS 0x3FD8F4 FORMAT "%.4g" /end MEASUREMENT
/begin MEASUREMENT lshvk_r_ad_st_b1 "Sonden-Ri-Adation-Status [RAM name from V530, voted 7]" UWORD M_FORMULA_0080 0 0 0 65535 ECU_ADDRESS 0x3FD8F4 /end MEASUREMENT
/begin MEASUREMENT lshvk_r_ad_gain_erfolgt_b2 "Erfolgte GAIN-Ri-Adaption [RAM name from V530, voted 1]" UWORD NO_COMPU_METHOD 0 0 0 65535 ECU_ADDRESS 0x3FD8F6 FORMAT "%.4g" /end MEASUREMENT
/begin MEASUREMENT lshvk_r_ad_gain_filt_st_b2 "GAIN-Ri-Filterung [RAM name from V530, voted 1]" UWORD NO_COMPU_METHOD 0 0 0 65535 ECU_ADDRESS 0x3FD8F6 FORMAT "%.4g" /end MEASUREMENT
/begin MEASUREMENT lshvk_r_ad_gain_freig_b2 "GAIN-Sonden-Ri-Adaption FREIGABE [RAM name from V530, voted 1]" UWORD NO_COMPU_METHOD 0 0 0 65535 ECU_ADDRESS 0x3FD8F6 FORMAT "%.4g" /end MEASUREMENT
/begin MEASUREMENT lshvk_r_ad_gain_st_b2 "GAIN-Sonden-Ri-Adaption [RAM name from V530, voted 1]" UWORD NO_COMPU_METHOD 0 0 0 65535 ECU_ADDRESS 0x3FD8F6 FORMAT "%.4g" /end MEASUREMENT
/begin MEASUREMENT lshvk_r_ad_offs_erfolgt_b2 "Erfolgte OFFSET-Ri-Adaption [RAM name from V530, voted 1]" UWORD NO_COMPU_METHOD 0 0 0 65535 ECU_ADDRESS 0x3FD8F6 FORMAT "%.4g" /end MEASUREMENT
/begin MEASUREMENT lshvk_r_ad_offs_filt_st_b2 "OFFSET-Ri-Filterung [RAM name from V530, voted 1]" UWORD NO_COMPU_METHOD 0 0 0 65535 ECU_ADDRESS 0x3FD8F6 FORMAT "%.4g" /end MEASUREMENT
/begin MEASUREMENT lshvk_r_ad_offs_freig_b2 "OFFSET-Sonden-Ri-Adaption FREIGABE [RAM name from V530, voted 1]" UWORD NO_COMPU_METHOD 0 0 0 65535 ECU_ADDRESS 0x3FD8F6 FORMAT "%.4g" /end MEASUREMENT
/begin MEASUREMENT lshvk_r_ad_offs_st_b2 "OFFSET-Sonden-Ri-Adaption [RAM name from V530, voted 1]" UWORD NO_COMPU_METHOD 0 0 0 65535 ECU_ADDRESS 0x3FD8F6 FORMAT "%.4g" /end MEASUREMENT
/begin MEASUREMENT lshvk_r_ad_st_b2 "Sonden-Ri-Adation-Status [RAM name from V530, voted 1]" UWORD M_FORMULA_0080 0 0 0 65535 ECU_ADDRESS 0x3FD8F6 /end MEASUREMENT
/begin MEASUREMENT lshvk_r_ad_offs_cnt_b1 "Zahler fuer Glaettungszeit [RAM name from V530, voted 6]" UWORD M_FORMULA_0010 0 0 0 65535 ECU_ADDRESS 0x3FD8F8 /end MEASUREMENT
/begin MEASUREMENT lshvk_r_ad_offs_cnt_b2 "Zahler fuer Glaettungszeit [RAM name from V530, voted 1]" UWORD M_FORMULA_0010 0 0 0 65535 ECU_ADDRESS 0x3FD8FA /end MEASUREMENT
/begin MEASUREMENT lshvk_r_ad_gain_cnt_b1 "Zahler fuer Glaettungszeit [RAM name from V530, voted 4]" UWORD M_FORMULA_0010 0 0 0 65535 ECU_ADDRESS 0x3FD8FC /end MEASUREMENT
/begin MEASUREMENT lshvk_r_ad_gain_cnt_b2 "Zahler fuer Glaettungszeit [RAM name from V530, voted 1]" UWORD M_FORMULA_0010 0 0 0 65535 ECU_ADDRESS 0x3FD8FE /end MEASUREMENT
/begin MEASUREMENT lshvk_r_ad_offs_filt_b1 "gem. AD-Wert f. OFFSET-Sonden-Ri-Adapt. [RAM name from V530, voted 5]" SWORD M_FORMULA_0536 0 0 -160000 159995.1172 ECU_ADDRESS 0x3FD900 /end MEASUREMENT
/begin MEASUREMENT lshvk_r_ad_offs_filt_b2 "gem. AD-Wert f. OFFSET-Sonden-Ri-Adapt. [RAM name from V530, voted 1]" SWORD M_FORMULA_0536 0 0 -160000 159995.1172 ECU_ADDRESS 0x3FD902 /end MEASUREMENT
/begin MEASUREMENT lshvk_r_ad_gain_filt_b1 "gem. AD-Wert f. GAIN-Sonden-Ri-Adapt. [RAM name from V530, voted 4]" UWORD M_FORMULA_0536 0 0 0 319995.1172 ECU_ADDRESS 0x3FD904 /end MEASUREMENT
/begin MEASUREMENT lshvk_r_ad_gain_filt_b2 "gem. AD-Wert f. GAIN-Sonden-Ri-Adapt. [RAM name from V530, voted 1]" UWORD M_FORMULA_0536 0 0 0 319995.1172 ECU_ADDRESS 0x3FD906 /end MEASUREMENT
/begin MEASUREMENT lshvk_r_ad_offs_delta_t_b1 "Delta-Zeit zwischen 2 OFFSET-Adaptionen [RAM name from V530, voted 1]" ULONG M_FORMULA_0147 0 0 0 42949672.95 ECU_ADDRESS 0x3FD914 /end MEASUREMENT
/begin MEASUREMENT lsh_ub_filt "gefilterter Spannungswert U_KL87 fuer LSH [RAM name from V530, voted 3]" SWORD M_FORMULA_0008 0 0 -3276.8 3276.7 ECU_ADDRESS 0x3FD91C /end MEASUREMENT
/begin MEASUREMENT mdrv_flags "MDRV fuer DME [RAM name from V530, voted 5]" UBYTE M_FORMULA_0003 0 0 0 255 ECU_ADDRESS 0x3FD922 /end MEASUREMENT
/begin MEASUREMENT mdrv_flags_kl15 "MDRV Kl15 [RAM name from V530, voted 5]" UBYTE NO_COMPU_METHOD 0 0 0 255 ECU_ADDRESS 0x3FD922 FORMAT "%.4g" /end MEASUREMENT
/begin MEASUREMENT mdrv_flags_power "MDRV Powertaster [RAM name from V530, voted 5]" UBYTE NO_COMPU_METHOD 0 0 0 255 ECU_ADDRESS 0x3FD922 FORMAT "%.4g" /end MEASUREMENT
/begin MEASUREMENT mdrv_flags_stat "MDRV fuer DME [RAM name from V530, voted 5]" UBYTE NO_COMPU_METHOD 0 0 0 255 ECU_ADDRESS 0x3FD922 FORMAT "%.4g" /end MEASUREMENT
/begin MEASUREMENT mdrv_pth_cnt "max. Entprellcounter [RAM name from V530, voted 2]" UBYTE M_FORMULA_0003 0 0 0 255 ECU_ADDRESS 0x3FD923 /end MEASUREMENT
/begin MEASUREMENT msg_exd_st "Ext. Ansteuerung [RAM name from V530, voted 9]" UBYTE M_FORMULA_0037 0 0 0 255 ECU_ADDRESS 0x3FD93C /end MEASUREMENT
/begin MEASUREMENT msg_send_typ "gesendeter Typ pro Zyklus [RAM name from V530, voted 2]" UBYTE NO_COMPU_METHOD 0 0 0 255 ECU_ADDRESS 0x3FD93D FORMAT "%.4g" /end MEASUREMENT
/begin MEASUREMENT msg_send_st "Sendestatus [RAM name from V530, voted 5]" UBYTE NO_COMPU_METHOD 0 0 0 255 ECU_ADDRESS 0x3FD93E FORMAT "%.4g" /end MEASUREMENT
/begin MEASUREMENT msg_send_timeout "Timeout der akt. ID [RAM name from V530, voted 2]" UBYTE M_FORMULA_0214 0 0 0 255 ECU_ADDRESS 0x3FD940 /end MEASUREMENT
/begin MEASUREMENT msg_send_id "gesendete ID pro Zyklus [RAM name from V530, voted 3]" UWORD NO_COMPU_METHOD 0 0 0 65535 ECU_ADDRESS 0x3FD942 FORMAT "%.4g" /end MEASUREMENT
/begin MEASUREMENT msg_send_buf "Sendebuffer [RAM name from V530, voted 113]" ULONG M_FORMULA_0000 0 0 0 4294967295 ECU_ADDRESS 0x3FD964 /end MEASUREMENT
/begin MEASUREMENT msg_clr_buf "Clear Sendebuffer [RAM name from V530, voted 94]" ULONG M_FORMULA_0000 0 0 0 4294967295 ECU_ADDRESS 0x3FD968 /end MEASUREMENT
/begin MEASUREMENT msg_exd_timeout "Timeout [RAM name from V530, voted 4]" UWORD M_FORMULA_0593 0 0 0 65535 ECU_ADDRESS 0x3FD96C /end MEASUREMENT
/begin MEASUREMENT msg_bos_kl15 "BOS-Meldg. bei Klemmenwechsel [RAM name from V530, voted 2]" UBYTE NO_COMPU_METHOD 0 0 0 255 ECU_ADDRESS 0x3FD970 FORMAT "%.4g" /end MEASUREMENT
/begin MEASUREMENT msg_rec_rtime "Repeattime [RAM name from V530, voted 1]" UBYTE M_FORMULA_0214 0 0 0 255 ECU_ADDRESS 0x3FD971 /end MEASUREMENT
/begin MEASUREMENT mvac_ml_psens "Luftmassenstrom neg. MVAC -> LLS, pos LLS -> MVAC [RAM name from V530, voted 1]" SLONG M_FORMULA_0963 0 0 -4194304 4194303.998 ECU_ADDRESS 0x3FD980 /end MEASUREMENT
/begin MEASUREMENT mvac_ml_sr_rsv_psens_roh "Luftmassenstrom neg. MVAC -> LLS, pos LLS -> MVAC [RAM name from V530, voted 3]" SLONG M_FORMULA_0963 0 0 -4194304 4194303.998 ECU_ADDRESS 0x3FD984 /end MEASUREMENT
/begin MEASUREMENT mvac_ml_sr_rsv_psens "Luftmassenstrom neg. MVAC -> LLS, pos LLS -> MVAC [RAM name from V530, voted 2]" SWORD M_FORMULA_0103 0 0 -3276.8 3276.7 ECU_ADDRESS 0x3FD988 /end MEASUREMENT
/begin MEASUREMENT mvac_elup_st_del "Zeitverzoegerung fuer Berechnung von mvac_ml_sr_rsv_psens [RAM name from V530, voted 4]" UWORD M_FORMULA_0109 0 0 0 327.675 ECU_ADDRESS 0x3FD98A /end MEASUREMENT
/begin MEASUREMENT mvac_pos_rsv "Zustand Rueckschlagventil(Modell) [RAM name from V530, voted 3]" UBYTE NO_COMPU_METHOD 0 0 0 255 ECU_ADDRESS 0x3FD98C FORMAT "%.4g" /end MEASUREMENT
/begin MEASUREMENT mvac_pos_rsv_mess "Zustand Rueckschlagventil(Sensor) [RAM name from V530, voted 3]" UBYTE NO_COMPU_METHOD 0 0 0 255 ECU_ADDRESS 0x3FD98D FORMAT "%.4g" /end MEASUREMENT
/begin MEASUREMENT mvac_del_rsv "Delay Schliesszeitverzug RSV(Modell) [RAM name from V530, voted 4]" UWORD M_FORMULA_0109 0 0 0 327.675 ECU_ADDRESS 0x3FD98E /end MEASUREMENT
/begin MEASUREMENT mvac_del_rsv_mess "Delay Schliesszeitverzug RSV(Sensor) [RAM name from V530, voted 2]" UWORD M_FORMULA_0109 0 0 0 327.675 ECU_ADDRESS 0x3FD990 /end MEASUREMENT
/begin MEASUREMENT mvac_pdiff_sr_roh "Differenzdruck(Modell) Saugrohr/Mastervac direkt [RAM name from V530, voted 1]" SWORD M_FORMULA_0075 0 0 -2048 2047.9375 ECU_ADDRESS 0x3FD992 /end MEASUREMENT
/begin MEASUREMENT mvac_pdiff_sr_mess_roh "Differenzdruck(Sensor) Saugrohr/Mastervac direkt [RAM name from V530, voted 1]" SWORD M_FORMULA_0075 0 0 -2048 2047.9375 ECU_ADDRESS 0x3FD994 /end MEASUREMENT
/begin MEASUREMENT mvac_pdiff_sr_mess "Differenzdruck(Sensor) Saugrohr/Mastervac mit Hysterese [RAM name from V530, voted 1]" SWORD M_FORMULA_0075 0 0 -2048 2047.9375 ECU_ADDRESS 0x3FD998 /end MEASUREMENT
/begin MEASUREMENT mvac_ml_sr_rsv_mess_roh "Luftmassenstromrohwert(Sensor) Saugrohr/Mvac [RAM name from V530, voted 1]" SWORD M_FORMULA_0103 0 0 -3276.8 3276.7 ECU_ADDRESS 0x3FD99C /end MEASUREMENT
/begin MEASUREMENT mvac_ml_sr_rsv "Luftmassenstrom(Modell) vom Saugrohr, differenzdruckabhaengig [RAM name from V530, voted 1]" SWORD M_FORMULA_0103 0 0 -3276.8 3276.7 ECU_ADDRESS 0x3FD99E /end MEASUREMENT
/begin MEASUREMENT mvac_ml_elup "Luftmassenstrom ELUP/Mastervac [RAM name from V530, voted 2]" SWORD M_FORMULA_0965 0 0 -64 63.99804688 ECU_ADDRESS 0x3FD9B4 /end MEASUREMENT
/begin MEASUREMENT mvac_ml_leck "Luftmassenstrom zum Mastervac durch Leckluft [RAM name from V530, voted 2]" SLONG M_FORMULA_0963 0 0 -4194304 4194303.998 ECU_ADDRESS 0x3FD9A4 /end MEASUREMENT
/begin MEASUREMENT mvac_ml_brp "Luftmassenstrom zum Mastervac durch brp [RAM name from V530, voted 3]" SLONG M_FORMULA_0963 0 0 -4194304 4194303.998 ECU_ADDRESS 0x3FD9A8 /end MEASUREMENT
/begin MEASUREMENT mvac_del_bls "Delay S_BLS bis can_brp_grad [RAM name from V530, voted 3]" UWORD M_FORMULA_0109 0 0 0 327.675 ECU_ADDRESS 0x3FD9B6 /end MEASUREMENT
/begin MEASUREMENT mvac_al_brp_grad "dynamischer Durchflusswert MVAC [RAM name from V530, voted 4]" SWORD M_FORMULA_0967 0 0 -32 31.99902344 ECU_ADDRESS 0x3FD9B8 /end MEASUREMENT
/begin MEASUREMENT mvac_ml_sr "Luftmassenstrom vom Saugrohr Bank2 zum Mastervac [RAM name from V530, voted 2]" SWORD M_FORMULA_0103 0 0 -3276.8 3276.7 ECU_ADDRESS 0x3FD9BA /end MEASUREMENT
/begin MEASUREMENT mvac_ml "Gesamtluftmassenstrom zum Mastervac [RAM name from V530, voted 3]" SLONG M_FORMULA_0963 0 0 -4194304 4194303.998 ECU_ADDRESS 0x3FD9C4 /end MEASUREMENT
/begin MEASUREMENT mvac_ml_old "Gesamtluftmassenstrom zum Mastervac t(-5ms) [RAM name from V530, voted 3]" SLONG M_FORMULA_0963 0 0 -4194304 4194303.998 ECU_ADDRESS 0x3FD9C8 /end MEASUREMENT
/begin MEASUREMENT mvac_p_modell_grad "Gradient Modelldruck Mastervac [RAM name from V530, voted 1]" SLONG M_FORMULA_0968 0 0 -1342177.28 1342177.279 ECU_ADDRESS 0x3FD9D0 /end MEASUREMENT
/begin MEASUREMENT mvac_aq_bre_b "AQ-Offset LL-Steller Bank 2 bei Bremsung [RAM name from V530, voted 1]" UWORD M_FORMULA_0143 0 0 0 6553.5 ECU_ADDRESS 0x3FD9D4 /end MEASUREMENT
/begin MEASUREMENT mvac_rmp_fkt_sa_start "MVAC Rampe bei SA gestartet [RAM name from V530, voted 4]" UBYTE NO_COMPU_METHOD 0 0 0 255 ECU_ADDRESS 0x3FD9D6 FORMAT "%.4g" /end MEASUREMENT
/begin MEASUREMENT mvac_rmp_fkt_sa_frei "MVAC Rampe bei SA grundsaetzlich bereit [RAM name from V530, voted 4]" UBYTE NO_COMPU_METHOD 0 0 0 255 ECU_ADDRESS 0x3FD9D7 FORMAT "%.4g" /end MEASUREMENT
/begin MEASUREMENT mvac_rmp_fkt_sa_pos "Wert Zeitfaktor steigende Abregelrampe durch B_SA [RAM name from V530, voted 4]" SWORD M_FORMULA_0109 0 0 -163.84 163.835 ECU_ADDRESS 0x3FD9D8 /end MEASUREMENT
/begin MEASUREMENT mvac_rmp_fkt_sa_neg "Wert Zeitfaktor fallende Abregelrampe durch B_SA [RAM name from V530, voted 4]" SWORD M_FORMULA_0109 0 0 -163.84 163.835 ECU_ADDRESS 0x3FD9DA /end MEASUREMENT
/begin MEASUREMENT mvac_rmp_fkt_sa "Wert Zeitfaktor Abregelrampe durch B_SA [RAM name from V530, voted 2]" SWORD M_FORMULA_0109 0 0 -163.84 163.835 ECU_ADDRESS 0x3FD9DC /end MEASUREMENT
/begin MEASUREMENT mvac_p_ad "Eingelesener Spannungswert fuer Unterdruck-MVAC [RAM name from V530, voted 2]" SWORD M_FORMULA_0114 0 0 -32768 32767 ECU_ADDRESS 0x3FD9E0 /end MEASUREMENT
/begin MEASUREMENT mvac_p_roh "Ungefilterter Messwert [RAM name from V530, voted 2]" SWORD M_FORMULA_0075 0 0 -2048 2047.9375 ECU_ADDRESS 0x3FD9E2 /end MEASUREMENT
/begin MEASUREMENT mvac_p_diag_pdiff_roh "Unterschied Differenzdruck Modell zu Sensor [RAM name from V530, voted 3]" SWORD M_FORMULA_0075 0 0 -2048 2047.9375 ECU_ADDRESS 0x3FD9E4 /end MEASUREMENT
/begin MEASUREMENT mvac_p_diag_pdiff_pos_roh "Unterschied Differenzdruck Modell > Sensor bei LL bzw. SA [RAM name from V530, voted 4]" SWORD M_FORMULA_0075 0 0 -2048 2047.9375 ECU_ADDRESS 0x3FD9E6 /end MEASUREMENT
/begin MEASUREMENT mvac_p_diag_pdiff_neg_roh "Unterschied Differenzdruck Modell < Sensor [RAM name from V530, voted 4]" SWORD M_FORMULA_0075 0 0 -2048 2047.9375 ECU_ADDRESS 0x3FD9E8 /end MEASUREMENT
/begin MEASUREMENT mvac_p_diag_pdiff_pos "Unterschied Differenzdruck Modellwert > Sensorwert [RAM name from V530, voted 2]" SWORD M_FORMULA_0075 0 0 -2048 2047.9375 ECU_ADDRESS 0x3FD9EA /end MEASUREMENT
/begin MEASUREMENT mvac_p_diag_pdiff_delay "Zeitverzoegerung fuer Berechnung von mvac_p_diag_pdiff_roh [RAM name from V530, voted 5]" UWORD M_FORMULA_0109 0 0 0 327.675 ECU_ADDRESS 0x3FD9FA /end MEASUREMENT
/begin MEASUREMENT mvac_pl_st "Prueflaufstatus MVAC [RAM name from V530, voted 10]" UBYTE NO_COMPU_METHOD 0 0 0 255 ECU_ADDRESS 0x3FD9FC FORMAT "%.4g" /end MEASUREMENT
/begin MEASUREMENT mvac_pl_timer "Timer fuer MVAC-Prueflauf [RAM name from V530, voted 2]" UBYTE M_FORMULA_0214 0 0 0 255 ECU_ADDRESS 0x3FD9FD /end MEASUREMENT
/begin MEASUREMENT mvac_pl_p_sensor_ml "PL Differenzdruck Sensorwert bei B_ZUST_ML [RAM name from V530, voted 2]" SWORD M_FORMULA_0075 0 0 -2048 2047.9375 ECU_ADDRESS 0x3FD9FE /end MEASUREMENT
/begin MEASUREMENT mvac_pl_p_modell_ml "PL Differenzdruck Modellwert bei B_ZUST_ML [RAM name from V530, voted 2]" SWORD M_FORMULA_0075 0 0 -2048 2047.9375 ECU_ADDRESS 0x3FDA00 /end MEASUREMENT
/begin MEASUREMENT mvac_pl_p_sensor_ms_ende "PL Differenzdruck Sensor-Endwert bei B_ZUST_MS [RAM name from V530, voted 2]" SWORD M_FORMULA_0075 0 0 -2048 2047.9375 ECU_ADDRESS 0x3FDA02 /end MEASUREMENT
/begin MEASUREMENT mvac_pl_p_sensor_ms_start "PL Differenzdruck Sensor-Startwert bei B_ZUST_MS [RAM name from V530, voted 2]" SWORD M_FORMULA_0075 0 0 -2048 2047.9375 ECU_ADDRESS 0x3FDA04 /end MEASUREMENT
/begin MEASUREMENT mzyl_b1.ml_asp "Wirksame Luftmasse/ASP [RAM name from V530, voted 2]" SWORD M_FORMULA_0104 0 0 -3276.8 3276.7 ECU_ADDRESS 0x3FDA0C /end MEASUREMENT
/begin MEASUREMENT mzyl_b1.ml_sum_sa "Summe Luftmassenstr. im ZUST_SA [RAM name from V530, voted 2]" SLONG M_FORMULA_0983 0 0 -214748364.8 214748364.7 ECU_ADDRESS 0x3FDA14 /end MEASUREMENT
/begin MEASUREMENT mzyl_b1.ml_sum_we "Summe Luftmassenstr. nach SA_WE [RAM name from V530, voted 5]" SLONG M_FORMULA_0983 0 0 -214748364.8 214748364.7 ECU_ADDRESS 0x3FDA18 /end MEASUREMENT
/begin MEASUREMENT n_st_a "Status Drehzahlerfassung [RAM name from V530, voted 9]" UBYTE NO_COMPU_METHOD 0 0 0 255 ECU_ADDRESS 0x3FDA50 FORMAT "%.4g" /end MEASUREMENT
/begin MEASUREMENT n_st_b "Status Drehzahlerfassung [RAM name from V530, voted 5]" UBYTE NO_COMPU_METHOD 0 0 0 255 ECU_ADDRESS 0x3FDA51 FORMAT "%.4g" /end MEASUREMENT
/begin MEASUREMENT n_timer_stoerung_a "Zeitzaehler fuer Freeze Drehzahlerfassung [RAM name from V530, voted 2]" SBYTE M_FORMULA_0306 0 0 -1.28 1.27 ECU_ADDRESS 0x3FDA52 /end MEASUREMENT
/begin MEASUREMENT n_proz "Ersatzdrehzahl des jeweiligen Prozessors. [RAM name from V530, voted 4]" SWORD M_FORMULA_0006 0 0 -32768 32767 ECU_ADDRESS 0x3FDA54 /end MEASUREMENT
/begin MEASUREMENT n_zahn_a "Drehzahl aus Zahnabstand [RAM name from V530, voted 2]" SWORD M_FORMULA_0006 0 0 -32768 32767 ECU_ADDRESS 0x3FDA56 /end MEASUREMENT
/begin MEASUREMENT n_segm_a "Drehzahl aus Segmentabstand. [RAM name from V530, voted 7]" SWORD M_FORMULA_0006 0 0 -32768 32767 ECU_ADDRESS 0x3FDA5A /end MEASUREMENT
/begin MEASUREMENT n_segm_b "Drehzahl aus Segmentabstand. [RAM name from V530, voted 2]" SWORD M_FORMULA_0006 0 0 -32768 32767 ECU_ADDRESS 0x3FDA5C /end MEASUREMENT
/begin MEASUREMENT n_t_segm_a "Segmentzeit. [RAM name from V530, voted 3]" UWORD M_FORMULA_0354 0 0 0 104.856 ECU_ADDRESS 0x3FDA5E /end MEASUREMENT
/begin MEASUREMENT n_t_segm_start_a "Segmentstartzeit. [RAM name from V530, voted 1]" ULONG M_FORMULA_0017 0 0 0 613566.7564 ECU_ADDRESS 0x3FDA64 /end MEASUREMENT
/begin MEASUREMENT n_dyn_timer "Aktuelle Sperrzeit fuer Ruecknahme N-Dynamik [RAM name from V530, voted 4]" UWORD M_FORMULA_0021 0 0 0 655.35 ECU_ADDRESS 0x3FDA6E /end MEASUREMENT
/begin MEASUREMENT n_dyn_filter "gefilterte Drehzahl fuer Dynamikerkennung [RAM name from V530, voted 4]" SWORD M_FORMULA_0006 0 0 -32768 32767 ECU_ADDRESS 0x3FDA70 /end MEASUREMENT
/begin MEASUREMENT n_grad_buf_0 "History Drehzahlgradient. [RAM name from V530, voted 1]" SWORD M_FORMULA_0006 0 0 -32768 32767 ECU_ADDRESS 0x3FDA72 /end MEASUREMENT
/begin MEASUREMENT n_begr_sk "SK-Drehzahlbegrenzung [RAM name from V530, voted 2]" SWORD M_FORMULA_0006 0 0 -32768 32767 ECU_ADDRESS 0x3FDAA6 /end MEASUREMENT
/begin MEASUREMENT n_begr_toel_heiss "Drehzahlbegrenzung bei heissem Oel [RAM name from V530, voted 2]" SWORD M_FORMULA_0006 0 0 -32768 32767 ECU_ADDRESS 0x3FDAAA /end MEASUREMENT
/begin MEASUREMENT n_begr_fetrawe "Drehzahlbegrenzung bei FeTraWe [RAM name from V530, voted 2]" SWORD M_FORMULA_0006 0 0 -32768 32767 ECU_ADDRESS 0x3FDAB8 /end MEASUREMENT
/begin MEASUREMENT n_begr_v_fehler "Drehzahlbegrenzung bei v-Fehler [RAM name from V530, voted 1]" SWORD M_FORMULA_0006 0 0 -32768 32767 ECU_ADDRESS 0x3FDABA /end MEASUREMENT
/begin MEASUREMENT n_begr_fzg_steht "Drehzahlbegrenzung bei stehendem Fzg [RAM name from V530, voted 1]" SWORD M_FORMULA_0006 0 0 -32768 32767 ECU_ADDRESS 0x3FDABC /end MEASUREMENT
/begin MEASUREMENT n_begr_tz_err "Drehzahlbegrenzung fuer Zuendspulenschutz [RAM name from V530, voted 1]" SWORD M_FORMULA_0006 0 0 -32768 32767 ECU_ADDRESS 0x3FDABE /end MEASUREMENT
/begin MEASUREMENT n_begr_status "Gewinner der MIN-Auswahl [RAM name from V530, voted 9]" UWORD NO_COMPU_METHOD 0 0 0 65535 ECU_ADDRESS 0x3FDA9C FORMAT "%.4g" /end MEASUREMENT
/begin MEASUREMENT o2_lam_soll_fett_hub_b1 "FETT-HUB [RAM name from V530, voted 12]" UWORD NO_COMPU_METHOD 0 0 0 65535 ECU_ADDRESS 0x3FDB28 FORMAT "%.4g" /end MEASUREMENT
/begin MEASUREMENT o2_lam_soll_fett_hub_trig_b1 "FETT-HUB nach Adaption [RAM name from V530, voted 12]" UWORD NO_COMPU_METHOD 0 0 0 65535 ECU_ADDRESS 0x3FDB28 FORMAT "%.4g" /end MEASUREMENT
/begin MEASUREMENT o2_lam_soll_fett_ukp_b1 "Umkehrpunkt im FETT-Hub [RAM name from V530, voted 12]" UWORD NO_COMPU_METHOD 0 0 0 65535 ECU_ADDRESS 0x3FDB28 FORMAT "%.4g" /end MEASUREMENT
/begin MEASUREMENT o2_lam_soll_mager_hub_b1 "MAGER-HUB [RAM name from V530, voted 12]" UWORD NO_COMPU_METHOD 0 0 0 65535 ECU_ADDRESS 0x3FDB28 FORMAT "%.4g" /end MEASUREMENT
/begin MEASUREMENT o2_lam_soll_mager_hub_trig_b1 "MAGER-HUB nach Adaption [RAM name from V530, voted 12]" UWORD NO_COMPU_METHOD 0 0 0 65535 ECU_ADDRESS 0x3FDB28 FORMAT "%.4g" /end MEASUREMENT
/begin MEASUREMENT o2_lam_soll_mager_per_b1 "Periodendauerberechnung auf MAGER-HUB [RAM name from V530, voted 12]" UWORD NO_COMPU_METHOD 0 0 0 65535 ECU_ADDRESS 0x3FDB28 FORMAT "%.4g" /end MEASUREMENT
/begin MEASUREMENT o2_lam_soll_mager_ukp_b1 "Umkehrpunkt im MAGER-Hub [RAM name from V530, voted 12]" UWORD NO_COMPU_METHOD 0 0 0 65535 ECU_ADDRESS 0x3FDB28 FORMAT "%.4g" /end MEASUREMENT
/begin MEASUREMENT o2_lam_soll_pus_b1 "Aktivierung Pulsgenerator [RAM name from V530, voted 12]" UWORD NO_COMPU_METHOD 0 0 0 65535 ECU_ADDRESS 0x3FDB28 FORMAT "%.4g" /end MEASUREMENT
/begin MEASUREMENT o2_obd_dyn_t_verz_b1 "Verzoegerungszeit nach Dynamik [RAM name from V530, voted 12]" UWORD NO_COMPU_METHOD 0 0 0 65535 ECU_ADDRESS 0x3FDB28 FORMAT "%.4g" /end MEASUREMENT
/begin MEASUREMENT o2_obd_rf_min_schwelle_b1 "RF-MIN-Schwelle [RAM name from V530, voted 12]" UWORD NO_COMPU_METHOD 0 0 0 65535 ECU_ADDRESS 0x3FDB28 FORMAT "%.4g" /end MEASUREMENT
/begin MEASUREMENT o2_obd_st_b1 "O2-OBD-Status [RAM name from V530, voted 12]" UWORD M_FORMULA_0080 0 0 0 65535 ECU_ADDRESS 0x3FDB28 /end MEASUREMENT
/begin MEASUREMENT o2_obd_tkat_min_b1 "TKAT-MIN-Schwelle [RAM name from V530, voted 12]" UWORD NO_COMPU_METHOD 0 0 0 65535 ECU_ADDRESS 0x3FDB28 FORMAT "%.4g" /end MEASUREMENT
/begin MEASUREMENT o2_obd_t_sum_b1 "Periodendauer d. Zwangsanregung [RAM name from V530, voted 4]" UWORD M_FORMULA_0763 0 0 0 65535 ECU_ADDRESS 0x3FDB2C /end MEASUREMENT
/begin MEASUREMENT o2_obd_t_mager_b1 "Zeit der MAGER-Beladung [RAM name from V530, voted 5]" UWORD M_FORMULA_0763 0 0 0 65535 ECU_ADDRESS 0x3FDB30 /end MEASUREMENT
/begin MEASUREMENT o2_obd_t_fett_b1 "Zeit der FETT-Beladung [RAM name from V530, voted 5]" UWORD M_FORMULA_0763 0 0 0 65535 ECU_ADDRESS 0x3FDB34 /end MEASUREMENT
/begin MEASUREMENT o2_obd_period_cnt_b1 "Anzahl d. durchgefuehrten Zwangsperioden [RAM name from V530, voted 5]" UWORD M_FORMULA_0010 0 0 0 65535 ECU_ADDRESS 0x3FDB38 /end MEASUREMENT
/begin MEASUREMENT o2_rf_min_schw_t_b1 "Verzoegerungszeit bei RF-MIN-Verletzung [RAM name from V530, voted 1]" UWORD M_FORMULA_0763 0 0 0 65535 ECU_ADDRESS 0x3FDB3C /end MEASUREMENT
/begin MEASUREMENT o2_obd_lam_soll_offs "LAM-SOLL-OFFSET - zusaetzliche Anfettung/Abmagerung [RAM name from V530, voted 4]" SWORD M_FORMULA_0025 0 0 -2 1.999938965 ECU_ADDRESS 0x3FDB44 /end MEASUREMENT
/begin MEASUREMENT kat_obd_zust_st_b1 "KAT-Diagnose Zustandsautomat [RAM name from V530, voted 9]" UWORD NO_COMPU_METHOD 0 0 0 65535 ECU_ADDRESS 0x3FDB48 FORMAT "%.4g" /end MEASUREMENT
/begin MEASUREMENT kat_obd_zust_st_b2 "KAT-Diagnose Zustandsautomat [RAM name from V530, voted 4]" UWORD NO_COMPU_METHOD 0 0 0 65535 ECU_ADDRESS 0x3FDB4A FORMAT "%.4g" /end MEASUREMENT
/begin MEASUREMENT kat_obd_fett_mager_b1 "Uebergang zu FETT nach MAGER [RAM name from V530, voted 10]" UWORD NO_COMPU_METHOD 0 0 0 65535 ECU_ADDRESS 0x3FDB4C FORMAT "%.4g" /end MEASUREMENT
/begin MEASUREMENT kat_obd_io_verz_b1 "Verzoegerung Fehlerheilung [RAM name from V530, voted 10]" UWORD NO_COMPU_METHOD 0 0 0 65535 ECU_ADDRESS 0x3FDB4C FORMAT "%.4g" /end MEASUREMENT
/begin MEASUREMENT kat_obd_lank_chk1_b1 "Verifikationscheck1 [RAM name from V530, voted 10]" UWORD NO_COMPU_METHOD 0 0 0 65535 ECU_ADDRESS 0x3FDB4C FORMAT "%.4g" /end MEASUREMENT
/begin MEASUREMENT kat_obd_lank_chk2_b1 "Verifikationscheck2 [RAM name from V530, voted 10]" UWORD NO_COMPU_METHOD 0 0 0 65535 ECU_ADDRESS 0x3FDB4C FORMAT "%.4g" /end MEASUREMENT
/begin MEASUREMENT kat_obd_st_b1 "KAT-Diagnose Status [RAM name from V530, voted 10]" UWORD M_FORMULA_0080 0 0 0 65535 ECU_ADDRESS 0x3FDB4C /end MEASUREMENT
/begin MEASUREMENT kat_obd_wert_ermittlung_b1 "Diagnosewert-Ermittlung [RAM name from V530, voted 10]" UWORD NO_COMPU_METHOD 0 0 0 65535 ECU_ADDRESS 0x3FDB4C FORMAT "%.4g" /end MEASUREMENT
/begin MEASUREMENT kat_obd_fett_mager_b2 "Uebergang zu FETT nach MAGER [RAM name from V530, voted 1]" UWORD NO_COMPU_METHOD 0 0 0 65535 ECU_ADDRESS 0x3FDB4E FORMAT "%.4g" /end MEASUREMENT
/begin MEASUREMENT kat_obd_io_verz_b2 "Verzoegerung Fehlerheilung [RAM name from V530, voted 1]" UWORD NO_COMPU_METHOD 0 0 0 65535 ECU_ADDRESS 0x3FDB4E FORMAT "%.4g" /end MEASUREMENT
/begin MEASUREMENT kat_obd_lank_chk1_b2 "Verifikationscheck1 [RAM name from V530, voted 1]" UWORD NO_COMPU_METHOD 0 0 0 65535 ECU_ADDRESS 0x3FDB4E FORMAT "%.4g" /end MEASUREMENT
/begin MEASUREMENT kat_obd_lank_chk2_b2 "Verifikationscheck2 [RAM name from V530, voted 1]" UWORD NO_COMPU_METHOD 0 0 0 65535 ECU_ADDRESS 0x3FDB4E FORMAT "%.4g" /end MEASUREMENT
/begin MEASUREMENT kat_obd_st_b2 "KAT-Diagnose Status [RAM name from V530, voted 1]" UWORD M_FORMULA_0080 0 0 0 65535 ECU_ADDRESS 0x3FDB4E /end MEASUREMENT
/begin MEASUREMENT kat_obd_wert_ermittlung_b2 "Diagnosewert-Ermittlung [RAM name from V530, voted 1]" UWORD NO_COMPU_METHOD 0 0 0 65535 ECU_ADDRESS 0x3FDB4E FORMAT "%.4g" /end MEASUREMENT
/begin MEASUREMENT kat_o2_per_cnt_passiv_b1 "akt, Zahl d. Zwangsperioden in PASSIV [RAM name from V530, voted 2]" UWORD M_FORMULA_0010 0 0 0 65535 ECU_ADDRESS 0x3FDB50 /end MEASUREMENT
/begin MEASUREMENT kat_obd_lank_sum_b1 "aufsummierter NKAT-LA-Wert [RAM name from V530, voted 3]" ULONG M_FORMULA_1016 0 0 0 262143.9999 ECU_ADDRESS 0x3FDB58 /end MEASUREMENT
/begin MEASUREMENT kat_obd_t_cnt_b1 "Zaehler - aufsummierten NKAT-LA-Werte [RAM name from V530, voted 3]" UWORD M_FORMULA_0010 0 0 0 65535 ECU_ADDRESS 0x3FDB60 /end MEASUREMENT
/begin MEASUREMENT kat_obd_lank_mw_b1 "gemittelter NKAT-LA-Wert [RAM name from V530, voted 3]" UWORD M_FORMULA_0025 0 0 0 3.999938965 ECU_ADDRESS 0x3FDB64 /end MEASUREMENT
/begin MEASUREMENT kat_obd_lank_mw_b2 "gemittelter NKAT-LA-Wert [RAM name from V530, voted 2]" UWORD M_FORMULA_0025 0 0 0 3.999938965 ECU_ADDRESS 0x3FDB66 /end MEASUREMENT
/begin MEASUREMENT kat_obd_lank_diff_b1 "Abweichung des akt. LANK-LA-Werts zum Mittelwert [RAM name from V530, voted 3]" UWORD M_FORMULA_0025 0 0 0 3.999938965 ECU_ADDRESS 0x3FDB68 /end MEASUREMENT
/begin MEASUREMENT kat_obd_lank_diff_sum_b1 "aufsummierte Abweichung d. akt. Werts zum Mittelwert [RAM name from V530, voted 3]" ULONG M_FORMULA_1016 0 0 0 262143.9999 ECU_ADDRESS 0x3FDB6C /end MEASUREMENT
/begin MEASUREMENT kat_obd_lank_diff_sum_f_b1 "aufsummierte Abweichung zum MW - Zyklus FETT [RAM name from V530, voted 2]" ULONG M_FORMULA_1016 0 0 0 262143.9999 ECU_ADDRESS 0x3FDB74 /end MEASUREMENT
/begin MEASUREMENT kat_obd_int_b1 "gemittelte Abweichung zum Mittelwert [RAM name from V530, voted 1]" UWORD M_FORMULA_0025 0 0 0 3.999938965 ECU_ADDRESS 0x3FDB84 /end MEASUREMENT
/begin MEASUREMENT kat_obd_wicht_b2 "gewichtete gem. Abweichung zum Mittelwert [RAM name from V530, voted 2]" UWORD M_FORMULA_0025 0 0 0 3.999938965 ECU_ADDRESS 0x3FDB8A /end MEASUREMENT
/begin MEASUREMENT kat_obd_wicht_sum_b1 "aufsum. gewichtete gem. Abweichung z. MW [RAM name from V530, voted 2]" ULONG M_FORMULA_1016 0 0 0 262143.9999 ECU_ADDRESS 0x3FDB8C /end MEASUREMENT
/begin MEASUREMENT kat_obd_verh_b2 "Wichtungsverhaeltnis - Diag.Wert [RAM name from V530, voted 2]" UWORD M_FORMULA_0073 0 0 0 63.99902344 ECU_ADDRESS 0x3FDB96 /end MEASUREMENT
/begin MEASUREMENT kat_obd_io_t_b1 "Verzoegerung d. Heilung [RAM name from V530, voted 8]" UWORD M_FORMULA_0021 0 0 0 655.35 ECU_ADDRESS 0x3FDB9C /end MEASUREMENT
/begin MEASUREMENT kat_obd_io_t_b2 "Verzoegerung d. Heilung [RAM name from V530, voted 5]" UWORD M_FORMULA_0021 0 0 0 655.35 ECU_ADDRESS 0x3FDB9E /end MEASUREMENT
/begin MEASUREMENT kat_obd_gesamt_max "Diagnoseschwelle - Gesamtsystem-KAT-Diag. [RAM name from V530, voted 2]" UWORD M_FORMULA_0025 0 0 0 3.999938965 ECU_ADDRESS 0x3FDBA0 /end MEASUREMENT
/begin MEASUREMENT kat_obd_wert_max_b1 "Diagnoseschwelle - max. KAT-Diag. [RAM name from V530, voted 5]" UWORD M_FORMULA_0025 0 0 0 3.999938965 ECU_ADDRESS 0x3FDBA2 /end MEASUREMENT
/begin MEASUREMENT kat_obd_wert_max_b2 "Diagnoseschwelle - max. KAT-Diag. [RAM name from V530, voted 2]" UWORD M_FORMULA_0025 0 0 0 3.999938965 ECU_ADDRESS 0x3FDBA4 /end MEASUREMENT
/begin MEASUREMENT lavk_obd_dyn_exd_b1 "Externe Ansteuerung [RAM name from V530, voted 20]" UWORD NO_COMPU_METHOD 0 0 0 65535 ECU_ADDRESS 0x3FDBB6 FORMAT "%.4g" /end MEASUREMENT
/begin MEASUREMENT lavk_obd_dyn_io_verz_b1 "Verzoegerung Fehlerheilung [RAM name from V530, voted 20]" UWORD NO_COMPU_METHOD 0 0 0 65535 ECU_ADDRESS 0x3FDBB6 FORMAT "%.4g" /end MEASUREMENT
/begin MEASUREMENT lavk_obd_dyn_max_b1 "Ermittlung max. LA-Wert [RAM name from V530, voted 20]" UWORD NO_COMPU_METHOD 0 0 0 65535 ECU_ADDRESS 0x3FDBB6 FORMAT "%.4g" /end MEASUREMENT
/begin MEASUREMENT lavk_obd_dyn_min_b1 "Ermittlung min. LA-Wert [RAM name from V530, voted 20]" UWORD NO_COMPU_METHOD 0 0 0 65535 ECU_ADDRESS 0x3FDBB6 FORMAT "%.4g" /end MEASUREMENT
/begin MEASUREMENT lavk_obd_dyn_st_b1 "dynamische LA-VKAT-Diagnose [RAM name from V530, voted 20]" UWORD M_FORMULA_0080 0 0 0 65535 ECU_ADDRESS 0x3FDBB6 /end MEASUREMENT
/begin MEASUREMENT lavk_obd_dyn_zustand_b1 "Zustand - dynamische LA-VKAT-Diagnose [RAM name from V530, voted 20]" UWORD NO_COMPU_METHOD 0 0 0 65535 ECU_ADDRESS 0x3FDBB6 FORMAT "%.4g" /end MEASUREMENT
/begin MEASUREMENT lavk_obd_dyn_exd_b2 "Externe Ansteuerung [RAM name from V530, voted 13]" UWORD NO_COMPU_METHOD 0 0 0 65535 ECU_ADDRESS 0x3FDBB8 FORMAT "%.4g" /end MEASUREMENT
/begin MEASUREMENT lavk_obd_dyn_io_verz_b2 "Verzoegerung Fehlerheilung [RAM name from V530, voted 13]" UWORD NO_COMPU_METHOD 0 0 0 65535 ECU_ADDRESS 0x3FDBB8 FORMAT "%.4g" /end MEASUREMENT
/begin MEASUREMENT lavk_obd_dyn_max_b2 "Ermittlung max. LA-Wert [RAM name from V530, voted 13]" UWORD NO_COMPU_METHOD 0 0 0 65535 ECU_ADDRESS 0x3FDBB8 FORMAT "%.4g" /end MEASUREMENT
/begin MEASUREMENT lavk_obd_dyn_min_b2 "Ermittlung min. LA-Wert [RAM name from V530, voted 13]" UWORD NO_COMPU_METHOD 0 0 0 65535 ECU_ADDRESS 0x3FDBB8 FORMAT "%.4g" /end MEASUREMENT
/begin MEASUREMENT lavk_obd_dyn_st_b2 "dynamische LA-VKAT-Diagnose [RAM name from V530, voted 13]" UWORD M_FORMULA_0080 0 0 0 65535 ECU_ADDRESS 0x3FDBB8 /end MEASUREMENT
/begin MEASUREMENT lavk_obd_dyn_zustand_b2 "Zustand - dynamische LA-VKAT-Diagnose [RAM name from V530, voted 13]" UWORD NO_COMPU_METHOD 0 0 0 65535 ECU_ADDRESS 0x3FDBB8 FORMAT "%.4g" /end MEASUREMENT
/begin MEASUREMENT lavk_obd_dyn_ampl_mw_b1 "gemittelte Amplitude [RAM name from V530, voted 2]" UWORD M_FORMULA_0025 0 0 0 3.999938965 ECU_ADDRESS 0x3FDBE4 /end MEASUREMENT
/begin MEASUREMENT lavk_obd_dyn_ampl_max_mw_b1 "gem. max. Amplitude [RAM name from V530, voted 2]" UWORD M_FORMULA_0025 0 0 0 3.999938965 ECU_ADDRESS 0x3FDBF0 /end MEASUREMENT
/begin MEASUREMENT lavk_obd_dyn_ampl_min_mw_b1 "gem. min. Amplitude [RAM name from V530, voted 2]" UWORD M_FORMULA_0025 0 0 0 3.999938965 ECU_ADDRESS 0x3FDBF4 /end MEASUREMENT
/begin MEASUREMENT lavk_obd_dyn_ampl_sum_b1 "aufsummierte Amplitude [RAM name from V530, voted 3]" ULONG M_FORMULA_1016 0 0 0 262143.9999 ECU_ADDRESS 0x3FDBF8 /end MEASUREMENT
/begin MEASUREMENT lavk_obd_dyn_norm_b1 "normierte Amplitude [RAM name from V530, voted 4]" UWORD M_FORMULA_0025 0 0 0 3.999938965 ECU_ADDRESS 0x3FDC10 /end MEASUREMENT
/begin MEASUREMENT lavk_obd_dyn_norm_b2 "normierte Amplitude [RAM name from V530, voted 2]" UWORD M_FORMULA_0025 0 0 0 3.999938965 ECU_ADDRESS 0x3FDC12 /end MEASUREMENT
/begin MEASUREMENT lavk_obd_dyn_kat_exd_t_b1 "Prueflauf Freigabezeit [RAM name from V530, voted 18]" UWORD M_FORMULA_0921 0 0 0 655.35 ECU_ADDRESS 0x3FDC14 /end MEASUREMENT
/begin MEASUREMENT lavk_obd_dyn_kat_exd_t_b2 "Prueflauf Freigabezeit [RAM name from V530, voted 9]" UWORD M_FORMULA_0921 0 0 0 655.35 ECU_ADDRESS 0x3FDC16 /end MEASUREMENT
/begin MEASUREMENT lavk_obd_dyn_io_t_b1 "Verzoegerung d. Heilung [RAM name from V530, voted 6]" UWORD M_FORMULA_0021 0 0 0 655.35 ECU_ADDRESS 0x3FDC18 /end MEASUREMENT
/begin MEASUREMENT lavk_obd_dyn_io_t_b2 "Verzoegerung d. Heilung [RAM name from V530, voted 3]" UWORD M_FORMULA_0021 0 0 0 655.35 ECU_ADDRESS 0x3FDC1A /end MEASUREMENT
/begin MEASUREMENT lavk_obd_dyn_wert_max_b1 "Diagnoseschwelle - dyn. Sondendiag. [RAM name from V530, voted 5]" UWORD M_FORMULA_0025 0 0 0 3.999938965 ECU_ADDRESS 0x3FDC1C /end MEASUREMENT
/begin MEASUREMENT lavk_obd_dyn_wert_max_b2 "Diagnoseschwelle - dyn. Sondendiag. [RAM name from V530, voted 2]" UWORD M_FORMULA_0025 0 0 0 3.999938965 ECU_ADDRESS 0x3FDC1E /end MEASUREMENT
/begin MEASUREMENT lavk_obd_dyn_gesamt_max "Diagnoseschwelle - Gesamtsystem dyn. Sondendiag. [RAM name from V530, voted 2]" UWORD M_FORMULA_0025 0 0 0 3.999938965 ECU_ADDRESS 0x3FDC22 /end MEASUREMENT
/begin MEASUREMENT os_err.id.cnt "OS-Err: ID [RAM name from V530, voted 4]" UBYTE M_FORMULA_0003 0 0 0 255 ECU_ADDRESS 0x3FDC8C /end MEASUREMENT
/begin MEASUREMENT os_err.limit.cnt "OS-Err: Limit [RAM name from V530, voted 2]" UBYTE M_FORMULA_0003 0 0 0 255 ECU_ADDRESS 0x3FDC8E /end MEASUREMENT
/begin MEASUREMENT os_err.tt_act.cnt "OS-Err: TT aktiv [RAM name from V530, voted 2]" UBYTE M_FORMULA_0003 0 0 0 255 ECU_ADDRESS 0x3FDC90 /end MEASUREMENT
/begin MEASUREMENT os_err.tt_miss.cnt "OS-Err: TT missing [RAM name from V530, voted 2]" UBYTE M_FORMULA_0003 0 0 0 255 ECU_ADDRESS 0x3FDC94 /end MEASUREMENT
/begin MEASUREMENT os_err.stack.cnt "OS-Err: Stack [RAM name from V530, voted 2]" UBYTE M_FORMULA_0003 0 0 0 255 ECU_ADDRESS 0x3FDC96 /end MEASUREMENT
/begin MEASUREMENT os_err.deadline.cnt "OS-Err: Deadline [RAM name from V530, voted 2]" UBYTE M_FORMULA_0003 0 0 0 255 ECU_ADDRESS 0x3FDC9C /end MEASUREMENT
/begin MEASUREMENT os_err.dflt.cnt "OS-Err: Default [RAM name from V530, voted 2]" UBYTE M_FORMULA_0003 0 0 0 255 ECU_ADDRESS 0x3FDC9E /end MEASUREMENT
/begin MEASUREMENT os_err.dflt.task "OS-Err: Default [RAM name from V530, voted 1]" UBYTE NO_COMPU_METHOD 0 0 0 255 ECU_ADDRESS 0x3FDC9F FORMAT "%.4g" /end MEASUREMENT
/begin MEASUREMENT os_err.addr "OS-Err: Adresse [RAM name from V530, voted 2]" ULONG M_FORMULA_0000 0 0 0 4294967295 ECU_ADDRESS 0x3FDCA0 /end MEASUREMENT
/begin MEASUREMENT os_err.sum_cnt "OS-Err: Summe [RAM name from V530, voted 2]" UBYTE M_FORMULA_0003 0 0 0 255 ECU_ADDRESS 0x3FDCA4 /end MEASUREMENT
/begin MEASUREMENT os_err.type "Fehlertyp [RAM name from V530, voted 2]" UBYTE NO_COMPU_METHOD 0 0 0 255 ECU_ADDRESS 0x3FDCA5 FORMAT "%.4g" /end MEASUREMENT
/begin MEASUREMENT St_oznivdl0 "Statuswort [RAM name from V530, voted 32]" UBYTE M_FORMULA_0003 0 0 0 255 ECU_ADDRESS 0x3FDCB7 /end MEASUREMENT
/begin MEASUREMENT St_oznivdl0.B_ozkrzkor "Bedingung drehzahlkorrigierter Kurzzeit Niveaumittelwert berechnet [RAM name from V530, voted 32]" UBYTE NO_COMPU_METHOD 0 0 0 255 ECU_ADDRESS 0x3FDCB7 FORMAT "%.4g" /end MEASUREMENT
/begin MEASUREMENT St_oznivdl0.B_ozkrzl "St_oznivdl0.B_ozkrzl [RAM name from V530, voted 32]" UBYTE NO_COMPU_METHOD 0 0 0 255 ECU_ADDRESS 0x3FDCB7 FORMAT "%.4g" /end MEASUREMENT
/begin MEASUREMENT St_oznivdl0.B_ozkrzlkor "St_oznivdl0.B_ozkrzlkor [RAM name from V530, voted 32]" UBYTE NO_COMPU_METHOD 0 0 0 255 ECU_ADDRESS 0x3FDCB7 FORMAT "%.4g" /end MEASUREMENT
/begin MEASUREMENT St_oznivdl0.B_ozlangmw "Bedingung Langzeit-Mittelwert berechnet [RAM name from V530, voted 32]" UBYTE NO_COMPU_METHOD 0 0 0 255 ECU_ADDRESS 0x3FDCB7 FORMAT "%.4g" /end MEASUREMENT
/begin MEASUREMENT St_oznivdl0.B_ozluft "Umgebungsluftdruck plausibel / Steigungserkennung aktiv [RAM name from V530, voted 32]" UBYTE NO_COMPU_METHOD 0 0 0 255 ECU_ADDRESS 0x3FDCB7 FORMAT "%.4g" /end MEASUREMENT
/begin MEASUREMENT St_oznivdl0.B_oznivb "St_oznivdl0.B_oznivb [RAM name from V530, voted 32]" UBYTE NO_COMPU_METHOD 0 0 0 255 ECU_ADDRESS 0x3FDCB7 FORMAT "%.4g" /end MEASUREMENT
/begin MEASUREMENT St_oznivdl0.B_ozor "Bedingung Orientierungsmessung erfolgt [RAM name from V530, voted 32]" UBYTE NO_COMPU_METHOD 0 0 0 255 ECU_ADDRESS 0x3FDCB7 FORMAT "%.4g" /end MEASUREMENT
/begin MEASUREMENT St_oznivdl0.B_ozvormw "Bedingung vorgezogener Mittelwert berechnet [RAM name from V530, voted 32]" UBYTE NO_COMPU_METHOD 0 0 0 255 ECU_ADDRESS 0x3FDCB7 FORMAT "%.4g" /end MEASUREMENT
/begin MEASUREMENT St_oznivdl1 "Statuswort [RAM name from V530, voted 32]" UBYTE M_FORMULA_0003 0 0 0 255 ECU_ADDRESS 0x3FDCB8 /end MEASUREMENT
/begin MEASUREMENT St_oznivdl1.B_ozfahrt "Das Fahrzeug hat sich bewegt [RAM name from V530, voted 32]" UBYTE NO_COMPU_METHOD 0 0 0 255 ECU_ADDRESS 0x3FDCB8 FORMAT "%.4g" /end MEASUREMENT
/begin MEASUREMENT St_oznivdl1.B_ozkrzkor2 "Ein Mittelwert von zwei KurzMw ist da [RAM name from V530, voted 32]" UBYTE NO_COMPU_METHOD 0 0 0 255 ECU_ADDRESS 0x3FDCB8 FORMAT "%.4g" /end MEASUREMENT
/begin MEASUREMENT St_oznivdl1.B_ozkrzkornb "Bedingung drehzahlkorrigierter Kurzzeit Niveaumittelwert und nicht drehzahlbegrenzt berechnet [RAM name from V530, voted 32]" UBYTE NO_COMPU_METHOD 0 0 0 255 ECU_ADDRESS 0x3FDCB8 FORMAT "%.4g" /end MEASUREMENT
/begin MEASUREMENT St_oznivdl1.B_ozml "Anforderung Messung l???uft [RAM name from V530, voted 32]" UBYTE NO_COMPU_METHOD 0 0 0 255 ECU_ADDRESS 0x3FDCB8 FORMAT "%.4g" /end MEASUREMENT
/begin MEASUREMENT St_oznivdl1.B_ozmreset "Reset der Messungen (beim INI2-Sprung) [RAM name from V530, voted 32]" UBYTE NO_COMPU_METHOD 0 0 0 255 ECU_ADDRESS 0x3FDCB8 FORMAT "%.4g" /end MEASUREMENT
/begin MEASUREMENT St_oznivdl1.B_ozoelcheck "St_oznivdl1.B_ozoelcheck [RAM name from V530, voted 32]" UBYTE NO_COMPU_METHOD 0 0 0 255 ECU_ADDRESS 0x3FDCB8 FORMAT "%.4g" /end MEASUREMENT
/begin MEASUREMENT St_oznivdl1.B_ozoelchok "St_oznivdl1.B_ozoelchok [RAM name from V530, voted 32]" UBYTE NO_COMPU_METHOD 0 0 0 255 ECU_ADDRESS 0x3FDCB8 FORMAT "%.4g" /end MEASUREMENT
/begin MEASUREMENT St_oznivdl1.B_ozueberf "???berf???llung entdeckt [RAM name from V530, voted 32]" UBYTE NO_COMPU_METHOD 0 0 0 255 ECU_ADDRESS 0x3FDCB8 FORMAT "%.4g" /end MEASUREMENT
/begin MEASUREMENT Oz_lp "oz level picture [RAM name from V530, voted 10]" UBYTE M_FORMULA_0003 0 0 0 255 ECU_ADDRESS 0x3FDCBE /end MEASUREMENT
/begin MEASUREMENT Oz_lv "oz level value [RAM name from V530, voted 10]" UBYTE M_FORMULA_0003 0 0 0 255 ECU_ADDRESS 0x3FDCBF /end MEASUREMENT
/begin MEASUREMENT Oz_nivakt "Aktuelles Niveau f???r den Tester [RAM name from V530, voted 2]" UBYTE M_FORMULA_0436 0 0 0 74.70703125 ECU_ADDRESS 0x3FDCC0 /end MEASUREMENT
/begin MEASUREMENT Oz_nivkrzt "Kurzmittelwert-Niveau f???r den Tester [RAM name from V530, voted 1]" UBYTE M_FORMULA_0436 0 0 0 74.70703125 ECU_ADDRESS 0x3FDCC3 /end MEASUREMENT
/begin MEASUREMENT Oz_nivlit "???lniveau in Liter [RAM name from V530, voted 1]" UBYTE M_FORMULA_0438 0 0 0 25.5 ECU_ADDRESS 0x3FDCC4 /end MEASUREMENT
/begin MEASUREMENT Oz_orikor "OriMw korrigiert [RAM name from V530, voted 1]" UBYTE M_FORMULA_0436 0 0 0 74.70703125 ECU_ADDRESS 0x3FDCC6 /end MEASUREMENT
/begin MEASUREMENT Oz_vormw "vorgezogener Mittelwert Niveau [RAM name from V530, voted 1]" UBYTE M_FORMULA_0436 0 0 0 74.70703125 ECU_ADDRESS 0x3FDCC7 /end MEASUREMENT
/begin MEASUREMENT pabg_b1 "Abgasgegendruck gesamt [RAM name from V530, voted 4]" SWORD M_FORMULA_0075 0 0 -2048 2047.9375 ECU_ADDRESS 0x3FDCCC /end MEASUREMENT
/begin MEASUREMENT pabg_b1.dif "Diff. Abgasgegendruck zur PUMG [RAM name from V530, voted 1]" SWORD M_FORMULA_0075 0 0 -2048 2047.9375 ECU_ADDRESS 0x3FDCD0 /end MEASUREMENT
/begin MEASUREMENT pabg_b2 "Abgasgegendruck gesamt [RAM name from V530, voted 1]" SWORD M_FORMULA_0075 0 0 -2048 2047.9375 ECU_ADDRESS 0x3FDCD6 /end MEASUREMENT
/begin MEASUREMENT pabg_b2.dif "Diff. Abgasgegendruck zur PUMG [RAM name from V530, voted 1]" SWORD M_FORMULA_0075 0 0 -2048 2047.9375 ECU_ADDRESS 0x3FDCDA /end MEASUREMENT
/begin MEASUREMENT pabg_m "Mittelwert Abgasgegendruck [RAM name from V530, voted 1]" SWORD M_FORMULA_0075 0 0 -2048 2047.9375 ECU_ADDRESS 0x3FDCE0 /end MEASUREMENT
/begin MEASUREMENT pctrl_t_old_ipk "vorheriger Timer Wert aus der IPK [RAM name from V530, voted 3]" ULONG M_FORMULA_0000 0 0 0 4294967295 ECU_ADDRESS 0x3FDCE4 /end MEASUREMENT
/begin MEASUREMENT pctrl_task_tb "Timerwert Task-Ueberwachungszyklus [RAM name from V530, voted 3]" UBYTE M_FORMULA_0357 0 0 0 1.275 ECU_ADDRESS 0x3FDCE8 /end MEASUREMENT
/begin MEASUREMENT pctrl_proz_tb "Timerwert Prozess-Ueberwachungszyklus [RAM name from V530, voted 4]" UBYTE M_FORMULA_0357 0 0 0 1.275 ECU_ADDRESS 0x3FDCE9 /end MEASUREMENT
/begin MEASUREMENT pctrl_tout "Timeout Zaehler [RAM name from V530, voted 4]" UBYTE M_FORMULA_0358 0 0 0 2550 ECU_ADDRESS 0x3FDCEA /end MEASUREMENT
/begin MEASUREMENT pctrl_task "Taskueberwachung [RAM name from V530, voted 24]" UBYTE M_FORMULA_0003 0 0 0 255 ECU_ADDRESS 0x3FDCEB /end MEASUREMENT
/begin MEASUREMENT pctrl_task_err "Fehler Taskueberwachung [RAM name from V530, voted 7]" UBYTE M_FORMULA_0003 0 0 0 255 ECU_ADDRESS 0x3FDCEC /end MEASUREMENT
/begin MEASUREMENT pctrl_proz "Prozessueberwachung [RAM name from V530, voted 22]" UWORD M_FORMULA_0010 0 0 0 65535 ECU_ADDRESS 0x3FDCEE /end MEASUREMENT
/begin MEASUREMENT pctrl_proz_err "Fehler Prozessueberwachung [RAM name from V530, voted 8]" UWORD M_FORMULA_0010 0 0 0 65535 ECU_ADDRESS 0x3FDCF0 /end MEASUREMENT
/begin MEASUREMENT St_pgentred_1s "Statuswort [RAM name from V530, voted 7]" UBYTE M_FORMULA_0003 0 0 0 255 ECU_ADDRESS 0x3FDCFE /end MEASUREMENT
/begin MEASUREMENT St_pgentred_1s.B_genht "Bedingung Generator Hochtemperatur [RAM name from V530, voted 7]" UBYTE NO_COMPU_METHOD 0 0 0 255 ECU_ADDRESS 0x3FDCFE FORMAT "%.4g" /end MEASUREMENT
/begin MEASUREMENT St_pgentred_1s.B_genhtkrit "St_pgentred_1s.B_genhtkrit [RAM name from V530, voted 7]" UBYTE NO_COMPU_METHOD 0 0 0 255 ECU_ADDRESS 0x3FDCFE FORMAT "%.4g" /end MEASUREMENT
/begin MEASUREMENT St_pgentred_1s.B_genhtkritv "Bedingung kritische Temparatur vor Entprellung [RAM name from V530, voted 7]" UBYTE NO_COMPU_METHOD 0 0 0 255 ECU_ADDRESS 0x3FDCFE FORMAT "%.4g" /end MEASUREMENT
/begin MEASUREMENT St_pgentred_1s.B_genhtmxgra "Maximale Gradient Chiptemparatur ???berstiegen [RAM name from V530, voted 7]" UBYTE NO_COMPU_METHOD 0 0 0 255 ECU_ADDRESS 0x3FDCFE FORMAT "%.4g" /end MEASUREMENT
/begin MEASUREMENT St_pgentred_1s.B_ierrgrenzh "Grenzstrom aus Hochtemperatur Generator aktiv [RAM name from V530, voted 7]" UBYTE NO_COMPU_METHOD 0 0 0 255 ECU_ADDRESS 0x3FDCFE FORMAT "%.4g" /end MEASUREMENT
/begin MEASUREMENT St_pgentred_1s.B_tdiodekrit "Diodentemparatur im kritischen Bereich [RAM name from V530, voted 7]" UBYTE NO_COMPU_METHOD 0 0 0 255 ECU_ADDRESS 0x3FDCFE FORMAT "%.4g" /end MEASUREMENT
/begin MEASUREMENT pks_obd_abw_filt "gefiltertes Kraftstoffdruck Ist-Soll Verhaeltniss [RAM name from V530, voted 3]" SWORD M_FORMULA_0543 0 0 -32768 32767 ECU_ADDRESS 0x3FDD48 /end MEASUREMENT
/begin MEASUREMENT pks_ad "eingelesener Spannungswert des Kraftstoffdrucksignals [RAM name from V530, voted 1]" SWORD M_FORMULA_0114 0 0 -32768 32767 ECU_ADDRESS 0x3FDD4A /end MEASUREMENT
/begin MEASUREMENT pks_ist_roh "Kraftstoffdruck, absolut, ungefiltert [RAM name from V530, voted 1]" SWORD M_FORMULA_0110 0 0 -32.768 32.767 ECU_ADDRESS 0x3FDD4C /end MEASUREMENT
/begin MEASUREMENT pks_rel_mdl "Kraftstoffdruck aus Modell [RAM name from V530, voted 1]" SWORD M_FORMULA_0110 0 0 -32.768 32.767 ECU_ADDRESS 0x3FDD4E /end MEASUREMENT
/begin MEASUREMENT pks_plau_delta "Delta zwischen Modell und pks_rel [RAM name from V530, voted 2]" SWORD M_FORMULA_0110 0 0 -32.768 32.767 ECU_ADDRESS 0x3FDD50 /end MEASUREMENT
/begin MEASUREMENT pks_aufbau_fehler "Differentzdruck zu PK_PKS_TV100_MIN [RAM name from V530, voted 3]" SWORD M_FORMULA_0110 0 0 -32.768 32.767 ECU_ADDRESS 0x3FDD56 /end MEASUREMENT
/begin MEASUREMENT pks_obd_zust "Zustandautomat pks_obd [RAM name from V530, voted 3]" UBYTE NO_COMPU_METHOD 0 0 0 255 ECU_ADDRESS 0x3FDD5D FORMAT "%.4g" /end MEASUREMENT
/begin MEASUREMENT pksr_ekp_100_rampe "Delta fuer Rampe aus 100Proz [RAM name from V530, voted 4]" UBYTE M_FORMULA_1033 0 0 0 25.5 ECU_ADDRESS 0x3FDD6A /end MEASUREMENT
/begin MEASUREMENT pks_soll_dyn "Sollwert Kraftstoffdruck, gefiltert [RAM name from V530, voted 3]" SWORD M_FORMULA_0110 0 0 -32.768 32.767 ECU_ADDRESS 0x3FDD6C /end MEASUREMENT
/begin MEASUREMENT pks_soll_dyn_delta_max "Sollwert Kraftstoffdruck, Filter-Abweichung [RAM name from V530, voted 2]" SWORD M_FORMULA_0110 0 0 -32.768 32.767 ECU_ADDRESS 0x3FDD70 /end MEASUREMENT
/begin MEASUREMENT pks_soll "Sollwert Kraftstoffdruck, relativ [RAM name from V530, voted 4]" SWORD M_FORMULA_0110 0 0 -32.768 32.767 ECU_ADDRESS 0x3FDD72 /end MEASUREMENT
/begin MEASUREMENT pksr_tv_regler "vom PI-Regler ermitteltes TV inkl. Spgs.-Korrektur [RAM name from V530, voted 3]" SWORD M_FORMULA_0161 0 0 -3200 3199.902344 ECU_ADDRESS 0x3FDD74 /end MEASUREMENT
/begin MEASUREMENT pksr_q_ekp "Volumenstrom EKP [RAM name from V530, voted 3]" SWORD M_FORMULA_0746 0 0 -4096 4095.875 ECU_ADDRESS 0x3FDD7E /end MEASUREMENT
/begin MEASUREMENT pksr_p_anteil "P-Anteil Kraftstoffdruckregler [RAM name from V530, voted 2]" SWORD M_FORMULA_0161 0 0 -3200 3199.902344 ECU_ADDRESS 0x3FDD80 /end MEASUREMENT
/begin MEASUREMENT pksr_s_anteil "Steuer-Anteil Kraftstoffdruckregler [RAM name from V530, voted 1]" SWORD M_FORMULA_0161 0 0 -3200 3199.902344 ECU_ADDRESS 0x3FDD8C /end MEASUREMENT
/begin MEASUREMENT pksr_status "Status Kraftstoffdruckregelung [RAM name from V530, voted 7]" UBYTE NO_COMPU_METHOD 0 0 0 255 ECU_ADDRESS 0x3FDD8E FORMAT "%.4g" /end MEASUREMENT
/begin MEASUREMENT pksr_ekp2_enable2 "Zuschaltbedingung2 f. EKP2 [RAM name from V530, voted 4]" SWORD NO_COMPU_METHOD 0 0 -32768 32767 ECU_ADDRESS 0x3FDD94 FORMAT "%.4g" /end MEASUREMENT
/begin MEASUREMENT pksr_t_vorlauf "Vorlauftimer [RAM name from V530, voted 3]" UWORD M_FORMULA_0021 0 0 0 655.35 ECU_ADDRESS 0x3FDDA0 /end MEASUREMENT
/begin MEASUREMENT pksr_t_abst "Abstelltimer [RAM name from V530, voted 5]" UWORD M_FORMULA_0021 0 0 0 655.35 ECU_ADDRESS 0x3FDDA2 /end MEASUREMENT
/begin MEASUREMENT St_pmdiag0 "Statuswort [RAM name from V530, voted 5]" UBYTE M_FORMULA_0003 0 0 0 255 ECU_ADDRESS 0x3FDE4A /end MEASUREMENT
/begin MEASUREMENT St_pmdiag0.B_ccbtnach "CC Meldung : Batterie Nachladen [RAM name from V530, voted 5]" UBYTE NO_COMPU_METHOD 0 0 0 255 ECU_ADDRESS 0x3FDE4A FORMAT "%.4g" /end MEASUREMENT
/begin MEASUREMENT St_pmdiag0.B_ccbttdfk "CC Meldung : Batterie verschlissen [RAM name from V530, voted 5]" UBYTE NO_COMPU_METHOD 0 0 0 255 ECU_ADDRESS 0x3FDE4A FORMAT "%.4g" /end MEASUREMENT
/begin MEASUREMENT St_pmdiag0.B_ccbttknt "CC Meldung : Batteriekontakt pruefen [RAM name from V530, voted 5]" UBYTE NO_COMPU_METHOD 0 0 0 255 ECU_ADDRESS 0x3FDE4A FORMAT "%.4g" /end MEASUREMENT
/begin MEASUREMENT St_pmdiag0.B_ccpmerr "CC Meldung : Powermgm ausser Betrieb [RAM name from V530, voted 5]" UBYTE NO_COMPU_METHOD 0 0 0 255 ECU_ADDRESS 0x3FDE4A FORMAT "%.4g" /end MEASUREMENT
/begin MEASUREMENT St_pmdiag0.B_ccprio "CC Meldung : Komfortverbraucher eingeschraenkt [RAM name from V530, voted 5]" UBYTE NO_COMPU_METHOD 0 0 0 255 ECU_ADDRESS 0x3FDE4A FORMAT "%.4g" /end MEASUREMENT
/begin MEASUREMENT St_pmdiag0.B_codierpm "Anfrage an CAS die Codierdaten erneut fuer PM zu senden. [RAM name from V530, voted 5]" UBYTE NO_COMPU_METHOD 0 0 0 255 ECU_ADDRESS 0x3FDE4A FORMAT "%.4g" /end MEASUREMENT
/begin MEASUREMENT St_pmdiag0.B_pcoschg "Bed. SVstatus darf ge???ndert werden. [RAM name from V530, voted 5]" UBYTE NO_COMPU_METHOD 0 0 0 255 ECU_ADDRESS 0x3FDE4A FORMAT "%.4g" /end MEASUREMENT
/begin MEASUREMENT St_pmdiag0.B_tiefrset "Tiefentladungsbit, B_tiefset, im IBS l???schen. [RAM name from V530, voted 5]" UBYTE NO_COMPU_METHOD 0 0 0 255 ECU_ADDRESS 0x3FDE4A FORMAT "%.4g" /end MEASUREMENT
/begin MEASUREMENT St_pmdiag1 "Statuswort [RAM name from V530, voted 2]" UBYTE M_FORMULA_0003 0 0 0 255 ECU_ADDRESS 0x3FDE4B /end MEASUREMENT
/begin MEASUREMENT St_pmdiag1.B_ccruhver "CC Meldung : erhoehter Ruhestrom [RAM name from V530, voted 2]" UBYTE NO_COMPU_METHOD 0 0 0 255 ECU_ADDRESS 0x3FDE4B FORMAT "%.4g" /end MEASUREMENT
/begin MEASUREMENT St_pmdiag1.B_histrset "IBS Histrogramm darf gel???scht werden. [RAM name from V530, voted 2]" UBYTE NO_COMPU_METHOD 0 0 0 255 ECU_ADDRESS 0x3FDE4B FORMAT "%.4g" /end MEASUREMENT
/begin MEASUREMENT St_pmdiag1.B_qelad1step "Q_elad 1. Takt vorbei [RAM name from V530, voted 2]" UBYTE NO_COMPU_METHOD 0 0 0 255 ECU_ADDRESS 0x3FDE4B FORMAT "%.4g" /end MEASUREMENT
/begin MEASUREMENT St_pmdiag1.B_ruhverl7 "Ruhestromverletzung derzeit vorhanden. [RAM name from V530, voted 2]" UBYTE NO_COMPU_METHOD 0 0 0 255 ECU_ADDRESS 0x3FDE4B FORMAT "%.4g" /end MEASUREMENT
/begin MEASUREMENT St_pmdiag1.B_sv_ihka "IHKA Standverbraucher aktiv [RAM name from V530, voted 2]" UBYTE NO_COMPU_METHOD 0 0 0 255 ECU_ADDRESS 0x3FDE4B FORMAT "%.4g" /end MEASUREMENT
/begin MEASUREMENT St_pmdiag1.B_timer_rst "Dient zum Aufziehen des internen Delay Timers [RAM name from V530, voted 2]" UBYTE NO_COMPU_METHOD 0 0 0 255 ECU_ADDRESS 0x3FDE4B FORMAT "%.4g" /end MEASUREMENT
/begin MEASUREMENT T3pmcntr "T3PMINFO countdowncounter [RAM name from V530, voted 3]" UWORD M_FORMULA_0071 0 0 0 6553.5 ECU_ADDRESS 0x3FDE5E /end MEASUREMENT
/begin MEASUREMENT Batt_index "Batterie Index [RAM name from V530, voted 2]" UBYTE M_FORMULA_0003 0 0 0 255 ECU_ADDRESS 0x3FDE6A /end MEASUREMENT
/begin MEASUREMENT C_battnenn "Batteriekapazitaet [RAM name from V530, voted 1]" UBYTE M_FORMULA_0487 0 0 0 255 ECU_ADDRESS 0x3FDE6B /end MEASUREMENT
/begin MEASUREMENT Ibsbor_hb "highbyte ibsborctr [RAM name from V530, voted 1]" UBYTE M_FORMULA_0003 0 0 0 255 ECU_ADDRESS 0x3FDE6D /end MEASUREMENT
/begin MEASUREMENT St_pmprsvcalc "Statuswort [RAM name from V530, voted 13]" UBYTE M_FORMULA_0003 0 0 0 255 ECU_ADDRESS 0x3FDF04 /end MEASUREMENT
/begin MEASUREMENT St_pmprsvcalc.B_gendef "Bedingung Generator defekt w???hrend Motorbetrieb [RAM name from V530, voted 13]" UBYTE NO_COMPU_METHOD 0 0 0 255 ECU_ADDRESS 0x3FDF04 FORMAT "%.4g" /end MEASUREMENT
/begin MEASUREMENT St_pmprsvcalc.B_ipmaktiv "IPM Massnahmen bzgl. Prios aktiviert [RAM name from V530, voted 13]" UBYTE NO_COMPU_METHOD 0 0 0 255 ECU_ADDRESS 0x3FDF04 FORMAT "%.4g" /end MEASUREMENT
/begin MEASUREMENT St_pmprsvcalc.B_ipmtimer "IPM Timer f???r Prios aktiv [RAM name from V530, voted 13]" UBYTE NO_COMPU_METHOD 0 0 0 255 ECU_ADDRESS 0x3FDF04 FORMAT "%.4g" /end MEASUREMENT
/begin MEASUREMENT St_pmprsvcalc.B_kwdr_old "Dient zur Erkennung einer steigender Flanke B_kl15 [RAM name from V530, voted 13]" UBYTE NO_COMPU_METHOD 0 0 0 255 ECU_ADDRESS 0x3FDF04 FORMAT "%.4g" /end MEASUREMENT
/begin MEASUREMENT St_pmprsvcalc.B_nkwptcio "NKW status f???r PTC i.o. [RAM name from V530, voted 13]" UBYTE NO_COMPU_METHOD 0 0 0 255 ECU_ADDRESS 0x3FDF04 FORMAT "%.4g" /end MEASUREMENT
/begin MEASUREMENT St_pmprsvcalc.B_ptckoor "PTC Koordinator Ma???nahmen Aktiv [RAM name from V530, voted 13]" UBYTE NO_COMPU_METHOD 0 0 0 255 ECU_ADDRESS 0x3FDF04 FORMAT "%.4g" /end MEASUREMENT
/begin MEASUREMENT St_pmprsvcalc.B_ubtlow "Bedingung Batterie in Unterspannungszustand [RAM name from V530, voted 13]" UBYTE NO_COMPU_METHOD 0 0 0 255 ECU_ADDRESS 0x3FDF04 FORMAT "%.4g" /end MEASUREMENT
/begin MEASUREMENT St_pmprsvcalc.B_uloreset "Bedingung Batterie nicht mehr in Unterspannungszustand [RAM name from V530, voted 13]" UBYTE NO_COMPU_METHOD 0 0 0 255 ECU_ADDRESS 0x3FDF04 FORMAT "%.4g" /end MEASUREMENT
/begin MEASUREMENT St_pmprsvcalc1 "Statuswort [RAM name from V530, voted 11]" UBYTE M_FORMULA_0003 0 0 0 255 ECU_ADDRESS 0x3FDF05 /end MEASUREMENT
/begin MEASUREMENT St_pmprsvcalc1.B_dubt "Bedg., ob dubt > 100mV [RAM name from V530, voted 11]" UBYTE NO_COMPU_METHOD 0 0 0 255 ECU_ADDRESS 0x3FDF05 FORMAT "%.4g" /end MEASUREMENT
/begin MEASUREMENT St_pmprsvcalc1.B_enwakeup "Bit, ob IBS Bus wecken darf oder nicht. [RAM name from V530, voted 11]" UBYTE NO_COMPU_METHOD 0 0 0 255 ECU_ADDRESS 0x3FDF05 FORMAT "%.4g" /end MEASUREMENT
/begin MEASUREMENT St_pmprsvcalc1.B_limcalc "Bedg. begrenzte Berechnung [RAM name from V530, voted 11]" UBYTE NO_COMPU_METHOD 0 0 0 255 ECU_ADDRESS 0x3FDF05 FORMAT "%.4g" /end MEASUREMENT
/begin MEASUREMENT St_pmprsvcalc1.B_notprsv "Bed.Notlauf aufg.Batt-Unterspg, Generatorstat und B_kl15 in PMPRSVCALC [RAM name from V530, voted 11]" UBYTE NO_COMPU_METHOD 0 0 0 255 ECU_ADDRESS 0x3FDF05 FORMAT "%.4g" /end MEASUREMENT
/begin MEASUREMENT St_pmprsvcalc1.B_pireset "Bedingung f???r PI-Reset [RAM name from V530, voted 11]" UBYTE NO_COMPU_METHOD 0 0 0 255 ECU_ADDRESS 0x3FDF05 FORMAT "%.4g" /end MEASUREMENT
/begin MEASUREMENT St_pmprsvcalc1.B_pmbsdanf "Bedg. ob 3b4 versendet wird [RAM name from V530, voted 11]" UBYTE NO_COMPU_METHOD 0 0 0 255 ECU_ADDRESS 0x3FDF05 FORMAT "%.4g" /end MEASUREMENT
/begin MEASUREMENT St_pmprsvcalc1.B_pmvsdanf "Bedg., ob 3b3 versendet wird [RAM name from V530, voted 11]" UBYTE NO_COMPU_METHOD 0 0 0 255 ECU_ADDRESS 0x3FDF05 FORMAT "%.4g" /end MEASUREMENT
/begin MEASUREMENT St_pmprsvcalc2 "Statuswort [RAM name from V530, voted 1]" UBYTE M_FORMULA_0003 0 0 0 255 ECU_ADDRESS 0x3FDF06 /end MEASUREMENT
/begin MEASUREMENT St_pmprsvcalc2.B_kwdrise "Motorstart Rising [RAM name from V530, voted 1]" UBYTE NO_COMPU_METHOD 0 0 0 255 ECU_ADDRESS 0x3FDF06 FORMAT "%.4g" /end MEASUREMENT
/begin MEASUREMENT St_pmprsvcalc2.B_pmsulevon "PM Sulev Ma???nahmen aktiv [RAM name from V530, voted 1]" UBYTE NO_COMPU_METHOD 0 0 0 255 ECU_ADDRESS 0x3FDF06 FORMAT "%.4g" /end MEASUREMENT
/begin MEASUREMENT Priopizw2 "Pi-Regler zw2 [RAM name from V530, voted 1]" SLONG M_FORMULA_0504 0 0 -16777216 16777215.99 ECU_ADDRESS 0x3FDF0C /end MEASUREMENT
/begin MEASUREMENT Dfpi2ptc "Gewichtung der Prios -> Gewichtung f???r PTC Ansteuerung [RAM name from V530, voted 1]" SWORD M_FORMULA_0505 0 0 -8192 8191.75 ECU_ADDRESS 0x3FDF1E /end MEASUREMENT
/begin MEASUREMENT Dsoc2pi "Batterieladezustand-Gewichtung auf Prios [RAM name from V530, voted 2]" SWORD M_FORMULA_0505 0 0 -8192 8191.75 ECU_ADDRESS 0x3FDF22 /end MEASUREMENT
/begin MEASUREMENT Ctrpwrcf "Komfort-Teil von ctrpwrcos [RAM name from V530, voted 1]" UWORD M_FORMULA_0010 0 0 0 65535 ECU_ADDRESS 0x3FDF2A /end MEASUREMENT
/begin MEASUREMENT Ctrpwrcos "Steuerung_Leistung_Verbraucher [RAM name from V530, voted 2]" UWORD M_FORMULA_0010 0 0 0 65535 ECU_ADDRESS 0x3FDF2C /end MEASUREMENT
/begin MEASUREMENT Ctrpwrmem "altes ctrpwrcos [RAM name from V530, voted 1]" UWORD M_FORMULA_0010 0 0 0 65535 ECU_ADDRESS 0x3FDF32 /end MEASUREMENT
/begin MEASUREMENT Dfprio "Dfprio [RAM name from V530, voted 1]" UWORD M_FORMULA_0507 0 0 0 16383.75 ECU_ADDRESS 0x3FDF36 /end MEASUREMENT
/begin MEASUREMENT Ctrcbr "Steuerung_Stromzweige [RAM name from V530, voted 1]" UBYTE M_FORMULA_0003 0 0 0 255 ECU_ADDRESS 0x3FDF4A /end MEASUREMENT
/begin MEASUREMENT Ctrcbrmem "altes ctrbr [RAM name from V530, voted 1]" UBYTE M_FORMULA_0003 0 0 0 255 ECU_ADDRESS 0x3FDF4C /end MEASUREMENT
/begin MEASUREMENT Ctrpcos "Steuerung_Standverbraucher [RAM name from V530, voted 1]" UBYTE M_FORMULA_0003 0 0 0 255 ECU_ADDRESS 0x3FDF4D /end MEASUREMENT
/begin MEASUREMENT Ctrpcosmem "altes ctrpcos [RAM name from V530, voted 1]" UBYTE M_FORMULA_0003 0 0 0 255 ECU_ADDRESS 0x3FDF4E /end MEASUREMENT
/begin MEASUREMENT Ctrprio "Steuerung_Spitzenreduzierung_Priorit???t [RAM name from V530, voted 1]" UBYTE M_FORMULA_0003 0 0 0 255 ECU_ADDRESS 0x3FDF4F /end MEASUREMENT
/begin MEASUREMENT Ctrprio7 "lokales ctrprio [RAM name from V530, voted 2]" UBYTE M_FORMULA_0003 0 0 0 255 ECU_ADDRESS 0x3FDF50 /end MEASUREMENT
/begin MEASUREMENT Ctrpriocf "Steuerung_Spitzenreduzierung_Priorit???t_Komfort [RAM name from V530, voted 1]" UBYTE M_FORMULA_0003 0 0 0 255 ECU_ADDRESS 0x3FDF51 /end MEASUREMENT
/begin MEASUREMENT Ctrpriocf7 "lokales ctrpriocf [RAM name from V530, voted 2]" UBYTE M_FORMULA_0003 0 0 0 255 ECU_ADDRESS 0x3FDF52 /end MEASUREMENT
/begin MEASUREMENT Ctrpriomem "altes ctrprio [RAM name from V530, voted 1]" UBYTE M_FORMULA_0003 0 0 0 255 ECU_ADDRESS 0x3FDF54 /end MEASUREMENT
/begin MEASUREMENT Ctrpwspcos "Steuerung_Leistung_Sonderverbraucher [RAM name from V530, voted 1]" UBYTE M_FORMULA_0510 0 0 0 127.5 ECU_ADDRESS 0x3FDF55 /end MEASUREMENT
/begin MEASUREMENT Dff_filt7 "lokales dffgenflit [RAM name from V530, voted 1]" UBYTE M_FORMULA_0475 0 0 0 99.609375 ECU_ADDRESS 0x3FDF56 /end MEASUREMENT
/begin MEASUREMENT Dfgenfilt "???ber PT-1 gefiltertes dffgen-Signal [RAM name from V530, voted 2]" UBYTE M_FORMULA_0475 0 0 0 99.609375 ECU_ADDRESS 0x3FDF57 /end MEASUREMENT
/begin MEASUREMENT Dfpt1ptc "Wert nach DFFGEN-Filter PTC [RAM name from V530, voted 1]" UBYTE M_FORMULA_0475 0 0 0 99.609375 ECU_ADDRESS 0x3FDF59 /end MEASUREMENT
/begin MEASUREMENT Picntr "Counter fuer PI-Reset [RAM name from V530, voted 2]" UBYTE M_FORMULA_0461 0 0 0 25.5 ECU_ADDRESS 0x3FDF5A /end MEASUREMENT
/begin MEASUREMENT Pmbscount "zyklisches Senden entspricht 5 sek [RAM name from V530, voted 1]" UBYTE M_FORMULA_0003 0 0 0 255 ECU_ADDRESS 0x3FDF5B /end MEASUREMENT
/begin MEASUREMENT Pmvscount "Z???hler bis zum n???chsten zyklischen Senden von 3b3 [RAM name from V530, voted 1]" UBYTE M_FORMULA_0003 0 0 0 255 ECU_ADDRESS 0x3FDF5C /end MEASUREMENT
/begin MEASUREMENT Ptc_pwr7 "lokales ptc_pwr [RAM name from V530, voted 1]" UBYTE M_FORMULA_0510 0 0 0 127.5 ECU_ADDRESS 0x3FDF5E /end MEASUREMENT
/begin MEASUREMENT Pwrspmem "altes ctrpwspcos [RAM name from V530, voted 1]" UBYTE M_FORMULA_0510 0 0 0 127.5 ECU_ADDRESS 0x3FDF5F /end MEASUREMENT
/begin MEASUREMENT Rqpcos "Anforderung_Standverbraucher [RAM name from V530, voted 1]" UBYTE M_FORMULA_0003 0 0 0 255 ECU_ADDRESS 0x3FDF60 /end MEASUREMENT
/begin MEASUREMENT Rqpcosmem "altes rqpcos [RAM name from V530, voted 1]" UBYTE M_FORMULA_0003 0 0 0 255 ECU_ADDRESS 0x3FDF62 /end MEASUREMENT
/begin MEASUREMENT Selspcos "Auswahl_Sonderverbraucher [RAM name from V530, voted 1]" UBYTE M_FORMULA_0003 0 0 0 255 ECU_ADDRESS 0x3FDF63 /end MEASUREMENT
/begin MEASUREMENT Selspcosme "altes selspcos [RAM name from V530, voted 1]" UBYTE M_FORMULA_0003 0 0 0 255 ECU_ADDRESS 0x3FDF64 /end MEASUREMENT
/begin MEASUREMENT Stpcos "Status_Standverbraucher [RAM name from V530, voted 1]" UBYTE M_FORMULA_0003 0 0 0 255 ECU_ADDRESS 0x3FDF65 /end MEASUREMENT
/begin MEASUREMENT Ulow "Unterspannungsstatus : 0=i.O, 1=in between, 2=unterspannung [RAM name from V530, voted 8]" UBYTE M_FORMULA_0003 0 0 0 255 ECU_ADDRESS 0x3FDF69 /end MEASUREMENT
/begin MEASUREMENT Ulowtimer "Zeit zur Unterspannungserkennung * Taskzeit (50*100ms = 5sec) [RAM name from V530, voted 5]" UBYTE M_FORMULA_0461 0 0 0 25.5 ECU_ADDRESS 0x3FDF6A /end MEASUREMENT
/begin MEASUREMENT St_pmsoccalc "Statuswort [RAM name from V530, voted 12]" UBYTE M_FORMULA_0003 0 0 0 255 ECU_ADDRESS 0x3FDF6C /end MEASUREMENT
/begin MEASUREMENT St_pmsoccalc.B_soc_pwf "Uo Kalibrierung durchgef???hrt [RAM name from V530, voted 12]" UBYTE NO_COMPU_METHOD 0 0 0 255 ECU_ADDRESS 0x3FDF6C FORMAT "%.4g" /end MEASUREMENT
/begin MEASUREMENT St_pmsoccalc.B_soccalc "Uo Kalibrierung durchgef???hrt [RAM name from V530, voted 12]" UBYTE NO_COMPU_METHOD 0 0 0 255 ECU_ADDRESS 0x3FDF6C FORMAT "%.4g" /end MEASUREMENT
/begin MEASUREMENT D_qelad "Delta Kapazit???t entladen [RAM name from V530, voted 1]" UWORD M_FORMULA_0498 0 0 0 1192.750253 ECU_ADDRESS 0x3FDF7E /end MEASUREMENT
/begin MEASUREMENT D_qlad "Delta Kapazit???t geladen [RAM name from V530, voted 3]" UWORD M_FORMULA_0498 0 0 0 1192.750253 ECU_ADDRESS 0x3FDF80 /end MEASUREMENT
/begin MEASUREMENT Soc_bila "Ladezustand durch Bilanzierung und Ruhespannungsmessung ermittelt [RAM name from V530, voted 1]" UWORD M_FORMULA_0462 0 0 0 99.99847412 ECU_ADDRESS 0x3FDF82 /end MEASUREMENT
/begin MEASUREMENT Soc_quali "Z???hler Genauigkeit Ladeztustandsbestimmung [RAM name from V530, voted 6]" UWORD M_FORMULA_0498 0 0 0 1192.750253 ECU_ADDRESS 0x3FDF84 /end MEASUREMENT
/begin MEASUREMENT Ubatt0 "Aus Wertetripel ausgew???hlter Ruhespannungswert [RAM name from V530, voted 7]" UWORD M_FORMULA_0501 0 0 6 22.38375 ECU_ADDRESS 0x3FDF86 /end MEASUREMENT
/begin MEASUREMENT Cbatt_lo "Nennkapazit???t Batterie, lokal [RAM name from V530, voted 1]" UBYTE M_FORMULA_0487 0 0 0 255 ECU_ADDRESS 0x3FDF88 /end MEASUREMENT
/begin MEASUREMENT Ib_commcnt "Z???hler Taskaufrufe zwischen periodischer Abfrage qlad und qelad [RAM name from V530, voted 2]" UBYTE M_FORMULA_0003 0 0 0 255 ECU_ADDRESS 0x3FDF89 /end MEASUREMENT
/begin MEASUREMENT Ib_commsta "Statemaschine zeiger zur Abfrage qlad und qelad [RAM name from V530, voted 3]" UBYTE M_FORMULA_0003 0 0 0 255 ECU_ADDRESS 0x3FDF8A /end MEASUREMENT
/begin MEASUREMENT Kalevcnt "Anzahl der Ruhespannungsmessungen [RAM name from V530, voted 3]" UBYTE M_FORMULA_0003 0 0 0 255 ECU_ADDRESS 0x3FDF8B /end MEASUREMENT
/begin MEASUREMENT Soc_fit_temp "Soc_fit_temp [RAM name from V530, voted 2]" UWORD M_FORMULA_0462 0 0 0 99.99847412 ECU_ADDRESS 0x3FDF8C /end MEASUREMENT
/begin MEASUREMENT Ubatts2 "Hilfswert2 Spannung aus Fitberechnung [RAM name from V530, voted 1]" UWORD M_FORMULA_0501 0 0 6 22.38375 ECU_ADDRESS 0x3FDF8E /end MEASUREMENT
/begin MEASUREMENT St_pmsockor0 "Statuswort [RAM name from V530, voted 25]" UBYTE M_FORMULA_0003 0 0 0 255 ECU_ADDRESS 0x3FDF90 /end MEASUREMENT
/begin MEASUREMENT St_pmsockor0.B_abschfit "Bedingung Korrektur Startf???higkeitsgrenze durchgef???hrt [RAM name from V530, voted 25]" UBYTE NO_COMPU_METHOD 0 0 0 255 ECU_ADDRESS 0x3FDF90 FORMAT "%.4g" /end MEASUREMENT
/begin MEASUREMENT St_pmsockor0.B_pm_fit2 "Bedingung Hilfsvariable Fit 2 [RAM name from V530, voted 25]" UBYTE NO_COMPU_METHOD 0 0 0 255 ECU_ADDRESS 0x3FDF90 FORMAT "%.4g" /end MEASUREMENT
/begin MEASUREMENT St_pmsockor0.B_pm_fit3 "Bedingung Hilfsvariable Fit 3 [RAM name from V530, voted 25]" UBYTE NO_COMPU_METHOD 0 0 0 255 ECU_ADDRESS 0x3FDF90 FORMAT "%.4g" /end MEASUREMENT
/begin MEASUREMENT St_pmsockor0.B_pmsocini "wird beim INIT wahr um den Timer zur???ckzusetzen [RAM name from V530, voted 25]" UBYTE NO_COMPU_METHOD 0 0 0 255 ECU_ADDRESS 0x3FDF90 FORMAT "%.4g" /end MEASUREMENT
/begin MEASUREMENT St_pmsockor0.B_q_start "Bedingung Startqualit???t vollst???ndig berechnet [RAM name from V530, voted 25]" UBYTE NO_COMPU_METHOD 0 0 0 255 ECU_ADDRESS 0x3FDF90 FORMAT "%.4g" /end MEASUREMENT
/begin MEASUREMENT St_pmsockor0.B_soc_npl "Bedingung SoC-Wert nicht plausibel [RAM name from V530, voted 25]" UBYTE NO_COMPU_METHOD 0 0 0 255 ECU_ADDRESS 0x3FDF90 FORMAT "%.4g" /end MEASUREMENT
/begin MEASUREMENT D_socw "Delta SoC [RAM name from V530, voted 1]" SWORD M_FORMULA_0479 0 0 -100 99.99694824 ECU_ADDRESS 0x3FDF92 /end MEASUREMENT
/begin MEASUREMENT St_pmsocstart0 "Statuswort [RAM name from V530, voted 9]" UBYTE M_FORMULA_0003 0 0 0 255 ECU_ADDRESS 0x3FDF9C /end MEASUREMENT
/begin MEASUREMENT St_pmsocstart0.B_pmstart7 "Bed. Motorstart f???r Startauswertung PM [RAM name from V530, voted 9]" UBYTE NO_COMPU_METHOD 0 0 0 255 ECU_ADDRESS 0x3FDF9C FORMAT "%.4g" /end MEASUREMENT
/begin MEASUREMENT St_pmsocstart0.B_resetsta "Bedingung Reset Startauswertung [RAM name from V530, voted 9]" UBYTE NO_COMPU_METHOD 0 0 0 255 ECU_ADDRESS 0x3FDF9C FORMAT "%.4g" /end MEASUREMENT
/begin MEASUREMENT St_pmsocstart0.B_rstdatardy "Motor aus erkannt, Startwerte im IBS bereit zum l???schen. [RAM name from V530, voted 9]" UBYTE NO_COMPU_METHOD 0 0 0 255 ECU_ADDRESS 0x3FDF9C FORMAT "%.4g" /end MEASUREMENT
/begin MEASUREMENT Pmstartsta "Schalter f???r Ablaufsteuerung [RAM name from V530, voted 4]" UBYTE M_FORMULA_0003 0 0 0 255 ECU_ADDRESS 0x3FDFAA /end MEASUREMENT
/begin MEASUREMENT pumg_ad "Eingelesener Spannungswert fuer Umgebungsdruck [RAM name from V530, voted 3]" SWORD M_FORMULA_0114 0 0 -32768 32767 ECU_ADDRESS 0x3FE0DE /end MEASUREMENT
/begin MEASUREMENT pumg_obd_filter "gradientenbasierter vorheriger Messwert [RAM name from V530, voted 2]" SWORD M_FORMULA_0075 0 0 -2048 2047.9375 ECU_ADDRESS 0x3FE0E0 /end MEASUREMENT
/begin MEASUREMENT pumg_obd_modell_mw "pumg-Modellmittelwert [RAM name from V530, voted 2]" SWORD M_FORMULA_0075 0 0 -2048 2047.9375 ECU_ADDRESS 0x3FE0EA /end MEASUREMENT
/begin MEASUREMENT qadc_lavk_last_samples "Letzten Werte bei der Auswertung [RAM name from V530, voted 4]" UWORD M_FORMULA_0010 0 0 0 65535 ECU_ADDRESS 0x3FE100 /end MEASUREMENT
/begin MEASUREMENT qadc_lavk_cwp_alt "Conversion Pointer bei letzter Auswertung [RAM name from V530, voted 2]" SWORD M_FORMULA_0010 0 0 -32768 32767 ECU_ADDRESS 0x3FE104 /end MEASUREMENT
/begin MEASUREMENT qadc_lavk_anz_b1 "Anzahl der Aufaddierten AD-Werte [RAM name from V530, voted 5]" UWORD M_FORMULA_0010 0 0 0 65535 ECU_ADDRESS 0x3FE108 /end MEASUREMENT
/begin MEASUREMENT qadc_lavk_anz_b2 "Anzahl der Aufaddierten AD-Werte [RAM name from V530, voted 2]" UWORD M_FORMULA_0010 0 0 0 65535 ECU_ADDRESS 0x3FE10A /end MEASUREMENT
/begin MEASUREMENT qadc_lavk_sum_b1 "Summe der AD-Werte [RAM name from V530, voted 5]" ULONG M_FORMULA_0000 0 0 0 4294967295 ECU_ADDRESS 0x3FE10C /end MEASUREMENT
/begin MEASUREMENT qadc_lavk_sum_b2 "Summe der AD-Werte [RAM name from V530, voted 2]" ULONG M_FORMULA_0000 0 0 0 4294967295 ECU_ADDRESS 0x3FE110 /end MEASUREMENT
/begin MEASUREMENT qadc_lavk_anz_read "Anzahl der LAVK Samples in der Queue [RAM name from V530, voted 1]" UWORD M_FORMULA_0010 0 0 0 65535 ECU_ADDRESS 0x3FE114 /end MEASUREMENT
/begin MEASUREMENT ram_chk_rptr "aktueller RAM_CHK Zeiger [RAM name from V530, voted 4]" ULONG M_FORMULA_0000 0 0 0 4294967295 ECU_ADDRESS 0x3FE1DC /end MEASUREMENT
/begin MEASUREMENT ram_chk_freq "Ueberprufeungsfreuquenz RAM [RAM name from V530, voted 1]" UWORD M_FORMULA_0360 0 0 0 655.35 ECU_ADDRESS 0x3FE1E0 /end MEASUREMENT
/begin MEASUREMENT rf_st_ll_ramp "Segmentzaehler fuer die rf Rampe von Start auf LL [RAM name from V530, voted 2]" UBYTE M_FORMULA_1059 0 0 0 127.5 ECU_ADDRESS 0x3FE1F2 /end MEASUREMENT
/begin MEASUREMENT rf_dyn_la_cnt "Zaehler fuer die LA Dynamik Erkennung [RAM name from V530, voted 8]" UWORD M_FORMULA_0080 0 0 0 65535 ECU_ADDRESS 0x3FE1F4 /end MEASUREMENT
/begin MEASUREMENT rf_dyn_o2_cnt "Zaehler fuer die O2 Dynamik Erkennung [RAM name from V530, voted 8]" UWORD M_FORMULA_0080 0 0 0 65535 ECU_ADDRESS 0x3FE1F6 /end MEASUREMENT
/begin MEASUREMENT rf_dyn_st "Statusbyte fuer rf Dynamik [RAM name from V530, voted 39]" UBYTE M_FORMULA_0037 0 0 0 255 ECU_ADDRESS 0x3FE1F8 /end MEASUREMENT
/begin MEASUREMENT rf_dyn_st_fplau "Statusbyte fuer rf Dynamik [RAM name from V530, voted 39]" UBYTE NO_COMPU_METHOD 0 0 0 255 ECU_ADDRESS 0x3FE1F8 FORMAT "%.4g" /end MEASUREMENT
/begin MEASUREMENT rf_dyn_st_la "Statusbyte fuer rf Dynamik [RAM name from V530, voted 39]" UBYTE NO_COMPU_METHOD 0 0 0 255 ECU_ADDRESS 0x3FE1F8 FORMAT "%.4g" /end MEASUREMENT
/begin MEASUREMENT rf_dyn_st_la_trim "Statusbyte fuer rf Dynamik [RAM name from V530, voted 39]" UBYTE NO_COMPU_METHOD 0 0 0 255 ECU_ADDRESS 0x3FE1F8 FORMAT "%.4g" /end MEASUREMENT
/begin MEASUREMENT rf_dyn_st_o2 "Statusbyte fuer rf Dynamik [RAM name from V530, voted 39]" UBYTE NO_COMPU_METHOD 0 0 0 255 ECU_ADDRESS 0x3FE1F8 FORMAT "%.4g" /end MEASUREMENT
/begin MEASUREMENT rf_dyn_st_te "Statusbyte fuer rf Dynamik [RAM name from V530, voted 39]" UBYTE NO_COMPU_METHOD 0 0 0 255 ECU_ADDRESS 0x3FE1F8 FORMAT "%.4g" /end MEASUREMENT
/begin MEASUREMENT rps_zust_allg "Allg. Zustand [RAM name from V530, voted 1]" UBYTE M_FORMULA_0003 0 0 0 255 ECU_ADDRESS 0x3FE204 /end MEASUREMENT
/begin MEASUREMENT sa_n "Drehzahlschwelle fuer Schubabschalten [RAM name from V530, voted 4]" SWORD M_FORMULA_0006 0 0 -32768 32767 ECU_ADDRESS 0x3FE26E /end MEASUREMENT
/begin MEASUREMENT sa_t_sa_trig_max "Maximale Verweilzeit im Zustand SA-Trigger [RAM name from V530, voted 1]" UWORD M_FORMULA_0109 0 0 0 327.675 ECU_ADDRESS 0x3FE272 /end MEASUREMENT
/begin MEASUREMENT sa_msr_t_sperre "MSR Sperrzeit fuer SA [RAM name from V530, voted 4]" UWORD M_FORMULA_0109 0 0 0 327.675 ECU_ADDRESS 0x3FE274 /end MEASUREMENT
/begin MEASUREMENT schalter_st_inj_old "schalter_st_inj_old [RAM name from V530, voted 3]" UWORD M_FORMULA_0080 0 0 0 65535 ECU_ADDRESS 0x3FE276 /end MEASUREMENT
/begin MEASUREMENT schalter_poel_time "Diagnosezeit [RAM name from V530, voted 4]" UWORD M_FORMULA_0021 0 0 0 655.35 ECU_ADDRESS 0x3FE282 /end MEASUREMENT
/begin MEASUREMENT schalter_getr_n_verh_fil "Getriebe Eingangsdrehzahl / Abtriebsdrehzahl gefiltert [RAM name from V530, voted 3]" SWORD M_FORMULA_0073 0 0 -32 31.99902344 ECU_ADDRESS 0x3FE28E /end MEASUREMENT
/begin MEASUREMENT schalter_kupp_diag "Status Kupplungsschalter [RAM name from V530, voted 4]" UWORD NO_COMPU_METHOD 0 0 0 65535 ECU_ADDRESS 0x3FE294 FORMAT "%.4g" /end MEASUREMENT
/begin MEASUREMENT schalter_kupp_diag_verz "Status Kupplungsschalter verzoegert [RAM name from V530, voted 2]" UWORD NO_COMPU_METHOD 0 0 0 65535 ECU_ADDRESS 0x3FE296 FORMAT "%.4g" /end MEASUREMENT
/begin MEASUREMENT schalter_kupp_diag_scharf "Diagnose Kupplungsschalter scharf [RAM name from V530, voted 2]" UBYTE NO_COMPU_METHOD 0 0 0 255 ECU_ADDRESS 0x3FE298 FORMAT "%.4g" /end MEASUREMENT
/begin MEASUREMENT schalter_kupp_diag_timer "Diagnosetimer Kupplungsschalter [RAM name from V530, voted 3]" UWORD M_FORMULA_0071 0 0 0 6553.5 ECU_ADDRESS 0x3FE29A /end MEASUREMENT
/begin MEASUREMENT schalter_ks_md_eff "effektives Wunschmoment fuer Kraftschluss [RAM name from V530, voted 1]" SWORD M_FORMULA_0009 0 0 -3276.8 3276.7 ECU_ADDRESS 0x3FE29E /end MEASUREMENT
/begin MEASUREMENT schalter_ks_n_ref "Referenzdrehzahl [RAM name from V530, voted 2]" SWORD M_FORMULA_0006 0 0 -32768 32767 ECU_ADDRESS 0x3FE2A2 /end MEASUREMENT
/begin MEASUREMENT schalter_ks_n_diff_ref "Abstand zur Referenzdrehzahl [RAM name from V530, voted 2]" SWORD M_FORMULA_0006 0 0 -32768 32767 ECU_ADDRESS 0x3FE2A4 /end MEASUREMENT
/begin MEASUREMENT schalter_ks_n_hys_timer "Timer Hysterese Drehzahldifferenz Kraftschluss [RAM name from V530, voted 2]" UWORD M_FORMULA_0021 0 0 0 655.35 ECU_ADDRESS 0x3FE2AA /end MEASUREMENT
/begin MEASUREMENT sk_fail_st_zyl "Zusammenfassung Ausblender [RAM name from V530, voted 6]" UWORD NO_COMPU_METHOD 0 0 0 65535 ECU_ADDRESS 0x3FE2B0 FORMAT "%.4g" /end MEASUREMENT
/begin MEASUREMENT sk_fm_gemisch "Eingang Gemisch-Matrix [RAM name from V530, voted 9]" UBYTE NO_COMPU_METHOD 0 0 0 255 ECU_ADDRESS 0x3FE2B2 FORMAT "%.4g" /end MEASUREMENT
/begin MEASUREMENT sk_fm_egas_exd "Abschaltung ueber Exd [RAM name from V530, voted 3]" UBYTE NO_COMPU_METHOD 0 0 0 255 ECU_ADDRESS 0x3FE2B4 FORMAT "%.4g" /end MEASUREMENT
/begin MEASUREMENT sk_tr_error_cnt "Fehlerzaehler Testrechnung [RAM name from V530, voted 1]" UBYTE M_FORMULA_0003 0 0 0 255 ECU_ADDRESS 0x3FE2B8 /end MEASUREMENT
/begin MEASUREMENT sk_md_begr_st "Ausloeser MD-Begrenzung [RAM name from V530, voted 10]" UWORD NO_COMPU_METHOD 0 0 0 65535 ECU_ADDRESS 0x3FE2BC FORMAT "%.4g" /end MEASUREMENT
/begin MEASUREMENT sk_ti_off_st "Ausloeser TI-Abschaltung [RAM name from V530, voted 5]" UWORD NO_COMPU_METHOD 0 0 0 65535 ECU_ADDRESS 0x3FE2BE FORMAT "%.4g" /end MEASUREMENT
/begin MEASUREMENT sk_egas_off_time_b1 "Zeit bis Egasabschaltung [RAM name from V530, voted 1]" UWORD M_FORMULA_0021 0 0 0 655.35 ECU_ADDRESS 0x3FE2C0 /end MEASUREMENT
/begin MEASUREMENT sk_egas_off_time_b2 "Zeit bis Egasabschaltung [RAM name from V530, voted 1]" UWORD M_FORMULA_0021 0 0 0 655.35 ECU_ADDRESS 0x3FE2C2 /end MEASUREMENT
/begin MEASUREMENT sk_ti_zyl_off_cnt "Anzahl der Ausblender [RAM name from V530, voted 2]" UBYTE M_FORMULA_0003 0 0 0 255 ECU_ADDRESS 0x3FE2C4 /end MEASUREMENT
/begin MEASUREMENT sk_hw_pwg1m_ad_alt "AD-Wandlerwert PWG1 des Masterprozessors vor 10ms [RAM name from V530, voted 3]" SWORD M_FORMULA_0114 0 0 -32768 32767 ECU_ADDRESS 0x3FE2C8 /end MEASUREMENT
/begin MEASUREMENT sk_hw_pwg1s_ad_alt "AD-Wandlerwert PWG1 des Slaveprozessors vor 10ms [RAM name from V530, voted 3]" SWORD M_FORMULA_0114 0 0 -32768 32767 ECU_ADDRESS 0x3FE2CA /end MEASUREMENT
/begin MEASUREMENT sk_hw_pwg1m_ad_zaehler "Zaehlervariable fuer Stationaerbetrieb PWG1-Master [RAM name from V530, voted 5]" UBYTE M_FORMULA_0357 0 0 0 1.275 ECU_ADDRESS 0x3FE2CC /end MEASUREMENT
/begin MEASUREMENT sk_hw_pwg1s_ad_zaehler "Zaehlervariable fuer Stationaerbetrieb PWG1-Slave [RAM name from V530, voted 3]" UBYTE M_FORMULA_0357 0 0 0 1.275 ECU_ADDRESS 0x3FE2CD /end MEASUREMENT
/begin MEASUREMENT sk_hw_pwg1_ad_ed_zaehler "Zaehlervariable bei fehlerhaftem AD-Wert [RAM name from V530, voted 6]" UBYTE M_FORMULA_0357 0 0 0 1.275 ECU_ADDRESS 0x3FE2CE /end MEASUREMENT
/begin MEASUREMENT sk_hw_pwg1_ad_mode "Zustand der AD-Wandler PWG1-Erfassung [RAM name from V530, voted 4]" UBYTE NO_COMPU_METHOD 0 0 0 255 ECU_ADDRESS 0x3FE2CF FORMAT "%.4g" /end MEASUREMENT
/begin MEASUREMENT sk_tr_wait "Wartezeit Testrechnung [RAM name from V530, voted 1]" UBYTE M_FORMULA_0461 0 0 0 25.5 ECU_ADDRESS 0x3FE2D0 /end MEASUREMENT
/begin MEASUREMENT sk_tr_state "Zustand Testrechnung [RAM name from V530, voted 1]" UBYTE NO_COMPU_METHOD 0 0 0 255 ECU_ADDRESS 0x3FE2D1 FORMAT "%.4g" /end MEASUREMENT
/begin MEASUREMENT sk_tr_error_nr "Fehler Testrechnung [RAM name from V530, voted 1]" UBYTE M_FORMULA_0003 0 0 0 255 ECU_ADDRESS 0x3FE2D2 /end MEASUREMENT
/begin MEASUREMENT slp_pabg_dif_max "Abgasgegendruck gefiltert [RAM name from V530, voted 6]" SWORD M_FORMULA_0075 0 0 -2048 2047.9375 ECU_ADDRESS 0x3FE2FE /end MEASUREMENT
/begin MEASUREMENT sls_obdh_diag_time_on "Time der sls-OBD Diagnoese [RAM name from V530, voted 3]" UWORD M_FORMULA_0644 0 0 0 655.35 ECU_ADDRESS 0x3FE322 /end MEASUREMENT
/begin COMPU_METHOD M_FORMULA_0000 "V530 FORMULA_0000" RAT_FUNC "%.4g" "-" COEFFS 0 1 0 0 0 1 /end COMPU_METHOD
/begin COMPU_METHOD M_FORMULA_0003 "V530 FORMULA_0003" RAT_FUNC "%.4g" "-" COEFFS 0 1 0 0 0 1 /end COMPU_METHOD
/begin COMPU_METHOD M_FORMULA_0006 "V530 FORMULA_0006" RAT_FUNC "%.4g" "Upm" COEFFS 0 1 0 0 0 1 /end COMPU_METHOD
/begin COMPU_METHOD M_FORMULA_0008 "V530 FORMULA_0008" RAT_FUNC "%.4g" "V" COEFFS 0 10 0 0 0 1 /end COMPU_METHOD
/begin COMPU_METHOD M_FORMULA_0009 "V530 FORMULA_0009" RAT_FUNC "%.4g" "Nm" COEFFS 0 10 0 0 0 1 /end COMPU_METHOD
/begin COMPU_METHOD M_FORMULA_0010 "V530 FORMULA_0010" RAT_FUNC "%.4g" "-" COEFFS 0 1 0 0 0 1 /end COMPU_METHOD
/begin COMPU_METHOD M_FORMULA_0017 "V530 FORMULA_0017" RAT_FUNC "%.4g" "ms" COEFFS 0 7000 0 0 0 1 /end COMPU_METHOD
/begin COMPU_METHOD M_FORMULA_0021 "V530 FORMULA_0021" RAT_FUNC "%.4g" "s" COEFFS 0 100 0 0 0 1 /end COMPU_METHOD
/begin COMPU_METHOD M_FORMULA_0023 "V530 FORMULA_0023" RAT_FUNC "%.4g" "???C" COEFFS 0 10 2732 0 0 1 /end COMPU_METHOD
/begin COMPU_METHOD M_FORMULA_0024 "V530 FORMULA_0024" RAT_FUNC "%.4g" "-" COEFFS 0 32768 0 0 0 1 /end COMPU_METHOD
/begin COMPU_METHOD M_FORMULA_0025 "V530 FORMULA_0025" RAT_FUNC "%.4g" "-" COEFFS 0 16384 0 0 0 1 /end COMPU_METHOD
/begin COMPU_METHOD M_FORMULA_0032 "V530 FORMULA_0032" RAT_FUNC "%.4g" "%" COEFFS 0 1 0 0 0 1 /end COMPU_METHOD
/begin COMPU_METHOD M_FORMULA_0037 "V530 FORMULA_0037" RAT_FUNC "%.4g" "-" COEFFS 0 1 0 0 0 1 /end COMPU_METHOD
/begin COMPU_METHOD M_FORMULA_0044 "V530 FORMULA_0044" RAT_FUNC "%.4g" "-" COEFFS 0 1 0 0 0 1 /end COMPU_METHOD
/begin COMPU_METHOD M_FORMULA_0071 "V530 FORMULA_0071" RAT_FUNC "%.4g" "s" COEFFS 0 10 0 0 0 1 /end COMPU_METHOD
/begin COMPU_METHOD M_FORMULA_0072 "V530 FORMULA_0072" RAT_FUNC "%.4g" "us" COEFFS 0 1 0 0 0 1 /end COMPU_METHOD
/begin COMPU_METHOD M_FORMULA_0073 "V530 FORMULA_0073" RAT_FUNC "%.4g" "-" COEFFS 0 1024 0 0 0 1 /end COMPU_METHOD
/begin COMPU_METHOD M_FORMULA_0075 "V530 FORMULA_0075" RAT_FUNC "%.4g" "mbar" COEFFS 0 16 0 0 0 1 /end COMPU_METHOD
/begin COMPU_METHOD M_FORMULA_0080 "V530 FORMULA_0080" RAT_FUNC "%.4g" "-" COEFFS 0 1 0 0 0 1 /end COMPU_METHOD
/begin COMPU_METHOD M_FORMULA_0090 "V530 FORMULA_0090" RAT_FUNC "%.4g" "mg" COEFFS 0 10 0 0 0 1 /end COMPU_METHOD
/begin COMPU_METHOD M_FORMULA_0103 "V530 FORMULA_0103" RAT_FUNC "%.4g" "kg/h" COEFFS 0 10 0 0 0 1 /end COMPU_METHOD
/begin COMPU_METHOD M_FORMULA_0104 "V530 FORMULA_0104" RAT_FUNC "%.4g" "mg/asp" COEFFS 0 10 0 0 0 1 /end COMPU_METHOD
/begin COMPU_METHOD M_FORMULA_0109 "V530 FORMULA_0109" RAT_FUNC "%.4g" "s" COEFFS 0 200 0 0 0 1 /end COMPU_METHOD
/begin COMPU_METHOD M_FORMULA_0110 "V530 FORMULA_0110" RAT_FUNC "%.4g" "bar" COEFFS 0 1000 0 0 0 1 /end COMPU_METHOD
/begin COMPU_METHOD M_FORMULA_0114 "V530 FORMULA_0114" RAT_FUNC "%.4g" "digit" COEFFS 0 1 0 0 0 1 /end COMPU_METHOD
/begin COMPU_METHOD M_FORMULA_0123 "V530 FORMULA_0123" RAT_FUNC "%.4g" "m/(s*s)" COEFFS 0 40 0 0 0 1 /end COMPU_METHOD
/begin COMPU_METHOD M_FORMULA_0143 "V530 FORMULA_0143" RAT_FUNC "%.4g" "qmm" COEFFS 0 10 0 0 0 1 /end COMPU_METHOD
/begin COMPU_METHOD M_FORMULA_0147 "V530 FORMULA_0147" RAT_FUNC "%.4g" "s" COEFFS 0 100 0 0 0 1 /end COMPU_METHOD
/begin COMPU_METHOD M_FORMULA_0161 "V530 FORMULA_0161" RAT_FUNC "%.4g" "%" COEFFS 0 10.24 0 0 0 1 /end COMPU_METHOD
/begin COMPU_METHOD M_FORMULA_0166 "V530 FORMULA_0166" RAT_FUNC "%.4g" "Upm" COEFFS 0 0.02 0 0 0 1 /end COMPU_METHOD
/begin COMPU_METHOD M_FORMULA_0199 "V530 FORMULA_0199" RAT_FUNC "%.4g" "-" COEFFS 0 16384 0 0 0 1 /end COMPU_METHOD
/begin COMPU_METHOD M_FORMULA_0214 "V530 FORMULA_0214" RAT_FUNC "%.4g" "s" COEFFS 0 1 0 0 0 1 /end COMPU_METHOD
/begin COMPU_METHOD M_FORMULA_0261 "V530 FORMULA_0261" RAT_FUNC "%.4g" "V" COEFFS 0 641.4697355 0 0 0 1 /end COMPU_METHOD
/begin COMPU_METHOD M_FORMULA_0306 "V530 FORMULA_0306" RAT_FUNC "%.4g" "s" COEFFS 0 100 0 0 0 1 /end COMPU_METHOD
/begin COMPU_METHOD M_FORMULA_0354 "V530 FORMULA_0354" RAT_FUNC "%.4g" "ms" COEFFS 0 625 0 0 0 1 /end COMPU_METHOD
/begin COMPU_METHOD M_FORMULA_0357 "V530 FORMULA_0357" RAT_FUNC "%.4g" "s" COEFFS 0 200 0 0 0 1 /end COMPU_METHOD
/begin COMPU_METHOD M_FORMULA_0358 "V530 FORMULA_0358" RAT_FUNC "%.4g" "ms" COEFFS 0 0.1 0 0 0 1 /end COMPU_METHOD
/begin COMPU_METHOD M_FORMULA_0360 "V530 FORMULA_0360" RAT_FUNC "%.4g" "kHz" COEFFS 0 100 0 0 0 1 /end COMPU_METHOD
/begin COMPU_METHOD M_FORMULA_0431 "V530 FORMULA_0431" RAT_FUNC "%.4g" "???C" COEFFS 0 10 0 0 0 1 /end COMPU_METHOD
/begin COMPU_METHOD M_FORMULA_0436 "V530 FORMULA_0436" RAT_FUNC "%.4g" "mm" COEFFS 0 3.413333333 0 0 0 1 /end COMPU_METHOD
/begin COMPU_METHOD M_FORMULA_0438 "V530 FORMULA_0438" RAT_FUNC "%.4g" "Liter" COEFFS 0 10 0 0 0 1 /end COMPU_METHOD
/begin COMPU_METHOD M_FORMULA_0461 "V530 FORMULA_0461" RAT_FUNC "%.4g" "s" COEFFS 0 10 0 0 0 1 /end COMPU_METHOD
/begin COMPU_METHOD M_FORMULA_0462 "V530 FORMULA_0462" RAT_FUNC "%.4g" "%" COEFFS 0 655.36 0 0 0 1 /end COMPU_METHOD
/begin COMPU_METHOD M_FORMULA_0463 "V530 FORMULA_0463" RAT_FUNC "%.4g" "" COEFFS 0 1 0 0 0 1 /end COMPU_METHOD
/begin COMPU_METHOD M_FORMULA_0475 "V530 FORMULA_0475" RAT_FUNC "%.4g" "%" COEFFS 0 2.56 0 0 0 1 /end COMPU_METHOD
/begin COMPU_METHOD M_FORMULA_0479 "V530 FORMULA_0479" RAT_FUNC "%.4g" "-" COEFFS 0 327.68 0 0 0 1 /end COMPU_METHOD
/begin COMPU_METHOD M_FORMULA_0487 "V530 FORMULA_0487" RAT_FUNC "%.4g" "-" COEFFS 0 1 0 0 0 1 /end COMPU_METHOD
/begin COMPU_METHOD M_FORMULA_0498 "V530 FORMULA_0498" RAT_FUNC "%.4g" "Ah" COEFFS 0 54.94444444 0 0 0 1 /end COMPU_METHOD
/begin COMPU_METHOD M_FORMULA_0501 "V530 FORMULA_0501" RAT_FUNC "%.4g" "" COEFFS 0 4000 -24000 0 0 1 /end COMPU_METHOD
/begin COMPU_METHOD M_FORMULA_0504 "V530 FORMULA_0504" RAT_FUNC "%.4g" "" COEFFS 0 128 0 0 0 1 /end COMPU_METHOD
/begin COMPU_METHOD M_FORMULA_0505 "V530 FORMULA_0505" RAT_FUNC "%.4g" "" COEFFS 0 4 0 0 0 1 /end COMPU_METHOD
/begin COMPU_METHOD M_FORMULA_0507 "V530 FORMULA_0507" RAT_FUNC "%.4g" "" COEFFS 0 4 0 0 0 1 /end COMPU_METHOD
/begin COMPU_METHOD M_FORMULA_0508 "V530 FORMULA_0508" RAT_FUNC "%.4g" "" COEFFS 0 12.5 2500 0 0 1 /end COMPU_METHOD
/begin COMPU_METHOD M_FORMULA_0510 "V530 FORMULA_0510" RAT_FUNC "%.4g" "%" COEFFS 0 2 0 0 0 1 /end COMPU_METHOD
/begin COMPU_METHOD M_FORMULA_0511 "V530 FORMULA_0511" RAT_FUNC "%.4g" "A" COEFFS 0 50 0 0 0 1 /end COMPU_METHOD
/begin COMPU_METHOD M_FORMULA_0515 "V530 FORMULA_0515" RAT_FUNC "%.4g" "A" COEFFS 0 50 0 0 0 1 /end COMPU_METHOD
/begin COMPU_METHOD M_FORMULA_0535 "V530 FORMULA_0535" RAT_FUNC "%.4g" "mg/ASP" COEFFS 0 64 0 0 0 1 /end COMPU_METHOD
/begin COMPU_METHOD M_FORMULA_0536 "V530 FORMULA_0536" RAT_FUNC "%.4g" "mV" COEFFS 0 0.2048 0 0 0 1 /end COMPU_METHOD
/begin COMPU_METHOD M_FORMULA_0541 "V530 FORMULA_0541" RAT_FUNC "%.4g" "Ohm" COEFFS 0 10 0 0 0 1 /end COMPU_METHOD
/begin COMPU_METHOD M_FORMULA_0543 "V530 FORMULA_0543" RAT_FUNC "%.4g" "%" COEFFS 0 1 0 0 0 1 /end COMPU_METHOD
/begin COMPU_METHOD M_FORMULA_0545 "V530 FORMULA_0545" RAT_FUNC "%.4g" "Diags" COEFFS 0 1 0 0 0 1 /end COMPU_METHOD
/begin COMPU_METHOD M_FORMULA_0553 "V530 FORMULA_0553" RAT_FUNC "%.4g" "mA" COEFFS 0 444.4444444 0 0 0 1 /end COMPU_METHOD
/begin COMPU_METHOD M_FORMULA_0559 "V530 FORMULA_0559" RAT_FUNC "%.4g" "l" COEFFS 0 2 0 0 0 1 /end COMPU_METHOD
/begin COMPU_METHOD M_FORMULA_0593 "V530 FORMULA_0593" RAT_FUNC "%.4g" "s" COEFFS 0 1 0 0 0 1 /end COMPU_METHOD
/begin COMPU_METHOD M_FORMULA_0638 "V530 FORMULA_0638" RAT_FUNC "%.4g" "" COEFFS 0 128 0 0 0 1 /end COMPU_METHOD
/begin COMPU_METHOD M_FORMULA_0640 "V530 FORMULA_0640" RAT_FUNC "%.4g" "ms" COEFFS 0 2 0 0 0 1 /end COMPU_METHOD
/begin COMPU_METHOD M_FORMULA_0644 "V530 FORMULA_0644" RAT_FUNC "%.4g" "s" COEFFS 0 100 0 0 0 1 /end COMPU_METHOD
/begin COMPU_METHOD M_FORMULA_0665 "V530 FORMULA_0665" RAT_FUNC "%.4g" "%" COEFFS 0 512 0 0 0 1 /end COMPU_METHOD
/begin COMPU_METHOD M_FORMULA_0668 "V530 FORMULA_0668" RAT_FUNC "%.4g" "ms" COEFFS 0 0.01 0 0 0 1 /end COMPU_METHOD
/begin COMPU_METHOD M_FORMULA_0674 "V530 FORMULA_0674" RAT_FUNC "%.4g" "mbar/s" COEFFS 0 16 0 0 0 1 /end COMPU_METHOD
/begin COMPU_METHOD M_FORMULA_0675 "V530 FORMULA_0675" RAT_FUNC "%.4g" "bar/s" COEFFS 0 0.32 0 0 0 1 /end COMPU_METHOD
/begin COMPU_METHOD M_FORMULA_0732 "V530 FORMULA_0732" RAT_FUNC "%.4g" "A" COEFFS 0 50 10000 0 0 1 /end COMPU_METHOD
/begin COMPU_METHOD M_FORMULA_0746 "V530 FORMULA_0746" RAT_FUNC "%.4g" "l/h" COEFFS 0 8 0 0 0 1 /end COMPU_METHOD
/begin COMPU_METHOD M_FORMULA_0761 "V530 FORMULA_0761" RAT_FUNC "%.4g" "ms" COEFFS 0 31.25 0 0 0 1 /end COMPU_METHOD
/begin COMPU_METHOD M_FORMULA_0763 "V530 FORMULA_0763" RAT_FUNC "%.4g" "ms" COEFFS 0 1 0 0 0 1 /end COMPU_METHOD
/begin COMPU_METHOD M_FORMULA_0764 "V530 FORMULA_0764" RAT_FUNC "%.4g" "-" COEFFS 0 32768 0 0 0 1 /end COMPU_METHOD
/begin COMPU_METHOD M_FORMULA_0791 "V530 FORMULA_0791" RAT_FUNC "%.4g" "???C" COEFFS 0 1 0 0 0 1 /end COMPU_METHOD
/begin COMPU_METHOD M_FORMULA_0854 "V530 FORMULA_0854" RAT_FUNC "%.4g" "s" COEFFS 0 10 0 0 0 1 /end COMPU_METHOD
/begin COMPU_METHOD M_FORMULA_0908 "V530 FORMULA_0908" RAT_FUNC "%.4g" "10exp-3 -/mV" COEFFS 0 80 0 0 0 1 /end COMPU_METHOD
/begin COMPU_METHOD M_FORMULA_0909 "V530 FORMULA_0909" RAT_FUNC "%.4g" "-/s" COEFFS 0 16384 0 0 0 1 /end COMPU_METHOD
/begin COMPU_METHOD M_FORMULA_0920 "V530 FORMULA_0920" RAT_FUNC "%.4g" "%" COEFFS 0 81.92 0 0 0 1 /end COMPU_METHOD
/begin COMPU_METHOD M_FORMULA_0921 "V530 FORMULA_0921" RAT_FUNC "%.4g" "s" COEFFS 0 100 0 0 0 1 /end COMPU_METHOD
/begin COMPU_METHOD M_FORMULA_0925 "V530 FORMULA_0925" RAT_FUNC "%.4g" "A" COEFFS 0 215 0 0 0 1 /end COMPU_METHOD
/begin COMPU_METHOD M_FORMULA_0934 "V530 FORMULA_0934" RAT_FUNC "%.4g" "mV" COEFFS 0 0.2048 0 0 0 1 /end COMPU_METHOD
/begin COMPU_METHOD M_FORMULA_0935 "V530 FORMULA_0935" RAT_FUNC "%.4g" "%" COEFFS 0 20.48 0 0 0 1 /end COMPU_METHOD
/begin COMPU_METHOD M_FORMULA_0937 "V530 FORMULA_0937" RAT_FUNC "%.4g" "s" COEFFS 0 10 0 0 0 1 /end COMPU_METHOD
/begin COMPU_METHOD M_FORMULA_0963 "V530 FORMULA_0963" RAT_FUNC "%.4g" "kg/h" COEFFS 0 512 0 0 0 1 /end COMPU_METHOD
/begin COMPU_METHOD M_FORMULA_0965 "V530 FORMULA_0965" RAT_FUNC "%.4g" "kg/h" COEFFS 0 512 0 0 0 1 /end COMPU_METHOD
/begin COMPU_METHOD M_FORMULA_0967 "V530 FORMULA_0967" RAT_FUNC "%.4g" "(kg/h)/mbar" COEFFS 0 1024 0 0 0 1 /end COMPU_METHOD
/begin COMPU_METHOD M_FORMULA_0968 "V530 FORMULA_0968" RAT_FUNC "%.4g" "Pa/s" COEFFS 0 1600 0 0 0 1 /end COMPU_METHOD
/begin COMPU_METHOD M_FORMULA_0983 "V530 FORMULA_0983" RAT_FUNC "%.4g" "mg" COEFFS 0 10 0 0 0 1 /end COMPU_METHOD
/begin COMPU_METHOD M_FORMULA_1016 "V530 FORMULA_1016" RAT_FUNC "%.4g" "-" COEFFS 0 16384 0 0 0 1 /end COMPU_METHOD
/begin COMPU_METHOD M_FORMULA_1033 "V530 FORMULA_1033" RAT_FUNC "%.4g" "bar/s" COEFFS 0 10 0 0 0 1 /end COMPU_METHOD
/begin COMPU_METHOD M_FORMULA_1059 "V530 FORMULA_1059" RAT_FUNC "%.4g" "Segmente" COEFFS 0 2 0 0 0 1 /end COMPU_METHOD
/begin COMPU_METHOD CM_0079 "X*0.1953125" RAT_FUNC "%.4g" "1/sec" COEFFS 0 1 0 0 0 0.1953125 /end COMPU_METHOD
/begin COMPU_METHOD CM_0080 "X" RAT_FUNC "%.4g" "Gang" COEFFS 0 1 0 0 0 1 /end COMPU_METHOD
/begin COMPU_METHOD CM_0084 "X*6.0" RAT_FUNC "%.4g" "us" COEFFS 0 1 0 0 0 6 /end COMPU_METHOD
/begin COMPU_METHOD CM_0085 "X" RAT_FUNC "%.4g" "bar" COEFFS 0 1 0 0 0 1 /end COMPU_METHOD
/begin COMPU_METHOD CM_0086 "X*0.1953125" RAT_FUNC "%.4g" "1/s" COEFFS 0 1 0 0 0 0.1953125 /end COMPU_METHOD
/begin COMPU_METHOD CM_0088 "X*10.0" RAT_FUNC "%.4g" "Nm/s" COEFFS 0 1 0 0 0 10 /end COMPU_METHOD
/begin COMPU_METHOD CM_0089 "X*0.0001" RAT_FUNC "%.4g" "Nms/Upm" COEFFS 0 1 0 0 0 0.0001 /end COMPU_METHOD
/begin COMPU_METHOD CM_0090 "X*0.0078125+1.0" RAT_FUNC "%.4g" "-" COEFFS 0 1 -1 0 0 0.0078125 /end COMPU_METHOD
/begin COMPU_METHOD CM_0092 "X*0.78125" RAT_FUNC "%.4g" "%FW" COEFFS 0 1 0 0 0 0.78125 /end COMPU_METHOD
/begin COMPU_METHOD CM_0093 "X*0.78125" RAT_FUNC "%.4g" "%t_END" COEFFS 0 1 0 0 0 0.78125 /end COMPU_METHOD
/begin COMPU_METHOD CM_0094 "X*0.0078125" RAT_FUNC "%.4g" "2" COEFFS 0 1 0 0 0 0.0078125 /end COMPU_METHOD
/begin COMPU_METHOD CM_0095 "X*0.001" RAT_FUNC "%.4g" "Nms/Upm" COEFFS 0 1 0 0 0 0.001 /end COMPU_METHOD
/begin COMPU_METHOD CM_0096 "X*0.0078125" RAT_FUNC "%.4g" "Nms2" COEFFS 0 1 0 0 0 0.0078125 /end COMPU_METHOD
/begin COMPU_METHOD CM_0097 "X*0.1" RAT_FUNC "%.4g" "Nm/Upm" COEFFS 0 1 0 0 0 0.1 /end COMPU_METHOD
/begin COMPU_METHOD CM_0098 "X" RAT_FUNC "%.4g" "Prog" COEFFS 0 1 0 0 0 1 /end COMPU_METHOD
/begin COMPU_METHOD CM_0099 "X*0.001" RAT_FUNC "%.4g" "Nm/Upm" COEFFS 0 1 0 0 0 0.001 /end COMPU_METHOD
/begin COMPU_METHOD CM_0100 "X" RAT_FUNC "%.4g" ".Prog" COEFFS 0 1 0 0 0 1 /end COMPU_METHOD
/begin COMPU_METHOD CM_0101 "X" RAT_FUNC "%.4g" "cm" COEFFS 0 1 0 0 0 1 /end COMPU_METHOD
/begin COMPU_METHOD CM_0103 "X*0.05-273.15" RAT_FUNC "%.4g" "?C" COEFFS 0 1 273.15 0 0 0.05 /end COMPU_METHOD
/begin COMPU_METHOD CM_0105 "X*0.1" RAT_FUNC "%.4g" "Kelvin/s" COEFFS 0 1 0 0 0 0.1 /end COMPU_METHOD
/begin COMPU_METHOD CM_0109 "X*0.0001" RAT_FUNC "%.4g" "Kelvin" COEFFS 0 1 0 0 0 0.0001 /end COMPU_METHOD
/begin COMPU_METHOD CM_0110 "X*0.01" RAT_FUNC "%.4g" "Anteil [0..1]" COEFFS 0 1 0 0 0 0.01 /end COMPU_METHOD
/begin COMPU_METHOD CM_0111 "X" RAT_FUNC "%.4g" "Kelvin/s" COEFFS 0 1 0 0 0 1 /end COMPU_METHOD
/begin COMPU_METHOD CM_0112 "X*1.1428571429" RAT_FUNC "%.4g" "us" COEFFS 0 1 0 0 0 1.142857143 /end COMPU_METHOD
/begin COMPU_METHOD CM_0113 "X*0.025" RAT_FUNC "%.4g" "Kelvin" COEFFS 0 1 0 0 0 0.025 /end COMPU_METHOD
/begin COMPU_METHOD CM_0114 "X*0.025-273.2" RAT_FUNC "%.4g" "?C" COEFFS 0 1 273.2 0 0 0.025 /end COMPU_METHOD
/begin COMPU_METHOD CM_0115 "X*0.0625" RAT_FUNC "%.4g" "km/h*10ms" COEFFS 0 1 0 0 0 0.0625 /end COMPU_METHOD
/begin COMPU_METHOD CM_0116 "X*0.00155892" RAT_FUNC "%.4g" "V" COEFFS 0 1 0 0 0 0.00155892 /end COMPU_METHOD
/begin COMPU_METHOD CM_0117 "X*0.00155892" RAT_FUNC "%.4g" "V/5ms" COEFFS 0 1 0 0 0 0.00155892 /end COMPU_METHOD
/begin COMPU_METHOD CM_0118 "X*0.0065104167" RAT_FUNC "%.4g" "V" COEFFS 0 1 0 0 0 0.0065104167 /end COMPU_METHOD
/begin COMPU_METHOD CM_0119 "X*0.001" RAT_FUNC "%.4g" "A" COEFFS 0 1 0 0 0 0.001 /end COMPU_METHOD
/begin COMPU_METHOD CM_0120 "X*0.0008" RAT_FUNC "%.4g" "ms" COEFFS 0 1 0 0 0 0.0008 /end COMPU_METHOD
/begin COMPU_METHOD CM_0121 "X*0.1" RAT_FUNC "%.4g" "?/5ms" COEFFS 0 1 0 0 0 0.1 /end COMPU_METHOD
/begin COMPU_METHOD CM_0122 "X*0.005" RAT_FUNC "%.4g" "1/s" COEFFS 0 1 0 0 0 0.005 /end COMPU_METHOD
/begin COMPU_METHOD CM_0265 "X*0.1" RAT_FUNC "%.4g" "degKW" COEFFS 0 1 0 0 0 0.1 /end COMPU_METHOD
/begin COMPU_METHOD CM_0270 "X/200" RAT_FUNC "%.4g" "s" COEFFS 0 200 0 0 0 1 /end COMPU_METHOD
/begin COMPU_METHOD CM_0272 "X*0.1" RAT_FUNC "%.4g" "K" COEFFS 0 1 0 0 0 0.1 /end COMPU_METHOD
/begin COMPU_METHOD CM_0278 "X/10" RAT_FUNC "%.4g" "Upm*s" COEFFS 0 10 0 0 0 1 /end COMPU_METHOD
/begin COMPU_METHOD CM_0279 "X/163840" RAT_FUNC "%.4g" "?KW" COEFFS 0 163840 0 0 0 1 /end COMPU_METHOD
/begin COMPU_METHOD CM_0281 "X/100" RAT_FUNC "%.4g" "?KW/Segment" COEFFS 0 100 0 0 0 1 /end COMPU_METHOD
/begin COMPU_METHOD CM_0283 "X/16384" RAT_FUNC "%.4g" "km/h" COEFFS 0 16384 0 0 0 1 /end COMPU_METHOD
/end MODULE
/end PROJECT
