ASAP2_VERSION 1 60
/begin PROJECT MSS60_V762_INJ "MSS60 (S65) V762 INJ CPU - generated 04.11.2026 from the reverse-engineered XDF"
/begin HEADER "Calibration description (characteristics from the XDF; measurements = V530 RAM names transferred to V762 addresses, confidence in each long identifier). Status tag in every long identifier: verified (checked against the code) / A2L-ref (placed from the V530 A2L) / EST (estimated) / unassigned (UNK placeholder)." VERSION "V762-RE-04112026" /end HEADER
/begin MODULE INJ "MSS60 V762 INJ"
/begin MOD_COMMON "" BYTE_ORDER MSB_FIRST ALIGNMENT_BYTE 1 ALIGNMENT_WORD 2 ALIGNMENT_LONG 4 /end MOD_COMMON
/begin CHARACTERISTIC K_AG_TI_ANZ "Number of directly consecutive suppressions (injection cut-outs) [verified]" VALUE 0x70298 RL_VAL_UW 0 CM_0000 0 65535 /end CHARACTERISTIC
/begin CHARACTERISTIC K_AG_TI_CFG "Source: PSB MS_S60 program 754 [verified]" VALUE 0x70294 RL_VAL_UB 0 CM_0000 0 255 /end CHARACTERISTIC
/begin CHARACTERISTIC K_AG_TI_PAUSE "Number of working cycles between suppressions [verified]" VALUE 0x7029A RL_VAL_UW 0 CM_0000 0 65535 /end CHARACTERISTIC
/begin CHARACTERISTIC K_AG_TI_V_MIN "Minimum vehicle speed threshold [km/h] [verified]" VALUE 0x7029C RL_VAL_SW 0 CM_0010 -2048 2047.9375 /end CHARACTERISTIC
/begin CHARACTERISTIC K_AG_TI_ZYL "Static suppression pattern [verified]" VALUE 0x70296 RL_VAL_UW 0 CM_0000 0 65535 /end CHARACTERISTIC
/begin CHARACTERISTIC K_N_MIN_FREEZE__INJ_ "Minimum entry speed for engine-speed freeze [Upm] [verified]" VALUE 0x76008 RL_VAL_SW 0 CM_0002 -32768 32767 /end CHARACTERISTIC
/begin CHARACTERISTIC K_N_OBERGRENZE__INJ_ "Plausibility limit for engine-speed sensing [Upm] [verified]" VALUE 0x76006 RL_VAL_SW 0 CM_0002 -32768 32767 /end CHARACTERISTIC
/begin CHARACTERISTIC K_N_ZEIT_STOERUNG__INJ_ "Freeze time of speed sensing after TPU fault [s] [verified]" VALUE 0x76004 RL_VAL_SB 0 CM_0025 -1.28 1.27 /end CHARACTERISTIC
/begin CHARACTERISTIC KF_SCHALTER_KS_N_DIFF_AUF "Speed difference, clutch open [verified]" MAP 0x784FE RL_MAP_SW_SW_SW 0 CM_0002 -32768 32767 /begin AXIS_DESCR STD_AXIS NO_INPUT_QUANTITY CM_0002 3 -32768 32767 /end AXIS_DESCR /begin AXIS_DESCR STD_AXIS NO_INPUT_QUANTITY CM_0017 3 -3276.8 3276.7 /end AXIS_DESCR /end CHARACTERISTIC
/begin CHARACTERISTIC KL_SCHALTER_KS_REG "Curve: P share of drivetrain-engagement controller [verified]" CURVE 0x784E4 RL_CUR_SB_UW 0 CM_0014 0 12.79980469 /begin AXIS_DESCR STD_AXIS NO_INPUT_QUANTITY CM_0015 8 -128 127 /end AXIS_DESCR /end CHARACTERISTIC
/begin CHARACTERISTIC K_SCHALTER_KS_N_DIFF "Speed difference engine - gearbox input [Upm] [verified]" VALUE 0x784DC RL_VAL_SW 0 CM_0002 -32768 32767 /end CHARACTERISTIC
/begin CHARACTERISTIC K_SCHALTER_KS_N_DIFF_REF "Switching threshold, distance to reference speed [Upm] [verified]" VALUE 0x784DA RL_VAL_SW 0 CM_0002 -32768 32767 /end CHARACTERISTIC
/begin CHARACTERISTIC K_SCHALTER_KS_N_HYS "Hysteresis, speed difference engine - gearbox input [verified]" VALUE 0x784DE RL_VAL_SW 0 CM_0002 -32768 32767 /end CHARACTERISTIC
/begin CHARACTERISTIC K_SCHALTER_KS_N_T "Timer, speed difference engine - gearbox input [s] [verified]" VALUE 0x784E0 RL_VAL_UW 0 CM_0025 0 655.35 /end CHARACTERISTIC
/begin CHARACTERISTIC K_SCHALTER_KS_SCHALT_T "Timer, gearshift [s] [verified]" VALUE 0x784E2 RL_VAL_UW 0 CM_0025 0 655.35 /end CHARACTERISTIC
/begin CHARACTERISTIC K_SCHALTER_KUPP_GESCHL "Switching threshold, clutch closed [digit] [verified]" VALUE 0x784CC RL_VAL_SW 0 CM_0087 -32768 32767 /end CHARACTERISTIC
/begin CHARACTERISTIC K_SCHALTER_KUPP_OFFEN "Switching threshold, clutch open [digit] [verified]" VALUE 0x784CE RL_VAL_SW 0 CM_0087 -32768 32767 /end CHARACTERISTIC
/begin CHARACTERISTIC K_SCHALTER_POEL_START_ENDE "Oil pressure build-up time [s] [verified]" VALUE 0x784A8 RL_VAL_UW 0 CM_0025 0 655.35 /end CHARACTERISTIC
/begin CHARACTERISTIC KF_ELU_PWM_MS "Map: electric-fan run-on request [verified]" MAP 0x724BC RL_MAP_SW_SW_UB 0 CM_0150 0 255 /begin AXIS_DESCR STD_AXIS NO_INPUT_QUANTITY CM_0006 5 -3550 3003.5 /end AXIS_DESCR /begin AXIS_DESCR STD_AXIS NO_INPUT_QUANTITY CM_0006 6 -3550 3003.5 /end AXIS_DESCR /end CHARACTERISTIC
/begin CHARACTERISTIC KL_ELU_KKOS "Curve: electric-fan speed on CAN A/C request [verified]" CURVE 0x72466 RL_CUR_UB_UB 0 CM_0150 0 255 /begin AXIS_DESCR STD_AXIS NO_INPUT_QUANTITY CM_0000 16 0 255 /end AXIS_DESCR /end CHARACTERISTIC
/begin CHARACTERISTIC KL_ELU_TAN "Curve: electric-fan speed from intake air temperature [verified]" CURVE 0x72488 RL_CUR_SW_UB 0 CM_0150 0 255 /begin AXIS_DESCR STD_AXIS NO_INPUT_QUANTITY CM_0006 6 -3550 3003.5 /end AXIS_DESCR /end CHARACTERISTIC
/begin CHARACTERISTIC KL_ELU_DTMOT "Curve: electric-fan speed from TKA (radiator outlet temperature) [verified]" CURVE 0x7243E RL_CUR_SW_UB 0 CM_0150 0 255 /begin AXIS_DESCR STD_AXIS NO_INPUT_QUANTITY CM_0151 6 -32768 32767 /end AXIS_DESCR /end CHARACTERISTIC
/begin CHARACTERISTIC KL_ELU_TKAT "Curve: electric-fan speed from catalyst temperature [verified]" CURVE 0x72452 RL_CUR_SW_UB 0 CM_0150 0 255 /begin AXIS_DESCR STD_AXIS NO_INPUT_QUANTITY CM_0006 6 -3550 3003.5 /end AXIS_DESCR /end CHARACTERISTIC
/begin CHARACTERISTIC KL_ELU_TUMG_KORR "Curve: electric-fan speed vs vehicle speed [verified]" CURVE 0x724A8 RL_CUR_SW_UB 0 CM_0037 0 1.9921875 /begin AXIS_DESCR STD_AXIS NO_INPUT_QUANTITY CM_0010 6 -2048 2047.9375 /end AXIS_DESCR /end CHARACTERISTIC
/begin CHARACTERISTIC K_ELU_ED_BLOCKIERT_CNT "Counter for additional debouncing of fan blocked [verified]" VALUE 0x72438 RL_VAL_UB 0 CM_0000 0 255 /end CHARACTERISTIC
/begin CHARACTERISTIC K_ELU_ED_BLOCKIERT_MAX "Maximum time for detecting the fan fault message [ms] [verified]" VALUE 0x72432 RL_VAL_UW 0 CM_0152 0 6553500 /end CHARACTERISTIC
/begin CHARACTERISTIC K_ELU_ED_BLOCKIERT_MIN "Minimum time for detecting the fan fault message [ms] [verified]" VALUE 0x72434 RL_VAL_UW 0 CM_0152 0 6553500 /end CHARACTERISTIC
/begin CHARACTERISTIC K_ELU_ED_BLOCKIER_ZYKLUS_TIME "Time until the next expected fan fault message [ms] [verified]" VALUE 0x72436 RL_VAL_UW 0 CM_0152 0 6553500 /end CHARACTERISTIC
/begin CHARACTERISTIC K_ELU_ED_OPENLOAD_CNT "Counter for additional debouncing of open load [verified]" VALUE 0x7243A RL_VAL_UB 0 CM_0000 0 255 /end CHARACTERISTIC
/begin CHARACTERISTIC K_ELU_ED_SH_TO_GND_CNT "Counter for additional debouncing of short to ground [verified]" VALUE 0x72439 RL_VAL_UB 0 CM_0000 0 255 /end CHARACTERISTIC
/begin CHARACTERISTIC K_ELU_ED_SH_TO_UB_DELAY "Delay for debouncing short to battery [ms] [verified]" VALUE 0x7242E RL_VAL_UW 0 CM_0152 0 6553500 /end CHARACTERISTIC
/begin CHARACTERISTIC K_ELU_ED_SH_TO_UB_OFF_TIME "Switch-off time of ATIC39 output stage on short to battery [ms] [verified]" VALUE 0x72430 RL_VAL_UW 0 CM_0152 0 6553500 /end CHARACTERISTIC
/begin CHARACTERISTIC KL_ELUP_AUS "Curve: electric vacuum pump switch-off threshold [verified]" CURVE 0x72550 RL_CUR_SW_SW 0 CM_0022 -2048 2047.9375 /begin AXIS_DESCR STD_AXIS NO_INPUT_QUANTITY CM_0022 8 -2048 2047.9375 /end AXIS_DESCR /end CHARACTERISTIC
/begin CHARACTERISTIC KL_ELUP_EIN "Curve: electric vacuum pump switch-on threshold [verified]" CURVE 0x7252E RL_CUR_SW_SW 0 CM_0022 -2048 2047.9375 /begin AXIS_DESCR STD_AXIS NO_INPUT_QUANTITY CM_0022 8 -2048 2047.9375 /end AXIS_DESCR /end CHARACTERISTIC
/begin CHARACTERISTIC KL_ELUP_EIN_V_DEL "X: Vehicle speed (v_vorne) [km/h] | Value: Switch-on delay from front-axle speed [s] [verified]" CURVE 0x7258C RL_CUR_SW_UW 0 CM_0025 0 655.35 /begin AXIS_DESCR STD_AXIS NO_INPUT_QUANTITY CM_0010 6 -2048 2047.9375 /end AXIS_DESCR /end CHARACTERISTIC
/begin CHARACTERISTIC KL_ELUP_V_OFFS "Curve: speed offset on vacuum-pump switching threshold [verified]" CURVE 0x72572 RL_CUR_SW_SW 0 CM_0022 -2048 2047.9375 /begin AXIS_DESCR STD_AXIS NO_INPUT_QUANTITY CM_0010 6 -2048 2047.9375 /end AXIS_DESCR /end CHARACTERISTIC
/begin CHARACTERISTIC K_ELUP_CFG "Source: PSB MS_S60 program 754 [verified]" VALUE 0x72514 RL_VAL_UB 0 CM_0000 0 255 /end CHARACTERISTIC
/begin CHARACTERISTIC K_ELUP_ED_ABS_DEL "Delay of vacuum-pump implausible fault from switch-on threshold [verified]" VALUE 0x72527 RL_VAL_UB 0 CM_0023 0 25.5 /end CHARACTERISTIC
/begin CHARACTERISTIC K_ELUP_ED_DEL "Delay of vacuum-pump implausible fault from pressure gradient [verified]" VALUE 0x72526 RL_VAL_UB 0 CM_0023 0 25.5 /end CHARACTERISTIC
/begin CHARACTERISTIC K_ELUP_PL_AN_SW "Vacuum-pump activation threshold for test run [mbar] [verified]" VALUE 0x72528 RL_VAL_SW 0 CM_0022 -2048 2047.9375 /end CHARACTERISTIC
/begin CHARACTERISTIC K_ELUP_PL_IO_SW "Vacuum-pump OK threshold during test run [mbar] [verified]" VALUE 0x7252A RL_VAL_SW 0 CM_0022 -2048 2047.9375 /end CHARACTERISTIC
/begin CHARACTERISTIC K_ELUP_PL_ON_TIME "Vacuum-pump activation time for test run [s] [verified]" VALUE 0x7252C RL_VAL_UW 0 CM_0025 0 655.35 /end CHARACTERISTIC
/begin CHARACTERISTIC KF_ZLRESOF "Map: generator switch-off time at standstill [verified]" MAP 0x76CCA RL_MAP_SW_UW_UB 0 CM_0023 0 25.5 /begin AXIS_DESCR STD_AXIS NO_INPUT_QUANTITY CM_0156 4 -327.68 327.67 /end AXIS_DESCR /begin AXIS_DESCR STD_AXIS NO_INPUT_QUANTITY CM_0157 4 0 655350 /end AXIS_DESCR /end CHARACTERISTIC
/begin CHARACTERISTIC KL_GENLDST "Generator utilisation [verified]" CURVE 0x7597A RL_CUR_SW_UB 0 CM_0158 0 99.609375 /begin AXIS_DESCR STD_AXIS NO_INPUT_QUANTITY CM_0159 6 -3276.8 3276.7 /end AXIS_DESCR /end CHARACTERISTIC
/begin CHARACTERISTIC KL_LORESPM "Engine-dependent load-response factor [verified]" CURVE 0x73CBC RL_CUR_SW_UB 0 CM_0160 0 3.984375 /begin AXIS_DESCR STD_AXIS NO_INPUT_QUANTITY CM_0156 6 -327.68 327.67 /end AXIS_DESCR /end CHARACTERISTIC
/begin CHARACTERISTIC K_APPUPLLDST "Calibration value St_ldstgen for run-on [verified]" VALUE 0x75972 RL_VAL_UB 0 CM_0000 0 255 /end CHARACTERISTIC
/begin CHARACTERISTIC KL_TGETR_NTC "Gearbox temperature curve [verified]" CURVE 0x79388 RL_CUR_SW_SW 0 CM_0107 -1092.35 546.025 /begin AXIS_DESCR STD_AXIS NO_INPUT_QUANTITY CM_0087 8 -32768 32767 /end AXIS_DESCR /end CHARACTERISTIC
/begin CHARACTERISTIC KF_LSHVK_TV_KORR_MAX "Maximum duty cycle, pre-cat sensor heater [verified]" MAP 0x75E48 RL_MAP_SW_SW_UW 0 CM_0176 0 3199.951172 /begin AXIS_DESCR STD_AXIS NO_INPUT_QUANTITY CM_0025 6 -327.68 327.67 /end AXIS_DESCR /begin AXIS_DESCR STD_AXIS NO_INPUT_QUANTITY CM_0021 6 -3276.8 3276.7 /end AXIS_DESCR /end CHARACTERISTIC
/begin CHARACTERISTIC KF_LSHVK_TV_VORST "Pre-control duty cycle, pre-cat sensor heater [verified]" MAP 0x75DE6 RL_MAP_SW_SW_UW 0 CM_0176 0 3199.951172 /begin AXIS_DESCR STD_AXIS NO_INPUT_QUANTITY CM_0006 6 -3550 3003.5 /end AXIS_DESCR /begin AXIS_DESCR STD_AXIS NO_INPUT_QUANTITY CM_0151 6 -32768 32767 /end AXIS_DESCR /end CHARACTERISTIC
/begin CHARACTERISTIC KL_LSHVK_R_MESS_F "Sensor adaptation factor [verified]" CURVE 0x75D84 RL_CUR_UW_UW 0 CM_0051 0 1.999970916 /begin AXIS_DESCR STD_AXIS NO_INPUT_QUANTITY CM_0000 2 0 65535 /end AXIS_DESCR /end CHARACTERISTIC
/begin CHARACTERISTIC KL_LSHVK_R_MESS_OFFS "Sensor adaptation offset [verified]" CURVE 0x75D8E RL_CUR_UW_SW 0 CM_0163 -160000 159995.1172 /begin AXIS_DESCR STD_AXIS NO_INPUT_QUANTITY CM_0000 2 0 65535 /end AXIS_DESCR /end CHARACTERISTIC
/begin CHARACTERISTIC KL_LSHVK_SOND_TEMP "Pre-cat sensor temperature from heater resistance [verified]" CURVE 0x75D98 RL_CUR_UW_SW 0 CM_0006 -3550 3003.5 /begin AXIS_DESCR STD_AXIS NO_INPUT_QUANTITY CM_0174 8 0 6553.5 /end AXIS_DESCR /end CHARACTERISTIC
/begin CHARACTERISTIC KL_LSHVK_TEMP_IST_HIGH "Actual sensor temperature [verified]" CURVE 0x75CBC RL_CUR_UW_SW 0 CM_0151 -32768 32767 /begin AXIS_DESCR STD_AXIS NO_INPUT_QUANTITY CM_0163 16 0 319995.1172 /end AXIS_DESCR /end CHARACTERISTIC
/begin CHARACTERISTIC KL_LSHVK_TEMP_IST_LOW "Actual sensor temperature with ATIC42 range 2 [verified]" CURVE 0x75CFE RL_CUR_UW_SW 0 CM_0151 -32768 32767 /begin AXIS_DESCR STD_AXIS NO_INPUT_QUANTITY CM_0163 16 0 319995.1172 /end AXIS_DESCR /end CHARACTERISTIC
/begin CHARACTERISTIC KL_LSHVK_TEMP_SOLL_MS "Target sensor temperature with engine stopped [verified]" CURVE 0x75D40 RL_CUR_SW_SW 0 CM_0151 -32768 32767 /begin AXIS_DESCR STD_AXIS NO_INPUT_QUANTITY CM_0006 6 -3550 3003.5 /end AXIS_DESCR /end CHARACTERISTIC
/begin CHARACTERISTIC KL_LSHVK_UEFF_MAX "Maximum effective heater voltage [verified]" CURVE 0x75DBA RL_CUR_SW_UW 0 CM_0021 0 6553.5 /begin AXIS_DESCR STD_AXIS NO_INPUT_QUANTITY CM_0006 6 -3550 3003.5 /end AXIS_DESCR /end CHARACTERISTIC
/begin CHARACTERISTIC K_LSHVK_RI_RANGE_SCHW "ATIC42 switchover temperature between range 1/2 Ri measurement [?C] [verified]" VALUE 0x75C5C RL_VAL_SW 0 CM_0151 -32768 32767 /end CHARACTERISTIC
/begin CHARACTERISTIC K_LSHVK_R_AD_GAIN_CNT "Counter for sensor Ri gain adaptation [verified]" VALUE 0x75C8C RL_VAL_UW 0 CM_0000 0 65535 /end CHARACTERISTIC
/begin CHARACTERISTIC K_LSHVK_R_AD_GAIN_CNT_MIN "Minimum counter for sensor Ri gain adaptation [verified]" VALUE 0x75C8A RL_VAL_UW 0 CM_0000 0 65535 /end CHARACTERISTIC
/begin CHARACTERISTIC K_LSHVK_R_AD_GAIN_GRAD "Maximum gain gradient [verified]" VALUE 0x75CA0 RL_VAL_UW 0 CM_0016 0 63.99902344 /end CHARACTERISTIC
/begin CHARACTERISTIC K_LSHVK_R_AD_GAIN_MAX "Maximum threshold for sensor Ri gain adaptation [mV] [verified]" VALUE 0x75C9C RL_VAL_UW 0 CM_0163 0 319995.1172 /end CHARACTERISTIC
/begin CHARACTERISTIC K_LSHVK_R_AD_GAIN_MIN "Minimum threshold for sensor Ri gain adaptation [mV] [verified]" VALUE 0x75C9A RL_VAL_UW 0 CM_0163 0 319995.1172 /end CHARACTERISTIC
/begin CHARACTERISTIC K_LSHVK_R_AD_GAIN_T "Minimum time between two gain adaptations [s] [verified]" VALUE 0x75C90 RL_VAL_UW 0 CM_0025 0 655.35 /end CHARACTERISTIC
/begin CHARACTERISTIC K_LSHVK_R_AD_GAIN_T1 "Filter coefficient - sensor Ri gain adaptation [verified]" VALUE 0x75C94 RL_VAL_UW 0 CM_0178 0 6553500 /end CHARACTERISTIC
/begin CHARACTERISTIC K_LSHVK_R_AD_OFFS_CNT "Counter for sensor Ri offset adaptation [verified]" VALUE 0x75C88 RL_VAL_UW 0 CM_0000 0 65535 /end CHARACTERISTIC
/begin CHARACTERISTIC K_LSHVK_R_AD_OFFS_CNT_MIN "Minimum counter for sensor Ri offset adaptation [verified]" VALUE 0x75C86 RL_VAL_UW 0 CM_0000 0 65535 /end CHARACTERISTIC
/begin CHARACTERISTIC K_LSHVK_R_AD_OFFS_GRAD "Maximum offset gradient [mV] [verified]" VALUE 0x75C9E RL_VAL_UW 0 CM_0163 0 319995.1172 /end CHARACTERISTIC
/begin CHARACTERISTIC K_LSHVK_R_AD_OFFS_MAX "Maximum threshold for sensor Ri offset adaptation [mV] [verified]" VALUE 0x75C98 RL_VAL_SW 0 CM_0163 -160000 159995.1172 /end CHARACTERISTIC
/begin CHARACTERISTIC K_LSHVK_R_AD_OFFS_MIN "Minimum threshold for sensor Ri offset adaptation [mV] [verified]" VALUE 0x75C96 RL_VAL_SW 0 CM_0163 -160000 159995.1172 /end CHARACTERISTIC
/begin CHARACTERISTIC K_LSHVK_R_AD_OFFS_T "Minimum time between two offset adaptations [s] [verified]" VALUE 0x75C8E RL_VAL_UW 0 CM_0025 0 655.35 /end CHARACTERISTIC
/begin CHARACTERISTIC K_LSHVK_R_AD_OFFS_T1 "Filter coefficient - sensor Ri offset adaptation [verified]" VALUE 0x75C92 RL_VAL_UW 0 CM_0178 0 6553500 /end CHARACTERISTIC
/begin CHARACTERISTIC K_LSHVK_R_AD_RESET "Source: PSB MS_S60 program 754 [verified]" VALUE 0x75C80 RL_VAL_UW 0 CM_0000 0 65535 /end CHARACTERISTIC
/begin CHARACTERISTIC K_LSHVK_R_REF "Ri reference voltage [mV] [verified]" VALUE 0x75C82 RL_VAL_UW 0 CM_0163 0 319995.1172 /end CHARACTERISTIC
/begin CHARACTERISTIC K_LSHVK_R_REF_OFFS "Ri reference voltage for offset adaptation [mV] [verified]" VALUE 0x75C84 RL_VAL_UW 0 CM_0163 0 319995.1172 /end CHARACTERISTIC
/begin CHARACTERISTIC K_LSHVK_TEMP_DIF_ZUL "Permitted temperature difference [?C] [verified]" VALUE 0x75C58 RL_VAL_SW 0 CM_0151 -32768 32767 /end CHARACTERISTIC
/begin CHARACTERISTIC K_LSHVK_TEMP_IST_ENABLE_IP_LOOP "Switch-on temperature for ATIC42 IP control loop [?C] [verified]" VALUE 0x75C5E RL_VAL_SW 0 CM_0151 -32768 32767 /end CHARACTERISTIC
/begin CHARACTERISTIC K_LSHVK_TEMP_IST_SCHW "Switchover temperature for filter constant [?C] [verified]" VALUE 0x75C5A RL_VAL_SW 0 CM_0151 -32768 32767 /end CHARACTERISTIC
/begin CHARACTERISTIC K_LSHVK_TEMP_MAX "Maximum sensor temperature [?C] [verified]" VALUE 0x75C52 RL_VAL_SW 0 CM_0151 -32768 32767 /end CHARACTERISTIC
/begin CHARACTERISTIC K_LSHVK_TEMP_MIN "Minimum sensor temperature [?C] [verified]" VALUE 0x75C54 RL_VAL_SW 0 CM_0151 -32768 32767 /end CHARACTERISTIC
/begin CHARACTERISTIC K_LSHVK_TEMP_REG_MIN "Minimum sensor temperature for controller activation [?C] [verified]" VALUE 0x75C56 RL_VAL_SW 0 CM_0151 -32768 32767 /end CHARACTERISTIC
/begin CHARACTERISTIC KF_MVAC_ELUP_ETA "Vacuum-pump efficiency in brake-booster model calculation [verified]" MAP 0x75FC8 RL_MAP_SW_SW_UB 0 CM_0037 0 1.9921875 /begin AXIS_DESCR STD_AXIS NO_INPUT_QUANTITY CM_0022 6 -2048 2047.9375 /end AXIS_DESCR /begin AXIS_DESCR STD_AXIS NO_INPUT_QUANTITY CM_0006 5 -3550 3003.5 /end AXIS_DESCR /end CHARACTERISTIC
/begin CHARACTERISTIC KL_MVAC_BRP_GRAD "Curve: brake-booster flow value from brake-pressure gradient [verified]" CURVE 0x75F62 RL_CUR_SW_SW 0 CM_0179 -32 31.99902344 /begin AXIS_DESCR STD_AXIS NO_INPUT_QUANTITY CM_0180 14 -1638400 1638350 /end AXIS_DESCR /end CHARACTERISTIC
/begin CHARACTERISTIC KL_MVAC_ELUP "Curve: weighting factor from mvac_ml_sr_rsv [verified]" CURVE 0x75F48 RL_CUR_SW_SW 0 CM_0181 -64 63.99804688 /begin AXIS_DESCR STD_AXIS NO_INPUT_QUANTITY CM_0022 6 -2048 2047.9375 /end AXIS_DESCR /end CHARACTERISTIC
/begin CHARACTERISTIC KL_MVAC_ML_WICHT "Curve: weighting factor from mvac_ml_sr_rsv [verified]" CURVE 0x75F26 RL_CUR_SW_SW 0 CM_0164 -128 127.9960938 /begin AXIS_DESCR STD_AXIS NO_INPUT_QUANTITY CM_0102 8 -3276.8 3276.7 /end AXIS_DESCR /end CHARACTERISTIC
/begin CHARACTERISTIC KL_MVAC_PDIFF_B "Curve: air cross-section intervention amount during braking [verified]" CURVE 0x75F9C RL_CUR_SW_UW 0 CM_0012 0 6553.5 /begin AXIS_DESCR STD_AXIS NO_INPUT_QUANTITY CM_0022 5 -2048 2047.9375 /end AXIS_DESCR /end CHARACTERISTIC
/begin CHARACTERISTIC KL_MVAC_PDIFF_SA "Curve: air cross-section intervention amount bank 2 at start [verified]" CURVE 0x75FB2 RL_CUR_SW_UW 0 CM_0012 0 6553.5 /begin AXIS_DESCR STD_AXIS NO_INPUT_QUANTITY CM_0022 5 -2048 2047.9375 /end AXIS_DESCR /end CHARACTERISTIC
/begin CHARACTERISTIC K_MVAC_AL_BLS "Dynamic brake-booster flow value at start of brake-light signal [(kg/h)/mbar] [verified]" VALUE 0x75F06 RL_VAL_SW 0 CM_0179 -32 31.99902344 /end CHARACTERISTIC
/begin CHARACTERISTIC K_MVAC_AL_LECK "Brake-booster leakage flow value [1/2^20] [verified]" VALUE 0x75F02 RL_VAL_SW 0 CM_0182 -2048 2047.9375 /end CHARACTERISTIC
/begin CHARACTERISTIC K_MVAC_AL_UMMV_STAT "Brake-booster steady-state flow value [1/2^20] [verified]" VALUE 0x75F00 RL_VAL_SW 0 CM_0182 -2048 2047.9375 /end CHARACTERISTIC
/begin CHARACTERISTIC K_MVAC_BRPGRAD_SW "Brake-pressure gradient release threshold for air cross-section intervention [bar/s] [EST]" VALUE 0x75F0A RL_VAL_SW 0 CM_0180 -1638400 1638350 /end CHARACTERISTIC
/begin CHARACTERISTIC K_MVAC_BRP_GRAD_RAMPE "Time factor for ramp-down [s] [verified]" VALUE 0x75F12 RL_VAL_SW 0 CM_0020 -163.84 163.835 /end CHARACTERISTIC
/begin CHARACTERISTIC K_MVAC_DEL_BLS "Delay from brake-light signal to brake-pressure gradient [s] [verified]" VALUE 0x75F04 RL_VAL_UW 0 CM_0020 0 327.675 /end CHARACTERISTIC
/begin CHARACTERISTIC K_MVAC_MLRF_SR_SPERRE "Output lock for mvac_rf_sr via time_ml [s] [verified]" VALUE 0x75EF6 RL_VAL_UW 0 CM_0025 0 655.35 /end CHARACTERISTIC
/begin CHARACTERISTIC K_MVAC_ML_AEB_NEG "Negative rate limit for mvac_ml_sr [kg/h] [verified]" VALUE 0x75EFA RL_VAL_UW 0 CM_0183 0 819.1875 /end CHARACTERISTIC
/begin CHARACTERISTIC K_MVAC_ML_AEB_POS "Positive rate limit for mvac_ml_sr [kg/h] [verified]" VALUE 0x75EF8 RL_VAL_UW 0 CM_0183 0 819.1875 /end CHARACTERISTIC
/begin CHARACTERISTIC K_MVAC_ML_INTEGRATOR_TAU "Time constant for mvac_ml integrator [s] [verified]" VALUE 0x75F08 RL_VAL_UW 0 CM_0027 0 65535 /end CHARACTERISTIC
/begin CHARACTERISTIC K_MVAC_ML_SR_MAX "Air mass flow threshold [kg/h] [verified]" VALUE 0x75EF4 RL_VAL_SW 0 CM_0102 -3276.8 3276.7 /end CHARACTERISTIC
/begin CHARACTERISTIC K_MVAC_ML_SR_MIN "Air mass flow threshold [kg/h] [verified]" VALUE 0x75EF2 RL_VAL_SW 0 CM_0102 -3276.8 3276.7 /end CHARACTERISTIC
/begin CHARACTERISTIC K_MVAC_N_MIN_B "Minimum engine speed for brake-booster idle-valve bank 2 intervention during braking [Upm] [verified]" VALUE 0x75F10 RL_VAL_SW 0 CM_0002 -32768 32767 /end CHARACTERISTIC
/begin CHARACTERISTIC K_MVAC_N_MIN_SA "Minimum engine speed for brake-booster idle-valve bank 2 intervention at start [Upm] [verified]" VALUE 0x75F16 RL_VAL_SW 0 CM_0002 -32768 32767 /end CHARACTERISTIC
/begin CHARACTERISTIC K_MVAC_PDIFF_FILTER_TAU "Time constant for mvac_pdiff_filter PT1 element [s] [verified]" VALUE 0x75F14 RL_VAL_UW 0 CM_0027 0 65535 /end CHARACTERISTIC
/begin CHARACTERISTIC K_MVAC_PDIFF_UM_BEGR_MAX "Maximum limit, differential pressure brake booster/ambient [mbar] [verified]" VALUE 0x75EFE RL_VAL_SW 0 CM_0022 -2048 2047.9375 /end CHARACTERISTIC
/begin CHARACTERISTIC K_MVAC_PDIFF_UM_BEGR_MIN "Minimum limit, differential pressure brake booster/ambient [mbar] [verified]" VALUE 0x75EFC RL_VAL_SW 0 CM_0022 -2048 2047.9375 /end CHARACTERISTIC
/begin CHARACTERISTIC K_MVAC_PL_PDIFF "Vacuum delta between sensor and model at test-run start [mbar] [verified]" VALUE 0x75F1C RL_VAL_SW 0 CM_0022 -2048 2047.9375 /end CHARACTERISTIC
/begin CHARACTERISTIC K_MVAC_PL_P_IO_SW "OK threshold of vacuum sensor value after 60 s [mbar] [verified]" VALUE 0x75F1E RL_VAL_SW 0 CM_0022 -2048 2047.9375 /end CHARACTERISTIC
/begin CHARACTERISTIC K_MVAC_PL_TIME_LIMIT "Timer limit for brake-booster test run [s] [verified]" VALUE 0x75F1A RL_VAL_UB 0 CM_0027 0 255 /end CHARACTERISTIC
/begin CHARACTERISTIC K_MVAC_PL_TIME_MS "Engine-off time for brake-booster test run [s] [verified]" VALUE 0x75F1B RL_VAL_UB 0 CM_0027 0 255 /end CHARACTERISTIC
/begin CHARACTERISTIC K_MVAC_P_SENSOR_OFFSET "Pressure-sensor offset [mbar] [verified]" VALUE 0x75EE0 RL_VAL_SW 0 CM_0022 -2048 2047.9375 /end CHARACTERISTIC
/begin CHARACTERISTIC K_MVAC_P_SENSOR_STEIGUNG "Pressure-sensor slope [mbar/V] [verified]" VALUE 0x75EDE RL_VAL_SW 0 CM_0184 -409.6 409.5875 /end CHARACTERISTIC
/begin CHARACTERISTIC K_MVAC_RMP_FKT_SA_BEGR "Ramp maximum for time factor at start [s] [verified]" VALUE 0x75F18 RL_VAL_SW 0 CM_0020 -163.84 163.835 /end CHARACTERISTIC
/begin CHARACTERISTIC K_MVAC_V "Brake-booster volume [ccm] [verified]" VALUE 0x75F0C RL_VAL_SL 0 CM_0185 -214748364.8 214748364.7 /end CHARACTERISTIC
/begin CHARACTERISTIC KF_IERRGREHT "Generator current limit at high generator temperature [verified]" MAP 0x76CA4 RL_MAP_SW_SW_UB 0 CM_0186 0 31.875 /begin AXIS_DESCR STD_AXIS NO_INPUT_QUANTITY CM_0002 3 -32768 32767 /end AXIS_DESCR /begin AXIS_DESCR STD_AXIS NO_INPUT_QUANTITY CM_0000 6 -32768 32767 /end AXIS_DESCR /end CHARACTERISTIC
/begin CHARACTERISTIC KL_NELUEFTGE "Electric-fan request from generator [verified] (axes fixed/not stored)" VAL_BLK 0x76C37 RL_BLK_UB 0 CM_0158 0 99.609375 NUMBER 6 /end CHARACTERISTIC
/begin CHARACTERISTIC KL_TCHIPOFFS "X: Gen_manufak [verified]" CURVE 0x76C66 RL_CUR_UB_SW 0 CM_0159 -3276.8 3276.7 /begin AXIS_DESCR STD_AXIS NO_INPUT_QUANTITY CM_0000 8 0 255 /end AXIS_DESCR /end CHARACTERISTIC
/begin CHARACTERISTIC K_CW_OZ "[verified]" VALUE 0x76898 RL_VAL_UW 0 CM_0000 0 65535 /end CHARACTERISTIC
/begin CHARACTERISTIC K_DTOG_UBMIN "[verified]" VALUE 0x70A32 RL_VAL_UW 0 CM_0191 0 6173.397 /end CHARACTERISTIC
/begin CHARACTERISTIC K_OZDELTOE "Delay for writing oil-sensor fault to fault memory [verified]" VALUE 0x70A34 RL_VAL_UW 0 CM_0000 0 65535 /end CHARACTERISTIC
/begin CHARACTERISTIC K_OZERRD "Debounce time, sensor and communication fault [verified]" VALUE 0x70A38 RL_VAL_UW 0 CM_0000 0 65535 /end CHARACTERISTIC
/begin CHARACTERISTIC K_OZHEAL "Debounce time, fault healing [verified]" VALUE 0x70A3A RL_VAL_UW 0 CM_0000 0 65535 /end CHARACTERISTIC
/begin CHARACTERISTIC K_OZMWK "Number of measurements for short-term level average [verified]" VALUE 0x768D4 RL_VAL_UB 0 CM_0000 0 255 /end CHARACTERISTIC
/begin CHARACTERISTIC K_OZNFERR "Top-up quantity display when pre-check OK [verified]" VALUE 0x768D5 RL_VAL_UB 0 CM_0000 0 255 /end CHARACTERISTIC
/begin CHARACTERISTIC K_OZNFML "Top-up quantity display while measuring [verified]" VALUE 0x768D6 RL_VAL_UB 0 CM_0000 0 255 /end CHARACTERISTIC
/begin CHARACTERISTIC K_OZNFOELCKO "Top-up quantity display when pre-check not OK [verified]" VALUE 0x768D7 RL_VAL_UB 0 CM_0000 0 255 /end CHARACTERISTIC
/begin CHARACTERISTIC K_OZNFOELCOK "Top-up quantity display when pre-check OK [verified]" VALUE 0x768D8 RL_VAL_UB 0 CM_0000 0 255 /end CHARACTERISTIC
/begin CHARACTERISTIC K_OZOELCOK "Pre-drive check threshold [mm] [verified]" VALUE 0x768D9 RL_VAL_UB 0 CM_0123 0 74.70703125 /end CHARACTERISTIC
/begin CHARACTERISTIC K_OZOELCVERZ "Delay for the oil check [s] [verified]" VALUE 0x768DA RL_VAL_UB 0 CM_0000 0 255 /end CHARACTERISTIC
/begin CHARACTERISTIC K_OZORIPEILTZO "Output level for dead zone, orientation check, electronic dipstick with old display >= middle [mm] [verified]" VALUE 0x768DB RL_VAL_UB 0 CM_0123 0 74.70703125 /end CHARACTERISTIC
/begin CHARACTERISTIC K_OZORIPEILTZU "Output level for dead zone, orientation check, electronic dipstick with old display < middle [mm] [verified]" VALUE 0x768DC RL_VAL_UB 0 CM_0123 0 74.70703125 /end CHARACTERISTIC
/begin CHARACTERISTIC K_OZPEIL12 "First bar of electronic dipstick [mm] [verified]" VALUE 0x768DD RL_VAL_UB 0 CM_0123 0 74.70703125 /end CHARACTERISTIC
/begin CHARACTERISTIC K_OZPEIL25 "Second bar of electronic dipstick [mm] [verified]" VALUE 0x768DE RL_VAL_UB 0 CM_0123 0 74.70703125 /end CHARACTERISTIC
/begin CHARACTERISTIC K_OZPEIL38 "Third bar of electronic dipstick [mm] [verified]" VALUE 0x768DF RL_VAL_UB 0 CM_0123 0 74.70703125 /end CHARACTERISTIC
/begin CHARACTERISTIC K_OZPEIL53 "Fourth bar of electronic dipstick [mm] [verified]" VALUE 0x768E0 RL_VAL_UB 0 CM_0123 0 74.70703125 /end CHARACTERISTIC
/begin CHARACTERISTIC K_OZPEIL69 "Fifth bar of electronic dipstick [mm] [verified]" VALUE 0x768E1 RL_VAL_UB 0 CM_0123 0 74.70703125 /end CHARACTERISTIC
/begin CHARACTERISTIC K_OZPEIL85 "Sixth bar of electronic dipstick [mm] [verified]" VALUE 0x768E2 RL_VAL_UB 0 CM_0123 0 74.70703125 /end CHARACTERISTIC
/begin CHARACTERISTIC K_OZPEILDO "Delta + hysteresis, dipstick [mm] [verified]" VALUE 0x768E3 RL_VAL_UB 0 CM_0123 0 74.70703125 /end CHARACTERISTIC
/begin CHARACTERISTIC K_OZPEILDOMIN "Delta + hysteresis, dipstick at minimum [mm] [verified]" VALUE 0x768E4 RL_VAL_UB 0 CM_0123 0 74.70703125 /end CHARACTERISTIC
/begin CHARACTERISTIC K_OZPEILDU "Delta - hysteresis, dipstick [mm] [verified]" VALUE 0x768E5 RL_VAL_UB 0 CM_0123 0 74.70703125 /end CHARACTERISTIC
/begin CHARACTERISTIC K_OZPEILDU38 "Delta - hysteresis, dipstick at 1/4 [mm] [verified]" VALUE 0x768E6 RL_VAL_UB 0 CM_0123 0 74.70703125 /end CHARACTERISTIC
/begin CHARACTERISTIC K_OZPEILERR "Bar display in fault case [verified]" VALUE 0x768E7 RL_VAL_UB 0 CM_0000 0 255 /end CHARACTERISTIC
/begin CHARACTERISTIC K_OZPEILKSPR "Maximum permitted level difference between old display and previous mean [mm] [verified]" VALUE 0x768E8 RL_VAL_UB 0 CM_0123 0 74.70703125 /end CHARACTERISTIC
/begin CHARACTERISTIC K_OZPEILLP85 "Bar display for level at 85% [verified]" VALUE 0x768E9 RL_VAL_UB 0 CM_0000 0 255 /end CHARACTERISTIC
/begin CHARACTERISTIC K_OZPEILML "Bar display while measuring [verified]" VALUE 0x768EA RL_VAL_UB 0 CM_0000 0 255 /end CHARACTERISTIC
/begin CHARACTERISTIC K_OZPEILOELCKO "Bar display when oil check not OK [verified]" VALUE 0x768EB RL_VAL_UB 0 CM_0000 0 255 /end CHARACTERISTIC
/begin CHARACTERISTIC K_OZPEILOELCOK "Bar display when oil check OK [verified]" VALUE 0x768EC RL_VAL_UB 0 CM_0000 0 255 /end CHARACTERISTIC
/begin CHARACTERISTIC K_OZPEILSPRUNG "Maximum permitted level difference between long-term means [mm] [verified]" VALUE 0x768ED RL_VAL_UB 0 CM_0123 0 74.70703125 /end CHARACTERISTIC
/begin CHARACTERISTIC K_OZSTANDVERZ "Delay for vehicle stationary [s] [verified]" VALUE 0x768EE RL_VAL_UB 0 CM_0000 0 255 /end CHARACTERISTIC
/begin CHARACTERISTIC K_OZSTARTVERZ "Oil-quality sensor start delay after engine speed [s] [verified]" VALUE 0x768EF RL_VAL_UB 0 CM_0000 0 255 /end CHARACTERISTIC
/begin CHARACTERISTIC K_OZTEMPQERR "Temperature threshold for permittivity fault [?C] [verified]" VALUE 0x70A30 RL_VAL_SW 0 CM_0159 -3276.8 3276.7 /end CHARACTERISTIC
/begin CHARACTERISTIC K_OZZTEMP "Maximum time with same temperature value (plausibility for ASIC pin break) [verified]" VALUE 0x70A3C RL_VAL_UW 0 CM_0000 0 65535 /end CHARACTERISTIC
/begin CHARACTERISTIC K_TOGVERZOEG "[verified]" VALUE 0x76815 RL_VAL_UB 0 CM_0000 0 255 /end CHARACTERISTIC
/begin CHARACTERISTIC KF_SOC0UBIB "[verified]" MAP 0x77752 RL_MAP_UW_SW_UW 0 CM_0194 0 1192.750251 /begin AXIS_DESCR STD_AXIS NO_INPUT_QUANTITY CM_0195 3 6 22.38375 /end AXIS_DESCR /begin AXIS_DESCR STD_AXIS NO_INPUT_QUANTITY CM_0129 5 -655.36 655.34 /end AXIS_DESCR /end CHARACTERISTIC
/begin CHARACTERISTIC KF_SOCLF "Charge factor vs temperature and state of charge [verified]" MAP 0x7773A RL_MAP_SW_UW_UB 0 CM_0160 0 3.984375 /begin AXIS_DESCR STD_AXIS NO_INPUT_QUANTITY CM_0159 3 -3276.8 3276.7 /end AXIS_DESCR /begin AXIS_DESCR STD_AXIS NO_INPUT_QUANTITY CM_0194 3 0 1192.750251 /end AXIS_DESCR /end CHARACTERISTIC
/begin CHARACTERISTIC KL_DFPRIO "Generator priority translator [verified]" CURVE 0x776D8 RL_CUR_UB_SW 0 CM_0196 -8192 8191.75 /begin AXIS_DESCR STD_AXIS NO_INPUT_QUANTITY CM_0158 6 0 99.609375 /end AXIS_DESCR /end CHARACTERISTIC
/begin CHARACTERISTIC KL_DFPTC "Filtered generator demand to priority weighting translator [verified]" CURVE 0x77670 RL_CUR_UB_SW 0 CM_0196 -8192 8191.75 /begin AXIS_DESCR STD_AXIS NO_INPUT_QUANTITY CM_0158 6 0 99.609375 /end AXIS_DESCR /end CHARACTERISTIC
/begin CHARACTERISTIC KL_DSOCPRIO "[verified]" CURVE 0x776EC RL_CUR_SW_UW 0 CM_0197 0 511.9921875
 /begin AXIS_DESCR STD_AXIS NO_INPUT_QUANTITY CM_0198 5 -99.99999959 99.99694783 /end AXIS_DESCR
/end CHARACTERISTIC
/begin CHARACTERISTIC KL_FITGRZ "Limit value for soc_fit [verified]" CURVE 0x7793A RL_CUR_SW_UW 0 CM_0199 0 99.99847371 /begin AXIS_DESCR STD_AXIS NO_INPUT_QUANTITY CM_0159 4 -3276.8 3276.7 /end AXIS_DESCR /end CHARACTERISTIC
/begin CHARACTERISTIC KL_ITNSTART "Start voltage depending on start current [verified]" CURVE 0x77996 RL_CUR_UB_UW 0 CM_0195 6 22.38375 /begin AXIS_DESCR STD_AXIS NO_INPUT_QUANTITY CM_0200 4 0 996.09375 /end AXIS_DESCR /end CHARACTERISTIC
/begin CHARACTERISTIC KL_PMSOCVU "State-of-charge value from fit calculation [verified]" CURVE 0x7778E RL_CUR_UW_UW 0 CM_0199 0 99.99847371 /begin AXIS_DESCR STD_AXIS NO_INPUT_QUANTITY CM_0195 3 6 22.38375 /end AXIS_DESCR /end CHARACTERISTIC
/begin CHARACTERISTIC KL_PRIO2PTC "Priority weighting for PTC heater control [verified]" CURVE 0x776B0 RL_CUR_UW_SW 0 CM_0196 -8192 8191.75 /begin AXIS_DESCR STD_AXIS NO_INPUT_QUANTITY CM_0196 5 0 16383.75 /end AXIS_DESCR /end CHARACTERISTIC
/begin CHARACTERISTIC KL_PRIOCF "[verified]" CURVE 0x77640 RL_CUR_SW_UB 0 CM_0000 0 255 /begin AXIS_DESCR STD_AXIS NO_INPUT_QUANTITY CM_0196 7 -8192 8191.75 /end AXIS_DESCR /end CHARACTERISTIC
/begin CHARACTERISTIC KL_PRIODF "[verified]" CURVE 0x77702 RL_CUR_UW_UB 0 CM_0000 0 255 /begin AXIS_DESCR STD_AXIS NO_INPUT_QUANTITY CM_0196 7 0 16383.75 /end AXIS_DESCR /end CHARACTERISTIC
/begin CHARACTERISTIC KL_PTC "PWM translator for PTC heater control [verified]" CURVE 0x7762E RL_CUR_UW_UB 0 CM_0201 0 127.5 /begin AXIS_DESCR STD_AXIS NO_INPUT_QUANTITY CM_0196 5 0 16383.75 /end AXIS_DESCR /end CHARACTERISTIC
/begin CHARACTERISTIC KL_PWRCF "[verified]" CURVE 0x77658 RL_CUR_SW_UB 0 CM_0000 0 255 /begin AXIS_DESCR STD_AXIS NO_INPUT_QUANTITY CM_0196 7 -8192 8191.75 /end AXIS_DESCR /end CHARACTERISTIC
/begin CHARACTERISTIC KL_PWRDF "[verified]" CURVE 0x77684 RL_CUR_UW_UB 0 CM_0000 0 255 /begin AXIS_DESCR STD_AXIS NO_INPUT_QUANTITY CM_0196 14 0 16383.75 /end AXIS_DESCR /end CHARACTERISTIC
/begin CHARACTERISTIC KL_SOC0TEMP "Temperaturabh?ngige Stromkorrektur f?r Ruhespannungsmessung [verified]" CURVE 0x77FBE RL_CUR_SW_UB 0 CM_0037 0 1.9921875 /begin AXIS_DESCR STD_AXIS NO_INPUT_QUANTITY CM_0159 5 -3276.8 3276.7 /end AXIS_DESCR /end CHARACTERISTIC
/begin CHARACTERISTIC KL_SOCPRIO "State-of-charge delta to priority translator [verified]" CURVE 0x776C6 RL_CUR_SW_SW 0 CM_0196 -8192 8191.75
 /begin AXIS_DESCR STD_AXIS NO_INPUT_QUANTITY CM_0198 4 -99.99999959 99.99694783 /end AXIS_DESCR
/end CHARACTERISTIC
/begin CHARACTERISTIC KL_SSOC "soc_s depending on seasonal temperature [verified]" CURVE 0x7794C RL_CUR_SW_UW 0 CM_0199 0 99.99847371 /begin AXIS_DESCR STD_AXIS NO_INPUT_QUANTITY CM_0159 4 -3276.8 3276.7 /end AXIS_DESCR /end CHARACTERISTIC
/begin CHARACTERISTIC KL_T2RELMAX "Maximum tolerance time of T2 [verified]" CURVE 0x774C0 RL_CUR_UW_UW 0 CM_0202 0 917490 /begin AXIS_DESCR STD_AXIS NO_INPUT_QUANTITY CM_0203 6 0 3669960 /end AXIS_DESCR /end CHARACTERISTIC
/begin CHARACTERISTIC KL_T2RELMXRG "Maximum tolerance time of T2, ring shift [verified]" CURVE 0x774A6 RL_CUR_UW_UW 0 CM_0202 0 917490 /begin AXIS_DESCR STD_AXIS NO_INPUT_QUANTITY CM_0203 6 0 3669960 /end AXIS_DESCR /end CHARACTERISTIC
/begin CHARACTERISTIC KL_T3RELMAX "Maximum tolerance time of T3 [verified]" CURVE 0x774DA RL_CUR_UW_UW 0 CM_0202 0 917490 /begin AXIS_DESCR STD_AXIS NO_INPUT_QUANTITY CM_0203 6 0 3669960 /end AXIS_DESCR /end CHARACTERISTIC
/begin CHARACTERISTIC KL_T3RELMXRG "Maximum tolerance time of T3, ring shift [verified]" CURVE 0x77506 RL_CUR_UW_UW 0 CM_0202 0 917490 /begin AXIS_DESCR STD_AXIS NO_INPUT_QUANTITY CM_0203 6 0 3669960 /end AXIS_DESCR /end CHARACTERISTIC
/begin CHARACTERISTIC KL_T4RELMAX "Maximum tolerance time of T4 [verified]" CURVE 0x77520 RL_CUR_UW_UW 0 CM_0202 0 917490 /begin AXIS_DESCR STD_AXIS NO_INPUT_QUANTITY CM_0203 6 0 3669960 /end AXIS_DESCR /end CHARACTERISTIC
/begin CHARACTERISTIC KL_T4RELMXRG "Maximum tolerance time of T4, ring shift [verified]" CURVE 0x7747A RL_CUR_UW_UW 0 CM_0202 0 917490 /begin AXIS_DESCR STD_AXIS NO_INPUT_QUANTITY CM_0203 6 0 3669960 /end AXIS_DESCR /end CHARACTERISTIC
/begin CHARACTERISTIC KL_UNSTART "Start voltage depending on engine speed [verified]" CURVE 0x7797A RL_CUR_SW_UW 0 CM_0195 6 22.38375 /begin AXIS_DESCR STD_AXIS NO_INPUT_QUANTITY CM_0002 2 -32768 32767 /end AXIS_DESCR /end CHARACTERISTIC
/begin CHARACTERISTIC K_ABSCHKORA "Calibration value for switch-off correction [verified]" VALUE 0x7790C RL_VAL_SW 0 CM_0204 -49.9999998 49.99847392 /end CHARACTERISTIC
/begin CHARACTERISTIC K_BILA_OGRZ "Source: PSB MS_S60 program 754 [verified]" VALUE 0x7791A RL_VAL_UW 0 CM_0199 0 99.99847371 /end CHARACTERISTIC
/begin CHARACTERISTIC K_BILA_UGRZ "[verified]" VALUE 0x7791C RL_VAL_UW 0 CM_0199 0 99.99847371 /end CHARACTERISTIC
/begin CHARACTERISTIC K_DAB_KORR1 "Correction constant 1 for switch-off [verified]" VALUE 0x7790E RL_VAL_SW 0 CM_0204 -49.9999998 49.99847392 /end CHARACTERISTIC
/begin CHARACTERISTIC K_DAB_KORR2 "Correction constant 2 for switch-off [verified]" VALUE 0x77910 RL_VAL_SW 0 CM_0204 -49.9999998 49.99847392 /end CHARACTERISTIC
/begin CHARACTERISTIC K_DAB_KORR3 "Correction constant 3 for switch-off [verified]" VALUE 0x77912 RL_VAL_SW 0 CM_0204 -49.9999998 49.99847392 /end CHARACTERISTIC
/begin CHARACTERISTIC K_DSOCA "Calibration value for d_soc [verified]" VALUE 0x77914 RL_VAL_SW 0 CM_0198 -99.99999959 99.99694783 /end CHARACTERISTIC
/begin CHARACTERISTIC K_DSOCABSCH "Calibration value for d_soc [verified]" VALUE 0x77916 RL_VAL_SW 0 CM_0198 -99.99999959 99.99694783 /end CHARACTERISTIC
/begin CHARACTERISTIC K_MN_PTCPI "Minimum value of PI controller, PTC control [verified]" VALUE 0x77584 RL_VAL_UW 0 CM_0197 0 511.9921875 /end CHARACTERISTIC
/begin CHARACTERISTIC K_MN_PWRDFPI "Minimum value of PI controller, generator priority [verified]" VALUE 0x77586 RL_VAL_UW 0 CM_0197 0 511.9921875 /end CHARACTERISTIC
/begin CHARACTERISTIC K_MX_PTCPI "Maximum value of PI controller, PTC control [verified]" VALUE 0x77588 RL_VAL_UW 0 CM_0197 0 511.9921875 /end CHARACTERISTIC
/begin CHARACTERISTIC K_PMTIMERSQ1 "Start value of timer for soc_quali [verified]" VALUE 0x7791E RL_VAL_UW 0 CM_0000 0 65535 /end CHARACTERISTIC
/begin CHARACTERISTIC K_PM_TABSMN "Calibration value for engine-off time tabsmn_w [s] [verified]" VALUE 0x77920 RL_VAL_UW 0 CM_0027 0 65535 /end CHARACTERISTIC
/begin CHARACTERISTIC K_PWRCOS15 "Consumer power control at terminal 15, engine off [verified]" VALUE 0x7758A RL_VAL_UW 0 CM_0000 0 65535 /end CHARACTERISTIC
/begin CHARACTERISTIC K_PWRCOSAPP "Consumer power control, bit-coded calibration value [verified]" VALUE 0x7758C RL_VAL_UW 0 CM_0000 0 65535 /end CHARACTERISTIC
/begin CHARACTERISTIC K_PWRCOSHT "Consumer power control value at high generator temperature [verified]" VALUE 0x7758E RL_VAL_UW 0 CM_0000 0 65535 /end CHARACTERISTIC
/begin CHARACTERISTIC K_QSOCCL1 "Limit for state-of-charge quality class 1 [Ah] [verified]" VALUE 0x77922 RL_VAL_UW 0 CM_0194 0 1192.750251 /end CHARACTERISTIC
/begin CHARACTERISTIC K_QSOCCL2 "Limit for state-of-charge quality class 2 [Ah] [verified]" VALUE 0x77924 RL_VAL_UW 0 CM_0194 0 1192.750251 /end CHARACTERISTIC
/begin CHARACTERISTIC K_QSOCCL3 "Limit for state-of-charge quality class 3 [Ah] [verified]" VALUE 0x77926 RL_VAL_UW 0 CM_0194 0 1192.750251 /end CHARACTERISTIC
/begin CHARACTERISTIC K_QSTARTFGA "Calibration value for q_startfgk [verified]" VALUE 0x77928 RL_VAL_UW 0 CM_0194 0 1192.750251 /end CHARACTERISTIC
/begin CHARACTERISTIC K_RIN_GRENZ1 "Battery internal resistance limit 1 [verified]" VALUE 0x7796A RL_VAL_UB 0 CM_0205 0 31.875 /end CHARACTERISTIC
/begin CHARACTERISTIC K_RIN_GRENZ2 "Battery internal resistance limit 2 [verified]" VALUE 0x7796B RL_VAL_UB 0 CM_0205 0 31.875 /end CHARACTERISTIC
/begin CHARACTERISTIC K_RIN_GRENZ3 "Battery internal resistance limit 3 [verified]" VALUE 0x7796C RL_VAL_UB 0 CM_0205 0 31.875 /end CHARACTERISTIC
/begin CHARACTERISTIC K_RIN_GRENZ4 "Battery internal resistance limit 4 [verified]" VALUE 0x7796D RL_VAL_UB 0 CM_0205 0 31.875 /end CHARACTERISTIC
/begin CHARACTERISTIC K_RIN_GRENZ5 "Battery internal resistance limit 5 [verified]" VALUE 0x7796E RL_VAL_UB 0 CM_0205 0 31.875 /end CHARACTERISTIC
/begin CHARACTERISTIC K_RIN_GRENZ6 "Battery internal resistance limit 6 [verified]" VALUE 0x7796F RL_VAL_UB 0 CM_0205 0 31.875 /end CHARACTERISTIC
/begin CHARACTERISTIC K_RIN_GRENZ7 "Battery internal resistance limit 7 [verified]" VALUE 0x77970 RL_VAL_UB 0 CM_0205 0 31.875 /end CHARACTERISTIC
/begin CHARACTERISTIC K_RIN_GRENZ8 "Battery internal resistance limit 8 [verified]" VALUE 0x77971 RL_VAL_UB 0 CM_0205 0 31.875 /end CHARACTERISTIC
/begin CHARACTERISTIC K_SOCFITGRZ "Limit value for soc_fit [verified]" VALUE 0x7792A RL_VAL_UW 0 CM_0199 0 99.99847371 /end CHARACTERISTIC
/begin CHARACTERISTIC K_SOCFITLIMH "Source: PSB MS_S60 program 754 [verified]" VALUE 0x7792C RL_VAL_UW 0 CM_0199 0 99.99847371 /end CHARACTERISTIC
/begin CHARACTERISTIC K_SOCFITLIML "Calibration constant for devaluing state of charge from fit calculation [verified]" VALUE 0x7792E RL_VAL_UW 0 CM_0199 0 99.99847371 /end CHARACTERISTIC
/begin CHARACTERISTIC K_SOC_STAFGA "Calibration value for state of charge from start capability [verified]" VALUE 0x77930 RL_VAL_UW 0 CM_0199 0 99.99847371 /end CHARACTERISTIC
/begin CHARACTERISTIC K_TSAISONFIL "Filter constant for seasonal temperature [verified]" VALUE 0x77932 RL_VAL_UW 0 CM_0000 0 65535 /end CHARACTERISTIC
/begin CHARACTERISTIC K_TSAISPWF "Default seasonal temperature on DME power fail [?C] [verified]" VALUE 0x77918 RL_VAL_SW 0 CM_0159 -3276.8 3276.7 /end CHARACTERISTIC
/begin CHARACTERISTIC K_USTARTGRZ "Voltage limit for start evaluation [verified]" VALUE 0x77968 RL_VAL_UW 0 CM_0195 6 22.38375 /end CHARACTERISTIC
/begin CHARACTERISTIC S_ABSCHK "Switch for calibration value absch_korr [verified]" VALUE 0x77934 RL_VAL_UB 0 CM_0000 0 255 /end CHARACTERISTIC
/begin CHARACTERISTIC S_DSOCS "Switch for calibration value delta state of charge [verified]" VALUE 0x77935 RL_VAL_UB 0 CM_0000 0 255 /end CHARACTERISTIC
/begin CHARACTERISTIC S_NKWITNSTRT "0 = engine-speed evaluation, 1 = start-current evaluation [verified]" VALUE 0x77972 RL_VAL_UB 0 CM_0000 0 255 /end CHARACTERISTIC
/begin CHARACTERISTIC S_PMSTARTQ "Calibration switch for B_pmstartq [verified]" VALUE 0x77973 RL_VAL_UB 0 CM_0000 0 255 /end CHARACTERISTIC
/begin CHARACTERISTIC S_PMTABSMN "Switch for calibrating engine-off time tabsmn_w [verified]" VALUE 0x77936 RL_VAL_UB 0 CM_0000 0 255 /end CHARACTERISTIC
/begin CHARACTERISTIC S_PTCMANUAL "Switch to activate manual PTC value [verified]" VALUE 0x775D6 RL_VAL_UB 0 CM_0000 0 255 /end CHARACTERISTIC
/begin CHARACTERISTIC S_PWRCFENA "[verified]" VALUE 0x775D7 RL_VAL_UB 0 CM_0000 0 255 /end CHARACTERISTIC
/begin CHARACTERISTIC S_QSTARTFK "Switch for calibrating q_startfgk [verified]" VALUE 0x77937 RL_VAL_UB 0 CM_0000 0 255 /end CHARACTERISTIC
/begin CHARACTERISTIC S_RIN "Switch for internal-resistance check calibration [verified]" VALUE 0x77975 RL_VAL_UB 0 CM_0000 0 255 /end CHARACTERISTIC
/begin CHARACTERISTIC S_SOCSTAFK "Switch for calibrating state of charge from start capability [verified]" VALUE 0x77938 RL_VAL_UB 0 CM_0000 0 255 /end CHARACTERISTIC
/begin CHARACTERISTIC S_STARTAW "Start evaluation finished [verified]" VALUE 0x77976 RL_VAL_UB 0 CM_0000 0 255 /end CHARACTERISTIC
/begin CHARACTERISTIC KF_MDRESWAFS "Engine lambda offset with secondary air [verified]" MAP 0x73DA4 RL_MAP_SW_SW_SW 0 CM_0019 -2.000001434 1.999940398 /begin AXIS_DESCR STD_AXIS NO_INPUT_QUANTITY CM_0025 6 -327.68 327.67 /end AXIS_DESCR /begin AXIS_DESCR STD_AXIS NO_INPUT_QUANTITY CM_0006 6 -3550 3003.5 /end AXIS_DESCR /end CHARACTERISTIC
/begin CHARACTERISTIC KL_SL_HFM_AD "Curve: mini air-mass meter (secondary air) [verified]" CURVE 0x78716 RL_CUR_SW_SW 0 CM_0102 -3276.8 3276.7 /begin AXIS_DESCR STD_AXIS NO_INPUT_QUANTITY CM_0087 10 -32768 32767 /end AXIS_DESCR /end CHARACTERISTIC
/begin CHARACTERISTIC KL_SL_LAM_MOT_DELAY "Time delay for engine lambda offset [verified]" CURVE 0x786FC RL_CUR_SW_UW 0 CM_0025 0 655.35 /begin AXIS_DESCR STD_AXIS NO_INPUT_QUANTITY CM_0006 6 -3550 3003.5 /end AXIS_DESCR /end CHARACTERISTIC
/begin CHARACTERISTIC KL_SL_LAM_MOT_OFFS_FILT_TAU "Filter constant for sl_lam_mot_offs_filt [verified]" CURVE 0x787AA RL_CUR_UW_UB 0 CM_0065 0.005019607843 1.28 /begin AXIS_DESCR STD_AXIS NO_INPUT_QUANTITY CM_0023 6 0 6553.5 /end AXIS_DESCR /end CHARACTERISTIC
/begin CHARACTERISTIC KL_SL_ML_MAX_PABG "Secondary air maximum flow vs exhaust back-pressure [verified]" CURVE 0x78752 RL_CUR_SW_SW 0 CM_0102 -3276.8 3276.7 /begin AXIS_DESCR STD_AXIS NO_INPUT_QUANTITY CM_0022 6 -2048 2047.9375 /end AXIS_DESCR /end CHARACTERISTIC
/begin CHARACTERISTIC KL_SL_ML_MAX_UB_FAKT "Battery-voltage correction [verified]" CURVE 0x78740 RL_CUR_SW_UW 0 CM_0016 0 63.99902344 /begin AXIS_DESCR STD_AXIS NO_INPUT_QUANTITY CM_0021 4 -3276.8 3276.7 /end AXIS_DESCR /end CHARACTERISTIC
/begin CHARACTERISTIC K_DMTL_I_REF_1_2_DIFF "Maximum difference Ref1 and Ref2 [mA] [verified]" VALUE 0x70956 RL_VAL_UW 0 CM_0211 0 147.45375 /end CHARACTERISTIC
/begin CHARACTERISTIC K_DMTL_I_REF_MAX "Maximum reference current [mA] [verified]" VALUE 0x70952 RL_VAL_UW 0 CM_0211 0 147.45375 /end CHARACTERISTIC
/begin CHARACTERISTIC K_DMTL_I_REF_MIN "Minimum reference current [mA] [verified]" VALUE 0x70954 RL_VAL_UW 0 CM_0211 0 147.45375 /end CHARACTERISTIC
/begin CHARACTERISTIC K_DMTL_START "Source: PSB MS_S60 program 754 [verified]" VALUE 0x70958 RL_VAL_UB 0 CM_0000 0 255 /end CHARACTERISTIC
/begin CHARACTERISTIC K_DMTL_TEMP_DECKEL_MAX "Maximum temperature for fuel-cap diagnosis [?C] [verified]" VALUE 0x7095E RL_VAL_SW 0 CM_0006 -3550 3003.5 /end CHARACTERISTIC
/begin CHARACTERISTIC K_DMTL_TEMP_DECKEL_MIN "Minimum temperature for fuel-cap diagnosis [?C] [verified]" VALUE 0x70960 RL_VAL_SW 0 CM_0006 -3550 3003.5 /end CHARACTERISTIC
/begin CHARACTERISTIC K_DMTL_TEMP_MAX "Maximum temperature for diagnosis [?C] [verified]" VALUE 0x7095A RL_VAL_SW 0 CM_0006 -3550 3003.5 /end CHARACTERISTIC
/begin CHARACTERISTIC K_DMTL_TEMP_MIN "Minimum temperature for diagnosis [?C] [verified]" VALUE 0x7095C RL_VAL_SW 0 CM_0006 -3550 3003.5 /end CHARACTERISTIC
/begin CHARACTERISTIC K_DMTL_TEMP_START_MIN "Minimum engine start temperature [?C] [verified]" VALUE 0x70964 RL_VAL_SW 0 CM_0006 -3550 3003.5 /end CHARACTERISTIC
/begin CHARACTERISTIC K_DMTL_TEMP_VENT_MIN "Minimum temperature for valve check [?C] [verified]" VALUE 0x70962 RL_VAL_SW 0 CM_0006 -3550 3003.5 /end CHARACTERISTIC
/begin CHARACTERISTIC K_DMTL_TAU_I "Filter time constant, current [verified]" VALUE 0x70966 RL_VAL_UW 0 CM_0025 0 655.35 /end CHARACTERISTIC
/begin CHARACTERISTIC K_DMTL_TP_I_BEG "Filter time constant, current at start [s] [verified]" VALUE 0x70968 RL_VAL_UB 0 CM_0027 0 255 /end CHARACTERISTIC
/begin CHARACTERISTIC K_DMTL_TP_I_ROH "Filter time constant, raw current [ms] [verified]" VALUE 0x70969 RL_VAL_UB 0 CM_0169 0 255 /end CHARACTERISTIC
/begin CHARACTERISTIC K_DMTL_TAU_I_TANK "Filter time constant, current for refuelling detection [verified]" VALUE 0x7096A RL_VAL_UW 0 CM_0025 0 655.35 /end CHARACTERISTIC
/begin CHARACTERISTIC K_DMTL_TP_UB "Filter time constant, voltage [ms] [verified]" VALUE 0x7096C RL_VAL_UB 0 CM_0032 0 1275 /end CHARACTERISTIC
/begin CHARACTERISTIC K_DMTL_T_ABSTELL "Minimum engine-off time for diagnosis start [min] [verified]" VALUE 0x7096E RL_VAL_UW 0 CM_0108 0 65535 /end CHARACTERISTIC
/begin CHARACTERISTIC K_DMTL_T_AY_DLY "Wait time, lateral acceleration [s] [verified]" VALUE 0x70970 RL_VAL_UB 0 CM_0023 0 25.5 /end CHARACTERISTIC
/begin CHARACTERISTIC K_DMTL_T_CC_DAUER "Maximum display duration of fuel-cap check-control message [s] [verified]" VALUE 0x70972 RL_VAL_UW 0 CM_0023 0 6553.5 /end CHARACTERISTIC
/begin CHARACTERISTIC K_DMTL_T_DECKEL_ML_MIN "Minimum engine run time for fuel-cap diagnosis start [min] [verified]" VALUE 0x70974 RL_VAL_UW 0 CM_0212 0 11184.63563 /end CHARACTERISTIC
/begin CHARACTERISTIC K_DMTL_T_FEUCHT_DLY "Wait time after humidity abort [s] [verified]" VALUE 0x70976 RL_VAL_UW 0 CM_0023 0 6553.5 /end CHARACTERISTIC
/begin CHARACTERISTIC K_DMTL_T_KURZSCHL "Wait time for short-circuit detection [ms] [verified]" VALUE 0x70978 RL_VAL_UB 0 CM_0213 0 127.5 /end CHARACTERISTIC
/begin CHARACTERISTIC K_DMTL_T_MESS_GES "Maximum total measurement time (without reference measurement) [s] [verified]" VALUE 0x7097A RL_VAL_UW 0 CM_0023 0 6553.5 /end CHARACTERISTIC
/begin CHARACTERISTIC K_DMTL_T_ML_MIN "Minimum engine run time for diagnosis start [min] [verified]" VALUE 0x7097C RL_VAL_UW 0 CM_0212 0 11184.63563 /end CHARACTERISTIC
/begin CHARACTERISTIC KF_TE_ANZUGSZEIT "Pull-in time, purge valve [verified]" MAP 0x78E40 RL_MAP_UW_UW_UW 0 CM_0214 0 655.35 /begin AXIS_DESCR STD_AXIS NO_INPUT_QUANTITY CM_0215 5 0 6553.5 /end AXIS_DESCR /begin AXIS_DESCR STD_AXIS NO_INPUT_QUANTITY CM_0021 5 0 6553.5 /end AXIS_DESCR /end CHARACTERISTIC
/begin CHARACTERISTIC KF_TE_GW_CNT_F "Factor, limit-value ramp [verified]" MAP 0x78E88 RL_MAP_SW_SW_UB 0 CM_0160 0 3.984375 /begin AXIS_DESCR STD_AXIS NO_INPUT_QUANTITY CM_0016 5 -32 31.99902344 /end AXIS_DESCR
 /begin AXIS_DESCR STD_AXIS NO_INPUT_QUANTITY CM_0051 2 -1.000000717 0.9999701992 /end AXIS_DESCR
/end CHARACTERISTIC
/begin CHARACTERISTIC KF_TE_GW_RAMPEN "Operating-point-dependent ramp time [verified]" MAP 0x78EA2 RL_MAP_SW_SW_UW 0 CM_0023 0 6553.5
 /begin AXIS_DESCR STD_AXIS NO_INPUT_QUANTITY CM_0019 9 -2.000001434 1.999940398 /end AXIS_DESCR
 /begin AXIS_DESCR STD_AXIS NO_INPUT_QUANTITY CM_0019 5 -2.000001434 1.999940398 /end AXIS_DESCR
/end CHARACTERISTIC
/begin CHARACTERISTIC KF_TE_TV_NORM "Normalised duty cycle [verified]" MAP 0x78F86 RL_MAP_UW_UW_UW 0 CM_0091 0 6399.902344 /begin AXIS_DESCR STD_AXIS NO_INPUT_QUANTITY CM_0091 11 0 6399.902344 /end AXIS_DESCR /begin AXIS_DESCR STD_AXIS NO_INPUT_QUANTITY CM_0215 5 0 6553.5 /end AXIS_DESCR /end CHARACTERISTIC
/begin CHARACTERISTIC KL_TE_GW_CNT_DEC "Decrement for te_gw_cnt [verified]" CURVE 0x78CCA RL_CUR_SW_SW 0 CM_0216 -320 319.9902344 /begin AXIS_DESCR STD_AXIS NO_INPUT_QUANTITY CM_0102 3 -3276.8 3276.7 /end AXIS_DESCR /end CHARACTERISTIC
/begin CHARACTERISTIC KL_TE_GW_F "Extension of ramp time [verified]" CURVE 0x78CD8 RL_CUR_UW_UW 0 CM_0016 0 63.99902344 /begin AXIS_DESCR STD_AXIS NO_INPUT_QUANTITY CM_0102 5 0 6553.5 /end AXIS_DESCR /end CHARACTERISTIC
/begin CHARACTERISTIC KL_TE_GW_LAM_REG_F "Extension of ramp time [verified]" CURVE 0x78CFC RL_CUR_UW_UW 0 CM_0016 0 63.99902344 /begin AXIS_DESCR STD_AXIS NO_INPUT_QUANTITY CM_0051 8 0 1.999970916 /end AXIS_DESCR /end CHARACTERISTIC
/begin CHARACTERISTIC KL_TE_GW_TI_MIN "Limit for ti_min control [verified]" CURVE 0x78D1E RL_CUR_UW_UW 0 CM_0023 0 6553.5 /begin AXIS_DESCR STD_AXIS NO_INPUT_QUANTITY CM_0141 5 0 65.535 /end AXIS_DESCR /end CHARACTERISTIC
/begin CHARACTERISTIC KL_TE_MKS_XSI "Discharge coefficient - injection with clutch closed [verified]" CURVE 0x78D58 RL_CUR_SW_UW 0 CM_0016 0 63.99902344
 /begin AXIS_DESCR STD_AXIS NO_INPUT_QUANTITY CM_0005 14 -199.9999992 199.9938957 /end AXIS_DESCR
/end CHARACTERISTIC
/begin CHARACTERISTIC KL_TE_ML_XSI "Discharge coefficient - air mass [verified]" CURVE 0x78D92 RL_CUR_SW_UW 0 CM_0016 0 63.99902344
 /begin AXIS_DESCR STD_AXIS NO_INPUT_QUANTITY CM_0005 14 -199.9999992 199.9938957 /end AXIS_DESCR
/end CHARACTERISTIC
/begin CHARACTERISTIC KL_TE_SYNC_FREQ "Segment-synchronous drive frequency [verified]" MAP 0x791EA RL_MAP_SW_SW_UW 0 CM_0215 0 6553.5 /begin AXIS_DESCR STD_AXIS NO_INPUT_QUANTITY CM_0002 8 -32768 32767 /end AXIS_DESCR /begin AXIS_DESCR STD_AXIS NO_INPUT_QUANTITY CM_0106 8 -32768 32767 /end AXIS_DESCR /end CHARACTERISTIC
/begin CHARACTERISTIC KL_TE_TI_MIN "Purge - minimum injection time [verified]" CURVE 0x78E00 RL_CUR_SW_UW 0 CM_0140 0 1023.984375 /begin AXIS_DESCR STD_AXIS NO_INPUT_QUANTITY CM_0142 5 -32.768 32.767 /end AXIS_DESCR /end CHARACTERISTIC
/begin CHARACTERISTIC KL_TE_T_BEGIN_MIN "Delay time - purge enable [verified]" CURVE 0x78DCC RL_CUR_SW_UW 0 CM_0025 0 655.35 /begin AXIS_DESCR STD_AXIS NO_INPUT_QUANTITY CM_0006 6 -3550 3003.5 /end AXIS_DESCR /end CHARACTERISTIC
/begin CHARACTERISTIC KL_TE_YPS_SQRT "Square-root representation of flow velocity [verified]" CURVE 0x78E16 RL_CUR_UW_UW 0 CM_0217 0 196605 /begin AXIS_DESCR STD_AXIS NO_INPUT_QUANTITY CM_0218 10 0 589815 /end AXIS_DESCR /end CHARACTERISTIC
/begin CHARACTERISTIC KF_TE_FREQU "Drive frequency [verified]" MAP 0x78F1A RL_MAP_UW_UW_UW 0 CM_0215 0 6553.5 /begin AXIS_DESCR STD_AXIS NO_INPUT_QUANTITY CM_0002 8 0 65535 /end AXIS_DESCR /begin AXIS_DESCR STD_AXIS NO_INPUT_QUANTITY CM_0012 5 0 6553.5 /end AXIS_DESCR /end CHARACTERISTIC
/begin CHARACTERISTIC K_TKSM_CFG "Source: PSB MS_S60 program 754 [verified]" VALUE 0x7A2B2 RL_VAL_UB 0 CM_0000 0 255 /end CHARACTERISTIC
/begin CHARACTERISTIC K_TKSM_MR_TAU "Filter constant for engine-bay temperature [s] [verified]" VALUE 0x7A2B4 RL_VAL_UW 0 CM_0027 0 65535 /end CHARACTERISTIC
/begin CHARACTERISTIC K_PUMG_AEBEGR "Gradient threshold, sensor acquisition [mbar/s] [verified]" VALUE 0x77E9E RL_VAL_UW 0 CM_0222 0 40959.375 /end CHARACTERISTIC
/begin CHARACTERISTIC K_PUMG_ERSATZ "Substitute value, ambient pressure [mbar] [verified]" VALUE 0x77E98 RL_VAL_SW 0 CM_0022 -2048 2047.9375 /end CHARACTERISTIC
/begin CHARACTERISTIC K_PUMG_SENSOR_OFFSET "Pressure-sensor offset [mbar] [verified]" VALUE 0x77E9C RL_VAL_SW 0 CM_0022 -2048 2047.9375 /end CHARACTERISTIC
/begin CHARACTERISTIC K_PUMG_SENSOR_STEIGUNG "Pressure-sensor slope [mbar/V] [verified]" VALUE 0x77E9A RL_VAL_UW 0 CM_0184 0 819.1875 /end CHARACTERISTIC
/begin CHARACTERISTIC K_PUMG_TAU "Filter constant for ambient-pressure acquisition [s] [verified]" VALUE 0x77EA0 RL_VAL_UB 0 CM_0027 0 255 /end CHARACTERISTIC
/begin CHARACTERISTIC K_OZVERLORI "Schwelle f?r Orientierungswert ?lniveau (Verlustwarnung) [EST]" VALUE 0x7689A RL_VAL_UB 0 CM_0241 0 74.70703125 /end CHARACTERISTIC
/begin CHARACTERISTIC K_OZMAXSLOPE "Maximale erlaubte Steigung [EST]" VALUE 0x7689C RL_VAL_SW 0 CM_0242 -64 63.99804688 /end CHARACTERISTIC
/begin CHARACTERISTIC K_OZMINSLOPE "Kleinste erlaubte Steigung (<0) [EST]" VALUE 0x7689E RL_VAL_SW 0 CM_0242 -64 63.99804688 /end CHARACTERISTIC
/begin CHARACTERISTIC K_OZNMOTMAX "obere Drehzahlgrenze f?r dreh-zahlkorrigierten Niveaumittelwert [EST]" VALUE 0x768A0 RL_VAL_SW 0 CM_0002 -32768 32767 /end CHARACTERISTIC
/begin CHARACTERISTIC K_OZNMOTMIN "untere Drehzahlgrenze f?r dreh- zahlkorrigierten Niveaumittelwert [EST]" VALUE 0x768A2 RL_VAL_SW 0 CM_0002 -32768 32767 /end CHARACTERISTIC
/begin CHARACTERISTIC K_OZTEMPBW "Temperaturschwelle ?ltempera-tur Motor betriebswarm [EST]" VALUE 0x768A4 RL_VAL_SW 0 CM_0243 -3276.8 3276.7 /end CHARACTERISTIC
/begin CHARACTERISTIC K_OZTORMIN "Mindest Temperatur f?r OrientierungMw QLT [EST]" VALUE 0x768A6 RL_VAL_SW 0 CM_0244 -327.68 327.67 /end CHARACTERISTIC
/begin CHARACTERISTIC K_OZTORMINF "Mindest Temperatur f?r OrientierungMw QLT w?hrend der Fahrt [EST]" VALUE 0x768A8 RL_VAL_SW 0 CM_0244 -327.68 327.67 /end CHARACTERISTIC
/begin CHARACTERISTIC K_OZVORMV "Korrektur von Vormw f?r Peilstab [EST]" VALUE 0x768AA RL_VAL_SW 0 CM_0245 -32 31.99902344 /end CHARACTERISTIC
/begin CHARACTERISTIC K_OZABSTELL "Mindestwert f?r die ?bernahme der Abstellzeit [EST]" VALUE 0x768AC RL_VAL_UW 0 CM_0108 0 65535 /end CHARACTERISTIC
/begin CHARACTERISTIC K_OZABZORIVL "Mindest Abstellzeit f?r die Frei- gabe ?lverlustanzeige nach der Orientierung [EST]" VALUE 0x768AE RL_VAL_UW 0 CM_0108 0 65535 /end CHARACTERISTIC
/begin CHARACTERISTIC K_OZALTANZABZ "Abstellzeit f?r die Ausgabe der letzten Anzeige nach dem ?lcheck [EST]" VALUE 0x768B0 RL_VAL_UW 0 CM_0108 0 65535 /end CHARACTERISTIC
/begin CHARACTERISTIC K_OZLUFTMAX "hPa 0.0p 3 10*x/256 Plausibel max luftsprung [EST]" VALUE 0x768B2 RL_VAL_UW 0 CM_0246 0 65535 /end CHARACTERISTIC
/begin CHARACTERISTIC K_OZMWL "Anzahl der Messwerte f?r Lang-zeit-Mittelwert Niveau [EST]" VALUE 0x768B4 RL_VAL_UW 0 CM_0000 0 65535 /end CHARACTERISTIC
/begin CHARACTERISTIC K_OZMWOR "Anzahl der Messwerte f?r Orien-tierungsmessung [EST]" VALUE 0x768B6 RL_VAL_UW 0 CM_0000 0 65535 /end CHARACTERISTIC
/begin CHARACTERISTIC K_OZMWV "Anzahl der Messwerte f?r vorge-zogenen Mittelwert Niveau [EST]" VALUE 0x768B8 RL_VAL_UW 0 CM_0000 0 65535 /end CHARACTERISTIC
/begin CHARACTERISTIC K_OZOELCABZ "Minimale Abstellzeit f?r den ?lCheck [EST]" VALUE 0x768BA RL_VAL_UW 0 CM_0108 0 65535 /end CHARACTERISTIC
/begin CHARACTERISTIC K_OZOELVERB "?lverbrauch [EST]" VALUE 0x768BC RL_VAL_UW 0 CM_0000 0 65535 /end CHARACTERISTIC
/begin CHARACTERISTIC K_OZSTARTABZ "Mindestlaufzeit f?r die ?bernah-me der Abstellzeit [EST]" VALUE 0x768BE RL_VAL_UW 0 CM_0247 0 655.35 /end CHARACTERISTIC
/begin CHARACTERISTIC K_OZSTMINW "Minimale Strecke f?r die Stei-gungserkennung [EST]" VALUE 0x768C0 RL_VAL_UW 0 CM_0248 0 9.999847412 /end CHARACTERISTIC
/begin CHARACTERISTIC K_OZLBESCHN "Negative L?ngsbeschleunigung Ausblendung-Schwelle [EST]" VALUE 0x768C2 RL_VAL_SB 0 CM_0249 -32 31.75 /end CHARACTERISTIC
/begin CHARACTERISTIC K_OZLBESCHORI "L?ngsbeschleunigung Ausblen-dung-Schwelle beim OriMw [EST]" VALUE 0x768C3 RL_VAL_SB 0 CM_0249 -32 31.75 /end CHARACTERISTIC
/begin CHARACTERISTIC K_OZLBESCHP "Positive L?ngsbeschleunigung Ausblendung-Schwelle [EST]" VALUE 0x768C4 RL_VAL_SB 0 CM_0249 -32 31.75 /end CHARACTERISTIC
/begin CHARACTERISTIC K_OZLBESCHST "L?ngsbeschleunigung Ausblen-dung-Schwelle im Stand [EST]" VALUE 0x768C5 RL_VAL_SB 0 CM_0249 -32 31.75 /end CHARACTERISTIC
/begin CHARACTERISTIC K_OZQBESCHN "Negative Querbeschleunigung Ausblendung-Schwelle [EST]" VALUE 0x768C6 RL_VAL_SB 0 CM_0249 -32 31.75 /end CHARACTERISTIC
/begin CHARACTERISTIC K_OZQBESCHORI "Querbeschleunigung Ausblen-dung-Schwelle Beim OriMw [EST]" VALUE 0x768C7 RL_VAL_SB 0 CM_0249 -32 31.75 /end CHARACTERISTIC
/begin CHARACTERISTIC K_OZQBESCHP "Positive Querbeschleunigung Ausblendung-Schwelle [EST]" VALUE 0x768C8 RL_VAL_SB 0 CM_0249 -32 31.75 /end CHARACTERISTIC
/begin CHARACTERISTIC K_OZQBESCHST "Querbeschleunigung Ausblen-dung-Schwelle im Stand [EST]" VALUE 0x768C9 RL_VAL_SB 0 CM_0249 -32 31.75 /end CHARACTERISTIC
/begin CHARACTERISTIC K_NACHFUELL12 "Nachf?ll Erste Balken von Peistab [EST]" VALUE 0x768CA RL_VAL_UB 0 CM_0000 0 255 /end CHARACTERISTIC
/begin CHARACTERISTIC K_NACHFUELL25 "Nachf?ll Zweite Balken von Peistab [EST]" VALUE 0x768CB RL_VAL_UB 0 CM_0000 0 255 /end CHARACTERISTIC
/begin CHARACTERISTIC K_NACHFUELL38 "Nachf?ll Dritte Balken von Peistab [EST]" VALUE 0x768CC RL_VAL_UB 0 CM_0000 0 255 /end CHARACTERISTIC
/begin CHARACTERISTIC K_NACHFUELL53 "Nachf?ll Vierte Balken von Peistab [EST]" VALUE 0x768CD RL_VAL_UB 0 CM_0000 0 255 /end CHARACTERISTIC
/begin CHARACTERISTIC K_NACHFUELL69 "Nachf?ll F?nfte Balken von Peistab [EST]" VALUE 0x768CE RL_VAL_UB 0 CM_0000 0 255 /end CHARACTERISTIC
/begin CHARACTERISTIC K_NACHFUELL85 "Nachf?ll Sechte Balken von Peistab [EST]" VALUE 0x768CF RL_VAL_UB 0 CM_0000 0 255 /end CHARACTERISTIC
/begin CHARACTERISTIC K_NACHFUELL95 "Nachf?ll Siebte Balken von Peistab [EST]" VALUE 0x768D0 RL_VAL_UB 0 CM_0000 0 255 /end CHARACTERISTIC
/begin CHARACTERISTIC K_OZBESCHAUS "Zahl Ausgeblendet bei Lengsbescheunigung [EST]" VALUE 0x768D1 RL_VAL_UB 0 CM_0000 0 255 /end CHARACTERISTIC
/begin CHARACTERISTIC K_OZDKNIVN "Ersatzwert f?r die Drehzahlkor-rektur bei Oz_peilaltanz = 0 [EST]" VALUE 0x768D2 RL_VAL_UB 0 CM_0241 0 74.70703125 /end CHARACTERISTIC
/begin CHARACTERISTIC K_OZFAKTORI "Faktor f?r die Gewichtung von Tmot/Toel bei der Ori-Korrektur [EST]" VALUE 0x768D3 RL_VAL_UB 0 CM_0250 0 0.99609375 /end CHARACTERISTIC
/begin CHARACTERISTIC KL_SL_LAM_MOT_KORR_DELAY "Delay for sl_lam_mot correction vs start temperature [verified]" CURVE 0x78790 RL_CUR_SW_UW 0 CM_0025 0 655.35 /begin AXIS_DESCR STD_AXIS NO_INPUT_QUANTITY CM_0006 6 -3550 3003.5 /end AXIS_DESCR /end CHARACTERISTIC
/begin CHARACTERISTIC KL_SL_LAM_MOT_OFFS_TIME_F "Spread of time_ml vs cat aging [verified]" CURVE 0x7876C RL_CUR_UW_UW 0 CM_0016 0 63.99902344 /begin AXIS_DESCR STD_AXIS NO_INPUT_QUANTITY CM_0236 4 0 3.999938965 /end AXIS_DESCR /end CHARACTERISTIC
/begin CHARACTERISTIC KL_SL_LAM_MOT_OFFS_KM "Cold-aging correction vs mileage [verified]" CURVE 0x7877E RL_CUR_SW_SW 0 CM_0016 -32 31.99902344 /begin AXIS_DESCR STD_AXIS NO_INPUT_QUANTITY CM_0000 4 -32768 32767 /end AXIS_DESCR /end CHARACTERISTIC
/begin CHARACTERISTIC K_SL_LAM_MOT_OFFS_MIN "Minimum fuer sl_lam_mot_offs [EST]" VALUE 0x786EC RL_VAL_SW 0 CM_0259 -2 1.999938965 /end CHARACTERISTIC
/begin CHARACTERISTIC K_SL_LAM_MOT_OFFS_MAX "Maximum fuer sl_lam_mot_offs [EST]" VALUE 0x786EE RL_VAL_SW 0 CM_0259 -2 1.999938965 /end CHARACTERISTIC
/begin CHARACTERISTIC K_SL_ML_MDL_CFG "0x0 sl_ml_mdl 0x1 sl_ml_max ELSE undef Schalter fuer sls_lam_mot_offs-Berechnung [EST]" VALUE 0x786F2 RL_VAL_UB 0 CM_0000 0 255 /end CHARACTERISTIC
/begin CHARACTERISTIC K_ELUP_UB_MIN "Mindestspannung an KL87 fuer ELUP-Ansteuerung [verified]" VALUE 0x72516 RL_VAL_SW 0 CM_0021 -3276.8 3276.7 /end CHARACTERISTIC
/begin CHARACTERISTIC K_ELUP_ON_TIME_MIN "mindest ELUP-Ansteuerzeit [EST]" VALUE 0x72518 RL_VAL_UW 0 CM_0025 0 655.35 /end CHARACTERISTIC
/begin CHARACTERISTIC K_ELUP_ON_TIME_MAX "maximale ELUP-Ansteuerzeit [EST]" VALUE 0x7251A RL_VAL_UW 0 CM_0025 0 655.35 /end CHARACTERISTIC
/begin CHARACTERISTIC K_ELUP_OFF_TIME_MIN "mindest ELUP -Verriegelungszeit [EST]" VALUE 0x7251C RL_VAL_UW 0 CM_0025 0 655.35 /end CHARACTERISTIC
/begin CHARACTERISTIC KL_ELU_V_KORR_FETRAWE "E-fan speed factor vs vehicle speed (FETRAWE) [verified]" CURVE 0x7249C RL_CUR_SW_UB 0 CM_0269 0 1.9921875 /begin AXIS_DESCR STD_AXIS NO_INPUT_QUANTITY CM_0260 3 -2048 2047.9375 /end AXIS_DESCR /end CHARACTERISTIC
/begin CHARACTERISTIC KF_ELU_V_KORR "E-fan speed factor map vs vehicle speed and ambient temperature [verified]" MAP 0x724F2 RL_MAP_SW_SW_UB 0 CM_0269 0 1.9921875 /begin AXIS_DESCR STD_AXIS NO_INPUT_QUANTITY CM_0260 4 -2048 2047.9375 /end AXIS_DESCR /begin AXIS_DESCR STD_AXIS NO_INPUT_QUANTITY CM_0006 4 -3550 3003.5 /end AXIS_DESCR /end CHARACTERISTIC
/begin CHARACTERISTIC K_ELU_TCR2_TICS "Periodendauer [EST]" VALUE 0x7241C RL_VAL_UW 0 CM_0274 0 39321 /end CHARACTERISTIC
/begin CHARACTERISTIC K_ELU_TCR2_TICS_NL "Periodendauer bei Nachlaufanforderung [EST]" VALUE 0x7241E RL_VAL_UW 0 CM_0274 0 39321 /end CHARACTERISTIC
/begin CHARACTERISTIC K_ELU_PWM_AUS "Tastverhaeltnis bei ausgeschaltenem Luefter [EST]" VALUE 0x72424 RL_VAL_UB 0 CM_0150 0 255 /end CHARACTERISTIC
/begin CHARACTERISTIC K_ELU_PWM_MAX_ML "Maximal ausgegebenes Tastverhaeltnis [EST]" VALUE 0x72423 RL_VAL_UB 0 CM_0150 0 255 /end CHARACTERISTIC
/begin CHARACTERISTIC K_ELU_PWM_MAX_MS "Maximal ausgegebenes Tastverhaeltnis bei Nachlaufanforderung [EST]" VALUE 0x72426 RL_VAL_UB 0 CM_0150 0 255 /end CHARACTERISTIC
/begin CHARACTERISTIC K_ELU_PWM_MIN_ML "Minimal ausgegebenes Tastverhaeltnis bei Luefterfunktion [EST]" VALUE 0x72422 RL_VAL_UB 0 CM_0150 0 255 /end CHARACTERISTIC
/begin CHARACTERISTIC K_ELU_PWM_MIN_MS "minimal ausgegebenes Tastverhaeltnis bei Nachlaufanforderung [EST]" VALUE 0x72425 RL_VAL_UB 0 CM_0150 0 255 /end CHARACTERISTIC
/begin CHARACTERISTIC K_ELU_PWM_GRAD_ZUL "max. zulaessiger Gradient des Tastverhaeltnisses [EST]" VALUE 0x72428 RL_VAL_UW 0 CM_0275 0 127.9980469 /end CHARACTERISTIC
/begin CHARACTERISTIC K_ELU_TMOT_SOLL "ideale MotorSollTemperatur [EST]" VALUE 0x7243C RL_VAL_SW 0 CM_0258 -3550 3003.5 /end CHARACTERISTIC
/begin CHARACTERISTIC K_DMTL_ABBR_FEIN "Diags 0 Anzahl abgebrochene Feindiags [verified]" VALUE 0x70932 RL_VAL_UB 0 CM_0300 0 255 /end CHARACTERISTIC
/begin CHARACTERISTIC K_DMTL_ABBR_FEUCHT "Diags 0 Max Anzahl Feuchteabbrueche ohne MIL [verified]" VALUE 0x70933 RL_VAL_UB 0 CM_0300 0 255 /end CHARACTERISTIC
/begin CHARACTERISTIC K_DMTL_ANZ_DECKEL "Diags 0 Anzahl Deckeldiagnose -Versuche [verified]" VALUE 0x70934 RL_VAL_UB 0 CM_0300 0 255 /end CHARACTERISTIC
/begin CHARACTERISTIC K_DMTL_ANZ_DECKEL_LECK "Diags 0 Max. Anzahl Deckeldiagn osen mit Ergebnis Leck [verified]" VALUE 0x70935 RL_VAL_UB 0 CM_0300 0 255 /end CHARACTERISTIC
/begin CHARACTERISTIC K_DMTL_ANZ_FAHRTEN "0 Anzahl der langen Fahrten [verified]" VALUE 0x70936 RL_VAL_UB 0 CM_0000 0 255 /end CHARACTERISTIC
/begin CHARACTERISTIC K_DMTL_AY_MAX "Maximale Querbeschleun igung bei Deckeldiagnose [verified]" VALUE 0x70938 RL_VAL_SW 0 CM_0288 -819.2 819.175 /end CHARACTERISTIC
/begin CHARACTERISTIC K_DMTL_CFG "0x0 Ohne DMTL 0x1 Mit DMTL 0x2 Keine Fehle r- heilung ELSE undef. Konfiguration DMTL [verified]" VALUE 0x7093A RL_VAL_UB 0 CM_0000 0 255 /end CHARACTERISTIC
/begin CHARACTERISTIC K_DMTL_DI_BETANK "DMTL DeltaStrom Betankung s-erkennung [verified]" VALUE 0x7093C RL_VAL_UW 0 CM_0211 0 147.45375 /end CHARACTERISTIC
/begin CHARACTERISTIC K_DMTL_DI_DECKEL "DMTL DeltaStrom Tankdeckel [verified]" VALUE 0x7093E RL_VAL_UW 0 CM_0211 0 147.45375 /end CHARACTERISTIC
/begin CHARACTERISTIC K_DMTL_DI_STABIL "DeltaStrom Stabil [verified]" VALUE 0x70940 RL_VAL_UW 0 CM_0211 0 147.45375 /end CHARACTERISTIC
/begin CHARACTERISTIC K_DMTL_DI_TEV_OFFEN "Strom unter i_min Abbr. TEV [verified]" VALUE 0x70942 RL_VAL_UW 0 CM_0211 0 147.45375 /end CHARACTERISTIC
/begin CHARACTERISTIC K_DMTL_DU_MAX "Max. Spannungsaenderung ohne Abbruch [verified]" VALUE 0x70944 RL_VAL_UB 0 CM_0297 0 25.5 /end CHARACTERISTIC
/begin CHARACTERISTIC K_DMTL_FST_MAX "Max. zul. Fuellstand [EST]" VALUE 0x70945 RL_VAL_UB 0 CM_0257 0 127.5 /end CHARACTERISTIC
/begin CHARACTERISTIC K_DMTL_FST_MIN "Min. zul. Fuellstand [verified]" VALUE 0x70946 RL_VAL_UB 0 CM_0257 0 127.5 /end CHARACTERISTIC
/begin CHARACTERISTIC K_DMTL_FST_ERSATZ "Ersatzwert bei FST-Fehler [EST]" VALUE 0x70947 RL_VAL_UB 0 CM_0257 0 127.5 /end CHARACTERISTIC
/begin CHARACTERISTIC K_DMTL_FST_DECKEL_MAX "Max. zul. Fuellstand fuer D e-ckelmessung [EST]" VALUE 0x70948 RL_VAL_UB 0 CM_0257 0 127.5 /end CHARACTERISTIC
/begin CHARACTERISTIC K_DMTL_GROB_OHNE_FEIN "Diags 0 Anzahl Grobleckdiags. ohne Feindiag [verified]" VALUE 0x70949 RL_VAL_UB 0 CM_0300 0 255 /end CHARACTERISTIC
/begin CHARACTERISTIC K_DMTL_I_FAKT_CCDECKEL "Faktor fuer I -ref zur Tankdeckel-pruefung [verified]" VALUE 0x7094A RL_VAL_UB 0 CM_0269 0 1.9921875 /end CHARACTERISTIC
/begin CHARACTERISTIC K_DMTL_I_FAKT_GROB "Faktor fuer I-ref zur Gobleck [verified]" VALUE 0x7094B RL_VAL_UB 0 CM_0269 0 1.9921875 /end CHARACTERISTIC
/begin CHARACTERISTIC K_DMTL_I_FAKT_P "Minimaler Strom- Abfall nach Ventil Umschalten [verified]" VALUE 0x7094C RL_VAL_UB 0 CM_0284 0 1 /end CHARACTERISTIC
/begin CHARACTERISTIC K_DMTL_I_KURZSCHL "Stromschwelle fuer Kurzschlu ?-erkennung [verified]" VALUE 0x7094E RL_VAL_UW 0 CM_0211 0 147.45375 /end CHARACTERISTIC
/begin CHARACTERISTIC K_DMTL_I_REF_DIFF "max. Referenzstromschwanku n-gen [verified]" VALUE 0x70950 RL_VAL_UW 0 CM_0211 0 147.45375 /end CHARACTERISTIC
/begin CHARACTERISTIC K_DMTL_T_KL50_DLY "Ausblendzeit nach Start fuer Deckeldiag [EST]" VALUE 0x70971 RL_VAL_UB 0 CM_0301 0 25.5 /end CHARACTERISTIC
/begin CHARACTERISTIC K_DMTL_T_REF "Messzeit Referenzstrom [verified]" VALUE 0x7097E RL_VAL_UB 0 CM_0301 0 25.5 /end CHARACTERISTIC
/begin CHARACTERISTIC K_DMTL_T_START_DLY "Wartezeit nach KL15 aus [verified]" VALUE 0x7097F RL_VAL_UB 0 CM_0301 0 25.5 /end CHARACTERISTIC
/begin CHARACTERISTIC K_DMTL_T_VENT_CHK "Zeit fuer Strompruefung nach Ventil umschalten [verified]" VALUE 0x70980 RL_VAL_UB 0 CM_0301 0 25.5 /end CHARACTERISTIC
/begin CHARACTERISTIC K_DMTL_T_VENT_UM "Zeit schnelle Stromfilterung nach Schalten [verified]" VALUE 0x70981 RL_VAL_UB 0 CM_0301 0 25.5 /end CHARACTERISTIC
/begin CHARACTERISTIC K_DMTL_P_MIN "Minimaler Luftdruck fuer Dia g-nose [verified]" VALUE 0x70988 RL_VAL_SW 0 CM_0291 -2048 2047.9375 /end CHARACTERISTIC
/begin CHARACTERISTIC K_DMTL_TE_AY_MAX "Maximale Querbeschleun igung bei Deckeldiagnose [verified]" VALUE 0x7098E RL_VAL_SW 0 CM_0288 -819.2 819.175 /end CHARACTERISTIC
/begin CHARACTERISTIC K_DMTL_TE_TIME_DC "Mindest-time_dc fuer TEV-Check [EST]" VALUE 0x70992 RL_VAL_UW 0 CM_0301 0 6553.5 /end CHARACTERISTIC
/begin CHARACTERISTIC K_DMTL_TE_MD_REL_MAX "max md_kupp_wunsch_filter_rel [EST]" VALUE 0x70998 RL_VAL_SW 0 CM_0276 -3276.8 3276.7 /end CHARACTERISTIC
/begin CHARACTERISTIC K_DMTL_TE_N_MIN "Mindest-Drehzahl TEV-Check [verified]" VALUE 0x7099A RL_VAL_SW 0 CM_0002 -32768 32767 /end CHARACTERISTIC
/begin CHARACTERISTIC K_DMTL_TE_V_MIN "Mindestgeschwindigkeit TEV -Check [verified]" VALUE 0x7099C RL_VAL_SW 0 CM_0260 -2048 2047.9375 /end CHARACTERISTIC
/begin CHARACTERISTIC K_DMTL_TE_T_REF "TEV-Check Messzeit Referen z-strom [verified]" VALUE 0x709A2 RL_VAL_UB 0 CM_0301 0 25.5 /end CHARACTERISTIC
/begin CHARACTERISTIC K_DMTL_TE_T_REF2 "Messzeit Ueberpruefen Abschal-ten DMTLV [verified]" VALUE 0x709A3 RL_VAL_UB 0 CM_0301 0 25.5 /end CHARACTERISTIC
/begin CHARACTERISTIC K_DMTL_TE_ANZ "Diags 0 Anzahl TEV-Check-Versuche [verified]" VALUE 0x709AA RL_VAL_UB 0 CM_0300 0 255 /end CHARACTERISTIC
/begin CHARACTERISTIC K_OSPGAPP "Oberspannungsschwelle [verified]" VALUE 0x77440 RL_VAL_UW 0 CM_0308 6 22.38375 /end CHARACTERISTIC
/begin CHARACTERISTIC K_OSPGHYST "Unterspannungshysterese [verified]" VALUE 0x7743C RL_VAL_UW 0 CM_0309 0 8.191875 /end CHARACTERISTIC
/begin CHARACTERISTIC K_USPGAPP "Unterspannungschwelle [verified]" VALUE 0x7745A RL_VAL_UW 0 CM_0308 6 22.38375 /end CHARACTERISTIC
/begin CHARACTERISTIC K_USPGHYST "Unterspannungshysterese [verified]" VALUE 0x7743E RL_VAL_UW 0 CM_0309 0 8.191875 /end CHARACTERISTIC
/begin CHARACTERISTIC K_QELADGESMX "Begrenzung Maximal Wert des Enladungsz?hlers im Infospeicher [verified]" VALUE 0x77442 RL_VAL_UW 0 CM_0000 0 65535 /end CHARACTERISTIC
/begin CHARACTERISTIC K_QELADLIM "Begrenzung des Qelad Wertes welcher in Infospeicher aufaddiert wird [verified]" VALUE 0x77444 RL_VAL_UW 0 CM_0310 0 19087.86408 /end CHARACTERISTIC
/begin CHARACTERISTIC K_QLADGESMX "Begrenzung Maximaler Wert des Ladez?hlers im Infospeicher [verified]" VALUE 0x77446 RL_VAL_UW 0 CM_0000 0 65535 /end CHARACTERISTIC
/begin CHARACTERISTIC K_QLADLIM "Begrenzung des Qlad Wertes welcher in Infospeicher aufaddiert wird [verified]" VALUE 0x77448 RL_VAL_UW 0 CM_0310 0 19087.86408 /end CHARACTERISTIC
/begin CHARACTERISTIC K_T2PMINFO "T2 Zykluszeit fuer PM Fehlerinfo [verified]" VALUE 0x7744A RL_VAL_UW 0 CM_0301 0 6553.5 /end CHARACTERISTIC
/begin CHARACTERISTIC K_T3PMINFO "T3 Zykluszeit fuer PM Fehlerinfo [verified]" VALUE 0x7744C RL_VAL_UW 0 CM_0301 0 6553.5 /end CHARACTERISTIC
/begin CHARACTERISTIC K_TBATNACHL "B_ccbtnach wird nach dieser Zeit aktiviert [verified]" VALUE 0x7744E RL_VAL_UW 0 CM_0301 0 6553.5 /end CHARACTERISTIC
/begin CHARACTERISTIC K_T_CCRUHVER "Dauer fuer CC -Meld. e rhoehter Ruhestrom [verified]" VALUE 0x77450 RL_VAL_UW 0 CM_0301 0 6553.5 /end CHARACTERISTIC
/begin CHARACTERISTIC K_T_KMSHIFT "Delayzeit f?r Km_st Info-shift [verified]" VALUE 0x77452 RL_VAL_UW 0 CM_0301 0 6553.5 /end CHARACTERISTIC
/begin CHARACTERISTIC K_T_OSPGSET "Entrpellzeit FS_oberspannungserkennung [verified]" VALUE 0x77454 RL_VAL_UW 0 CM_0301 0 6553.5 /end CHARACTERISTIC
/begin CHARACTERISTIC K_T_TIEFPRE "Entprellung R?cksetzen keine Tiefentladung mehr [verified]" VALUE 0x77456 RL_VAL_UW 0 CM_0301 0 6553.5 /end CHARACTERISTIC
/begin CHARACTERISTIC K_T_USPGSET "Zeit f?r 1x Unterspannungsentprellung [verified]" VALUE 0x77458 RL_VAL_UW 0 CM_0301 0 6553.5 /end CHARACTERISTIC
/begin CHARACTERISTIC K_TE_R_C3H8 "Gaskonstante C3H8 [verified]" VALUE 0x78C50 RL_VAL_UW 0 CM_0313 0 65535 /end CHARACTERISTIC
/begin CHARACTERISTIC K_TE_R_LUFT "Gaskonstante LUFT [verified]" VALUE 0x78C52 RL_VAL_UW 0 CM_0313 0 65535 /end CHARACTERISTIC
/begin CHARACTERISTIC K_TE_TMOT "TMOT-Schwelle f. Freig a-be [verified]" VALUE 0x78C66 RL_VAL_SW 0 CM_0256 -3550 3003.5 /end CHARACTERISTIC
/begin CHARACTERISTIC K_TE_FREQ_C_AKF "Niedr. Frequenz, wenn c_akf kleiner [verified]" VALUE 0x78C26 RL_VAL_UW 0 CM_0259 0 3.999938965 /end CHARACTERISTIC
/begin CHARACTERISTIC K_TE_FREQ_C_AKF_HYS "Hysterese fuer niedr. Frequenz [EST]" VALUE 0x78C28 RL_VAL_UW 0 CM_0259 0 3.999938965 /end CHARACTERISTIC
/begin CHARACTERISTIC K_TE_FREQ_LUFT "Frequenz bei kleinen c_akf [EST]" VALUE 0x78C2A RL_VAL_UW 0 CM_0314 0 6553.5 /end CHARACTERISTIC
/begin CHARACTERISTIC K_DMTL_TE_T_TIMEOUT "Maxzeit TEV-Check ueber DMTL [EST]" VALUE 0x7099E RL_VAL_UW 0 CM_0301 0 6553.5 /end CHARACTERISTIC
/begin CHARACTERISTIC K_DMTL_TE_T_ZU "Maxzeit Spuelvolumen zu klein [EST]" VALUE 0x709A0 RL_VAL_UW 0 CM_0301 0 6553.5 /end CHARACTERISTIC
/begin CHARACTERISTIC K_DMTL_TE_VOL_OFFS "Offset auf Volumenstrom TEV [EST]" VALUE 0x709A4 RL_VAL_UW 0 CM_0318 0 131.07 /end CHARACTERISTIC
/begin CHARACTERISTIC K_DMTL_TE_VOL_PUMP "Pumpleistung DMTL [EST]" VALUE 0x709A6 RL_VAL_UW 0 CM_0318 0 131.07 /end CHARACTERISTIC
/begin CHARACTERISTIC K_DMTL_TE_DLY "Wartezeit nach Abbruch TEV -Check [EST]" VALUE 0x709A8 RL_VAL_UW 0 CM_0301 0 6553.5 /end CHARACTERISTIC
/begin CHARACTERISTIC K_R_LADLTG "Applikationskonstante f?r Widerstand Ladeleitung [verified]" VALUE 0x76BDE RL_VAL_UW 0 CM_0319 0 1023.984375 /end CHARACTERISTIC
/begin CHARACTERISTIC K_DMTL_TE_CFG "0x0 Aus 0x1 MSA - Codierung 0x2 Immer aktiv ELSE undef. Konfiguration TEV-Check DMTL [EST]" VALUE 0x70990 RL_VAL_UB 0 CM_0000 0 255 /end CHARACTERISTIC
/begin CHARACTERISTIC K_DMTL_TE_DI_PUMP "Stromanstieg vor TEV-Oeffnen [EST]" VALUE 0x70994 RL_VAL_UW 0 CM_0211 0 147.45375 /end CHARACTERISTIC
/begin CHARACTERISTIC K_DMTL_TE_DI_OK "Stromabfall TEV-Check o.K [EST]" VALUE 0x70996 RL_VAL_UW 0 CM_0211 0 147.45375 /end CHARACTERISTIC
/begin CHARACTERISTIC K_TANZYL_CFG "0 In tan_mw, Out tanzyl 0x1 In tan_mw, Out tanzyl_delta 0x2 In tumg, Out tanzyl 0x3 In tumg, Out tan [verified]" VALUE 0x78B50 RL_VAL_UB 0 CM_0000 0 255 /end CHARACTERISTIC
/begin CHARACTERISTIC K_TANZYL_MR_TAU "Filterkonstante fuer Motor-raumtemperatur [verified]" VALUE 0x78B52 RL_VAL_UW 0 CM_0324 0.1 6553.5 /end CHARACTERISTIC
/begin CHARACTERISTIC K_TANZYL_TMOT_TUMG_DELTA_NORM "Last- und Drehzahla b-haengige Normbedingung [verified]" VALUE 0x78B54 RL_VAL_SW 0 CM_0323 -3276.8 3276.7 /end CHARACTERISTIC
/begin CHARACTERISTIC K_TANZYL_TUMG_NORM "Offset Normbedingung [verified]" VALUE 0x78B56 RL_VAL_SW 0 CM_0256 -3550 3003.5 /end CHARACTERISTIC
/begin CHARACTERISTIC K_SLP_TIME_AUS "Auszeit SLP nach Abschalten [verified]" VALUE 0x7883C RL_VAL_UW 0 CM_0027 0 65535 /end CHARACTERISTIC
/begin CHARACTERISTIC K_SLP_PABG_SCHWELLE "Abbruchschwelle durch Abgasgege n-druck [verified]" VALUE 0x7883E RL_VAL_SW 0 CM_0291 -2048 2047.9375 /end CHARACTERISTIC
/begin CHARACTERISTIC K_SLP_PABG_TAU "Filterkonstante fuer den Abgasdruck [verified]" VALUE 0x78840 RL_VAL_UB 0 CM_0306 0.1003921569 25.6 /end CHARACTERISTIC
/begin CHARACTERISTIC K_SLP_TIME_MAX "Maxlaufzeit der SLP [verified]" VALUE 0x78842 RL_VAL_UW 0 CM_0301 0 6553.5 /end CHARACTERISTIC
/begin CHARACTERISTIC K_TGETR_CC_HIGH "Obere Grenze CC Meldung Getriebetemperatur [verified]" VALUE 0x79382 RL_VAL_SW 0 CM_0303 -1092.35 546.025 /end CHARACTERISTIC
/begin CHARACTERISTIC K_TGETR_CC_HYST "Hysterese CC Meldung Getriebetemperatur [verified]" VALUE 0x79384 RL_VAL_SW 0 CM_0335 -819.2 819.175 /end CHARACTERISTIC
/begin CHARACTERISTIC K_TGETR_TAU "Filterkonstante fuer die Getriebetemperatur [verified]" VALUE 0x79386 RL_VAL_UB 0 CM_0306 0.1003921569 25.6 /end CHARACTERISTIC
/begin CHARACTERISTIC K_CBATTAPP "Cbattnenn appl. [verified]" VALUE 0x77461 RL_VAL_UB 0 CM_0336 0 255 /end CHARACTERISTIC
/begin CHARACTERISTIC K_BATTINDAPP "batt_index appl. [verified]" VALUE 0x7745E RL_VAL_UB 0 CM_0000 0 255 /end CHARACTERISTIC
/begin CHARACTERISTIC K_PWGLLANH "% -800.0p 2 100*x/4096 Fahrpedalwinkel-Schwelle f?r R?cksetzen der Leerlaufanhebung Generatorlast [verified]" VALUE 0x76BDC RL_VAL_SW 0 CM_0150 -32768 32767 /end CHARACTERISTIC
/begin CHARACTERISTIC K_SCHPWGLLRED "% -800.0p 2 100*x/4096 Grenze Pedalwertgeber f?r Verz?gerung B_ll in PGENLLRED [verified]" VALUE 0x76BE0 RL_VAL_SW 0 CM_0150 -32768 32767 /end CHARACTERISTIC
/begin CHARACTERISTIC K_TMOTLLANH "Motortemperatur-Schwelle zum Aktivieren der Leerlaufanhebung Generatorlast [verified]" VALUE 0x76BE2 RL_VAL_SW 0 CM_0244 -327.68 327.67 /end CHARACTERISTIC
/begin CHARACTERISTIC K_GELIVMAX "Maximale Fahrzeuggeschwindigkeit f?r Generatorlastbegrenzung [verified]" VALUE 0x76BE4 RL_VAL_UW 0 CM_0337 0 6553.5 /end CHARACTERISTIC
/begin CHARACTERISTIC K_GENPDTIME "Predrivetime f?r Ladekontrollampe KL61 [EST]" VALUE 0x76BE6 RL_VAL_UW 0 CM_0301 0 6553.5 /end CHARACTERISTIC
/begin CHARACTERISTIC K_TDFDTMAX "Zeitschwelle zum Erkennen Drehzahlabweichung durch Generatorlastschwankung [verified]" VALUE 0x76BE8 RL_VAL_UW 0 CM_0338 0 13107 /end CHARACTERISTIC
/begin CHARACTERISTIC K_TDFFABLF "Zeitschwelle (Tdffgen) zum R?cksetzen der Leerlaufanhebung [verified]" VALUE 0x76BEA RL_VAL_UW 0 CM_0338 0 13107 /end CHARACTERISTIC
/begin CHARACTERISTIC K_TDFFMAX "Maximale Periodendauer Generatorlastschwankungen f?r Leerlaufstabilisierung [verified]" VALUE 0x76BEC RL_VAL_UW 0 CM_0338 0 13107 /end CHARACTERISTIC
/begin CHARACTERISTIC K_TDFFMIN "Minimale Periodendauer Generatorlastschwankungen f?r Leerlaufstabilisierung [verified]" VALUE 0x76BEE RL_VAL_UW 0 CM_0338 0 13107 /end CHARACTERISTIC
/begin CHARACTERISTIC K_VFZGLLANH "Fahrgeschwindigkeits-Schwelle ? fur R? ucksetzen der Leerlaufanhebung Generatorlast [verified]" VALUE 0x76BF4 RL_VAL_UW 0 CM_0339 0 65535 /end CHARACTERISTIC
/begin CHARACTERISTIC K_DFFSCHZMX "Z?hlerschwelle f?r Aktivieren der Leerlauf-Solldrehzahlanhebung bei Generatorlastschw. [verified]" VALUE 0x76BF9 RL_VAL_UB 0 CM_0000 0 255 /end CHARACTERISTIC
/begin CHARACTERISTIC K_GELIIEAPP "Applikationswert Generatorlastbegrenzung f?r Leerlaufsolldrehzahlberechnung [verified]" VALUE 0x76BFA RL_VAL_UB 0 CM_0340 0 31.875 /end CHARACTERISTIC
/begin CHARACTERISTIC K_GELISETAPP "Aoolikationswert Generatorlastbegrenzung f?r Leerlaufstabilisierung [verified]" VALUE 0x76BFC RL_VAL_UB 0 CM_0000 0 255 /end CHARACTERISTIC
/begin CHARACTERISTIC K_PR_IERRLLRED "Prio Erregerstrombegrenzung durch LL S?gen [verified]" VALUE 0x76BFD RL_VAL_UB 0 CM_0000 0 255 /end CHARACTERISTIC
/begin CHARACTERISTIC K_TDNHOLD "Haltezeit f?r Bedingung Drehzahlabweichung durch Generatorlastschwankung [verified]" VALUE 0x76BFE RL_VAL_UB 0 CM_0338 0 51 /end CHARACTERISTIC
/begin CHARACTERISTIC K_VFZGGENKOR "Aktivierung Einrechnung B_ll in PGENLLRED [verified]" VALUE 0x76BFF RL_VAL_UB 0 CM_0341 0 7.96875 /end CHARACTERISTIC
/begin CHARACTERISTIC K_GENMXGRADH "?C -3276.8p 2 0.75*x Maximal zul?ssiger Gradi ent Chiptemperatur [verified]" VALUE 0x76C12 RL_VAL_SW 0 CM_0342 -3276.8 3276.7 /end CHARACTERISTIC
/begin CHARACTERISTIC K_TGENMXGRAD "?C -3276.8p 2 0.75*x Schwellwert f?r Erkennung mayimaler Gradient [verified]" VALUE 0x76C18 RL_VAL_SW 0 CM_0342 -3276.8 3276.7 /end CHARACTERISTIC
/begin CHARACTERISTIC K_TGENMXTHD "?C -3276.8p 2 0.75*x Schwellwert f?r ?berh?hte Temparatur Generator [verified]" VALUE 0x76C1A RL_VAL_SW 0 CM_0342 -3276.8 3276.7 /end CHARACTERISTIC
/begin CHARACTERISTIC K_TGENRSHT "?C -3276.8p 2 0.75*x Reset bei unterschrittener Chiptemperatur [verified]" VALUE 0x76C1C RL_VAL_SW 0 CM_0342 -3276.8 3276.7 /end CHARACTERISTIC
/begin CHARACTERISTIC K_TE_A_MIN "min. Querschnittsflaeche TEV [verified]" VALUE 0x78BF4 RL_VAL_UW 0 CM_0350 0 65.535 /end CHARACTERISTIC
/begin CHARACTERISTIC K_TE_B_ABBR_FST_SUM "B_TE_ABBR nur, wenn fst_sum groesser [verified]" VALUE 0x78BF6 RL_VAL_UW 0 CM_0257 0 32767.5 /end CHARACTERISTIC
/begin CHARACTERISTIC K_TE_B_ABBR_TUMG "B_TE_ABBR nur, wenn tumg kleiner [verified]" VALUE 0x78BF8 RL_VAL_SW 0 CM_0256 -3550 3003.5 /end CHARACTERISTIC
/begin CHARACTERISTIC K_TE_B_LANG_C_AKF "B_TE_LANG, wenn c_akf groesser [verified]" VALUE 0x78BFA RL_VAL_UW 0 CM_0259 0 3.999938965 /end CHARACTERISTIC
/begin CHARACTERISTIC K_TE_B_LANG_FST_SUM "B_TE_LANG, wenn fst_sum kleiner [verified]" VALUE 0x78BFC RL_VAL_UW 0 CM_0257 0 32767.5 /end CHARACTERISTIC
/begin CHARACTERISTIC K_TE_B_LANG_VOL_SUM "B_TE_LANG, wenn te_vol_ges kleiner [EST]" VALUE 0x78BFE RL_VAL_UW 0 CM_0351 0 14316.3392 /end CHARACTERISTIC
/begin CHARACTERISTIC K_TE_B_LANG_TUMG "B_TE_LANG, wenn tumg groesser [EST]" VALUE 0x78C00 RL_VAL_SW 0 CM_0256 -3550 3003.5 /end CHARACTERISTIC
/begin CHARACTERISTIC K_TE_C_AKF_RESET "0 inaktiv 1 aktiv RESET C -AKF- Zustandsautomat [verified]" VALUE 0x78C02 RL_VAL_UB 0 CM_0348 0 255 /end CHARACTERISTIC
/begin CHARACTERISTIC K_TE_C_APPL "RESET C -AKF-Konzentration [verified]" VALUE 0x78C04 RL_VAL_UW 0 CM_0259 0 3.999938965 /end CHARACTERISTIC
/begin CHARACTERISTIC K_TE_C_DMTL "C-AKF-Konzentration bei DMTL TEV-Check [verified]" VALUE 0x78C06 RL_VAL_UW 0 CM_0259 0 3.999938965 /end CHARACTERISTIC
/begin CHARACTERISTIC K_TE_C_DMTL_ABREG "C-AKF-Konzentration bei DMTL TEV-Check [verified]" VALUE 0x78C08 RL_VAL_UB 0 CM_0301 0 25.5 /end CHARACTERISTIC
/begin CHARACTERISTIC K_TE_C_LERN_RED_TAU "Filterkonstante c_akf r e-duziertes Lernen [verified]" VALUE 0x78C0A RL_VAL_UW 0 CM_0324 0.1 6553.5 /end CHARACTERISTIC
/begin CHARACTERISTIC K_TE_C_LERN_TAU "Filterkonstante c_akf no r-mal [verified]" VALUE 0x78C0C RL_VAL_UW 0 CM_0324 0.1 6553.5 /end CHARACTERISTIC
/begin CHARACTERISTIC K_TE_C_MAX "max. fuer te_c_akf_vor_filt [verified]" VALUE 0x78C0E RL_VAL_SW 0 CM_0352 -4 3.99987793 /end CHARACTERISTIC
/begin CHARACTERISTIC K_TE_C_MIN "min. fuer te_c_akf_roh [verified]" VALUE 0x78C10 RL_VAL_SW 0 CM_0352 -4 3.99987793 /end CHARACTERISTIC
/begin CHARACTERISTIC K_TE_C_ML_SOLL_MG_MIN "min. te_ml_soll_mg fuer C_AKF-Uebernahme [verified]" VALUE 0x78C12 RL_VAL_UW 0 CM_0353 0 1023.984375 /end CHARACTERISTIC
/begin CHARACTERISTIC K_TE_C_PKS_MAX "max. SPUEL -Zeit f. K_TE_C_LERN_TAU [verified]" VALUE 0x78C14 RL_VAL_SW 0 CM_0240 -32.768 32.767 /end CHARACTERISTIC
/begin CHARACTERISTIC K_TE_C_STAT_DELTA "max. C -Abweichung f. eingependelte Adapt. [verified]" VALUE 0x78C16 RL_VAL_UW 0 CM_0259 0 3.999938965 /end CHARACTERISTIC
/begin CHARACTERISTIC K_TE_C_STAT_T "min. Zeit f. eingependelte Adapt. [verified]" VALUE 0x78C18 RL_VAL_UW 0 CM_0247 0 655.35 /end CHARACTERISTIC
/begin CHARACTERISTIC K_TE_C_T_SPUEL_MAX "max. SPUEL -Zeit f. K_TE_C_LERN_TAU [verified]" VALUE 0x78C1A RL_VAL_UW 0 CM_0301 0 6553.5 /end CHARACTERISTIC
/begin CHARACTERISTIC K_TE_C_T_SPUEL_MIN "min. SPUEL -Zeit f. K_TE_C_LERN_TAU [verified]" VALUE 0x78C1C RL_VAL_UW 0 CM_0301 0 6553.5 /end CHARACTERISTIC
/begin CHARACTERISTIC K_TE_C_X_MIN "min. Spuelluftanteil - zu Uebergang LERNEN [verified]" VALUE 0x78C1E RL_VAL_UW 0 CM_0307 0 1.999969482 /end CHARACTERISTIC
/begin CHARACTERISTIC K_TE_TV_MIN "Freigabe TE [verified]" VALUE 0x78C20 RL_VAL_UB 0 CM_0354 0 255 /end CHARACTERISTIC
/begin CHARACTERISTIC K_TE_DYN_DELTA_RF "RF-Delta f. Sperre c_akf -Filterung [verified]" VALUE 0x78C22 RL_VAL_SW 0 CM_0282 -3.2768 3.2767 /end CHARACTERISTIC
/begin CHARACTERISTIC K_TE_DYN_RF_T "Sperrzeit c_akf -Filterung nach rf-Dynamik [verified]" VALUE 0x78C24 RL_VAL_UW 0 CM_0247 0 655.35 /end CHARACTERISTIC
/begin CHARACTERISTIC K_TE_GW_F_KATD "Verlaeng. Schliessrampe bei Katdiag [verified]" VALUE 0x78C2C RL_VAL_UB 0 CM_0341 0 7.96875 /end CHARACTERISTIC
/begin CHARACTERISTIC K_TE_GW_LAM_DELTA_HYS "LAM_Delta_F-Hysterese f. GW [verified]" VALUE 0x78C2E RL_VAL_UW 0 CM_0259 0 3.999938965 /end CHARACTERISTIC
/begin CHARACTERISTIC K_TE_GW_LAM_DELTA_MAGER "LAM_Delta-Mager-Schwelle f. GW [verified]" VALUE 0x78C30 RL_VAL_SW 0 CM_0259 -2 1.999938965 /end CHARACTERISTIC
/begin CHARACTERISTIC K_TE_GW_LAM_GES_OFFS_MIN "LAM-Gesamt Offset f. GW [verified]" VALUE 0x78C32 RL_VAL_SW 0 CM_0307 -1 0.9999694824 /end CHARACTERISTIC
/begin CHARACTERISTIC K_TE_GW_LAM_REG_FETT "LAM-REG-Fett-Schwelle f. GW [verified]" VALUE 0x78C34 RL_VAL_UW 0 CM_0307 0 1.999969482 /end CHARACTERISTIC
/begin CHARACTERISTIC K_TE_GW_LAM_REG_HYS "LAM-REG-Hysterese f. GW [verified]" VALUE 0x78C36 RL_VAL_UW 0 CM_0307 0 1.999969482 /end CHARACTERISTIC
/begin CHARACTERISTIC K_TE_GW_LAM_REG_MAGER "LAM-REG-Mager-Schwelle f. GW [verified]" VALUE 0x78C38 RL_VAL_UW 0 CM_0307 0 1.999969482 /end CHARACTERISTIC
/begin CHARACTERISTIC K_TE_LAA_F_TE_MCS "0 inaktiv 1 aktiv MCS-Faktor fuer laa_f_te [EST]" VALUE 0x78C3A RL_VAL_UB 0 CM_0348 0 255 /end CHARACTERISTIC
/begin CHARACTERISTIC K_TE_LAM_SOLL_MAX "max. LA-SOLL-Schwelle f. TE-Freigabe [verified]" VALUE 0x78C3C RL_VAL_UW 0 CM_0259 0 3.999938965 /end CHARACTERISTIC
/begin CHARACTERISTIC K_TE_LAM_SOLL_MIN "min. LA- SOLL-Schwelle f. TE-Freigabe [verified]" VALUE 0x78C3E RL_VAL_UW 0 CM_0259 0 3.999938965 /end CHARACTERISTIC
/begin CHARACTERISTIC K_TE_MKS_F_AEBG_SCHW_NEG "Schwelle te_lam_ges fuer neg. Rampe [EST]" VALUE 0x78C40 RL_VAL_SW 0 CM_0307 -1 0.9999694824 /end CHARACTERISTIC
/begin CHARACTERISTIC K_TE_MKS_F_AEBG_SCHW_POS "Schwelle te_lam_ges fuer pos. Rampe [EST]" VALUE 0x78C42 RL_VAL_SW 0 CM_0307 -1 0.9999694824 /end CHARACTERISTIC
/begin CHARACTERISTIC K_TE_MKS_F_LAM_SCHW "Schwelle te_lam_delta fuer Rampen [EST]" VALUE 0x78C44 RL_VAL_SW 0 CM_0259 -2 1.999938965 /end CHARACTERISTIC
/begin CHARACTERISTIC K_TE_MKS_F_MAX "max Wert fuer te_mks_f [EST]" VALUE 0x78C46 RL_VAL_UW 0 CM_0307 0 1.999969482 /end CHARACTERISTIC
/begin CHARACTERISTIC K_TE_MKS_F_NEG "max. Lambda -Aenderung je Sekunde [EST]" VALUE 0x78C48 RL_VAL_UW 0 CM_0355 0 799.987793 /end CHARACTERISTIC
/begin CHARACTERISTIC K_TE_MKS_F_POS "max. Lambda- Aenderung je Sekunde [EST]" VALUE 0x78C4A RL_VAL_UW 0 CM_0355 0 799.987793 /end CHARACTERISTIC
/begin CHARACTERISTIC K_TE_ML_SOLL_NEG_TAU "neg. Filterkonstante te_ml_soll_filt [EST]" VALUE 0x78C4C RL_VAL_UB 0 CM_0277 0.01003921569 2.56 /end CHARACTERISTIC
/begin CHARACTERISTIC K_TE_ML_SOLL_POS_TAU "pos. Filterkonstante te_ml_soll_filt [EST]" VALUE 0x78C4D RL_VAL_UB 0 CM_0277 0.01003921569 2.56 /end CHARACTERISTIC
/begin CHARACTERISTIC K_TE_MZYL_SEC_F "Wicht-Fakor auf te_ml_soll fuer sec. Einfluss te_ml_ist [EST]" VALUE 0x78C4E RL_VAL_UB 0 CM_0356 0 3.984375 /end CHARACTERISTIC
/begin CHARACTERISTIC K_OZ_KRZ_MESSUNG_LL "Oelstanderfassung nach x sec. im Leerlauf [verified]" VALUE 0x702D4 RL_VAL_UW 0 CM_0247 0 655.35 /end CHARACTERISTIC
/begin CHARACTERISTIC K_OZ_KRZ_ORI_MESSUNG "Oelstanderfassung nach x sec. im Leerlauf [verified]" VALUE 0x702D6 RL_VAL_UW 0 CM_0357 0 655.35 /end CHARACTERISTIC
/begin CHARACTERISTIC K_OZ_ALT_NACHF "Nachfuellerkennung Motoroel [verified]" VALUE 0x702D8 RL_VAL_UB 0 CM_0358 0 25.5 /end CHARACTERISTIC
/begin CHARACTERISTIC K_OZ_KRZ_HYST_CBS "Mindestschwankung (CBS frisch) [verified]" VALUE 0x702D9 RL_VAL_UB 0 CM_0358 0 25.5 /end CHARACTERISTIC
/begin CHARACTERISTIC K_OZ_ALT_HYST_U "Mind.schwankung (nach unten) Erstuebernahme Lzw. [verified]" VALUE 0x702DA RL_VAL_UB 0 CM_0358 0 25.5 /end CHARACTERISTIC
/begin CHARACTERISTIC K_OZ_ALT_HYST_F "Mindestschwankung Langzeitmsg. [verified]" VALUE 0x702DB RL_VAL_UB 0 CM_0358 0 25.5 /end CHARACTERISTIC
/begin CHARACTERISTIC K_OZ_KRZ_HYST "Mindestschwankung Kurzzeitmsg. [verified]" VALUE 0x702DC RL_VAL_UB 0 CM_0358 0 25.5 /end CHARACTERISTIC
/begin CHARACTERISTIC K_OZ_LZW_AEND_BEGR "neg. Inkrement Langzeitmsg. [verified]" VALUE 0x702DD RL_VAL_UB 0 CM_0358 0 25.5 /end CHARACTERISTIC
/begin CHARACTERISTIC K_OZ_ORI_HYST_O "Nachfuellerkennung Orientierungsmsg. [verified]" VALUE 0x702DE RL_VAL_UB 0 CM_0358 0 25.5 /end CHARACTERISTIC
/begin CHARACTERISTIC K_OZ_ORI_HYST_U "Oelablasserkennung Orientierungsmsg. [verified]" VALUE 0x702DF RL_VAL_UB 0 CM_0358 0 25.5 /end CHARACTERISTIC
/begin CHARACTERISTIC K_OZ_1L_BEGR_U "untere 1L-Schwelle abzgl. Kraftst. [verified]" VALUE 0x702E0 RL_VAL_UB 0 CM_0359 -10 15.5 /end CHARACTERISTIC
/begin CHARACTERISTIC K_OZ_CC_OELVERBRAUC "Schwelle Motoroel bei Minimum [verified]" VALUE 0x702E1 RL_VAL_UB 0 CM_0360 -10 15.5 /end CHARACTERISTIC
/begin CHARACTERISTIC K_OZ_CC_OELVERLUST "Schwelle Motoroel unter Mini-mum bzw. Oelverlust [verified]" VALUE 0x702E2 RL_VAL_UB 0 CM_0359 -10 15.5 /end CHARACTERISTIC
/begin CHARACTERISTIC K_OZ_OELVERLUST_FSP "Schwelle Motoroel unter Mini-mum mit FSP-Eintrag [verified]" VALUE 0x702E3 RL_VAL_UB 0 CM_0359 -10 15.5 /end CHARACTERISTIC
/begin CHARACTERISTIC K_OZ_1L_BEGR_O "obere 1L-Schwelle abzgl. Kraftst. [verified]" VALUE 0x702E4 RL_VAL_UB 0 CM_0359 -10 15.5 /end CHARACTERISTIC
/begin CHARACTERISTIC K_OZ_1_5_L_BEGR "1,5L-Anzeigeschwelle [verified]" VALUE 0x702E5 RL_VAL_UB 0 CM_0359 -10 15.5 /end CHARACTERISTIC
/begin CHARACTERISTIC K_OZ_AG_MESSSTAB_MIN "Schwelle Motoroel Min-OK [verified]" VALUE 0x702E6 RL_VAL_UB 0 CM_0361 -10 15.5 /end CHARACTERISTIC
/begin CHARACTERISTIC K_OZ_AG_MESSSTAB_OK "Schwelle Motoroel OK [verified]" VALUE 0x702E7 RL_VAL_UB 0 CM_0359 -10 15.5 /end CHARACTERISTIC
/begin CHARACTERISTIC K_OZ_AG_MESSSTAB_OK_ "Schwelle Motoroel OK-Max [verified]" VALUE 0x702E8 RL_VAL_UB 0 CM_0362 -10 15.5 /end CHARACTERISTIC
/begin CHARACTERISTIC K_OZ_MIN_LEVEL_VOL "Gesamtoelmenge Min-Stand [verified]" VALUE 0x702EA RL_VAL_UW 0 CM_0363 0 65.535 /end CHARACTERISTIC
/begin CHARACTERISTIC K_OZ_NIV_KM_MAX "max. Km nach letzter Oelnivmessg. [verified]" VALUE 0x702EC RL_VAL_UL 0 CM_0082 0 4294967295 /end CHARACTERISTIC
/begin CHARACTERISTIC K_OZ_RESTWEG_APPL_MO "0 Codiert 32 8000 km Restweg 40 10000 km Restweg 48 12000 km Restweg 60 15000 km Restweg 96 24000 km [verified]" VALUE 0x702F0 RL_VAL_UB 0 CM_0364 0 255 /end CHARACTERISTIC
/begin CHARACTERISTIC K_OZ_TEMPBW_KOPF "Mindesttemp. am Oelfilterkopf [verified]" VALUE 0x702F4 RL_VAL_SW 0 CM_0256 -3550 3003.5 /end CHARACTERISTIC
/begin CHARACTERISTIC K_OZ_TEMPBW_SUMPF "?C -3276.8p 2 0.75*x Mindesttemp. Oelwanne [verified]" VALUE 0x702F6 RL_VAL_SW 0 CM_0342 -3276.8 3276.7 /end CHARACTERISTIC
/begin CHARACTERISTIC K_OZ_ORI_TEMPBW_KOPF "Mindesttemp. am Oelfilterkopf [verified]" VALUE 0x702F8 RL_VAL_SW 0 CM_0256 -3550 3003.5 /end CHARACTERISTIC
/begin CHARACTERISTIC K_OZ_ORI_TEMPBW_SUMP "F ?C -3276.8p 2 0.75*x Mindesttemp. Oelwanne [verified]" VALUE 0x702FA RL_VAL_SW 0 CM_0342 -3276.8 3276.7 /end CHARACTERISTIC
/begin CHARACTERISTIC K_OZ_TEMP_KOR "Korrekturfaktor Volumenaus-dehnung [verified]" VALUE 0x702FC RL_VAL_UB 0 CM_0365 0 25.5 /end CHARACTERISTIC
/begin CHARACTERISTIC K_OZ_ORI_TEMP_KOR "Orientierungsmsg. Korrekturfak-tor Volumenausdehnung [verified]" VALUE 0x702FD RL_VAL_UB 0 CM_0365 0 25.5 /end CHARACTERISTIC
/begin CHARACTERISTIC K_OZ_TEMP_75 "?C -3276.8p 2 0.75*x Mindesttemp. Oelwanne [verified]" VALUE 0x702FE RL_VAL_SW 0 CM_0342 -3276.8 3276.7 /end CHARACTERISTIC
/begin CHARACTERISTIC K_SCHNELLMSG_FSP_AKTI "FSP-Eintrag aus Schnellmsg. [verified]" VALUE 0x70300 RL_VAL_UB 0 CM_0057 0 255 /end CHARACTERISTIC
/begin CHARACTERISTIC K_SCHNELLMSG_ANZAHL_ "Anzahl Oelsensor-Rohwerte [verified]" VALUE 0x70301 RL_VAL_UB 0 CM_0366 0 255 /end CHARACTERISTIC
/begin CHARACTERISTIC K_SCHNELLMSG_KL15_MA "s 0p 2 x/100 CC-Mld-Schnellmessung-Aktivzeit [verified]" VALUE 0x70302 RL_VAL_UW 0 CM_0000 0 65535 /end CHARACTERISTIC
/begin CHARACTERISTIC K_SCHNELLMSG_KL15_AU "Ausblendungszeit Bedingung Schnellmsg. [verified]" VALUE 0x70304 RL_VAL_UW 0 CM_0367 0 655.35 /end CHARACTERISTIC
/begin CHARACTERISTIC K_SCHNELLMSG_OZLBES "Laengsbeschl. Ausblendung-Schwelle Schnellmessung [verified]" VALUE 0x70306 RL_VAL_SB 0 CM_0368 -32 31.75 /end CHARACTERISTIC
/begin CHARACTERISTIC K_SCHNELLMSG_OZQBES "Querbeschl. Ausblendung-Schwelle Schnellmessung [verified]" VALUE 0x70307 RL_VAL_SB 0 CM_0368 -32 31.75 /end CHARACTERISTIC
/begin CHARACTERISTIC K_SCHNELLMSG_PERM_PL "Luft-im-Sensor-Schwelle AUS [verified]" VALUE 0x70308 RL_VAL_UW 0 CM_0369 0 5.999908447 /end CHARACTERISTIC
/begin CHARACTERISTIC K_SCHNELLMSG_T_MS "Motor steht-Schwelle [verified]" VALUE 0x7030A RL_VAL_UW 0 CM_0108 0 65535 /end CHARACTERISTIC
/begin CHARACTERISTIC K_SCHNELLMSG_TOEL_MI "Mindestoeltemp. fuer Schnell-messung [verified]" VALUE 0x7030C RL_VAL_SW 0 CM_0370 -3550 3003.5 /end CHARACTERISTIC
/begin CHARACTERISTIC K_SCHNELLMSG_N_MAX "Maximaldrehzahl fuer Schnell-messung [verified]" VALUE 0x7030E RL_VAL_SW 0 CM_0002 -32768 32767 /end CHARACTERISTIC
/begin CHARACTERISTIC K_SCHNELLMSG_V_MAX "Max.geschwindigkeit Schnell-messung [verified]" VALUE 0x70310 RL_VAL_SW 0 CM_0260 -2048 2047.9375 /end CHARACTERISTIC
/begin CHARACTERISTIC CBATT_DEF "Ersatzwert Batteriekapazit???t [verified]" VALUE 0x77722 RL_VAL_UB 0 CM_0000 0 255 /end CHARACTERISTIC
/begin CHARACTERISTIC KF_TE_X_SOLL_MKS "betriebspunktabh. Kraftstof f-anteil [EST]" MAP 0x79148 RL_MAP_SW_SW_UW 0 CM_0307 0 1.999969482 /begin AXIS_DESCR STD_AXIS NO_INPUT_QUANTITY CM_0002 8 -32768 32767 /end AXIS_DESCR /begin AXIS_DESCR STD_AXIS NO_INPUT_QUANTITY CM_0291 8 -2048 2047.9375 /end AXIS_DESCR /end CHARACTERISTIC
/begin CHARACTERISTIC KF_TE_X_SOLL_NOT "Spuelluftanteil bei NOTLAUF [verified]" MAP 0x7928C RL_MAP_SW_SW_UW 0 CM_0307 0 1.999969482 /begin AXIS_DESCR STD_AXIS NO_INPUT_QUANTITY CM_0002 8 -32768 32767 /end AXIS_DESCR /begin AXIS_DESCR STD_AXIS NO_INPUT_QUANTITY CM_0291 8 -2048 2047.9375 /end AXIS_DESCR /end CHARACTERISTIC
/begin CHARACTERISTIC K_BATTREGAPP "Batterietauschregristrieren App [verified]" VALUE 0x7745D RL_VAL_UB 0 CM_0000 0 255 /end CHARACTERISTIC
/begin CHARACTERISTIC K_CAN_I_SC_MIN_INIT "min. Kurzschlu???strom [EST]" VALUE 0x70556 RL_VAL_UB 0 CM_0392 0 2550 /end CHARACTERISTIC
/begin CHARACTERISTIC K_CCPRIOSET "Schwelle von E65Prios ab dem ccmeldung aktiv ist. [verified]" VALUE 0x7745F RL_VAL_UB 0 CM_0000 0 255 /end CHARACTERISTIC
/begin CHARACTERISTIC K_CTRPRIOAPP "Steuerung Spitzenreduzierung Prioritaet Applikationsgroesse [A2L-ref]" VALUE 0x775B0 RL_VAL_UB 0 CM_0000 0 255 /end CHARACTERISTIC
/begin CHARACTERISTIC K_CTRPRIOCF_1of7_ "[A2L-ref]" VALUE 0x77602 RL_VAL_UB 0 CM_0000 0 255 /end CHARACTERISTIC
/begin CHARACTERISTIC K_CTRPRIOCF_2of7_ "[A2L-ref]" VALUE 0x77603 RL_VAL_UB 0 CM_0000 0 255 /end CHARACTERISTIC
/begin CHARACTERISTIC K_CTRPRIOCF_3of7_ "[A2L-ref]" VALUE 0x77604 RL_VAL_UB 0 CM_0000 0 255 /end CHARACTERISTIC
/begin CHARACTERISTIC K_CTRPRIOCF_4of7_ "[A2L-ref]" VALUE 0x77605 RL_VAL_UB 0 CM_0000 0 255 /end CHARACTERISTIC
/begin CHARACTERISTIC K_CTRPRIOCF_5of7_ "[A2L-ref]" VALUE 0x77606 RL_VAL_UB 0 CM_0000 0 255 /end CHARACTERISTIC
/begin CHARACTERISTIC K_CTRPRIOCF_6of7_ "[A2L-ref]" VALUE 0x77607 RL_VAL_UB 0 CM_0000 0 255 /end CHARACTERISTIC
/begin CHARACTERISTIC K_CTRPRIOCF_7of7_ "[A2L-ref]" VALUE 0x77608 RL_VAL_UB 0 CM_0000 0 255 /end CHARACTERISTIC
/begin CHARACTERISTIC K_CTRPWRCF_1of7_ "[A2L-ref]" VALUE 0x775D8 RL_VAL_UW 0 CM_0000 0 65535 /end CHARACTERISTIC
/begin CHARACTERISTIC K_CTRPWRCF_2of7_ "[A2L-ref]" VALUE 0x775DA RL_VAL_UW 0 CM_0000 0 65535 /end CHARACTERISTIC
/begin CHARACTERISTIC K_CTRPWRCF_3of7_ "[A2L-ref]" VALUE 0x775DC RL_VAL_UW 0 CM_0000 0 65535 /end CHARACTERISTIC
/begin CHARACTERISTIC K_CTRPWRCF_4of7_ "[A2L-ref]" VALUE 0x775DE RL_VAL_UW 0 CM_0000 0 65535 /end CHARACTERISTIC
/begin CHARACTERISTIC K_CTRPWRCF_5of7_ "[A2L-ref]" VALUE 0x775E0 RL_VAL_UW 0 CM_0000 0 65535 /end CHARACTERISTIC
/begin CHARACTERISTIC K_CTRPWRCF_6of7_ "[A2L-ref]" VALUE 0x775E2 RL_VAL_UW 0 CM_0000 0 65535 /end CHARACTERISTIC
/begin CHARACTERISTIC K_CTRPWRCF_7of7_ "[A2L-ref]" VALUE 0x775E4 RL_VAL_UW 0 CM_0000 0 65535 /end CHARACTERISTIC
/begin CHARACTERISTIC K_CTRPWRDF_10of14_ "[A2L-ref]" VALUE 0x775F8 RL_VAL_UW 0 CM_0000 0 65535 /end CHARACTERISTIC
/begin CHARACTERISTIC K_CTRPWRDF_11of14_ "[A2L-ref]" VALUE 0x775FA RL_VAL_UW 0 CM_0000 0 65535 /end CHARACTERISTIC
/begin CHARACTERISTIC K_CTRPWRDF_12of14_ "[A2L-ref]" VALUE 0x775FC RL_VAL_UW 0 CM_0000 0 65535 /end CHARACTERISTIC
/begin CHARACTERISTIC K_CTRPWRDF_13of14_ "[A2L-ref]" VALUE 0x775FE RL_VAL_UW 0 CM_0000 0 65535 /end CHARACTERISTIC
/begin CHARACTERISTIC K_CTRPWRDF_14of14_ "[A2L-ref]" VALUE 0x77600 RL_VAL_UW 0 CM_0000 0 65535 /end CHARACTERISTIC
/begin CHARACTERISTIC K_CTRPWRDF_1of14_ "[A2L-ref]" VALUE 0x775E6 RL_VAL_UW 0 CM_0000 0 65535 /end CHARACTERISTIC
/begin CHARACTERISTIC K_CTRPWRDF_2of14_ "[A2L-ref]" VALUE 0x775E8 RL_VAL_UW 0 CM_0000 0 65535 /end CHARACTERISTIC
/begin CHARACTERISTIC K_CTRPWRDF_3of14_ "[A2L-ref]" VALUE 0x775EA RL_VAL_UW 0 CM_0000 0 65535 /end CHARACTERISTIC
/begin CHARACTERISTIC K_CTRPWRDF_4of14_ "[A2L-ref]" VALUE 0x775EC RL_VAL_UW 0 CM_0000 0 65535 /end CHARACTERISTIC
/begin CHARACTERISTIC K_CTRPWRDF_5of14_ "[A2L-ref]" VALUE 0x775EE RL_VAL_UW 0 CM_0000 0 65535 /end CHARACTERISTIC
/begin CHARACTERISTIC K_CTRPWRDF_6of14_ "[A2L-ref]" VALUE 0x775F0 RL_VAL_UW 0 CM_0000 0 65535 /end CHARACTERISTIC
/begin CHARACTERISTIC K_CTRPWRDF_7of14_ "[A2L-ref]" VALUE 0x775F2 RL_VAL_UW 0 CM_0000 0 65535 /end CHARACTERISTIC
/begin CHARACTERISTIC K_CTRPWRDF_8of14_ "[A2L-ref]" VALUE 0x775F4 RL_VAL_UW 0 CM_0000 0 65535 /end CHARACTERISTIC
/begin CHARACTERISTIC K_CTRPWRDF_9of14_ "[A2L-ref]" VALUE 0x775F6 RL_VAL_UW 0 CM_0000 0 65535 /end CHARACTERISTIC
/begin CHARACTERISTIC K_DFFILTAPP "Schalter, um dffgenfilt auf DFFILT_APP umzustellen [A2L-ref]" VALUE 0x775B1 RL_VAL_UB 0 CM_0158 0 99.609375 /end CHARACTERISTIC
/begin CHARACTERISTIC K_DFKOMMERR "Ersatzwert Dffgen bei Gen. Komm. Fehler [A2L-ref]" VALUE 0x775B2 RL_VAL_UB 0 CM_0158 0 99.609375 /end CHARACTERISTIC
/begin CHARACTERISTIC K_DFMODE "DF-Mode-Schalter themermisch/elektrisch [A2L-ref]" VALUE 0x75973 RL_VAL_UB 0 CM_0000 0 255 /end CHARACTERISTIC
/begin CHARACTERISTIC K_DFOVERRIDE "Schwellwert wann Generator als ueberlastet erkannt wird [A2L-ref]" VALUE 0x779AE RL_VAL_UB 0 CM_0158 0 99.609375 /end CHARACTERISTIC
/begin CHARACTERISTIC K_DFPTC_LP "K-Faktor des df-Tiefpass Filters zur Berechnung von PTC [A2L-ref]" VALUE 0x775B3 RL_VAL_UB 0 CM_0164 0 0.99609375 /end CHARACTERISTIC
/begin CHARACTERISTIC K_DFS_MAX "DF-Auslastung Maximalschwelle [A2L-ref]" VALUE 0x75974 RL_VAL_UB 0 CM_0158 0 99.609375 /end CHARACTERISTIC
/begin CHARACTERISTIC K_DFS_MIN "DF-Auslastung Minimalschwelle [A2L-ref]" VALUE 0x75975 RL_VAL_UB 0 CM_0158 0 99.609375 /end CHARACTERISTIC
/begin CHARACTERISTIC K_DFS_MITT "DF-Auslastung Mittelschwelle [A2L-ref]" VALUE 0x75976 RL_VAL_UB 0 CM_0158 0 99.609375 /end CHARACTERISTIC
/begin CHARACTERISTIC K_DF_LP "K-Faktor des df-Tiefpass Filters zur Berechnung von ctrpwrdf [A2L-ref]" VALUE 0x775B4 RL_VAL_UB 0 CM_0164 0 0.99609375 /end CHARACTERISTIC
/begin CHARACTERISTIC K_DMTL_2_STABIL "0x0 1x Stabilzeit 0x1 2x Stabilzeit ELSE undef. Stabilkriterium ein oder zweimal zu erfuellen [A2L-ref]" VALUE 0x7098B RL_VAL_UB 0 CM_0000 0 255 /end CHARACTERISTIC
/begin CHARACTERISTIC K_DMTL_FAKT_T_DECKEL "Faktor fuer Deckeldiagnose auf Grobleckzeit [A2L-ref]" VALUE 0x7098A RL_VAL_UB 0 CM_0394 0 7.96875 /end CHARACTERISTIC
/begin CHARACTERISTIC K_DMTL_UB_MAX "max. Diagnosespannung [A2L-ref]" VALUE 0x70982 RL_VAL_SW 0 CM_0021 -3276.8 3276.7 /end CHARACTERISTIC
/begin CHARACTERISTIC K_DMTL_UB_MIN "min. Diagnosespannung Diagnose Modul Tank Leck ?ltemperatursensor (QLT)/ Plausibilit?t Seite 586 von [A2L-ref]" VALUE 0x70984 RL_VAL_SW 0 CM_0021 -3276.8 3276.7 /end CHARACTERISTIC
/begin CHARACTERISTIC K_DMTL_V_MIN "Mindestgeschwindigkeit fuer Betankungserkennung [A2L-ref]" VALUE 0x70986 RL_VAL_SW 0 CM_0010 -2048 2047.9375 /end CHARACTERISTIC
/begin CHARACTERISTIC K_DSOCHYSTCC "DSOC Hyst. fuer B_ccbtnach reset [verified]" VALUE 0x77438 RL_VAL_SW 0 CM_0395 -99.99999998 99.99694823 /end CHARACTERISTIC
/begin CHARACTERISTIC K_DSOCLLANH "Abstand zur Stfgrz, bei der die LLDZanh aktiviert wird. [A2L-ref]" VALUE 0x75B3A RL_VAL_SW 0 CM_0395 -99.99999998 99.99694823 /end CHARACTERISTIC
/begin CHARACTERISTIC K_DSOCLOW "DSOC Grenze f. CCmeld Batt Nachladen [verified]" VALUE 0x7743A RL_VAL_SW 0 CM_0395 -99.99999998 99.99694823 /end CHARACTERISTIC
/begin CHARACTERISTIC K_DWF_ORANGE_OFF "Offset auf roten Bereich [A2L-ref]" VALUE 0x70A50 RL_VAL_SB 0 CM_0396 -6400 6350 /end CHARACTERISTIC
/begin CHARACTERISTIC K_DWF_SHLI_AX_AKTIV "Aktivierungsschwelle [A2L-ref]" VALUE 0x70A5C RL_VAL_SW 0 CM_0042 -819.2 819.175 /end CHARACTERISTIC
/begin CHARACTERISTIC K_DWF_SHLI_T_AKTIV "Aktivierungsschwelle [A2L-ref]" VALUE 0x70A56 RL_VAL_UW 0 CM_0025 0 655.35 /end CHARACTERISTIC
/begin CHARACTERISTIC K_DWF_SHLI_T_BL "Aktivierungsschwelle Blinken [A2L-ref]" VALUE 0x70A5A RL_VAL_UW 0 CM_0020 0 327.675 /end CHARACTERISTIC
/begin CHARACTERISTIC K_DWF_SHLI_T_INAKTIV "Deaktivierungsschwelle [A2L-ref]" VALUE 0x70A58 RL_VAL_UW 0 CM_0025 0 655.35 /end CHARACTERISTIC
/begin CHARACTERISTIC K_EBOX_ELU_EIN "Eischaltschwelle [A2L-ref]" VALUE 0x70ABC RL_VAL_SW 0 CM_0006 -3550 3003.5 /end CHARACTERISTIC
/begin CHARACTERISTIC K_EBOX_ELU_HYS "Ausschalt-Hysterese [A2L-ref]" VALUE 0x70ABE RL_VAL_SW 0 CM_0024 -3276.8 3276.7 /end CHARACTERISTIC
/begin CHARACTERISTIC K_EBOX_ELU_LOSBRECHEN "Eischaltdauer zum Losbrechen [A2L-ref]" VALUE 0x70AC0 RL_VAL_UW 0 CM_0025 0 655.35 /end CHARACTERISTIC
/begin CHARACTERISTIC K_ENAPPLRESP "Enable Handsteuerung Loadresponse [EST]" VALUE 0x759D4 RL_VAL_UB 0 CM_0000 0 255 /end CHARACTERISTIC
/begin CHARACTERISTIC K_GENLDDFMAX "Schwell Anzeige maximaler Auslastungsgrad Generator [A2L-ref]" VALUE 0x75977 RL_VAL_UB 0 CM_0158 0 99.609375 /end CHARACTERISTIC
/begin CHARACTERISTIC K_GEN_BSD_VARIANTE "Gen.-regler-Variante [A2L-ref]" VALUE 0x702A2 RL_VAL_UB 0 CM_0000 0 255 /end CHARACTERISTIC
/begin CHARACTERISTIC K_IBSVERSION_10of16_ "Liste der kompatiblen IBS SW- Versionen [A2L-ref]" VALUE 0x741D0 RL_VAL_UB 0 CM_0000 0 255 /end CHARACTERISTIC
/begin CHARACTERISTIC K_IBSVERSION_11of16_ "Liste der kompatiblen IBS SW- Versionen [A2L-ref]" VALUE 0x741D1 RL_VAL_UB 0 CM_0000 0 255 /end CHARACTERISTIC
/begin CHARACTERISTIC K_IBSVERSION_12of16_ "Liste der kompatiblen IBS SW- Versionen [A2L-ref]" VALUE 0x741D2 RL_VAL_UB 0 CM_0000 0 255 /end CHARACTERISTIC
/begin CHARACTERISTIC K_IBSVERSION_13of16_ "Liste der kompatiblen IBS SW- Versionen [A2L-ref]" VALUE 0x741D3 RL_VAL_UB 0 CM_0000 0 255 /end CHARACTERISTIC
/begin CHARACTERISTIC K_IBSVERSION_14of16_ "Liste der kompatiblen IBS SW- Versionen [A2L-ref]" VALUE 0x741D4 RL_VAL_UB 0 CM_0000 0 255 /end CHARACTERISTIC
/begin CHARACTERISTIC K_IBSVERSION_15of16_ "Liste der kompatiblen IBS SW- Versionen [A2L-ref]" VALUE 0x741D5 RL_VAL_UB 0 CM_0000 0 255 /end CHARACTERISTIC
/begin CHARACTERISTIC K_IBSVERSION_16of16_ "Liste der kompatiblen IBS SW- Versionen [A2L-ref]" VALUE 0x741D6 RL_VAL_UB 0 CM_0000 0 255 /end CHARACTERISTIC
/begin CHARACTERISTIC K_IBSVERSION_1of16_ "Liste der kompatiblen IBS SW- Versionen [A2L-ref]" VALUE 0x741C7 RL_VAL_UB 0 CM_0000 0 255 /end CHARACTERISTIC
/begin CHARACTERISTIC K_IBSVERSION_2of16_ "Liste der kompatiblen IBS SW- Versionen [A2L-ref]" VALUE 0x741C8 RL_VAL_UB 0 CM_0000 0 255 /end CHARACTERISTIC
/begin CHARACTERISTIC K_IBSVERSION_3of16_ "Liste der kompatiblen IBS SW- Versionen [A2L-ref]" VALUE 0x741C9 RL_VAL_UB 0 CM_0000 0 255 /end CHARACTERISTIC
/begin CHARACTERISTIC K_IBSVERSION_4of16_ "Liste der kompatiblen IBS SW- Versionen [A2L-ref]" VALUE 0x741CA RL_VAL_UB 0 CM_0000 0 255 /end CHARACTERISTIC
/begin CHARACTERISTIC K_IBSVERSION_5of16_ "Liste der kompatiblen IBS SW- Versionen [A2L-ref]" VALUE 0x741CB RL_VAL_UB 0 CM_0000 0 255 /end CHARACTERISTIC
/begin CHARACTERISTIC K_IBSVERSION_6of16_ "Liste der kompatiblen IBS SW- Versionen [A2L-ref]" VALUE 0x741CC RL_VAL_UB 0 CM_0000 0 255 /end CHARACTERISTIC
/begin CHARACTERISTIC K_IBSVERSION_7of16_ "Liste der kompatiblen IBS SW- Versionen [A2L-ref]" VALUE 0x741CD RL_VAL_UB 0 CM_0000 0 255 /end CHARACTERISTIC
/begin CHARACTERISTIC K_IBSVERSION_8of16_ "Liste der kompatiblen IBS SW- Versionen [A2L-ref]" VALUE 0x741CE RL_VAL_UB 0 CM_0000 0 255 /end CHARACTERISTIC
/begin CHARACTERISTIC K_IBSVERSION_9of16_ "Liste der kompatiblen IBS SW- Versionen [A2L-ref]" VALUE 0x741CF RL_VAL_UB 0 CM_0000 0 255 /end CHARACTERISTIC
/begin CHARACTERISTIC K_IBSWAKEAPP "Bit, ob IBS Bus wecken darf oder nicht. Applikationsgroesse. [A2L-ref]" VALUE 0x775B5 RL_VAL_UB 0 CM_0000 0 255 /end CHARACTERISTIC
/begin CHARACTERISTIC K_IB_COMMVAL "Anzahl Taskaufrufe zwischen periodischer A bfrage qlad und qelad [verified]" VALUE 0x77723 RL_VAL_UB 0 CM_0000 0 255 /end CHARACTERISTIC
/begin CHARACTERISTIC K_IERRFIL "0x0 FALSE 0x1 TRUE ELSE TRUE Bed. Motorstart f?r Startauswertung PM durch Erkennung Spannngseinbruch [A2L-ref]" VALUE 0x75978 RL_VAL_UB 0 CM_0164 0 0.99609375 /end CHARACTERISTIC
/begin CHARACTERISTIC K_IPMPMDEC "Prio-dekrementfaktor aufgrund IPM [A2L-ref]" VALUE 0x77580 RL_VAL_UW 0 CM_0397 0 16383.75 /end CHARACTERISTIC
/begin CHARACTERISTIC K_IPMPMINC "Prio-Inkrementfaktor aufgrund IPM [A2L-ref]" VALUE 0x77582 RL_VAL_UW 0 CM_0397 0 16383.75 /end CHARACTERISTIC
/begin CHARACTERISTIC K_IWAKEAPP "Wakeupgrenze Appl. [verified]" VALUE 0x77463 RL_VAL_UB 0 CM_0398 0 0.31875 /end CHARACTERISTIC
/begin CHARACTERISTIC K_I_FITAUSW "Grenzwert Fitstrom [verified]" VALUE 0x77782 RL_VAL_UW 0 CM_0399 -200 5042.8 /end CHARACTERISTIC
/begin CHARACTERISTIC K_KBMCNT_APP "Zeit, indem KBM alle Straenge einschalten soll. [A2L-ref]" VALUE 0x775B6 RL_VAL_UB 0 CM_0023 0 25.5 /end CHARACTERISTIC
/begin CHARACTERISTIC K_KSOGRZAPP "Ikurz_ogrz appl. [verified]" VALUE 0x77464 RL_VAL_UB 0 CM_0400 0 1305.6 /end CHARACTERISTIC
/begin CHARACTERISTIC K_KSUGRZAPP "Ikurz_ugrz Appl. [verified]" VALUE 0x77465 RL_VAL_UB 0 CM_0400 0 1305.6 /end CHARACTERISTIC
/begin CHARACTERISTIC K_KW_ED_DELTA_N "Max zul. Nockenwellendrehzahl im Startversuch bei n immer noch null. [A2L-ref]" VALUE 0x741EC RL_VAL_SW 0 CM_0002 -32768 32767 /end CHARACTERISTIC
/begin CHARACTERISTIC K_KW_ED_DELTA_N_RATE "Fehlerrate Startversuch. [A2L-ref]" VALUE 0x741F2 RL_VAL_UW 0 CM_0000 0 65535 /end CHARACTERISTIC
/begin CHARACTERISTIC K_KW_ED_DELTA_U "Max zul. Abweichung der mittleren Differenzspannung. [A2L-ref]" VALUE 0x741F0 RL_VAL_SW 0 CM_0087 -32768 32767 /end CHARACTERISTIC
/begin CHARACTERISTIC K_KW_ED_N_DROP "Max zul. Abrissdrehzahl. [A2L-ref]" VALUE 0x741EE RL_VAL_SW 0 CM_0002 -32768 32767 /end CHARACTERISTIC
/begin CHARACTERISTIC K_KW_ED_N_DROP_RATE "Fehlerrate Abriss. [A2L-ref]" VALUE 0x741F4 RL_VAL_UW 0 CM_0000 0 65535 /end CHARACTERISTIC
/begin CHARACTERISTIC K_LLPMFILTK "Filterkonstante : Tiefpassfilter DF-Signal [A2L-ref]" VALUE 0x775B7 RL_VAL_UB 0 CM_0164 0 0.99609375 /end CHARACTERISTIC
/begin CHARACTERISTIC K_LSHVK_CFG "0x0 keine Heizung 0x1 Heizung ELSE undefiniert LSH-Freigabe [A2L-ref]" VALUE 0x75C3E RL_VAL_UW 0 CM_0348 0 65535 /end CHARACTERISTIC
/begin CHARACTERISTIC K_LSHVK_REG_K "Verstaerkungsfaktor PI -Regler [A2L-ref]" VALUE 0x75C44 RL_VAL_UW 0 CM_0404 0 63.99902344 /end CHARACTERISTIC
/begin CHARACTERISTIC K_LSHVK_REG_TN "Nachstellzeit PI-Regler [A2L-ref]" VALUE 0x75C46 RL_VAL_UW 0 CM_0027 0 65535 /end CHARACTERISTIC
/begin CHARACTERISTIC K_LSHVK_R_AD_GAIN_NV_MAX "max. Grenze fuer GAIN -Sonden-Ri-Adapt. [A2L-ref]" VALUE 0x75CB4 RL_VAL_UW 0 CM_0016 0 63.99902344 /end CHARACTERISTIC
/begin CHARACTERISTIC K_LSHVK_R_AD_GAIN_NV_MIN "min. Grenze fuer GAIN -Sonden-Ri-Adapt. [A2L-ref]" VALUE 0x75CB6 RL_VAL_UW 0 CM_0016 0 63.99902344 /end CHARACTERISTIC
/begin CHARACTERISTIC K_LSHVK_R_AD_OFFS_NV_MAX "max. Grenze fuer OFFEST -Sonden-Ri-Adapt. [A2L-ref]" VALUE 0x75CB0 RL_VAL_SW 0 CM_0163 -160000 159995.1172 /end CHARACTERISTIC
/begin CHARACTERISTIC K_LSHVK_R_AD_OFFS_NV_MIN "min. Grenze fuer OFFEST -Sonden-Ri-Adapt. [A2L-ref]" VALUE 0x75CB2 RL_VAL_SW 0 CM_0163 -160000 159995.1172 /end CHARACTERISTIC
/begin CHARACTERISTIC K_LSHVK_TV_KORR_MIN "min. Tastverhaeltnis VKAT [A2L-ref]" VALUE 0x75C4A RL_VAL_UW 0 CM_0176 0 3199.951172 /end CHARACTERISTIC
/begin CHARACTERISTIC K_LSHVK_T_KL15_MAX "max. Heizdauer bei KL15 an [A2L-ref]" VALUE 0x75C40 RL_VAL_UW 0 CM_0025 0 655.35 /end CHARACTERISTIC
/begin CHARACTERISTIC K_LSHVK_UB_MAX "max. Bordspannung [A2L-ref]" VALUE 0x75C4E RL_VAL_UW 0 CM_0021 0 6553.5 /end CHARACTERISTIC
/begin CHARACTERISTIC K_LSHVK_UB_NORM "Normbordspannung [A2L-ref]" VALUE 0x75C4C RL_VAL_UW 0 CM_0021 0 6553.5 /end CHARACTERISTIC
/begin CHARACTERISTIC K_LSHVK_UEFF_GRAD "Effektivspannungsgradient [A2L-ref]" VALUE 0x75C50 RL_VAL_UW 0 CM_0405 0 6553.5 /end CHARACTERISTIC
/begin CHARACTERISTIC K_LSH_UB_TAU "Zeitkonstante LSH-UB [A2L-ref]" VALUE 0x75CAE RL_VAL_UB 0 CM_0306 0.1003921569 25.6 /end CHARACTERISTIC
/begin CHARACTERISTIC K_MSKIBSERR "[A2L-ref]" VALUE 0x70931 RL_VAL_UB 0 CM_0000 0 255 /end CHARACTERISTIC
/begin CHARACTERISTIC K_MVAC_AL_SRMV "Durchflusswert SR/Mvac [A2L-ref]" VALUE 0x75EF0 RL_VAL_SW 0 CM_0179 -32 31.99902344 /end CHARACTERISTIC
/begin CHARACTERISTIC K_MVAC_DEL_RSV "Verzug Schliesszeit RSV [A2L-ref]" VALUE 0x75EEE RL_VAL_UW 0 CM_0020 0 327.675 /end CHARACTERISTIC
/begin CHARACTERISTIC K_MVAC_ELUP_ST_DEL "Zeitverzoegerung fuer B e- rechnung von mvac_ml_sr_rsv_psens [A2L-ref]" VALUE 0x75EE6 RL_VAL_UW 0 CM_0020 0 327.675 /end CHARACTERISTIC
/begin CHARACTERISTIC K_MVAC_HYS_MAX "Filterschwelle Differenzdruck [A2L-ref]" VALUE 0x75EEC RL_VAL_SW 0 CM_0022 -2048 2047.9375 /end CHARACTERISTIC
/begin CHARACTERISTIC K_MVAC_HYS_MIN "Filterschwelle Differenzdruck [A2L-ref]" VALUE 0x75EEA RL_VAL_SW 0 CM_0022 -2048 2047.9375 /end CHARACTERISTIC
/begin CHARACTERISTIC K_MVAC_ML_CFG "0x00 mvac_ml_sr_rsv_mess 0x01 mvac_ml_sr_rsv_psens ELSE undef Software-Schalter mvac_ml_sr [A2L-ref]" VALUE 0x75EE9 RL_VAL_UB 0 CM_0000 0 255 /end CHARACTERISTIC
/begin CHARACTERISTIC K_MVAC_ML_MIN "Schwelle Luftmassenstrom [A2L-ref]" VALUE 0x75EE4 RL_VAL_SW 0 CM_0102 -3276.8 3276.7 /end CHARACTERISTIC
/begin CHARACTERISTIC K_MVAC_ML_TAU "Tau fuer mvac_ml_psens PT1-Glied [A2L-ref]" VALUE 0x75EE2 RL_VAL_UW 0 CM_0011 0.004999923705 327.67 /end CHARACTERISTIC
/begin CHARACTERISTIC K_MVAC_P_TAU "Filterkonstante fuer den Unterdruck-MVAC [A2L-ref]" VALUE 0x75EE8 RL_VAL_UB 0 CM_0065 0.005019607843 1.28 /end CHARACTERISTIC
/begin CHARACTERISTIC K_MZYL_R "Allgemeine Gaskonstante R [A2L-ref]" VALUE 0x76002 RL_VAL_UW 0 CM_0406 0 6553.5 /end CHARACTERISTIC
/begin CHARACTERISTIC K_NGENOFMN "0x0 FALSE 0x1 TRUE ELSE TRUE [A2L-ref]" VALUE 0x75B2C RL_VAL_SW 0 CM_0407 -32768 32767 /end CHARACTERISTIC
/begin CHARACTERISTIC K_NKW2HIPTC "Nkw i.O. PTC darf zugeschaltet werden. [A2L-ref]" VALUE 0x7757C RL_VAL_SW 0 CM_0002 -32768 32767 /end CHARACTERISTIC
/begin CHARACTERISTIC K_NSUBU "N_soll bei Ladebilanz iO [EST]" VALUE 0x75A18 RL_VAL_SW 0 CM_0002 -32768 32767 /end CHARACTERISTIC
/begin CHARACTERISTIC K_NW_IO "Anzahl NW-Impulse fuer erneute NW-Synchronisation [A2L-ref]" VALUE 0x76220 RL_VAL_UB 0 CM_0000 0 255 /end CHARACTERISTIC
/begin CHARACTERISTIC K_NW_IO_ASP "nach x korrekten Arbeitsspielen kein Rueckschalten in 360???-Mode [A2L-ref]" VALUE 0x76228 RL_VAL_UW 0 CM_0000 0 65535 /end CHARACTERISTIC
/begin CHARACTERISTIC K_NW_MFMAX_1of2_ "Obergrenze NW-Messfenster [A2L-ref]" VALUE 0x76224 RL_VAL_UB 0 CM_0000 0 255 /end CHARACTERISTIC
/begin CHARACTERISTIC K_NW_MFMAX_2of2_ "Obergrenze NW-Messfenster [A2L-ref]" VALUE 0x76225 RL_VAL_UB 0 CM_0000 0 255 /end CHARACTERISTIC
/begin CHARACTERISTIC K_NW_MFMIN_1of2_ "Untergrenze NW-Messfenster [A2L-ref]" VALUE 0x76222 RL_VAL_UB 0 CM_0000 0 255 /end CHARACTERISTIC
/begin CHARACTERISTIC K_NW_MFMIN_2of2_ "Untergrenze NW-Messfenster [A2L-ref]" VALUE 0x76223 RL_VAL_UB 0 CM_0000 0 255 /end CHARACTERISTIC
/begin CHARACTERISTIC K_NW_NIO "Schwelle fehlende/falsche NW-Impulse fuer NW-Desynchronisation [A2L-ref]" VALUE 0x76226 RL_VAL_UB 0 CM_0000 0 255 /end CHARACTERISTIC
/begin CHARACTERISTIC K_NW_NIO_INC "Inkremente fuer NW-Fehlerzaehler [A2L-ref]" VALUE 0x76227 RL_VAL_UB 0 CM_0000 0 255 /end CHARACTERISTIC
/begin CHARACTERISTIC K_NW_SYNC_ION_IO "Anzahl guter Verbrennungen fuer NW-Synchronisation ueber Ionenstrom [A2L-ref]" VALUE 0x76221 RL_VAL_UB 0 CM_0000 0 255 /end CHARACTERISTIC
/begin CHARACTERISTIC K_OSPGPRELLZ "Anzahl der Entprellungen f???r Oberspannungsfehlereintrag [verified]" VALUE 0x77466 RL_VAL_UB 0 CM_0000 0 255 /end CHARACTERISTIC
/begin CHARACTERISTIC K_OZLBESCH_STAND_CC "Laengsbeschl.-Ausblendung Standmsg. [A2L-ref]" VALUE 0x702C4 RL_VAL_SB 0 CM_0196 -32 31.75 /end CHARACTERISTIC
/begin CHARACTERISTIC K_OZNIVKL "Konvertierungsfaktor f?r den Niveau-Wert QLT [A2L-ref]" VALUE 0x76800 RL_VAL_UB 0 CM_0123 0 74.70703125 /end CHARACTERISTIC
/begin CHARACTERISTIC K_OZPERCMW "Anzahl Messungen f?r den Mit-telwert Permittivit?t [A2L-ref]" VALUE 0x76801 RL_VAL_UB 0 CM_0000 0 255 /end CHARACTERISTIC
/begin CHARACTERISTIC K_OZPERGRADKD "ber?cksichti- gen) [A2L-ref]" VALUE 0x76802 RL_VAL_UB 0 CM_0408 0 255 /end CHARACTERISTIC
/begin CHARACTERISTIC K_OZPERGRADMAX "Obere Grenze Permittivit???tsgradient (bitte K_OZPERGRADKD ber???cksichtigen) [A2L-ref]" VALUE 0x767EA RL_VAL_SW 0 CM_0000 -32768 32767 /end CHARACTERISTIC
/begin CHARACTERISTIC K_OZPERGRADMIN "Untere Grenze Permittivit???tsgradient (bitte K_OZPERGRADKD ber???cksichtigen) [A2L-ref]" VALUE 0x767EC RL_VAL_SW 0 CM_0000 -32768 32767 /end CHARACTERISTIC
/begin CHARACTERISTIC K_OZPERGRADTN "Zeitkonstante f?r den Permittivit?tsgradientenverlauf [A2L-ref]" VALUE 0x76803 RL_VAL_UB 0 CM_0164 0 0.99609375 /end CHARACTERISTIC
/begin CHARACTERISTIC K_OZPERINI "Startwert f?r Oz_perref [A2L-ref]" VALUE 0x767F2 RL_VAL_UW 0 CM_0000 0 65535 /end CHARACTERISTIC
/begin CHARACTERISTIC K_OZPERKFIL "Zeitkonstante Permittivit?ts-LOW-Pass-Filter [A2L-ref]" VALUE 0x767F4 RL_VAL_UW 0 CM_0409 0 99.9984741 /end CHARACTERISTIC
/begin CHARACTERISTIC K_OZPERMWDMAX "Max positives Delta zwischen Mittelwerten Permittivit?t [A2L-ref]" VALUE 0x767EE RL_VAL_SW 0 CM_0000 -32768 32767 /end CHARACTERISTIC
/begin CHARACTERISTIC K_OZPERMWDMIN "Max negatives Delta zwischen Mittelwerten Permittivit?t [A2L-ref]" VALUE 0x767F0 RL_VAL_SW 0 CM_0000 -32768 32767 /end CHARACTERISTIC
/begin CHARACTERISTIC K_OZPLTEMP "Max Temperatursprung QLT (Plausibilisierung wegen ASIC- Pins Bruch) [A2L-ref]" VALUE 0x70A41 RL_VAL_UB 0 CM_0000 0 255 /end CHARACTERISTIC
/begin CHARACTERISTIC K_OZPLZTEMP "Max unplausibel Spr?nge (Plausibilisierung wegen ASIC- Pins Bruch) [A2L-ref]" VALUE 0x70A42 RL_VAL_UB 0 CM_0000 0 255 /end CHARACTERISTIC
/begin CHARACTERISTIC K_OZPRREFMAX "Maximum f?r Referenzpermittivit?t [A2L-ref]" VALUE 0x767FA RL_VAL_UW 0 CM_0000 0 65535 /end CHARACTERISTIC
/begin CHARACTERISTIC K_OZPRREFMIN "Minimum f?r Referenzpermittivit?t [A2L-ref]" VALUE 0x767FC RL_VAL_UW 0 CM_0000 0 65535 /end CHARACTERISTIC
/begin CHARACTERISTIC K_OZQBESCH_STAND_CC "Querbeschl.-Ausblendung Standmsg. [A2L-ref]" VALUE 0x702C5 RL_VAL_SB 0 CM_0196 -32 31.75 /end CHARACTERISTIC
/begin CHARACTERISTIC K_OZUEBERF "Schwelle f???r die ???berf???llung [A2L-ref]" VALUE 0x768F0 RL_VAL_UB 0 CM_0123 0 74.70703125 /end CHARACTERISTIC
/begin CHARACTERISTIC K_OZVERZNIVERS "Verz?gerung Umschaltung auf Niveau-Ersatzwert [A2L-ref]" VALUE 0x76805 RL_VAL_UB 0 CM_0027 0 255 /end CHARACTERISTIC
/begin CHARACTERISTIC K_OZ_N_OELMAXKORR_O "ob. Drehz.grenze Wichtung Langzeitmw. [A2L-ref]" VALUE 0x702C8 RL_VAL_SW 0 CM_0002 -32768 32767 /end CHARACTERISTIC
/begin CHARACTERISTIC K_OZ_N_OELMAXKORR_U "unt. Drehz.grenze Wichtung Langzeitmw. [A2L-ref]" VALUE 0x702C6 RL_VAL_SW 0 CM_0002 -32768 32767 /end CHARACTERISTIC
/begin CHARACTERISTIC K_PCTRL_PROZ_ZYKL "Prozess-Ueberwachungszyklus [A2L-ref]" VALUE 0x76BD2 RL_VAL_UB 0 CM_0020 0 1.275 /end CHARACTERISTIC
/begin CHARACTERISTIC K_PCTRL_TASK_ZYKL "Task-Ueberwachungszyklus [A2L-ref]" VALUE 0x76BD1 RL_VAL_UB 0 CM_0020 0 1.275 /end CHARACTERISTIC
/begin CHARACTERISTIC K_PMQ_UX "trapolationsteiler 7.96875p S_BSOCCALC - 0p 0 x Enable R?cksetzten Ruhespannungen IBS [verified]" VALUE 0x77724 RL_VAL_UB 0 CM_0394 0 7.96875 /end CHARACTERISTIC
/begin CHARACTERISTIC K_PRIOCF15 "PrioCF bei kl.15, Motor aus [A2L-ref]" VALUE 0x775B9 RL_VAL_UB 0 CM_0000 0 255 /end CHARACTERISTIC
/begin CHARACTERISTIC K_PRIOCFAPP "Steuerung Spitzenreduzierung Prioritaet Komfort App [A2L-ref]" VALUE 0x775BA RL_VAL_UB 0 CM_0000 0 255 /end CHARACTERISTIC
/begin CHARACTERISTIC K_PRIOCF_R "Prio Comfort Bei Kl.R [A2L-ref]" VALUE 0x775BB RL_VAL_UB 0 CM_0000 0 255 /end CHARACTERISTIC
/begin CHARACTERISTIC K_PRIODF_1of7_ "[A2L-ref]" VALUE 0x77609 RL_VAL_UB 0 CM_0000 0 255 /end CHARACTERISTIC
/begin CHARACTERISTIC K_PRIODF_2of7_ "[A2L-ref]" VALUE 0x7760A RL_VAL_UB 0 CM_0000 0 255 /end CHARACTERISTIC
/begin CHARACTERISTIC K_PRIODF_3of7_ "[A2L-ref]" VALUE 0x7760B RL_VAL_UB 0 CM_0000 0 255 /end CHARACTERISTIC
/begin CHARACTERISTIC K_PRIODF_4of7_ "[A2L-ref]" VALUE 0x7760C RL_VAL_UB 0 CM_0000 0 255 /end CHARACTERISTIC
/begin CHARACTERISTIC K_PRIODF_5of7_ "[A2L-ref]" VALUE 0x7760D RL_VAL_UB 0 CM_0000 0 255 /end CHARACTERISTIC
/begin CHARACTERISTIC K_PRIODF_6of7_ "[A2L-ref]" VALUE 0x7760E RL_VAL_UB 0 CM_0000 0 255 /end CHARACTERISTIC
/begin CHARACTERISTIC K_PRIODF_7of7_ "[A2L-ref]" VALUE 0x7760F RL_VAL_UB 0 CM_0000 0 255 /end CHARACTERISTIC
/begin CHARACTERISTIC K_PRIO_R "Prio Bei Kl.R [A2L-ref]" VALUE 0x775BC RL_VAL_UB 0 CM_0000 0 255 /end CHARACTERISTIC
/begin CHARACTERISTIC K_PTCPWRAPP "Ansteuerung PWM-Ausgang f???r PTC-Zuheizer. Applikationsgroesse. [A2L-ref]" VALUE 0x775BD RL_VAL_UB 0 CM_0201 0 127.5 /end CHARACTERISTIC
/begin CHARACTERISTIC K_PTC_PI "K-Faktor des PI-Reglers PTC-Ansteuerung [A2L-ref]" VALUE 0x775BE RL_VAL_UB 0 CM_0164 0 0.99609375 /end CHARACTERISTIC
/begin CHARACTERISTIC K_PWRCOSULEV "Bitcodierte ctrpwrcos Zuschaltung bei Sulev [A2L-ref]" VALUE 0x77594 RL_VAL_UW 0 CM_0000 0 65535 /end CHARACTERISTIC
/begin CHARACTERISTIC K_PWRCSGNDEF "ctrpwrcos-Wert bei Gen. mechn. el. Fehler [A2L-ref]" VALUE 0x77598 RL_VAL_UW 0 CM_0000 0 65535 /end CHARACTERISTIC
/begin CHARACTERISTIC K_PWRDF_PI "K-Faktor des PI Reglers zur Berechnung von ctrpwrdf [A2L-ref]" VALUE 0x775BF RL_VAL_UB 0 CM_0164 0 0.99609375 /end CHARACTERISTIC
/begin CHARACTERISTIC K_Q_BILAPWF "Defaultwert f?r q_bila nach Powerfail [verified]" VALUE 0x7771A RL_VAL_UW 0 CM_0410 0 1192.750252 /end CHARACTERISTIC
/begin CHARACTERISTIC K_RESET_PI "PI-Reset-Zeit bei steigender Kl.15 [A2L-ref]" VALUE 0x775C0 RL_VAL_UB 0 CM_0023 0 25.5 /end CHARACTERISTIC
/begin CHARACTERISTIC K_RQPCOSA "Parameter f???r SV-Anmeldung [A2L-ref]" VALUE 0x775C1 RL_VAL_UB 0 CM_0000 0 255 /end CHARACTERISTIC
/begin CHARACTERISTIC K_RUHVERMODE "Ruhestromverletzungserkennungsmode [verified]" VALUE 0x7746A RL_VAL_UB 0 CM_0000 0 255 /end CHARACTERISTIC
/begin CHARACTERISTIC K_SCHALTER_GETR_A0 "Nullpunktadaption Schalter Getriebeleergasse [A2L-ref]" VALUE 0x784B4 RL_VAL_SW 0 CM_0087 -32768 32767 /end CHARACTERISTIC
/begin CHARACTERISTIC K_SCHALTER_GETR_FIL_TAU "Filterkonstante fuer AD_Wert Getriebeleergasse [A2L-ref]" VALUE 0x784B6 RL_VAL_UB 0 CM_0277 0.01003921569 2.56 /end CHARACTERISTIC
/begin CHARACTERISTIC K_SCHALTER_GETR_HYSTERESE_BREITE "Hysterese zwischen Erken- nung Leergasse und Gang (in AD Schritten) [A2L-ref]" VALUE 0x784BC RL_VAL_SW 0 CM_0087 -32768 32767 /end CHARACTERISTIC
/begin CHARACTERISTIC K_SCHALTER_GETR_LEERGASSE_MAX "maximaler AD -Wert f?r G e-triebeleergasse [A2L-ref]" VALUE 0x784BA RL_VAL_SW 0 CM_0087 -32768 32767 /end CHARACTERISTIC
/begin CHARACTERISTIC K_SCHALTER_GETR_LEERGASSE_MIN "minimaler AD -Wert f?r G e-triebeleergasse [A2L-ref]" VALUE 0x784B8 RL_VAL_SW 0 CM_0087 -32768 32767 /end CHARACTERISTIC
/begin CHARACTERISTIC K_SELSPCOSA "Spezialverbraucher [A2L-ref]" VALUE 0x775C4 RL_VAL_UB 0 CM_0000 0 255 /end CHARACTERISTIC
/begin CHARACTERISTIC K_SELSPCSAPP "Auswahl Sonderverbraucher Applikationsgroesse [A2L-ref]" VALUE 0x775C5 RL_VAL_UB 0 CM_0000 0 255 /end CHARACTERISTIC
/begin CHARACTERISTIC K_SLS_PL_T_MDF_STOP "MDF Diagnoseende fuer Prueflauf [A2L-ref]" VALUE 0x788E6 RL_VAL_UW 0 CM_0025 0 655.35 /end CHARACTERISTIC
/begin CHARACTERISTIC K_SL_HFM_TAU "Filterkonstante Rohwert [A2L-ref]" VALUE 0x786DE RL_VAL_UB 0 CM_0065 0.005019607843 1.28 /end CHARACTERISTIC
/begin CHARACTERISTIC K_SL_I_MAX "I-Anteil Max SL Mengenregelung [EST]" VALUE 0x786E4 RL_VAL_SW 0 CM_0236 -2 1.999938965 /end CHARACTERISTIC
/begin CHARACTERISTIC K_SL_I_MIN "I-Anteil Min SL Mengenregelung [EST]" VALUE 0x786E6 RL_VAL_SW 0 CM_0236 -2 1.999938965 /end CHARACTERISTIC
/begin CHARACTERISTIC K_SL_LAM_MAX_FAK "Motorlambda B2 Korr-Fak. MAX-Wert [A2L-ref]" VALUE 0x786F0 RL_VAL_SW 0 CM_0016 -32 31.99902344 /end CHARACTERISTIC
/begin CHARACTERISTIC K_SOCFITAPP "Schalter Initialisierung Fit -Filter mit SOCFIT [verified]" VALUE 0x77786 RL_VAL_UW 0 CM_0409 0 99.9984741 /end CHARACTERISTIC
/begin CHARACTERISTIC K_SOC_BILAWA "Applikationswert soc_bila [verified]" VALUE 0x7771C RL_VAL_UW 0 CM_0409 0 99.9984741 /end CHARACTERISTIC
/begin CHARACTERISTIC K_SOC_QPWF "Ladezustandsqualit?t nach Powerfail [verified]" VALUE 0x7771E RL_VAL_UW 0 CM_0410 0 1192.750252 /end CHARACTERISTIC
/begin CHARACTERISTIC K_SOC_QUALIA "Applikationswert soc_quali [verified]" VALUE 0x77720 RL_VAL_UW 0 CM_0410 0 1192.750252 /end CHARACTERISTIC
/begin CHARACTERISTIC K_STPCOSAPP "Status Standverbraucher Applikationsgroesse [A2L-ref]" VALUE 0x775C6 RL_VAL_UB 0 CM_0000 0 255 /end CHARACTERISTIC
/begin CHARACTERISTIC K_T1PMINFO "T1 Zykluszeit fuer PM Fehlerinfo [verified]" VALUE 0x7746B RL_VAL_UB 0 CM_0023 0 25.5 /end CHARACTERISTIC
/begin CHARACTERISTIC K_TCHIPFIL "Filterkonstante schneller Tchip Filter [verified]" VALUE 0x76C20 RL_VAL_UW 0 CM_0239 0 0.999984741 /end CHARACTERISTIC
/begin CHARACTERISTIC K_TCODIERPM "T1 Zyklus fuer Fehlerinfo [verified]" VALUE 0x7746C RL_VAL_UB 0 CM_0023 0 25.5 /end CHARACTERISTIC
/begin CHARACTERISTIC K_TDNGENKRIT "Verz???gerung Generator im kritischen Drehzahlbereich [verified]" VALUE 0x76C28 RL_VAL_UB 0 CM_0108 0 255 /end CHARACTERISTIC
/begin CHARACTERISTIC K_TDTCHIPKRI "Verz???gerung Generatorhochtemperatur [verified]" VALUE 0x76C29 RL_VAL_UB 0 CM_0108 0 255 /end CHARACTERISTIC
/begin CHARACTERISTIC K_TDTCHIPMX "Verz???gerung erh???hte Chiptemperatur [verified]" VALUE 0x76C2A RL_VAL_UB 0 CM_0000 0 255 /end CHARACTERISTIC
/begin CHARACTERISTIC K_TDUBFZMN "Verz???gerung Bordnetzschwelle [verified]" VALUE 0x76C2B RL_VAL_UB 0 CM_0108 0 255 /end CHARACTERISTIC
/begin CHARACTERISTIC K_TE_ANZUGSZEIT_OFFS_B1 "Offset Ventil Anzugszeit [EST]" VALUE 0x78BF2 RL_VAL_UW 0 CM_0214 0 655.35 /end CHARACTERISTIC
/begin CHARACTERISTIC K_TE_STOECH "stoechometrischer Faktor [EST]" VALUE 0x78C54 RL_VAL_UW 0 CM_0037 0 511.9921875 /end CHARACTERISTIC
/begin CHARACTERISTIC K_TE_TI_MIN_DIFF "Min Abstand ti_tpu zu ti_bj.min [verified]" VALUE 0x78C64 RL_VAL_UW 0 CM_0141 0 65.535 /end CHARACTERISTIC
/begin CHARACTERISTIC K_TE_TMOT_START_HS "min. tmot_start Heisstarterkennung [EST]" VALUE 0x78C68 RL_VAL_SW 0 CM_0006 -3550 3003.5 /end CHARACTERISTIC
/begin CHARACTERISTIC K_TE_T_LAA "TE_LAA und SPUELEN_WARTE_LAA Zeit [EST]" VALUE 0x78C56 RL_VAL_UW 0 CM_0023 0 6553.5 /end CHARACTERISTIC
/begin CHARACTERISTIC K_TE_T_LAA_INI_HS "TE_LAA_INI-Zeit nach Heisstart [EST]" VALUE 0x78C58 RL_VAL_UW 0 CM_0023 0 6553.5 /end CHARACTERISTIC
/begin CHARACTERISTIC K_TE_T_LANG "min te_t_spuel fuer Ueberg. in TE_LAA [EST]" VALUE 0x78C5C RL_VAL_UW 0 CM_0023 0 6553.5 /end CHARACTERISTIC
/begin CHARACTERISTIC K_TE_T_MIN "min. te_t_spuel bei B_TE_ABBR fuer Uebe r- gang in TE_LAA [A2L-ref]" VALUE 0x78C5E RL_VAL_UW 0 CM_0023 0 6553.5 /end CHARACTERISTIC
/begin CHARACTERISTIC K_TE_T_NORM "max. te_t_spuel bei SPUELEN_KURZ [EST]" VALUE 0x78C60 RL_VAL_UW 0 CM_0023 0 6553.5 /end CHARACTERISTIC
/begin CHARACTERISTIC K_TE_X_MKS_CFG "te_x_mks - Auswahl [EST]" VALUE 0x78CEE RL_VAL_UB 0 CM_0000 0 255 /end CHARACTERISTIC
/begin CHARACTERISTIC K_TE_X_ML_SOLL_APPL_B2 "applikatives te_x_ml_soll [A2L-ref]" VALUE 0x78C76 RL_VAL_UW 0 CM_0237 0 1.999969482 /end CHARACTERISTIC
/begin CHARACTERISTIC K_TE_X_ML_SOLL_CFG "0 Rampe B1,B2 1 Appl B1, Rampe B2 2 Rampe B1, Appl B2 3 Appl B1,B2 te_x_ml_soll - Auswahl [verified]" VALUE 0x78C78 RL_VAL_UW 0 CM_0348 0 65535 /end CHARACTERISTIC
/begin CHARACTERISTIC K_TE_X_ML_SOLL_MAX "max. Spuelluftanteil f. System [verified]" VALUE 0x78C7A RL_VAL_UW 0 CM_0237 0 1.999969482 /end CHARACTERISTIC
/begin CHARACTERISTIC K_TE_X_ML_SOLL_MIN "min. gewuenschter Durchsatz [verified]" VALUE 0x78C7C RL_VAL_UW 0 CM_0237 0 1.999969482 /end CHARACTERISTIC
/begin CHARACTERISTIC K_TE_ZU_LERN "TEV Zufahrtzeit - LERNEN [verified]" VALUE 0x78C80 RL_VAL_UW 0 CM_0023 0 6553.5 /end CHARACTERISTIC
/begin CHARACTERISTIC K_TFIGENHT "Filterkonstante verteilter Generatorstrom [verified]" VALUE 0x76C2C RL_VAL_UB 0 CM_0164 0 0.99609375 /end CHARACTERISTIC
/begin CHARACTERISTIC K_TLCHTEP "Schalter zur Aktivierung ?berwachung Diodentemparatur [verified]" VALUE 0x76C2D RL_VAL_UB 0 CM_0418 0 255 /end CHARACTERISTIC
/begin CHARACTERISTIC K_TRTYP "Faktor f?r die Berechnung ?l-Temperatur T?ns [A2L-ref]" VALUE 0x767FE RL_VAL_UW 0 CM_0025 0 655.35 /end CHARACTERISTIC
/begin CHARACTERISTIC K_T_NKPTCAUS "Zeit PTC aus aufgrund NKW zu niedrig. [A2L-ref]" VALUE 0x775C7 RL_VAL_UB 0 CM_0023 0 25.5 /end CHARACTERISTIC
/begin CHARACTERISTIC K_T_PMVS "Zeit zwischen zwei zyklischen Sendungen von 3b3 [A2L-ref]" VALUE 0x775C9 RL_VAL_UB 0 CM_0108 0 255 /end CHARACTERISTIC
/begin CHARACTERISTIC K_T_PTCKWAN "PTC-Ein Wartezeit nach Motor an. [A2L-ref]" VALUE 0x775CA RL_VAL_UB 0 CM_0023 0 25.5 /end CHARACTERISTIC
/begin CHARACTERISTIC K_T_PTCPI "T-Faktor des PI-Reglers f???r PTC-Ansteuerung [A2L-ref]" VALUE 0x775A2 RL_VAL_UW 0 CM_0023 0 6553.5 /end CHARACTERISTIC
/begin CHARACTERISTIC K_T_RUHAUSW "min 0.0p 4 14*x/15 Minimal verstrichene Zeit f?r Ruheverl. Auswertung [verified]" VALUE 0x7746F RL_VAL_UB 0 CM_0419 0 238 /end CHARACTERISTIC
/begin CHARACTERISTIC K_T_SQSHIFT "Delayzeit f?r Soc_quali Info-shift [verified]" VALUE 0x77470 RL_VAL_UB 0 CM_0023 0 25.5 /end CHARACTERISTIC
/begin CHARACTERISTIC K_T_SULEVON "Zeit f???r SULEV-ctrpwrcos-prios nach Motorstart [A2L-ref]" VALUE 0x7759C RL_VAL_UW 0 CM_0023 0 6553.5 /end CHARACTERISTIC
/begin CHARACTERISTIC K_T_USPGRSET "Uterspannung Resetzeit [verified]" VALUE 0x77471 RL_VAL_UB 0 CM_0023 0 25.5 /end CHARACTERISTIC
/begin CHARACTERISTIC K_UBAT_LP "K-Faktor des ubatt-tiefpass Filters zur Berechnung von ctrpwrdf [A2L-ref]" VALUE 0x7759E RL_VAL_UW 0 CM_0239 0 0.999984741 /end CHARACTERISTIC
/begin CHARACTERISTIC K_UBTAPP "Batteriespannung Applikationsgroesse [A2L-ref]" VALUE 0x775A8 RL_VAL_UW 0 CM_0420 0 983.025 /end CHARACTERISTIC
/begin CHARACTERISTIC K_UBTLOWMAX "Obere Unterspannungsgrenze [A2L-ref]" VALUE 0x775AA RL_VAL_UW 0 CM_0421 6 22.38375 /end CHARACTERISTIC
/begin CHARACTERISTIC K_UBTLOWMIN "Untere Unterspannungsgrenze [A2L-ref]" VALUE 0x775AC RL_VAL_UW 0 CM_0421 6 22.38375 /end CHARACTERISTIC
/begin CHARACTERISTIC K_UGENNORM "Generator Normspannung [A2L-ref]" VALUE 0x779A4 RL_VAL_SW 0 CM_0403 -128 127.9960938 /end CHARACTERISTIC
/begin CHARACTERISTIC K_USPGPRELLZ "Anzahl der FS_uspg Entprellungen f???r Fehlereintrag [verified]" VALUE 0x77473 RL_VAL_UB 0 CM_0000 0 255 /end CHARACTERISTIC
/begin CHARACTERISTIC K_ZUST_MD_HYST_LL_TL "MD Hysterese f. Uebergang TL --> LL [verified]" VALUE 0x7B63E RL_VAL_SW 0 CM_0013 -3276.8 3276.7 /end CHARACTERISTIC
/begin CHARACTERISTIC K_ZUST_MD_HYST_TL_VL "MD Hysterese f. Uebergang TL --> VL [verified]" VALUE 0x7B640 RL_VAL_SW 0 CM_0013 -3276.8 3276.7 /end CHARACTERISTIC
/begin CHARACTERISTIC K_ZUST_MD_LL_TL "Momentenschwelle f. Uebergang LL --> TL [verified]" VALUE 0x7B63C RL_VAL_SW 0 CM_0013 -3276.8 3276.7 /end CHARACTERISTIC
/begin CHARACTERISTIC K_ZUST_NL_TIMOUT_INJ "Timeoutueberwachung fuer INJ [verified]" VALUE 0x7B644 RL_VAL_UW 0 CM_0169 0 65535 /end CHARACTERISTIC
/begin CHARACTERISTIC K_ZUST_N_PS_LL "Drehzahlschwelle f. Ueber gang PRESYNC --> LL [verified]" VALUE 0x7B638 RL_VAL_SW 0 CM_0002 -32768 32767 /end CHARACTERISTIC
/begin CHARACTERISTIC K_ZUST_T_NL "Nachlaufzeit [verified]" VALUE 0x7B642 RL_VAL_UW 0 CM_0025 0 655.35 /end CHARACTERISTIC
/begin CHARACTERISTIC S_BSDKOORD "[A2L-ref]" VALUE 0x7092D RL_VAL_UB 0 CM_0000 0 255 /end CHARACTERISTIC
/begin CHARACTERISTIC S_BSOCCALC "Enable R???cksetzten Ruhespannungen IBS [verified]" VALUE 0x77725 RL_VAL_UB 0 CM_0000 0 255 /end CHARACTERISTIC
/begin CHARACTERISTIC S_HTDETEC "Schalter zur Aktivierung ???berwachung Diodentemparatur [verified]" VALUE 0x76C2E RL_VAL_UB 0 CM_0000 0 255 /end CHARACTERISTIC
/begin CHARACTERISTIC S_IPMPTC "PTC Einschr???nkung aufgrund IPM [A2L-ref]" VALUE 0x775CF RL_VAL_UB 0 CM_0000 0 255 /end CHARACTERISTIC
/begin CHARACTERISTIC S_OZBSDKOORD "BSD Koordinator aktiv [A2L-ref]" VALUE 0x70A43 RL_VAL_UB 0 CM_0000 0 255 /end CHARACTERISTIC
/begin CHARACTERISTIC S_PMMESS "Schalter Messemode aktiv [A2L-ref]" VALUE 0x775D1 RL_VAL_UB 0 CM_0000 0 255 /end CHARACTERISTIC
/begin CHARACTERISTIC S_PMSOCFIT "Schalter zur Applikation SoC aus der Fitberechnung [verified]" VALUE 0x7778C RL_VAL_UB 0 CM_0000 0 255 /end CHARACTERISTIC
/begin CHARACTERISTIC S_PMSV_LUFT "Standlueften wird f???r Nibble-historie ausgewertet [verified]" VALUE 0x77476 RL_VAL_UB 0 CM_0000 0 255 /end CHARACTERISTIC
/begin CHARACTERISTIC S_PRIOCFENA "[A2L-ref]" VALUE 0x775D2 RL_VAL_UB 0 CM_0000 0 255 /end CHARACTERISTIC
/begin CHARACTERISTIC S_PRIOMANUAL "Manueller Schalter fuer E60/E65-Can Botschaften [A2L-ref]" VALUE 0x775D3 RL_VAL_UB 0 CM_0000 0 255 /end CHARACTERISTIC
/begin CHARACTERISTIC S_PTCKOOR "Schalter Aktivierung PTC Koordinator im PMPRSVCALC [A2L-ref]" VALUE 0x775D4 RL_VAL_UB 0 CM_0000 0 255 /end CHARACTERISTIC
/begin CHARACTERISTIC S_SOC_BILA "Schalter f???r Applik. soc_bila [verified]" VALUE 0x77726 RL_VAL_UB 0 CM_0000 0 255 /end CHARACTERISTIC
/begin CHARACTERISTIC S_SOC_QUAL "Schalter f???r Applik. soc_quali [verified]" VALUE 0x77727 RL_VAL_UB 0 CM_0000 0 255 /end CHARACTERISTIC
/begin CHARACTERISTIC S_UIBS "Schalter f???r UIBS, wenn True dann uibs=UIBSAPP [A2L-ref]" VALUE 0x77A80 RL_VAL_UB 0 CM_0000 0 255 /end CHARACTERISTIC
/begin CHARACTERISTIC ZK_PMSOC "Zeitfaktor [verified]" VALUE 0x77788 RL_VAL_UW 0 CM_0239 0 0.999984741 /end CHARACTERISTIC
/begin CHARACTERISTIC cfg.betriebsmode "Konfigurationsparameter: SG Typ [A2L-ref]" VALUE 0x78B47 RL_VAL_UB 0 CM_0000 0 255 /end CHARACTERISTIC
/begin CHARACTERISTIC K_DSOCHYST "Hystereschwelle SOC [EST]" VALUE 0x75B38 RL_VAL_SW 0 CM_0395 -99.99999998 99.99694823 /end CHARACTERISTIC
/begin CHARACTERISTIC K_DWF_CFG "Konfiguration DWF-Anzeige [EST]" VALUE 0x70A48 RL_VAL_UW 0 CM_0000 0 65535 /end CHARACTERISTIC
/begin CHARACTERISTIC K_ELU_PWM_OFFS "Offset fuer berechnetes Tastverhaeltnis bei Luefterfunktion [EST]" VALUE 0x72421 RL_VAL_SB 0 CM_0150 -128 127 /end CHARACTERISTIC
/begin CHARACTERISTIC K_ELU_T_MS_MAX "zeitliche Begr. des PWM -Signals der NL-Anforderung [EST]" VALUE 0x7242C RL_VAL_UW 0 CM_0027 0 65535 /end CHARACTERISTIC
/begin CHARACTERISTIC K_FST_TANK_LEER_RECHTS "Fuellstand rechts Tank Leer Info [EST]" VALUE 0x728DD RL_VAL_UB 0 CM_0192 0 127.5 /end CHARACTERISTIC
/begin CHARACTERISTIC K_FST_TANK_LEER_SUM "Summenfuellstand Tank Leer Info [EST]" VALUE 0x728DC RL_VAL_UB 0 CM_0192 0 127.5 /end CHARACTERISTIC
/begin CHARACTERISTIC K_HTGENDFGRO "Schwelle Generaorauslastung zur E-L???fteranforderung [verified]" VALUE 0x76C24 RL_VAL_UB 0 CM_0000 0 255 /end CHARACTERISTIC
/begin CHARACTERISTIC K_KW_ED_SH_TO_GND_RATE "Fehlerrate Kurzschluss nach Masse. [EST]" VALUE 0x741F8 RL_VAL_UW 0 CM_0000 0 65535 /end CHARACTERISTIC
/begin CHARACTERISTIC K_KW_ED_SH_TO_UB_RATE "Fehlerrate Kurzschluss nach Ub. [EST]" VALUE 0x741F6 RL_VAL_UW 0 CM_0000 0 65535 /end CHARACTERISTIC
/begin CHARACTERISTIC K_MSKGENKL61 "Hier k?nnte Ihr Langbezeichner stehen [A2L-ref]" VALUE 0x70922 RL_VAL_UB 0 CM_0422 0 255 /end CHARACTERISTIC
/begin CHARACTERISTIC K_NGENHTMN1 "Untere Drehzahlschwelle f???r kritischen Bereich Didentemparatur [verified]" VALUE 0x76C14 RL_VAL_SW 0 CM_0002 -32768 32767 /end CHARACTERISTIC
/begin CHARACTERISTIC K_NGENHTMX1 "Obere Drehzahlschwelle f???r kritischen Bereich Didentemparatur [verified]" VALUE 0x76C16 RL_VAL_SW 0 CM_0002 -32768 32767 /end CHARACTERISTIC
/begin CHARACTERISTIC K_NKW2LOWPTC "Nkw zu niedrig, PTC wird abgeschaltet [EST]" VALUE 0x7757E RL_VAL_SW 0 CM_0002 -32768 32767 /end CHARACTERISTIC
/begin CHARACTERISTIC K_OZKMUPL "F?r die Kontrolle der Km_st-Plausibilit?t [A2L-ref]" VALUE 0x708D2 RL_VAL_UW 0 CM_0157 0 655350 /end CHARACTERISTIC
/begin CHARACTERISTIC K_OZORLIM2 "Schwelle f?r Orientierungswert ?lniveau (Verlustwarnung) [EST]" VALUE 0x702C0 RL_VAL_UB 0 CM_0123 0 74.70703125 /end CHARACTERISTIC
/begin CHARACTERISTIC K_OZVERZERRBSD "Verz?gerung f?r Peilstab-Fehlerfall beim BSD-Fehler [EST]" VALUE 0x768F1 RL_VAL_UB 0 CM_0027 0 255 /end CHARACTERISTIC
/begin CHARACTERISTIC K_PRIO15 "Prios bei Kl.15, Motor aus [EST]" VALUE 0x775B8 RL_VAL_UB 0 CM_0000 0 255 /end CHARACTERISTIC
/begin CHARACTERISTIC K_SCHALTER_POEL_N_DELAY "Delay fuer n == 0 bei S_POEL-Diagnose [EST]" VALUE 0x784B2 RL_VAL_UW 0 CM_0152 0 6553500 /end CHARACTERISTIC
/begin CHARACTERISTIC K_SCHALTER_POEL_TOEL "Schwelle Oeltemperatur im Nachlauf [EST]" VALUE 0x784B0 RL_VAL_SW 0 CM_0006 -3550 3003.5 /end CHARACTERISTIC
/begin CHARACTERISTIC K_TD_PWRDFPI "K-Faktor des PI Reglers zur Berechnung von ctrpwrdf [EST]" VALUE 0x775A0 RL_VAL_UW 0 CM_0023 0 6553.5 /end CHARACTERISTIC
/begin CHARACTERISTIC K_TE_T_LAA_INI "TE_LAA_INI-Zeit Norma l-start [EST]" VALUE 0x78C5A RL_VAL_UW 0 CM_0023 0 6553.5 /end CHARACTERISTIC
/begin CHARACTERISTIC K_TE_T_SPUEL_INI "ununterbrech. TE -SPUELEN [EST]" VALUE 0x78C62 RL_VAL_UW 0 CM_0023 0 6553.5 /end CHARACTERISTIC
/begin CHARACTERISTIC K_ZUST_POWER "0x0 Inaktiv 0x1 Aktiv 0x2 Ist-Md Konfiguration Powertaster [verified]" VALUE 0x7B636 RL_VAL_UB 0 CM_0000 0 255 /end CHARACTERISTIC
/begin CHARACTERISTIC KL_TE_B_ABBR_VOL_SUM "B_TE_ABBR nur, wenn c_akf kleiner [verified]" CURVE 0x78CB4 RL_CUR_UW_UW 0 CM_0259 0 3.999938965 /begin AXIS_DESCR STD_AXIS NO_INPUT_QUANTITY CM_0351 5 0 14316.3392 /end AXIS_DESCR /end CHARACTERISTIC
/begin CHARACTERISTIC KL_TE_C_AEBG_MSA "Konzentrationsanstieg in MSA [EST]" CURVE 0x78DE6 RL_CUR_SW_UW 0 CM_0428 0 299.9958801 /begin AXIS_DESCR STD_AXIS NO_INPUT_QUANTITY CM_0006 6 -3550 3003.5 /end AXIS_DESCR /end CHARACTERISTIC
/begin CHARACTERISTIC KL_TE_C_RF_MAX "max rf zum C_AKF lernen [EST]" CURVE 0x78C9E RL_CUR_SW_SW 0 CM_0282 -3.2768 3.2767 /begin AXIS_DESCR STD_AXIS NO_INPUT_QUANTITY CM_0002 5 -32768 32767 /end AXIS_DESCR /end CHARACTERISTIC
/begin CHARACTERISTIC KL_TE_GW_LAM_DELTA_FETT "LAM_Delta_F-Fett-Schwelle f. GW [verified]" CURVE 0x78CEE RL_CUR_UW_SW 0 CM_0259 -2 1.999938965 /begin AXIS_DESCR STD_AXIS NO_INPUT_QUANTITY CM_0259 3 0 3.999938965 /end AXIS_DESCR /end CHARACTERISTIC
/begin CHARACTERISTIC KF_TE_TV_A "Koeff A [EST]" MAP 0x79016 RL_MAP_UW_UW_UW 0 CM_0245 0 63.99902344 /begin AXIS_DESCR STD_AXIS NO_INPUT_QUANTITY CM_0314 5 0 6553.5 /end AXIS_DESCR /begin AXIS_DESCR STD_AXIS NO_INPUT_QUANTITY CM_0297 5 0 6553.5 /end AXIS_DESCR /end CHARACTERISTIC
/begin CHARACTERISTIC KF_TE_TV_OFFS_OBEN "Uebergang tv auf 100% Durchfluss [EST]" MAP 0x7905E RL_MAP_UW_UW_UW 0 CM_0091 0 6399.902344 /begin AXIS_DESCR STD_AXIS NO_INPUT_QUANTITY CM_0314 5 0 6553.5 /end AXIS_DESCR /begin AXIS_DESCR STD_AXIS NO_INPUT_QUANTITY CM_0297 5 0 6553.5 /end AXIS_DESCR /end CHARACTERISTIC
/begin CHARACTERISTIC KL_U00QUA_T "QVC U00 - Qualit?tsindex U00 Temperatureinfluss [EST]" CURVE 0x77FFA RL_CUR_UW_SB 0 CM_0418 -128 127 /begin AXIS_DESCR STD_AXIS NO_INPUT_QUANTITY CM_0151 6 0 65535 /end AXIS_DESCR /end CHARACTERISTIC
/begin CHARACTERISTIC K_TOG_CNTMAX "Max Versuche f?r Signal-Fehler Toens [EST]" VALUE 0x70A46 RL_VAL_UW 0 CM_0247 0 655.35 /end CHARACTERISTIC
/begin CHARACTERISTIC KL_LSHVK_T_DELAY "temp. abh. Verzoegerungszeit - Wasserschlagschutz [verified]" CURVE 0x75D5A RL_CUR_SW_UW 0 CM_0247 0 655.35 /begin AXIS_DESCR STD_AXIS NO_INPUT_QUANTITY CM_0006 10 -3550 3003.5 /end AXIS_DESCR /end CHARACTERISTIC
/begin CHARACTERISTIC K_ELU_HYS_SCHLEPP "Hysterese Schleppzeiger [verified]" VALUE 0x72420 RL_VAL_UB 0 CM_0150 0 255 /end CHARACTERISTIC
/begin CHARACTERISTIC K_ELU_TAN_DREH_ERSATZ "Ersatzluefterdrehzahl bei TAN-Fehler [verified]" VALUE 0x72427 RL_VAL_UB 0 CM_0150 0 255 /end CHARACTERISTIC
/begin CHARACTERISTIC K_ELU_T_ML_MIN "Verweilzeit nach Startende [verified]" VALUE 0x7242A RL_VAL_UW 0 CM_0052 0 655350 /end CHARACTERISTIC
/begin CHARACTERISTIC K_OELSTAND_CAN_PST_LI "Oelstand per CAN Ident-381h [EST]" VALUE 0x702B9 RL_VAL_UB 0 CM_0454 0 255 /end CHARACTERISTIC
/begin CHARACTERISTIC K_OZ_ACFZG_FIL "Filterkonstante Beschleuni-gungssensor (Ascet) [verified]" VALUE 0x702BA RL_VAL_UB 0 CM_0250 0 0.99609375 /end CHARACTERISTIC
/begin CHARACTERISTIC K_OZLBESCHS "Laengsbeschleunigung Aus-blendung-Schwelle im Stand [verified]" VALUE 0x702BB RL_VAL_SB 0 CM_0249 -32 31.75 /end CHARACTERISTIC
/begin CHARACTERISTIC K_OZL_ORI_BESCH "Laengsbeschl.-Schwelle Orien-tierungsmessung [verified]" VALUE 0x702BC RL_VAL_SB 0 CM_0249 -32 31.75 /end CHARACTERISTIC
/begin CHARACTERISTIC K_OZQBESCHS "Querbeschleunigung Ausblen-dung-Schwelle im Stand [verified]" VALUE 0x702BD RL_VAL_SB 0 CM_0249 -32 31.75 /end CHARACTERISTIC
/begin CHARACTERISTIC K_OZQ_ORI_BESCH "Querbeschl.-Schwelle Orientie-rungsmessung [verified]" VALUE 0x702BE RL_VAL_SB 0 CM_0249 -32 31.75 /end CHARACTERISTIC
/begin CHARACTERISTIC K_OZAQNIVBEGR "Querbeschl.-Ausblendung Linkskurve [verified]" VALUE 0x702BF RL_VAL_SB 0 CM_0249 -32 31.75 /end CHARACTERISTIC
/begin CHARACTERISTIC K_CW_OZ_2 "Codeword OZ - 2 [verified]" VALUE 0x767E6 RL_VAL_UW 0 CM_0000 0 65535 /end CHARACTERISTIC
/begin CHARACTERISTIC K_CW_OZ_PERM "Codeword Permittivit?t [verified]" VALUE 0x767E8 RL_VAL_UB 0 CM_0000 0 255 /end CHARACTERISTIC
/begin CHARACTERISTIC K_OZSTZYK "Max Permittivit?tsfahler f?r die Niveau-Freigabe [verified]" VALUE 0x76804 RL_VAL_UB 0 CM_0000 0 255 /end CHARACTERISTIC
/begin CHARACTERISTIC K_TE_TV_A_OFFS "Offset auf te_tv_a_kf [verified]" VALUE 0x78C6C RL_VAL_UW 0 CM_0245 0 63.99902344 /end CHARACTERISTIC
/begin CHARACTERISTIC K_TE_TV_MAX "max. Tastverhaeltnis TEV [verified]" VALUE 0x78C70 RL_VAL_UW 0 CM_0091 0 6399.902344 /end CHARACTERISTIC
/begin CHARACTERISTIC K_TE_X_ML_BETRIEB_OFFS "Offset fuer te_x_ml_betrieb [verified]" VALUE 0x78C72 RL_VAL_UW 0 CM_0307 0 1.999969482 /end CHARACTERISTIC
/begin CHARACTERISTIC K_TE_ZU_NORM "TEV Zufahrtzeit - Normal-betrieb [verified]" VALUE 0x78C7E RL_VAL_UW 0 CM_0301 0 6553.5 /end CHARACTERISTIC
/begin CHARACTERISTIC K_TE_ZU_SA "TEV Zufahrtzeit - B_ZUST_SA [verified]" VALUE 0x78C82 RL_VAL_UW 0 CM_0301 0 6553.5 /end CHARACTERISTIC
/begin CHARACTERISTIC K_FST_ABWEICHUNG "Zulaessige Abweichung Ve r-brauch/Fuellstand [verified]" VALUE 0x728D6 RL_VAL_UB 0 CM_0257 0 127.5 /end CHARACTERISTIC
/begin CHARACTERISTIC K_FST_NACHTANK "Delta fuer Nachtankerkennung [verified]" VALUE 0x728DA RL_VAL_UB 0 CM_0257 0 127.5 /end CHARACTERISTIC
/begin CHARACTERISTIC K_FST_FILT "Filter Geberwert Li/Re [verified]" VALUE 0x728DB RL_VAL_UB 0 CM_0424 1.003921569 256 /end CHARACTERISTIC
/begin CHARACTERISTIC K_FST_VOLL "Maximaler Fuellstand fuer Volld i-agnose [verified]" VALUE 0x728DE RL_VAL_UB 0 CM_0257 0 127.5 /end CHARACTERISTIC
/begin CHARACTERISTIC K_FST_V_BETANK_END "Geschw. fuer Tanken beendet [verified]" VALUE 0x728E0 RL_VAL_SW 0 CM_0260 -2048 2047.9375 /end CHARACTERISTIC
/begin CHARACTERISTIC K_FST_VERBRAUCH "FST-Plausi, wenn soviel ve r-braucht [verified]" VALUE 0x728E2 RL_VAL_UB 0 CM_0257 0 127.5 /end CHARACTERISTIC
/begin CHARACTERISTIC K_FST_VERBRAUCH_VOLL "Unplausibl. Verbrauch bei FST voll [verified]" VALUE 0x728E3 RL_VAL_UB 0 CM_0257 0 127.5 /end CHARACTERISTIC
/begin CHARACTERISTIC K_DMTL_TE_AKTIV_MIN "2 x*1000/166666 Min. TEV1 Aktivzeit fuer TEV -Check [verified]" VALUE 0x7098C RL_VAL_UW 0 CM_0169 0 65535 /end CHARACTERISTIC
/begin CHARACTERISTIC K_OZPERMRMIN "Grenze f?r Niveauberechnung aus Permittivit?t [verified]" VALUE 0x767F6 RL_VAL_UW 0 CM_0000 0 65535 /end CHARACTERISTIC
/begin CHARACTERISTIC K_OZPERMRMIN_1 "Grenze f?r Niveauberechnung aus Permittivit?t [verified]" VALUE 0x767F8 RL_VAL_UW 0 CM_0000 0 65535 /end CHARACTERISTIC
/begin CHARACTERISTIC K_HISTDMERST "Manueller Reset d. Histogramm in der DME [verified]" VALUE 0x77467 RL_VAL_UB 0 CM_0000 0 255 /end CHARACTERISTIC
/begin CHARACTERISTIC K_HISTIBSRST "Manueller Histogramm Reset in IBS [verified]" VALUE 0x77468 RL_VAL_UB 0 CM_0000 0 255 /end CHARACTERISTIC
/begin CHARACTERISTIC K_TRINGSHIFT "min 0.0p 4 14*x/15 Ruhezeit nachdem der Ruhestrom -Ringspeicher eingetragen wird. [verified]" VALUE 0x7746D RL_VAL_UB 0 CM_0108 0 255 /end CHARACTERISTIC
/begin CHARACTERISTIC KF_PMRIBAT2 "Kennfeld Innenwiderstand Batterie2 [verified]" MAP 0x77882 RL_MAP_UW_UW_UB 0 CM_0245 0 0.2490234375 /begin AXIS_DESCR STD_AXIS NO_INPUT_QUANTITY CM_0151 4 0 65535 /end AXIS_DESCR /begin AXIS_DESCR STD_AXIS NO_INPUT_QUANTITY CM_0464 6 -200 5042.8 /end AXIS_DESCR /end CHARACTERISTIC
/begin CHARACTERISTIC KF_PMRIBAT8 "Kennfeld Innenwiderstand Batterie8 [verified]" MAP 0x7779C RL_MAP_UW_UW_UB 0 CM_0245 0 0.2490234375 /begin AXIS_DESCR STD_AXIS NO_INPUT_QUANTITY CM_0151 4 0 65535 /end AXIS_DESCR /begin AXIS_DESCR STD_AXIS NO_INPUT_QUANTITY CM_0464 6 -200 5042.8 /end AXIS_DESCR /end CHARACTERISTIC
/begin CHARACTERISTIC KF_PMRIBAT6 "Kennfeld Innenwiderstand Batterie6 [verified]" MAP 0x777CA RL_MAP_UW_UW_UB 0 CM_0245 0 0.2490234375 /begin AXIS_DESCR STD_AXIS NO_INPUT_QUANTITY CM_0151 4 0 65535 /end AXIS_DESCR /begin AXIS_DESCR STD_AXIS NO_INPUT_QUANTITY CM_0464 6 -200 5042.8 /end AXIS_DESCR /end CHARACTERISTIC
/begin CHARACTERISTIC KF_PMRIBAT5 "Kennfeld Innenwiderstand Batterie5 [verified]" MAP 0x777F8 RL_MAP_UW_UW_UB 0 CM_0245 0 0.2490234375 /begin AXIS_DESCR STD_AXIS NO_INPUT_QUANTITY CM_0151 4 0 65535 /end AXIS_DESCR /begin AXIS_DESCR STD_AXIS NO_INPUT_QUANTITY CM_0464 6 -200 5042.8 /end AXIS_DESCR /end CHARACTERISTIC
/begin CHARACTERISTIC KF_PMRIBAT3 "Kennfeld Innenwiderstand Batterie3 [verified]" MAP 0x77826 RL_MAP_UW_UW_UB 0 CM_0245 0 0.2490234375 /begin AXIS_DESCR STD_AXIS NO_INPUT_QUANTITY CM_0151 4 0 65535 /end AXIS_DESCR /begin AXIS_DESCR STD_AXIS NO_INPUT_QUANTITY CM_0464 6 -200 5042.8 /end AXIS_DESCR /end CHARACTERISTIC
/begin CHARACTERISTIC KF_PMRIBAT4 "Kennfeld Innenwiderstand Batterie4 [verified]" MAP 0x77854 RL_MAP_UW_UW_UB 0 CM_0245 0 0.2490234375 /begin AXIS_DESCR STD_AXIS NO_INPUT_QUANTITY CM_0151 4 0 65535 /end AXIS_DESCR /begin AXIS_DESCR STD_AXIS NO_INPUT_QUANTITY CM_0464 6 -200 5042.8 /end AXIS_DESCR /end CHARACTERISTIC
/begin CHARACTERISTIC KF_PMRIBAT7 "Kennfeld Innenwiderstand Batterie7 [verified]" MAP 0x778DE RL_MAP_UW_UW_UB 0 CM_0245 0 0.2490234375 /begin AXIS_DESCR STD_AXIS NO_INPUT_QUANTITY CM_0151 4 0 65535 /end AXIS_DESCR /begin AXIS_DESCR STD_AXIS NO_INPUT_QUANTITY CM_0464 6 -200 5042.8 /end AXIS_DESCR /end CHARACTERISTIC
/begin CHARACTERISTIC KL_TMAXDIODE "Zul?ssige Diodenmaximaltemperatur [verified]" CURVE 0x76C3E RL_CUR_SB_UW 0 CM_0151 0 65535 /begin AXIS_DESCR STD_AXIS NO_INPUT_QUANTITY CM_0465 6 -128 127 /end AXIS_DESCR /end CHARACTERISTIC
/begin CHARACTERISTIC KL_RTHJADIOD "Temperaturkoeffizient der Diode [verified]" CURVE 0x76C52 RL_CUR_SB_SW 0 CM_0418 -32768 32767 /begin AXIS_DESCR STD_AXIS NO_INPUT_QUANTITY CM_0465 6 -128 127 /end AXIS_DESCR /end CHARACTERISTIC
/begin CHARACTERISTIC KF_UFDIODE "Kennfeld f?r Diodenvorw?rtsspannung [verified]" MAP 0x76C80 RL_MAP_UW_SB_SW 0 CM_0418 -32768 32767 /begin AXIS_DESCR STD_AXIS NO_INPUT_QUANTITY CM_0151 2 0 65535 /end AXIS_DESCR /begin AXIS_DESCR STD_AXIS NO_INPUT_QUANTITY CM_0465 6 -128 127 /end AXIS_DESCR /end CHARACTERISTIC
/begin CHARACTERISTIC KF_LORESP "Kennfeld Loadresponse ueber Motordrehzahl und rel. Luftmasse [verified]" MAP 0x73D66 RL_MAP_SW_SW_UB 0 CM_0301 0 25.5 /begin AXIS_DESCR STD_AXIS NO_INPUT_QUANTITY CM_0467 6 -32768 32767 /end AXIS_DESCR /begin AXIS_DESCR STD_AXIS NO_INPUT_QUANTITY CM_0000 6 -32768 32767 /end AXIS_DESCR /end CHARACTERISTIC
/begin CHARACTERISTIC KF_LORESPKH "Loadresponse bei Kat-Heizen [verified]" MAP 0x73CEA RL_MAP_SW_SW_UB 0 CM_0301 0 25.5 /begin AXIS_DESCR STD_AXIS NO_INPUT_QUANTITY CM_0467 6 -32768 32767 /end AXIS_DESCR /begin AXIS_DESCR STD_AXIS NO_INPUT_QUANTITY CM_0000 6 -32768 32767 /end AXIS_DESCR /end CHARACTERISTIC
/begin CHARACTERISTIC KF_LRWAFS "Loadresponse bei Lenken mit EPS [verified]" MAP 0x73D28 RL_MAP_SW_SW_UB 0 CM_0301 0 25.5 /begin AXIS_DESCR STD_AXIS NO_INPUT_QUANTITY CM_0276 6 -3276.8 3276.7 /end AXIS_DESCR /begin AXIS_DESCR STD_AXIS NO_INPUT_QUANTITY CM_0276 6 -3276.8 3276.7 /end AXIS_DESCR /end CHARACTERISTIC
/begin CHARACTERISTIC K_SCHWPRSPWGLR1 "Schwellwert f?r Spannungsreglereingriff auf Loadresponse [verified]" VALUE 0x73CB6 RL_VAL_UB 0 CM_0000 0 255 /end CHARACTERISTIC
/begin CHARACTERISTIC K_SCHWPRSPWGLR2 "Schwellwert f?r Spannungsreglereingriff auf Loadresponse [verified]" VALUE 0x73CB7 RL_VAL_UB 0 CM_0000 0 255 /end CHARACTERISTIC
/begin CHARACTERISTIC K_SCHWPRSPWGLR3 "Schwellwert f?r Spannungsreglereingriff auf Loadresponse [verified]" VALUE 0x73CB8 RL_VAL_UB 0 CM_0000 0 255 /end CHARACTERISTIC
/begin CHARACTERISTIC K_SCHWPRSPWGLR4 "Schwellwert f?r Spannungsreglereingriff auf Loadresponse [verified]" VALUE 0x73CB9 RL_VAL_UB 0 CM_0000 0 255 /end CHARACTERISTIC
/begin CHARACTERISTIC K_SCHWPRSPWGLR5 "Schwellwert f?r Spannungsreglereingriff auf Loadresponse [verified]" VALUE 0x73CBA RL_VAL_UB 0 CM_0000 0 255 /end CHARACTERISTIC
/begin CHARACTERISTIC K_LRBNS "Loadrespo?nse bei Warnun g Bordnetzstabilit?t gef?hrdet [EST]" VALUE 0x73CB3 RL_VAL_UB 0 CM_0301 0 25.5 /end CHARACTERISTIC
/begin CHARACTERISTIC K_LRSPGW "Loadresponse bei Spannungsw?chtereingriff [EST]" VALUE 0x73CB1 RL_VAL_UB 0 CM_0301 0 25.5 /end CHARACTERISTIC
/begin CHARACTERISTIC KL_F_GENTYP "Faktor auf Maximalmoment Generator [EST]" CURVE 0x73CD0 RL_CUR_UW_SB 0 CM_0468 -128 127 /begin AXIS_DESCR STD_AXIS NO_INPUT_QUANTITY CM_0000 8 0 65535 /end AXIS_DESCR /end CHARACTERISTIC
/begin COMPU_METHOD CM_0000 "X" RAT_FUNC "%.4g" "-" COEFFS 0 1 0 0 0 1 /end COMPU_METHOD
/begin COMPU_METHOD CM_0002 "X" RAT_FUNC "%.4g" "Upm" COEFFS 0 1 0 0 0 1 /end COMPU_METHOD
/begin COMPU_METHOD CM_0005 "X*0.0061035156" RAT_FUNC "%.4g" "%" COEFFS 0 1 0 0 0 0.0061035156 /end COMPU_METHOD
/begin COMPU_METHOD CM_0006 "X*0.1-273.2" RAT_FUNC "%.4g" "?C" COEFFS 0 1 273.2 0 0 0.1 /end COMPU_METHOD
/begin COMPU_METHOD CM_0010 "X*0.0625" RAT_FUNC "%.4g" "km/h" COEFFS 0 1 0 0 0 0.0625 /end COMPU_METHOD
/begin COMPU_METHOD CM_0011 "327.67/X" RAT_FUNC "%.4g" "s" COEFFS 0 0 -327.67 0 -1 0 /end COMPU_METHOD
/begin COMPU_METHOD CM_0012 "X*0.1" RAT_FUNC "%.4g" "qmm" COEFFS 0 1 0 0 0 0.1 /end COMPU_METHOD
/begin COMPU_METHOD CM_0013 "X*0.1" RAT_FUNC "%.4g" "%" COEFFS 0 1 0 0 0 0.1 /end COMPU_METHOD
/begin COMPU_METHOD CM_0014 "X*0.0001953125" RAT_FUNC "%.4g" "Nm/Upm" COEFFS 0 1 0 0 0 0.0001953125 /end COMPU_METHOD
/begin COMPU_METHOD CM_0015 "X" RAT_FUNC "%.4g" ".Gang" COEFFS 0 1 0 0 0 1 /end COMPU_METHOD
/begin COMPU_METHOD CM_0016 "X*0.0009765625" RAT_FUNC "%.4g" "-" COEFFS 0 1 0 0 0 0.0009765625 /end COMPU_METHOD
/begin COMPU_METHOD CM_0017 "X*0.1" RAT_FUNC "%.4g" "Nm" COEFFS 0 1 0 0 0 0.1 /end COMPU_METHOD
/begin COMPU_METHOD CM_0019 "X*0.0000610352" RAT_FUNC "%.4g" "-" COEFFS 0 1 0 0 0 6.10352e-05 /end COMPU_METHOD
/begin COMPU_METHOD CM_0020 "X*0.005" RAT_FUNC "%.4g" "s" COEFFS 0 1 0 0 0 0.005 /end COMPU_METHOD
/begin COMPU_METHOD CM_0021 "X*0.1" RAT_FUNC "%.4g" "V" COEFFS 0 1 0 0 0 0.1 /end COMPU_METHOD
/begin COMPU_METHOD CM_0022 "X*0.0625" RAT_FUNC "%.4g" "mbar" COEFFS 0 1 0 0 0 0.0625 /end COMPU_METHOD
/begin COMPU_METHOD CM_0023 "X*0.1" RAT_FUNC "%.4g" "s" COEFFS 0 1 0 0 0 0.1 /end COMPU_METHOD
/begin COMPU_METHOD CM_0024 "X*0.1" RAT_FUNC "%.4g" "Kelvin" COEFFS 0 1 0 0 0 0.1 /end COMPU_METHOD
/begin COMPU_METHOD CM_0025 "X*0.01" RAT_FUNC "%.4g" "s" COEFFS 0 1 0 0 0 0.01 /end COMPU_METHOD
/begin COMPU_METHOD CM_0027 "X" RAT_FUNC "%.4g" "s" COEFFS 0 1 0 0 0 1 /end COMPU_METHOD
/begin COMPU_METHOD CM_0032 "X*5.0" RAT_FUNC "%.4g" "ms" COEFFS 0 1 0 0 0 5 /end COMPU_METHOD
/begin COMPU_METHOD CM_0037 "X*0.0078125" RAT_FUNC "%.4g" "-" COEFFS 0 1 0 0 0 0.0078125 /end COMPU_METHOD
/begin COMPU_METHOD CM_0042 "X*0.025" RAT_FUNC "%.4g" "m/(s*s)" COEFFS 0 1 0 0 0 0.025 /end COMPU_METHOD
/begin COMPU_METHOD CM_0051 "X*0.0000305176" RAT_FUNC "%.4g" "-" COEFFS 0 1 0 0 0 3.05176e-05 /end COMPU_METHOD
/begin COMPU_METHOD CM_0052 "X*10.0" RAT_FUNC "%.4g" "ms" COEFFS 0 1 0 0 0 10 /end COMPU_METHOD
/begin COMPU_METHOD CM_0057 "X" RAT_FUNC "%.4g" "V" COEFFS 0 1 0 0 0 1 /end COMPU_METHOD
/begin COMPU_METHOD CM_0065 "1.28/X" RAT_FUNC "%.4g" "s" COEFFS 0 0 -1.28 0 -1 0 /end COMPU_METHOD
/begin COMPU_METHOD CM_0082 "X" RAT_FUNC "%.4g" "km" COEFFS 0 1 0 0 0 1 /end COMPU_METHOD
/begin COMPU_METHOD CM_0087 "X" RAT_FUNC "%.4g" "digit" COEFFS 0 1 0 0 0 1 /end COMPU_METHOD
/begin COMPU_METHOD CM_0091 "X*0.09765625" RAT_FUNC "%.4g" "%" COEFFS 0 1 0 0 0 0.09765625 /end COMPU_METHOD
/begin COMPU_METHOD CM_0102 "X*0.1" RAT_FUNC "%.4g" "kg/h" COEFFS 0 1 0 0 0 0.1 /end COMPU_METHOD
/begin COMPU_METHOD CM_0106 "X" RAT_FUNC "%.4g" "raw" COEFFS 0 1 0 0 0 1 /end COMPU_METHOD
/begin COMPU_METHOD CM_0107 "X*0.025-273.15" RAT_FUNC "%.4g" "?C" COEFFS 0 1 273.15 0 0 0.025 /end COMPU_METHOD
/begin COMPU_METHOD CM_0108 "X" RAT_FUNC "%.4g" "min" COEFFS 0 1 0 0 0 1 /end COMPU_METHOD
/begin COMPU_METHOD CM_0123 "X*0.29296875" RAT_FUNC "%.4g" "mm" COEFFS 0 1 0 0 0 0.29296875 /end COMPU_METHOD
/begin COMPU_METHOD CM_0129 "X*0.02" RAT_FUNC "%.4g" "A" COEFFS 0 1 0 0 0 0.02 /end COMPU_METHOD
/begin COMPU_METHOD CM_0140 "X*0.015625" RAT_FUNC "%.4g" "mg" COEFFS 0 1 0 0 0 0.015625 /end COMPU_METHOD
/begin COMPU_METHOD CM_0141 "X*0.001" RAT_FUNC "%.4g" "ms" COEFFS 0 1 0 0 0 0.001 /end COMPU_METHOD
/begin COMPU_METHOD CM_0142 "X*0.001" RAT_FUNC "%.4g" "bar" COEFFS 0 1 0 0 0 0.001 /end COMPU_METHOD
/begin COMPU_METHOD CM_0150 "X" RAT_FUNC "%.4g" "%" COEFFS 0 1 0 0 0 1 /end COMPU_METHOD
/begin COMPU_METHOD CM_0151 "X" RAT_FUNC "%.4g" "?C" COEFFS 0 1 0 0 0 1 /end COMPU_METHOD
/begin COMPU_METHOD CM_0152 "X*100.0" RAT_FUNC "%.4g" "ms" COEFFS 0 1 0 0 0 100 /end COMPU_METHOD
/begin COMPU_METHOD CM_0156 "X*0.01" RAT_FUNC "%.4g" "?C" COEFFS 0 1 0 0 0 0.01 /end COMPU_METHOD
/begin COMPU_METHOD CM_0157 "X*10.0" RAT_FUNC "%.4g" "km" COEFFS 0 1 0 0 0 10 /end COMPU_METHOD
/begin COMPU_METHOD CM_0158 "X*0.390625" RAT_FUNC "%.4g" "%" COEFFS 0 1 0 0 0 0.390625 /end COMPU_METHOD
/begin COMPU_METHOD CM_0159 "X*0.1" RAT_FUNC "%.4g" "?C" COEFFS 0 1 0 0 0 0.1 /end COMPU_METHOD
/begin COMPU_METHOD CM_0160 "X*0.0156250000" RAT_FUNC "%.4g" "-" COEFFS 0 1 0 0 0 0.015625 /end COMPU_METHOD
/begin COMPU_METHOD CM_0163 "X*4.8828125" RAT_FUNC "%.4g" "mV" COEFFS 0 1 0 0 0 4.8828125 /end COMPU_METHOD
/begin COMPU_METHOD CM_0164 "X*0.00390625" RAT_FUNC "%.4g" "-" COEFFS 0 1 0 0 0 0.00390625 /end COMPU_METHOD
/begin COMPU_METHOD CM_0169 "X" RAT_FUNC "%.4g" "ms" COEFFS 0 1 0 0 0 1 /end COMPU_METHOD
/begin COMPU_METHOD CM_0174 "X*0.1" RAT_FUNC "%.4g" "Ohm" COEFFS 0 1 0 0 0 0.1 /end COMPU_METHOD
/begin COMPU_METHOD CM_0176 "X*0.0488281250" RAT_FUNC "%.4g" "%" COEFFS 0 1 0 0 0 0.048828125 /end COMPU_METHOD
/begin COMPU_METHOD CM_0178 "X*100.0" RAT_FUNC "%.4g" "-" COEFFS 0 1 0 0 0 100 /end COMPU_METHOD
/begin COMPU_METHOD CM_0179 "X*0.0009765625" RAT_FUNC "%.4g" "(kg/h)/mbar" COEFFS 0 1 0 0 0 0.0009765625 /end COMPU_METHOD
/begin COMPU_METHOD CM_0180 "X*50.0" RAT_FUNC "%.4g" "bar/s" COEFFS 0 1 0 0 0 50 /end COMPU_METHOD
/begin COMPU_METHOD CM_0181 "X*0.001953125" RAT_FUNC "%.4g" "kg/h" COEFFS 0 1 0 0 0 0.001953125 /end COMPU_METHOD
/begin COMPU_METHOD CM_0182 "X*0.0625" RAT_FUNC "%.4g" "1/2^20" COEFFS 0 1 0 0 0 0.0625 /end COMPU_METHOD
/begin COMPU_METHOD CM_0183 "X*0.0125" RAT_FUNC "%.4g" "kg/h" COEFFS 0 1 0 0 0 0.0125 /end COMPU_METHOD
/begin COMPU_METHOD CM_0184 "X*0.0125" RAT_FUNC "%.4g" "mbar/V" COEFFS 0 1 0 0 0 0.0125 /end COMPU_METHOD
/begin COMPU_METHOD CM_0185 "X*0.1" RAT_FUNC "%.4g" "ccm" COEFFS 0 1 0 0 0 0.1 /end COMPU_METHOD
/begin COMPU_METHOD CM_0186 "X*0.125" RAT_FUNC "%.4g" "A" COEFFS 0 1 0 0 0 0.125 /end COMPU_METHOD
/begin COMPU_METHOD CM_0191 "X*0.0942" RAT_FUNC "%.4g" "V" COEFFS 0 1 0 0 0 0.0942 /end COMPU_METHOD
/begin COMPU_METHOD CM_0192 "X*0.5" RAT_FUNC "%.4g" "l" COEFFS 0 1 0 0 0 0.5 /end COMPU_METHOD
/begin COMPU_METHOD CM_0194 "X*0.0182002022" RAT_FUNC "%.4g" "Ah" COEFFS 0 1 0 0 0 0.0182002022 /end COMPU_METHOD
/begin COMPU_METHOD CM_0195 "X*0.00025+6.0" RAT_FUNC "%.4g" "-" COEFFS 0 1 -6 0 0 0.00025 /end COMPU_METHOD
/begin COMPU_METHOD CM_0196 "X*0.25" RAT_FUNC "%.4g" "-" COEFFS 0 1 0 0 0 0.25 /end COMPU_METHOD
/begin COMPU_METHOD CM_0197 "X*0.0078125" RAT_FUNC "%.4g" "%" COEFFS 0 1 0 0 0 0.0078125 /end COMPU_METHOD
/begin COMPU_METHOD CM_0198 "X*0.0030517578" RAT_FUNC "%.4g" "-" COEFFS 0 1 0 0 0 0.0030517578 /end COMPU_METHOD
/begin COMPU_METHOD CM_0199 "X*0.0015258789" RAT_FUNC "%.4g" "%" COEFFS 0 1 0 0 0 0.0015258789 /end COMPU_METHOD
/begin COMPU_METHOD CM_0200 "X*3.9062500000" RAT_FUNC "%.4g" "A" COEFFS 0 1 0 0 0 3.90625 /end COMPU_METHOD
/begin COMPU_METHOD CM_0201 "X*0.5" RAT_FUNC "%.4g" "%" COEFFS 0 1 0 0 0 0.5 /end COMPU_METHOD
/begin COMPU_METHOD CM_0202 "X*14.0" RAT_FUNC "%.4g" "s" COEFFS 0 1 0 0 0 14 /end COMPU_METHOD
/begin COMPU_METHOD CM_0203 "X*56.0" RAT_FUNC "%.4g" "s" COEFFS 0 1 0 0 0 56 /end COMPU_METHOD
/begin COMPU_METHOD CM_0204 "X*0.0015258789" RAT_FUNC "%.4g" "-" COEFFS 0 1 0 0 0 0.0015258789 /end COMPU_METHOD
/begin COMPU_METHOD CM_0205 "X*0.125" RAT_FUNC "%.4g" "-" COEFFS 0 1 0 0 0 0.125 /end COMPU_METHOD
/begin COMPU_METHOD CM_0211 "X*0.00225" RAT_FUNC "%.4g" "mA" COEFFS 0 1 0 0 0 0.00225 /end COMPU_METHOD
/begin COMPU_METHOD CM_0212 "X*0.1706666" RAT_FUNC "%.4g" "min" COEFFS 0 1 0 0 0 0.1706666 /end COMPU_METHOD
/begin COMPU_METHOD CM_0213 "X*0.5" RAT_FUNC "%.4g" "ms" COEFFS 0 1 0 0 0 0.5 /end COMPU_METHOD
/begin COMPU_METHOD CM_0214 "X*0.01" RAT_FUNC "%.4g" "ms" COEFFS 0 1 0 0 0 0.01 /end COMPU_METHOD
/begin COMPU_METHOD CM_0215 "X*0.1" RAT_FUNC "%.4g" "Hz" COEFFS 0 1 0 0 0 0.1 /end COMPU_METHOD
/begin COMPU_METHOD CM_0216 "X*0.009765625" RAT_FUNC "%.4g" "1/s" COEFFS 0 1 0 0 0 0.009765625 /end COMPU_METHOD
/begin COMPU_METHOD CM_0217 "X*3.0" RAT_FUNC "%.4g" "kg/(m2*s)" COEFFS 0 1 0 0 0 3 /end COMPU_METHOD
/begin COMPU_METHOD CM_0218 "X*9.0" RAT_FUNC "%.4g" "(kg/(m2*s))2" COEFFS 0 1 0 0 0 9 /end COMPU_METHOD
/begin COMPU_METHOD CM_0222 "X*0.625" RAT_FUNC "%.4g" "mbar/s" COEFFS 0 1 0 0 0 0.625 /end COMPU_METHOD
/begin COMPU_METHOD CM_0236 "X*0.00006103515625" RAT_FUNC "%.4g" "-" COEFFS 0 1 0 0 0 6.103515625e-05 /end COMPU_METHOD
/begin COMPU_METHOD CM_0237 "X*0.000030517578125" RAT_FUNC "%.4g" "-" COEFFS 0 1 0 0 0 3.051757812e-05 /end COMPU_METHOD
/begin COMPU_METHOD CM_0239 "X*0.0000152587890625" RAT_FUNC "%.4g" "-" COEFFS 0 1 0 0 0 1.525878906e-05 /end COMPU_METHOD
/begin COMPU_METHOD CM_0240 "X/1000" RAT_FUNC "%.4g" "bar" COEFFS 0 1000 0 0 0 1 /end COMPU_METHOD
/begin COMPU_METHOD CM_0241 "X*75/256" RAT_FUNC "%.4g" "mm" COEFFS 0 256 0 0 0 75 /end COMPU_METHOD
/begin COMPU_METHOD CM_0242 "X*128/65536" RAT_FUNC "%.4g" "-" COEFFS 0 512 0 0 0 1 /end COMPU_METHOD
/begin COMPU_METHOD CM_0243 "X/10" RAT_FUNC "%.4g" "?C" COEFFS 0 10 0 0 0 1 /end COMPU_METHOD
/begin COMPU_METHOD CM_0244 "X/100" RAT_FUNC "%.4g" "?C" COEFFS 0 100 0 0 0 1 /end COMPU_METHOD
/begin COMPU_METHOD CM_0245 "X*32/32768" RAT_FUNC "%.4g" "-" COEFFS 0 1024 0 0 0 1 /end COMPU_METHOD
/begin COMPU_METHOD CM_0246 "X" RAT_FUNC "%.4g" "hPa" COEFFS 0 1 0 0 0 1 /end COMPU_METHOD
/begin COMPU_METHOD CM_0247 "X/100" RAT_FUNC "%.4g" "s" COEFFS 0 100 0 0 0 1 /end COMPU_METHOD
/begin COMPU_METHOD CM_0248 "X*10/65536" RAT_FUNC "%.4g" "%" COEFFS 0 32768 0 0 0 5 /end COMPU_METHOD
/begin COMPU_METHOD CM_0249 "X/4" RAT_FUNC "%.4g" "-" COEFFS 0 4 0 0 0 1 /end COMPU_METHOD
/begin COMPU_METHOD CM_0250 "X/256" RAT_FUNC "%.4g" "-" COEFFS 0 256 0 0 0 1 /end COMPU_METHOD
/begin COMPU_METHOD CM_0256 "(X-2732)/10" RAT_FUNC "%.4g" "?C" COEFFS 0 10 2732 0 0 1 /end COMPU_METHOD
/begin COMPU_METHOD CM_0257 "X/2" RAT_FUNC "%.4g" "l" COEFFS 0 2 0 0 0 1 /end COMPU_METHOD
/begin COMPU_METHOD CM_0258 "X*0.1-273.2" RAT_FUNC "%.4g" "degC" COEFFS 0 1 273.2 0 0 0.1 /end COMPU_METHOD
/begin COMPU_METHOD CM_0259 "X/16384" RAT_FUNC "%.4g" "-" COEFFS 0 16384 0 0 0 1 /end COMPU_METHOD
/begin COMPU_METHOD CM_0260 "X/16" RAT_FUNC "%.4g" "km/h" COEFFS 0 16 0 0 0 1 /end COMPU_METHOD
/begin COMPU_METHOD CM_0269 "X/128" RAT_FUNC "%.4g" "-" COEFFS 0 128 0 0 0 1 /end COMPU_METHOD
/begin COMPU_METHOD CM_0274 "X*6/10" RAT_FUNC "%.4g" "ms" COEFFS 0 5 0 0 0 3 /end COMPU_METHOD
/begin COMPU_METHOD CM_0275 "X/512" RAT_FUNC "%.4g" "%/100ms" COEFFS 0 512 0 0 0 1 /end COMPU_METHOD
/begin COMPU_METHOD CM_0276 "X/10" RAT_FUNC "%.4g" "%" COEFFS 0 10 0 0 0 1 /end COMPU_METHOD
/begin COMPU_METHOD CM_0277 "2.56/X" RAT_FUNC "%.4g" "s" COEFFS 0 0 -2.56 0 -1 0 /end COMPU_METHOD
/begin COMPU_METHOD CM_0282 "X/10000" RAT_FUNC "%.4g" "-" COEFFS 0 10000 0 0 0 1 /end COMPU_METHOD
/begin COMPU_METHOD CM_0284 "X/255" RAT_FUNC "%.4g" "-" COEFFS 0 255 0 0 0 1 /end COMPU_METHOD
/begin COMPU_METHOD CM_0288 "X/40" RAT_FUNC "%.4g" "m/(s*s)" COEFFS 0 40 0 0 0 1 /end COMPU_METHOD
/begin COMPU_METHOD CM_0291 "X/16" RAT_FUNC "%.4g" "mbar" COEFFS 0 16 0 0 0 1 /end COMPU_METHOD
/begin COMPU_METHOD CM_0297 "X/10" RAT_FUNC "%.4g" "V" COEFFS 0 10 0 0 0 1 /end COMPU_METHOD
/begin COMPU_METHOD CM_0300 "X" RAT_FUNC "%.4g" "Diags" COEFFS 0 1 0 0 0 1 /end COMPU_METHOD
/begin COMPU_METHOD CM_0301 "X/10" RAT_FUNC "%.4g" "s" COEFFS 0 10 0 0 0 1 /end COMPU_METHOD
/begin COMPU_METHOD CM_0303 "X/40-273.15" RAT_FUNC "%.4g" "?C" COEFFS 0 40 10926 0 0 1 /end COMPU_METHOD
/begin COMPU_METHOD CM_0306 "25.6/X" RAT_FUNC "%.4g" "s" COEFFS 0 0 -25.6 0 -1 0 /end COMPU_METHOD
/begin COMPU_METHOD CM_0307 "X/32768" RAT_FUNC "%.4g" "-" COEFFS 0 32768 0 0 0 1 /end COMPU_METHOD
/begin COMPU_METHOD CM_0308 "X/4000+6" RAT_FUNC "%.4g" "V" COEFFS 0 4000 -24000 0 0 1 /end COMPU_METHOD
/begin COMPU_METHOD CM_0309 "X/8000" RAT_FUNC "%.4g" "V" COEFFS 0 8000 0 0 0 1 /end COMPU_METHOD
/begin COMPU_METHOD CM_0310 "X*30/103" RAT_FUNC "%.4g" "Ah" COEFFS 0 103 0 0 0 30 /end COMPU_METHOD
/begin COMPU_METHOD CM_0313 "X" RAT_FUNC "%.4g" "J/kgK" COEFFS 0 1 0 0 0 1 /end COMPU_METHOD
/begin COMPU_METHOD CM_0314 "X/10" RAT_FUNC "%.4g" "Hz" COEFFS 0 10 0 0 0 1 /end COMPU_METHOD
/begin COMPU_METHOD CM_0318 "X/500" RAT_FUNC "%.4g" "l/min" COEFFS 0 500 0 0 0 1 /end COMPU_METHOD
/begin COMPU_METHOD CM_0319 "X/64" RAT_FUNC "%.4g" "mOhm" COEFFS 0 64 0 0 0 1 /end COMPU_METHOD
/begin COMPU_METHOD CM_0323 "X/10" RAT_FUNC "%.4g" "Kelvin" COEFFS 0 10 0 0 0 1 /end COMPU_METHOD
/begin COMPU_METHOD CM_0324 "6553.5/X" RAT_FUNC "%.4g" "s" COEFFS 0 0 -6553.5 0 -1 0 /end COMPU_METHOD
/begin COMPU_METHOD CM_0335 "X/40" RAT_FUNC "%.4g" "?C" COEFFS 0 40 0 0 0 1 /end COMPU_METHOD
/begin COMPU_METHOD CM_0336 "X" RAT_FUNC "%.4g" "Ah" COEFFS 0 1 0 0 0 1 /end COMPU_METHOD
/begin COMPU_METHOD CM_0337 "X/10" RAT_FUNC "%.4g" "km/h" COEFFS 0 10 0 0 0 1 /end COMPU_METHOD
/begin COMPU_METHOD CM_0338 "X/5" RAT_FUNC "%.4g" "s" COEFFS 0 5 0 0 0 1 /end COMPU_METHOD
/begin COMPU_METHOD CM_0339 "X" RAT_FUNC "%.4g" "km/h" COEFFS 0 1 0 0 0 1 /end COMPU_METHOD
/begin COMPU_METHOD CM_0340 "X/8" RAT_FUNC "%.4g" "A" COEFFS 0 8 0 0 0 1 /end COMPU_METHOD
/begin COMPU_METHOD CM_0341 "X/32" RAT_FUNC "%.4g" "-" COEFFS 0 32 0 0 0 1 /end COMPU_METHOD
/begin COMPU_METHOD CM_0342 "X/10" RAT_FUNC "%.4g" "degC" COEFFS 0 10 0 0 0 1 /end COMPU_METHOD
/begin COMPU_METHOD CM_0348 "X" RAT_FUNC "%.4g" "0" COEFFS 0 1 0 0 0 1 /end COMPU_METHOD
/begin COMPU_METHOD CM_0350 "X/1000" RAT_FUNC "%.4g" "qmm" COEFFS 0 1000 0 0 0 1 /end COMPU_METHOD
/begin COMPU_METHOD CM_0351 "(X*65536)/300000" RAT_FUNC "%.4g" "l" COEFFS 0 9375 0 0 0 2048 /end COMPU_METHOD
/begin COMPU_METHOD CM_0352 "X/8192" RAT_FUNC "%.4g" "-" COEFFS 0 8192 0 0 0 1 /end COMPU_METHOD
/begin COMPU_METHOD CM_0353 "X/64" RAT_FUNC "%.4g" "mg" COEFFS 0 64 0 0 0 1 /end COMPU_METHOD
/begin COMPU_METHOD CM_0354 "X" RAT_FUNC "%.4g" "Freigabe" COEFFS 0 1 0 0 0 1 /end COMPU_METHOD
/begin COMPU_METHOD CM_0355 "(X*100)/8192" RAT_FUNC "%.4g" "%lam/s" COEFFS 0 2048 0 0 0 25 /end COMPU_METHOD
/begin COMPU_METHOD CM_0356 "X/64" RAT_FUNC "%.4g" "-" COEFFS 0 64 0 0 0 1 /end COMPU_METHOD
/begin COMPU_METHOD CM_0357 "X/100" RAT_FUNC "%.4g" "_LL" COEFFS 0 100 0 0 0 1 /end COMPU_METHOD
/begin COMPU_METHOD CM_0358 "X/10" RAT_FUNC "%.4g" "Liter" COEFFS 0 10 0 0 0 1 /end COMPU_METHOD
/begin COMPU_METHOD CM_0359 "(X/10)-10" RAT_FUNC "%.4g" "Liter" COEFFS 0 10 100 0 0 1 /end COMPU_METHOD
/begin COMPU_METHOD CM_0360 "(X/10)-10" RAT_FUNC "%.4g" "H" COEFFS 0 10 100 0 0 1 /end COMPU_METHOD
/begin COMPU_METHOD CM_0361 "(X/10)-10" RAT_FUNC "%.4g" "_OK" COEFFS 0 10 100 0 0 1 /end COMPU_METHOD
/begin COMPU_METHOD CM_0362 "(X/10)-10" RAT_FUNC "%.4g" "-" COEFFS 0 10 100 0 0 1 /end COMPU_METHOD
/begin COMPU_METHOD CM_0363 "X/1000" RAT_FUNC "%.4g" "Liter" COEFFS 0 1000 0 0 0 1 /end COMPU_METHOD
/begin COMPU_METHOD CM_0364 "X" RAT_FUNC "%.4g" "DE" COEFFS 0 1 0 0 0 1 /end COMPU_METHOD
/begin COMPU_METHOD CM_0365 "X/10" RAT_FUNC "%.4g" "-" COEFFS 0 10 0 0 0 1 /end COMPU_METHOD
/begin COMPU_METHOD CM_0366 "X" RAT_FUNC "%.4g" "WERTE" COEFFS 0 1 0 0 0 1 /end COMPU_METHOD
/begin COMPU_METHOD CM_0367 "X/100" RAT_FUNC "%.4g" "SBLEND" COEFFS 0 100 0 0 0 1 /end COMPU_METHOD
/begin COMPU_METHOD CM_0368 "X/4" RAT_FUNC "%.4g" "CHS" COEFFS 0 4 0 0 0 1 /end COMPU_METHOD
/begin COMPU_METHOD CM_0369 "X*6/65536" RAT_FUNC "%.4g" "-" COEFFS 0 32768 0 0 0 3 /end COMPU_METHOD
/begin COMPU_METHOD CM_0370 "(X-2732)/10" RAT_FUNC "%.4g" "N" COEFFS 0 10 2732 0 0 1 /end COMPU_METHOD
/begin COMPU_METHOD CM_0392 "X*10" RAT_FUNC "%.4g" "A" COEFFS 0 1 0 0 0 10 /end COMPU_METHOD
/begin COMPU_METHOD CM_0394 "X*0.03125" RAT_FUNC "%.4g" "-" COEFFS 0 1 0 0 0 0.03125 /end COMPU_METHOD
/begin COMPU_METHOD CM_0395 "X*0.003051757812" RAT_FUNC "%.4g" "-" COEFFS 0 1 0 0 0 0.003051757812 /end COMPU_METHOD
/begin COMPU_METHOD CM_0396 "X*50" RAT_FUNC "%.4g" "Upm" COEFFS 0 1 0 0 0 50 /end COMPU_METHOD
/begin COMPU_METHOD CM_0397 "X*0.25" RAT_FUNC "%.4g" "" COEFFS 0 1 0 0 0 0.25 /end COMPU_METHOD
/begin COMPU_METHOD CM_0398 "X*0.00125" RAT_FUNC "%.4g" "0.0p" COEFFS 0 1 0 0 0 0.00125 /end COMPU_METHOD
/begin COMPU_METHOD CM_0399 "X*0.08-200" RAT_FUNC "%.4g" "-200.0p" COEFFS 0 1 200 0 0 0.08 /end COMPU_METHOD
/begin COMPU_METHOD CM_0400 "X*5.12" RAT_FUNC "%.4g" "" COEFFS 0 1 0 0 0 5.12 /end COMPU_METHOD
/begin COMPU_METHOD CM_0403 "X*0.00390625" RAT_FUNC "%.4g" "V" COEFFS 0 1 0 0 0 0.00390625 /end COMPU_METHOD
/begin COMPU_METHOD CM_0404 "X*0.0009765625" RAT_FUNC "%.4g" "%/???C" COEFFS 0 1 0 0 0 0.0009765625 /end COMPU_METHOD
/begin COMPU_METHOD CM_0405 "X*0.1" RAT_FUNC "%.4g" "V/s" COEFFS 0 1 0 0 0 0.1 /end COMPU_METHOD
/begin COMPU_METHOD CM_0406 "X*0.1" RAT_FUNC "%.4g" "J/K*mol" COEFFS 0 1 0 0 0 0.1 /end COMPU_METHOD
/begin COMPU_METHOD CM_0407 "X" RAT_FUNC "%.4g" "Nkw-Schwelle" COEFFS 0 1 0 0 0 1 /end COMPU_METHOD
/begin COMPU_METHOD CM_0408 "X" RAT_FUNC "%.4g" "ber?cksichti-" COEFFS 0 1 0 0 0 1 /end COMPU_METHOD
/begin COMPU_METHOD CM_0409 "X*0.001525878906" RAT_FUNC "%.4g" "%" COEFFS 0 1 0 0 0 0.001525878906 /end COMPU_METHOD
/begin COMPU_METHOD CM_0410 "X*0.01820020222" RAT_FUNC "%.4g" "Ah" COEFFS 0 1 0 0 0 0.01820020222 /end COMPU_METHOD
/begin COMPU_METHOD CM_0418 "X*" RAT_FUNC "%.4g" "0.0p" COEFFS 0 1 0 0 0 1 /end COMPU_METHOD
/begin COMPU_METHOD CM_0419 "X*0.9333333333" RAT_FUNC "%.4g" "min" COEFFS 0 1 0 0 0 0.9333333333 /end COMPU_METHOD
/begin COMPU_METHOD CM_0420 "X*0.015" RAT_FUNC "%.4g" "V" COEFFS 0 1 0 0 0 0.015 /end COMPU_METHOD
/begin COMPU_METHOD CM_0421 "X*0.00025+6" RAT_FUNC "%.4g" "" COEFFS 0 1 -6 0 0 0.00025 /end COMPU_METHOD
/begin COMPU_METHOD CM_0422 "X*" RAT_FUNC "%.4g" "0p" COEFFS 0 1 0 0 0 1 /end COMPU_METHOD
/begin COMPU_METHOD CM_0424 "256/X" RAT_FUNC "%.4g" "s" COEFFS 0 0 -256 0 -1 0 /end COMPU_METHOD
/begin COMPU_METHOD CM_0428 "X/218.453" RAT_FUNC "%.4g" "1/min" COEFFS 0 1 0 0 0 0.004577643704 /end COMPU_METHOD
/begin COMPU_METHOD CM_0454 "X" RAT_FUNC "%.4g" "NEAR" COEFFS 0 1 0 0 0 1 /end COMPU_METHOD
/begin COMPU_METHOD CM_0464 "X*2/25-200" RAT_FUNC "%.4g" "3" COEFFS 0 25 5000 0 0 2 /end COMPU_METHOD
/begin COMPU_METHOD CM_0465 "X" RAT_FUNC "%.4g" "Gen_awnumm[6]" COEFFS 0 1 0 0 0 1 /end COMPU_METHOD
/begin COMPU_METHOD CM_0467 "X" RAT_FUNC "%.4g" "Nkw[6]" COEFFS 0 1 0 0 0 1 /end COMPU_METHOD
/begin COMPU_METHOD CM_0468 "X" RAT_FUNC "%.4g" "KL_F_GENTYP" COEFFS 0 1 0 0 0 1 /end COMPU_METHOD
/begin RECORD_LAYOUT RL_BLK_UB FNC_VALUES 1 UBYTE ROW_DIR DIRECT /end RECORD_LAYOUT
/begin RECORD_LAYOUT RL_CUR_SB_SW FNC_VALUES 4 SWORD COLUMN_DIR DIRECT AXIS_PTS_X 3 SBYTE INDEX_INCR DIRECT NO_AXIS_PTS_X 1 UBYTE RESERVED 2 BYTE /end RECORD_LAYOUT
/begin RECORD_LAYOUT RL_CUR_SB_UW FNC_VALUES 4 UWORD COLUMN_DIR DIRECT AXIS_PTS_X 3 SBYTE INDEX_INCR DIRECT NO_AXIS_PTS_X 1 UBYTE RESERVED 2 BYTE /end RECORD_LAYOUT
/begin RECORD_LAYOUT RL_CUR_SW_SW FNC_VALUES 4 SWORD COLUMN_DIR DIRECT AXIS_PTS_X 3 SWORD INDEX_INCR DIRECT NO_AXIS_PTS_X 1 UBYTE RESERVED 2 BYTE /end RECORD_LAYOUT
/begin RECORD_LAYOUT RL_CUR_SW_UB FNC_VALUES 4 UBYTE COLUMN_DIR DIRECT AXIS_PTS_X 3 SWORD INDEX_INCR DIRECT NO_AXIS_PTS_X 1 UBYTE RESERVED 2 BYTE /end RECORD_LAYOUT
/begin RECORD_LAYOUT RL_CUR_SW_UW FNC_VALUES 4 UWORD COLUMN_DIR DIRECT AXIS_PTS_X 3 SWORD INDEX_INCR DIRECT NO_AXIS_PTS_X 1 UBYTE RESERVED 2 BYTE /end RECORD_LAYOUT
/begin RECORD_LAYOUT RL_CUR_UB_SW FNC_VALUES 4 SWORD COLUMN_DIR DIRECT AXIS_PTS_X 3 UBYTE INDEX_INCR DIRECT NO_AXIS_PTS_X 1 UBYTE RESERVED 2 BYTE /end RECORD_LAYOUT
/begin RECORD_LAYOUT RL_CUR_UB_UB FNC_VALUES 4 UBYTE COLUMN_DIR DIRECT AXIS_PTS_X 3 UBYTE INDEX_INCR DIRECT NO_AXIS_PTS_X 1 UBYTE RESERVED 2 BYTE /end RECORD_LAYOUT
/begin RECORD_LAYOUT RL_CUR_UB_UW FNC_VALUES 4 UWORD COLUMN_DIR DIRECT AXIS_PTS_X 3 UBYTE INDEX_INCR DIRECT NO_AXIS_PTS_X 1 UBYTE RESERVED 2 BYTE /end RECORD_LAYOUT
/begin RECORD_LAYOUT RL_CUR_UW_SB FNC_VALUES 4 SBYTE COLUMN_DIR DIRECT AXIS_PTS_X 3 UWORD INDEX_INCR DIRECT NO_AXIS_PTS_X 1 UBYTE RESERVED 2 BYTE /end RECORD_LAYOUT
/begin RECORD_LAYOUT RL_CUR_UW_SW FNC_VALUES 4 SWORD COLUMN_DIR DIRECT AXIS_PTS_X 3 UWORD INDEX_INCR DIRECT NO_AXIS_PTS_X 1 UBYTE RESERVED 2 BYTE /end RECORD_LAYOUT
/begin RECORD_LAYOUT RL_CUR_UW_UB FNC_VALUES 4 UBYTE COLUMN_DIR DIRECT AXIS_PTS_X 3 UWORD INDEX_INCR DIRECT NO_AXIS_PTS_X 1 UBYTE RESERVED 2 BYTE /end RECORD_LAYOUT
/begin RECORD_LAYOUT RL_CUR_UW_UW FNC_VALUES 4 UWORD COLUMN_DIR DIRECT AXIS_PTS_X 3 UWORD INDEX_INCR DIRECT NO_AXIS_PTS_X 1 UBYTE RESERVED 2 BYTE /end RECORD_LAYOUT
/begin RECORD_LAYOUT RL_MAP_SW_SW_SW FNC_VALUES 5 SWORD COLUMN_DIR DIRECT AXIS_PTS_X 3 SWORD INDEX_INCR DIRECT AXIS_PTS_Y 4 SWORD INDEX_INCR DIRECT NO_AXIS_PTS_X 1 UBYTE NO_AXIS_PTS_Y 2 UBYTE /end RECORD_LAYOUT
/begin RECORD_LAYOUT RL_MAP_SW_SW_UB FNC_VALUES 5 UBYTE COLUMN_DIR DIRECT AXIS_PTS_X 3 SWORD INDEX_INCR DIRECT AXIS_PTS_Y 4 SWORD INDEX_INCR DIRECT NO_AXIS_PTS_X 1 UBYTE NO_AXIS_PTS_Y 2 UBYTE /end RECORD_LAYOUT
/begin RECORD_LAYOUT RL_MAP_SW_SW_UW FNC_VALUES 5 UWORD COLUMN_DIR DIRECT AXIS_PTS_X 3 SWORD INDEX_INCR DIRECT AXIS_PTS_Y 4 SWORD INDEX_INCR DIRECT NO_AXIS_PTS_X 1 UBYTE NO_AXIS_PTS_Y 2 UBYTE /end RECORD_LAYOUT
/begin RECORD_LAYOUT RL_MAP_SW_UW_UB FNC_VALUES 5 UBYTE COLUMN_DIR DIRECT AXIS_PTS_X 3 SWORD INDEX_INCR DIRECT AXIS_PTS_Y 4 UWORD INDEX_INCR DIRECT NO_AXIS_PTS_X 1 UBYTE NO_AXIS_PTS_Y 2 UBYTE /end RECORD_LAYOUT
/begin RECORD_LAYOUT RL_MAP_UW_SB_SW FNC_VALUES 5 SWORD COLUMN_DIR DIRECT AXIS_PTS_X 3 UWORD INDEX_INCR DIRECT AXIS_PTS_Y 4 SBYTE INDEX_INCR DIRECT NO_AXIS_PTS_X 1 UBYTE NO_AXIS_PTS_Y 2 UBYTE /end RECORD_LAYOUT
/begin RECORD_LAYOUT RL_MAP_UW_SW_UW FNC_VALUES 5 UWORD COLUMN_DIR DIRECT AXIS_PTS_X 3 UWORD INDEX_INCR DIRECT AXIS_PTS_Y 4 SWORD INDEX_INCR DIRECT NO_AXIS_PTS_X 1 UBYTE NO_AXIS_PTS_Y 2 UBYTE /end RECORD_LAYOUT
/begin RECORD_LAYOUT RL_MAP_UW_UW_UB FNC_VALUES 5 UBYTE COLUMN_DIR DIRECT AXIS_PTS_X 3 UWORD INDEX_INCR DIRECT AXIS_PTS_Y 4 UWORD INDEX_INCR DIRECT NO_AXIS_PTS_X 1 UBYTE NO_AXIS_PTS_Y 2 UBYTE /end RECORD_LAYOUT
/begin RECORD_LAYOUT RL_MAP_UW_UW_UW FNC_VALUES 5 UWORD COLUMN_DIR DIRECT AXIS_PTS_X 3 UWORD INDEX_INCR DIRECT AXIS_PTS_Y 4 UWORD INDEX_INCR DIRECT NO_AXIS_PTS_X 1 UBYTE NO_AXIS_PTS_Y 2 UBYTE /end RECORD_LAYOUT
/begin RECORD_LAYOUT RL_VAL_SB FNC_VALUES 1 SBYTE COLUMN_DIR DIRECT /end RECORD_LAYOUT
/begin RECORD_LAYOUT RL_VAL_SL FNC_VALUES 1 SLONG COLUMN_DIR DIRECT /end RECORD_LAYOUT
/begin RECORD_LAYOUT RL_VAL_SW FNC_VALUES 1 SWORD COLUMN_DIR DIRECT /end RECORD_LAYOUT
/begin RECORD_LAYOUT RL_VAL_UB FNC_VALUES 1 UBYTE COLUMN_DIR DIRECT /end RECORD_LAYOUT
/begin RECORD_LAYOUT RL_VAL_UL FNC_VALUES 1 ULONG COLUMN_DIR DIRECT /end RECORD_LAYOUT
/begin RECORD_LAYOUT RL_VAL_UW FNC_VALUES 1 UWORD COLUMN_DIR DIRECT /end RECORD_LAYOUT
/begin GROUP G_9_Engine_states___sensors___settings "9 Engine states & sensors - settings" ROOT
 /begin REF_CHARACTERISTIC K_N_MIN_FREEZE__INJ_ K_N_OBERGRENZE__INJ_ K_N_ZEIT_STOERUNG__INJ_ K_CW_OZ K_DTOG_UBMIN K_OZDELTOE K_OZERRD K_OZHEAL K_OZMWK K_OZNFERR K_OZNFML K_OZNFOELCKO K_OZNFOELCOK K_OZOELCOK K_OZOELCVERZ K_OZORIPEILTZO K_OZORIPEILTZU K_OZPEIL12 K_OZPEIL25 K_OZPEIL38 K_OZPEIL53 K_OZPEIL69 K_OZPEIL85 K_OZPEILDO K_OZPEILDOMIN K_OZPEILDU K_OZPEILDU38 K_OZPEILERR K_OZPEILKSPR K_OZPEILLP85 K_OZPEILML K_OZPEILOELCKO K_OZPEILOELCOK K_OZPEILSPRUNG K_OZSTANDVERZ K_OZSTARTVERZ K_OZTEMPQERR K_OZZTEMP K_TOGVERZOEG K_DMTL_I_REF_1_2_DIFF K_DMTL_I_REF_MAX K_DMTL_I_REF_MIN K_DMTL_START K_DMTL_TEMP_DECKEL_MAX K_DMTL_TEMP_DECKEL_MIN K_DMTL_TEMP_MAX K_DMTL_TEMP_MIN K_DMTL_TEMP_START_MIN K_DMTL_TEMP_VENT_MIN K_DMTL_TAU_I K_DMTL_TP_I_BEG K_DMTL_TP_I_ROH K_DMTL_TAU_I_TANK K_DMTL_TP_UB K_DMTL_T_ABSTELL K_DMTL_T_AY_DLY K_DMTL_T_CC_DAUER K_DMTL_T_DECKEL_ML_MIN K_DMTL_T_FEUCHT_DLY K_DMTL_T_KURZSCHL K_DMTL_T_MESS_GES K_DMTL_T_ML_MIN K_TKSM_CFG K_TKSM_MR_TAU K_PUMG_AEBEGR K_PUMG_ERSATZ K_PUMG_SENSOR_OFFSET K_PUMG_SENSOR_STEIGUNG K_PUMG_TAU K_OZVERLORI K_OZMAXSLOPE K_OZMINSLOPE K_OZNMOTMAX K_OZNMOTMIN K_OZTEMPBW K_OZTORMIN K_OZTORMINF K_OZVORMV K_OZABSTELL K_OZABZORIVL K_OZALTANZABZ K_OZLUFTMAX K_OZMWL K_OZMWOR K_OZMWV K_OZOELCABZ K_OZOELVERB K_OZSTARTABZ K_OZSTMINW K_OZLBESCHN K_OZLBESCHORI K_OZLBESCHP K_OZLBESCHST K_OZQBESCHN K_OZQBESCHORI K_OZQBESCHP K_OZQBESCHST K_NACHFUELL12 K_NACHFUELL25 K_NACHFUELL38 K_NACHFUELL53 K_NACHFUELL69 K_NACHFUELL85 K_NACHFUELL95 K_OZBESCHAUS K_OZDKNIVN K_OZFAKTORI K_DMTL_ABBR_FEIN K_DMTL_ABBR_FEUCHT K_DMTL_ANZ_DECKEL K_DMTL_ANZ_DECKEL_LECK K_DMTL_ANZ_FAHRTEN K_DMTL_AY_MAX K_DMTL_CFG K_DMTL_DI_BETANK K_DMTL_DI_DECKEL K_DMTL_DI_STABIL K_DMTL_DI_TEV_OFFEN K_DMTL_DU_MAX K_DMTL_FST_MAX K_DMTL_FST_MIN K_DMTL_FST_ERSATZ K_DMTL_FST_DECKEL_MAX K_DMTL_GROB_OHNE_FEIN K_DMTL_I_FAKT_CCDECKEL K_DMTL_I_FAKT_GROB K_DMTL_I_FAKT_P K_DMTL_I_KURZSCHL K_DMTL_I_REF_DIFF K_DMTL_T_KL50_DLY K_DMTL_T_REF K_DMTL_T_START_DLY K_DMTL_T_VENT_CHK K_DMTL_T_VENT_UM K_DMTL_P_MIN K_DMTL_TE_AY_MAX K_DMTL_TE_TIME_DC K_DMTL_TE_MD_REL_MAX K_DMTL_TE_N_MIN K_DMTL_TE_V_MIN K_DMTL_TE_T_REF K_DMTL_TE_T_REF2 K_DMTL_TE_ANZ K_DMTL_TE_T_TIMEOUT K_DMTL_TE_T_ZU K_DMTL_TE_VOL_OFFS K_DMTL_TE_VOL_PUMP K_DMTL_TE_DLY K_DMTL_TE_CFG K_DMTL_TE_DI_PUMP K_DMTL_TE_DI_OK K_TANZYL_CFG K_TANZYL_MR_TAU K_TANZYL_TMOT_TUMG_DELTA_NORM K_TANZYL_TUMG_NORM K_SLP_TIME_AUS K_SLP_PABG_SCHWELLE K_SLP_PABG_TAU K_SLP_TIME_MAX K_OZ_KRZ_MESSUNG_LL K_OZ_KRZ_ORI_MESSUNG K_OZ_ALT_NACHF K_OZ_KRZ_HYST_CBS K_OZ_ALT_HYST_U K_OZ_ALT_HYST_F K_OZ_KRZ_HYST K_OZ_LZW_AEND_BEGR K_OZ_ORI_HYST_O K_OZ_ORI_HYST_U K_OZ_1L_BEGR_U K_OZ_CC_OELVERBRAUC K_OZ_CC_OELVERLUST K_OZ_OELVERLUST_FSP K_OZ_1L_BEGR_O K_OZ_1_5_L_BEGR K_OZ_AG_MESSSTAB_MIN K_OZ_AG_MESSSTAB_OK K_OZ_AG_MESSSTAB_OK_ K_OZ_MIN_LEVEL_VOL K_OZ_NIV_KM_MAX K_OZ_RESTWEG_APPL_MO K_OZ_TEMPBW_KOPF K_OZ_TEMPBW_SUMPF K_OZ_ORI_TEMPBW_KOPF K_OZ_ORI_TEMPBW_SUMP K_OZ_TEMP_KOR K_OZ_ORI_TEMP_KOR K_OZ_TEMP_75 K_SCHNELLMSG_FSP_AKTI K_SCHNELLMSG_ANZAHL_ K_SCHNELLMSG_KL15_MA K_SCHNELLMSG_KL15_AU K_SCHNELLMSG_OZLBES K_SCHNELLMSG_OZQBES K_SCHNELLMSG_PERM_PL K_SCHNELLMSG_T_MS K_SCHNELLMSG_TOEL_MI K_SCHNELLMSG_N_MAX K_SCHNELLMSG_V_MAX K_CAN_I_SC_MIN_INIT K_DMTL_2_STABIL K_DMTL_FAKT_T_DECKEL K_DMTL_UB_MAX K_DMTL_UB_MIN K_DMTL_V_MIN K_DSOCLLANH K_DWF_ORANGE_OFF K_DWF_SHLI_AX_AKTIV K_DWF_SHLI_T_AKTIV K_DWF_SHLI_T_BL K_DWF_SHLI_T_INAKTIV K_GEN_BSD_VARIANTE K_KW_ED_DELTA_N K_KW_ED_DELTA_N_RATE K_KW_ED_DELTA_U K_KW_ED_N_DROP K_KW_ED_N_DROP_RATE K_MSKIBSERR K_MZYL_R K_NW_IO K_NW_IO_ASP K_NW_MFMAX_1of2_ K_NW_MFMAX_2of2_ K_NW_MFMIN_1of2_ K_NW_MFMIN_2of2_ K_NW_NIO K_NW_NIO_INC K_NW_SYNC_ION_IO K_OZLBESCH_STAND_CC K_OZNIVKL K_OZPERCMW K_OZPERGRADKD K_OZPERGRADMAX K_OZPERGRADMIN K_OZPERGRADTN K_OZPERINI K_OZPERKFIL K_OZPERMWDMAX K_OZPERMWDMIN K_OZPLTEMP K_OZPLZTEMP K_OZPRREFMAX K_OZPRREFMIN K_OZQBESCH_STAND_CC K_OZUEBERF K_OZVERZNIVERS K_OZ_N_OELMAXKORR_O K_OZ_N_OELMAXKORR_U K_SLS_PL_T_MDF_STOP K_TRTYP K_ZUST_MD_HYST_LL_TL K_ZUST_MD_HYST_TL_VL K_ZUST_MD_LL_TL K_ZUST_NL_TIMOUT_INJ K_ZUST_N_PS_LL K_ZUST_T_NL S_BSDKOORD S_OZBSDKOORD cfg.betriebsmode K_DSOCHYST K_DWF_CFG K_FST_TANK_LEER_RECHTS K_FST_TANK_LEER_SUM K_KW_ED_SH_TO_GND_RATE K_KW_ED_SH_TO_UB_RATE K_OZKMUPL K_OZORLIM2 K_OZVERZERRBSD K_ZUST_POWER K_TOG_CNTMAX K_OELSTAND_CAN_PST_LI K_OZ_ACFZG_FIL K_OZLBESCHS K_OZL_ORI_BESCH K_OZQBESCHS K_OZQ_ORI_BESCH K_OZAQNIVBEGR K_CW_OZ_2 K_CW_OZ_PERM K_OZSTZYK K_FST_ABWEICHUNG K_FST_NACHTANK K_FST_FILT K_FST_VOLL K_FST_V_BETANK_END K_FST_VERBRAUCH K_FST_VERBRAUCH_VOLL K_DMTL_TE_AKTIV_MIN K_OZPERMRMIN K_OZPERMRMIN_1 /end REF_CHARACTERISTIC
/end GROUP
/begin GROUP G_Other___Electrical__cooling___comfort "Other - Electrical, cooling & comfort" ROOT
 /begin REF_CHARACTERISTIC KF_SCHALTER_KS_N_DIFF_AUF KL_SCHALTER_KS_REG K_SCHALTER_KS_N_DIFF K_SCHALTER_KS_N_DIFF_REF K_SCHALTER_KS_N_HYS K_SCHALTER_KS_N_T K_SCHALTER_KS_SCHALT_T K_SCHALTER_KUPP_GESCHL K_SCHALTER_KUPP_OFFEN K_SCHALTER_POEL_START_ENDE KF_ELU_PWM_MS KL_ELU_KKOS KL_ELU_TAN KL_ELU_DTMOT KL_ELU_TKAT KL_ELU_TUMG_KORR K_ELU_ED_BLOCKIERT_CNT K_ELU_ED_BLOCKIERT_MAX K_ELU_ED_BLOCKIERT_MIN K_ELU_ED_BLOCKIER_ZYKLUS_TIME K_ELU_ED_OPENLOAD_CNT K_ELU_ED_SH_TO_GND_CNT K_ELU_ED_SH_TO_UB_DELAY K_ELU_ED_SH_TO_UB_OFF_TIME KL_ELUP_AUS KL_ELUP_EIN KL_ELUP_EIN_V_DEL KL_ELUP_V_OFFS K_ELUP_CFG K_ELUP_ED_ABS_DEL K_ELUP_ED_DEL K_ELUP_PL_AN_SW K_ELUP_PL_IO_SW K_ELUP_PL_ON_TIME KF_ZLRESOF KL_GENLDST KL_LORESPM K_APPUPLLDST KF_LSHVK_TV_KORR_MAX KF_LSHVK_TV_VORST KL_LSHVK_R_MESS_F KL_LSHVK_R_MESS_OFFS KL_LSHVK_SOND_TEMP KL_LSHVK_TEMP_IST_HIGH KL_LSHVK_TEMP_IST_LOW KL_LSHVK_TEMP_SOLL_MS KL_LSHVK_UEFF_MAX K_LSHVK_RI_RANGE_SCHW K_LSHVK_R_AD_GAIN_CNT K_LSHVK_R_AD_GAIN_CNT_MIN K_LSHVK_R_AD_GAIN_GRAD K_LSHVK_R_AD_GAIN_MAX K_LSHVK_R_AD_GAIN_MIN K_LSHVK_R_AD_GAIN_T K_LSHVK_R_AD_GAIN_T1 K_LSHVK_R_AD_OFFS_CNT K_LSHVK_R_AD_OFFS_CNT_MIN K_LSHVK_R_AD_OFFS_GRAD K_LSHVK_R_AD_OFFS_MAX K_LSHVK_R_AD_OFFS_MIN K_LSHVK_R_AD_OFFS_T K_LSHVK_R_AD_OFFS_T1 K_LSHVK_R_AD_RESET K_LSHVK_R_REF K_LSHVK_R_REF_OFFS K_LSHVK_TEMP_DIF_ZUL K_LSHVK_TEMP_IST_ENABLE_IP_LOOP K_LSHVK_TEMP_IST_SCHW K_LSHVK_TEMP_MAX K_LSHVK_TEMP_MIN K_LSHVK_TEMP_REG_MIN KF_MVAC_ELUP_ETA KL_MVAC_BRP_GRAD KL_MVAC_ELUP KL_MVAC_ML_WICHT KL_MVAC_PDIFF_B KL_MVAC_PDIFF_SA K_MVAC_AL_BLS K_MVAC_AL_LECK K_MVAC_AL_UMMV_STAT K_MVAC_BRPGRAD_SW K_MVAC_BRP_GRAD_RAMPE K_MVAC_DEL_BLS K_MVAC_MLRF_SR_SPERRE K_MVAC_ML_AEB_NEG K_MVAC_ML_AEB_POS K_MVAC_ML_INTEGRATOR_TAU K_MVAC_ML_SR_MAX K_MVAC_ML_SR_MIN K_MVAC_N_MIN_B K_MVAC_N_MIN_SA K_MVAC_PDIFF_FILTER_TAU K_MVAC_PDIFF_UM_BEGR_MAX K_MVAC_PDIFF_UM_BEGR_MIN K_MVAC_PL_PDIFF K_MVAC_PL_P_IO_SW K_MVAC_PL_TIME_LIMIT K_MVAC_PL_TIME_MS K_MVAC_P_SENSOR_OFFSET K_MVAC_P_SENSOR_STEIGUNG K_MVAC_RMP_FKT_SA_BEGR K_MVAC_V KF_IERRGREHT KL_NELUEFTGE KL_TCHIPOFFS KF_SOC0UBIB KF_SOCLF KL_DFPRIO KL_DFPTC KL_DSOCPRIO KL_FITGRZ KL_ITNSTART KL_PMSOCVU KL_PRIO2PTC KL_PRIOCF KL_PRIODF KL_PTC KL_PWRCF KL_PWRDF KL_SOC0TEMP KL_SOCPRIO KL_SSOC KL_T2RELMAX KL_T2RELMXRG KL_T3RELMAX KL_T3RELMXRG KL_T4RELMAX KL_T4RELMXRG KL_UNSTART K_ABSCHKORA K_BILA_OGRZ K_BILA_UGRZ K_DAB_KORR1 K_DAB_KORR2 K_DAB_KORR3 K_DSOCA K_DSOCABSCH K_MN_PTCPI K_MN_PWRDFPI K_MX_PTCPI K_PMTIMERSQ1 K_PM_TABSMN K_PWRCOS15 K_PWRCOSAPP K_PWRCOSHT K_QSOCCL1 K_QSOCCL2 K_QSOCCL3 K_QSTARTFGA K_RIN_GRENZ1 K_RIN_GRENZ2 K_RIN_GRENZ3 K_RIN_GRENZ4 K_RIN_GRENZ5 K_RIN_GRENZ6 K_RIN_GRENZ7 K_RIN_GRENZ8 K_SOCFITGRZ K_SOCFITLIMH K_SOCFITLIML K_SOC_STAFGA K_TSAISONFIL K_TSAISPWF K_USTARTGRZ S_ABSCHK S_DSOCS S_NKWITNSTRT S_PMSTARTQ S_PMTABSMN S_PTCMANUAL S_PWRCFENA S_QSTARTFK S_RIN S_SOCSTAFK S_STARTAW KF_MDRESWAFS K_ELUP_UB_MIN K_ELUP_ON_TIME_MIN K_ELUP_ON_TIME_MAX K_ELUP_OFF_TIME_MIN KL_ELU_V_KORR_FETRAWE KF_ELU_V_KORR K_ELU_TCR2_TICS K_ELU_TCR2_TICS_NL K_ELU_PWM_AUS K_ELU_PWM_MAX_ML K_ELU_PWM_MAX_MS K_ELU_PWM_MIN_ML K_ELU_PWM_MIN_MS K_ELU_PWM_GRAD_ZUL K_ELU_TMOT_SOLL K_OSPGAPP K_OSPGHYST K_USPGAPP K_USPGHYST K_QELADGESMX K_QELADLIM K_QLADGESMX K_QLADLIM K_T2PMINFO K_T3PMINFO K_TBATNACHL K_T_CCRUHVER K_T_KMSHIFT K_T_OSPGSET K_T_TIEFPRE K_T_USPGSET K_R_LADLTG K_CBATTAPP K_BATTINDAPP K_PWGLLANH K_SCHPWGLLRED K_TMOTLLANH K_GELIVMAX K_GENPDTIME K_TDFDTMAX K_TDFFABLF K_TDFFMAX K_TDFFMIN K_VFZGLLANH K_DFFSCHZMX K_GELIIEAPP K_GELISETAPP K_PR_IERRLLRED K_TDNHOLD K_VFZGGENKOR K_GENMXGRADH K_TGENMXGRAD K_TGENMXTHD K_TGENRSHT CBATT_DEF K_BATTREGAPP K_CCPRIOSET K_CTRPRIOAPP K_CTRPRIOCF_1of7_ K_CTRPRIOCF_2of7_ K_CTRPRIOCF_3of7_ K_CTRPRIOCF_4of7_ K_CTRPRIOCF_5of7_ K_CTRPRIOCF_6of7_ K_CTRPRIOCF_7of7_ K_CTRPWRCF_1of7_ K_CTRPWRCF_2of7_ K_CTRPWRCF_3of7_ K_CTRPWRCF_4of7_ K_CTRPWRCF_5of7_ K_CTRPWRCF_6of7_ K_CTRPWRCF_7of7_ K_CTRPWRDF_10of14_ K_CTRPWRDF_11of14_ K_CTRPWRDF_12of14_ K_CTRPWRDF_13of14_ K_CTRPWRDF_14of14_ K_CTRPWRDF_1of14_ K_CTRPWRDF_2of14_ K_CTRPWRDF_3of14_ K_CTRPWRDF_4of14_ K_CTRPWRDF_5of14_ K_CTRPWRDF_6of14_ K_CTRPWRDF_7of14_ K_CTRPWRDF_8of14_ K_CTRPWRDF_9of14_ K_DFFILTAPP K_DFKOMMERR K_DFMODE K_DFOVERRIDE K_DFPTC_LP K_DFS_MAX K_DFS_MIN K_DFS_MITT K_DF_LP K_DSOCHYSTCC K_DSOCLOW K_EBOX_ELU_EIN K_EBOX_ELU_HYS K_EBOX_ELU_LOSBRECHEN K_ENAPPLRESP K_GENLDDFMAX K_IBSVERSION_10of16_ K_IBSVERSION_11of16_ K_IBSVERSION_12of16_ K_IBSVERSION_13of16_ K_IBSVERSION_14of16_ K_IBSVERSION_15of16_ K_IBSVERSION_16of16_ K_IBSVERSION_1of16_ K_IBSVERSION_2of16_ K_IBSVERSION_3of16_ K_IBSVERSION_4of16_ K_IBSVERSION_5of16_ K_IBSVERSION_6of16_ K_IBSVERSION_7of16_ K_IBSVERSION_8of16_ K_IBSVERSION_9of16_ K_IBSWAKEAPP K_IB_COMMVAL K_IERRFIL K_IPMPMDEC K_IPMPMINC K_IWAKEAPP K_I_FITAUSW K_KBMCNT_APP K_KSOGRZAPP K_KSUGRZAPP K_LLPMFILTK K_LSHVK_CFG K_LSHVK_REG_K K_LSHVK_REG_TN K_LSHVK_R_AD_GAIN_NV_MAX K_LSHVK_R_AD_GAIN_NV_MIN K_LSHVK_R_AD_OFFS_NV_MAX K_LSHVK_R_AD_OFFS_NV_MIN K_LSHVK_TV_KORR_MIN K_LSHVK_T_KL15_MAX K_LSHVK_UB_MAX K_LSHVK_UB_NORM K_LSHVK_UEFF_GRAD K_LSH_UB_TAU K_MVAC_AL_SRMV K_MVAC_DEL_RSV K_MVAC_ELUP_ST_DEL K_MVAC_HYS_MAX K_MVAC_HYS_MIN K_MVAC_ML_CFG K_MVAC_ML_MIN K_MVAC_ML_TAU K_MVAC_P_TAU K_NGENOFMN K_NKW2HIPTC K_NSUBU K_OSPGPRELLZ K_PCTRL_PROZ_ZYKL K_PCTRL_TASK_ZYKL K_PMQ_UX K_PRIOCF15 K_PRIOCFAPP K_PRIOCF_R K_PRIODF_1of7_ K_PRIODF_2of7_ K_PRIODF_3of7_ K_PRIODF_4of7_ K_PRIODF_5of7_ K_PRIODF_6of7_ K_PRIODF_7of7_ K_PRIO_R K_PTCPWRAPP K_PTC_PI K_PWRCOSULEV K_PWRCSGNDEF K_PWRDF_PI K_Q_BILAPWF K_RESET_PI K_RQPCOSA K_RUHVERMODE K_SCHALTER_GETR_A0 K_SCHALTER_GETR_FIL_TAU K_SCHALTER_GETR_HYSTERESE_BREITE K_SCHALTER_GETR_LEERGASSE_MAX K_SCHALTER_GETR_LEERGASSE_MIN K_SELSPCOSA K_SELSPCSAPP K_SOCFITAPP K_SOC_BILAWA K_SOC_QPWF K_SOC_QUALIA K_STPCOSAPP K_T1PMINFO K_TCHIPFIL K_TCODIERPM K_TDNGENKRIT K_TDTCHIPKRI K_TDTCHIPMX K_TDUBFZMN K_TFIGENHT K_TLCHTEP K_T_NKPTCAUS K_T_PMVS K_T_PTCKWAN K_T_PTCPI K_T_RUHAUSW K_T_SQSHIFT K_T_SULEVON K_T_USPGRSET K_UBAT_LP K_UBTAPP K_UBTLOWMAX K_UBTLOWMIN K_UGENNORM K_USPGPRELLZ S_BSOCCALC S_HTDETEC S_IPMPTC S_PMMESS S_PMSOCFIT S_PMSV_LUFT S_PRIOCFENA S_PRIOMANUAL S_PTCKOOR S_SOC_BILA S_SOC_QUAL S_UIBS ZK_PMSOC K_ELU_PWM_OFFS K_ELU_T_MS_MAX K_HTGENDFGRO K_MSKGENKL61 K_NGENHTMN1 K_NGENHTMX1 K_NKW2LOWPTC K_PRIO15 K_SCHALTER_POEL_N_DELAY K_SCHALTER_POEL_TOEL K_TD_PWRDFPI KL_U00QUA_T KL_LSHVK_T_DELAY K_ELU_HYS_SCHLEPP K_ELU_TAN_DREH_ERSATZ K_ELU_T_ML_MIN K_HISTDMERST K_HISTIBSRST K_TRINGSHIFT KF_PMRIBAT2 KF_PMRIBAT8 KF_PMRIBAT6 KF_PMRIBAT5 KF_PMRIBAT3 KF_PMRIBAT4 KF_PMRIBAT7 KL_TMAXDIODE KL_RTHJADIOD KF_UFDIODE KF_LORESP KF_LORESPKH KF_LRWAFS K_SCHWPRSPWGLR1 K_SCHWPRSPWGLR2 K_SCHWPRSPWGLR3 K_SCHWPRSPWGLR4 K_SCHWPRSPWGLR5 K_LRBNS K_LRSPGW KL_F_GENTYP /end REF_CHARACTERISTIC
/end GROUP
/begin GROUP G_Other___Emissions___catalyst "Other - Emissions & catalyst" ROOT
 /begin REF_CHARACTERISTIC K_AG_TI_ANZ K_AG_TI_CFG K_AG_TI_PAUSE K_AG_TI_V_MIN K_AG_TI_ZYL KL_SL_HFM_AD KL_SL_LAM_MOT_DELAY KL_SL_LAM_MOT_OFFS_FILT_TAU KL_SL_ML_MAX_PABG KL_SL_ML_MAX_UB_FAKT KF_TE_ANZUGSZEIT KF_TE_GW_CNT_F KF_TE_GW_RAMPEN KF_TE_TV_NORM KL_TE_GW_CNT_DEC KL_TE_GW_F KL_TE_GW_LAM_REG_F KL_TE_GW_TI_MIN KL_TE_MKS_XSI KL_TE_ML_XSI KL_TE_SYNC_FREQ KL_TE_TI_MIN KL_TE_T_BEGIN_MIN KL_TE_YPS_SQRT KF_TE_FREQU KL_SL_LAM_MOT_KORR_DELAY KL_SL_LAM_MOT_OFFS_TIME_F KL_SL_LAM_MOT_OFFS_KM K_SL_LAM_MOT_OFFS_MIN K_SL_LAM_MOT_OFFS_MAX K_SL_ML_MDL_CFG K_TE_R_C3H8 K_TE_R_LUFT K_TE_TMOT K_TE_FREQ_C_AKF K_TE_FREQ_C_AKF_HYS K_TE_FREQ_LUFT K_TE_A_MIN K_TE_B_ABBR_FST_SUM K_TE_B_ABBR_TUMG K_TE_B_LANG_C_AKF K_TE_B_LANG_FST_SUM K_TE_B_LANG_VOL_SUM K_TE_B_LANG_TUMG K_TE_C_AKF_RESET K_TE_C_APPL K_TE_C_DMTL K_TE_C_DMTL_ABREG K_TE_C_LERN_RED_TAU K_TE_C_LERN_TAU K_TE_C_MAX K_TE_C_MIN K_TE_C_ML_SOLL_MG_MIN K_TE_C_PKS_MAX K_TE_C_STAT_DELTA K_TE_C_STAT_T K_TE_C_T_SPUEL_MAX K_TE_C_T_SPUEL_MIN K_TE_C_X_MIN K_TE_TV_MIN K_TE_DYN_DELTA_RF K_TE_DYN_RF_T K_TE_GW_F_KATD K_TE_GW_LAM_DELTA_HYS K_TE_GW_LAM_DELTA_MAGER K_TE_GW_LAM_GES_OFFS_MIN K_TE_GW_LAM_REG_FETT K_TE_GW_LAM_REG_HYS K_TE_GW_LAM_REG_MAGER K_TE_LAA_F_TE_MCS K_TE_LAM_SOLL_MAX K_TE_LAM_SOLL_MIN K_TE_MKS_F_AEBG_SCHW_NEG K_TE_MKS_F_AEBG_SCHW_POS K_TE_MKS_F_LAM_SCHW K_TE_MKS_F_MAX K_TE_MKS_F_NEG K_TE_MKS_F_POS K_TE_ML_SOLL_NEG_TAU K_TE_ML_SOLL_POS_TAU K_TE_MZYL_SEC_F KF_TE_X_SOLL_MKS KF_TE_X_SOLL_NOT K_SL_HFM_TAU K_SL_I_MAX K_SL_I_MIN K_SL_LAM_MAX_FAK K_TE_ANZUGSZEIT_OFFS_B1 K_TE_STOECH K_TE_TI_MIN_DIFF K_TE_TMOT_START_HS K_TE_T_LAA K_TE_T_LAA_INI_HS K_TE_T_LANG K_TE_T_MIN K_TE_T_NORM K_TE_X_MKS_CFG K_TE_X_ML_SOLL_APPL_B2 K_TE_X_ML_SOLL_CFG K_TE_X_ML_SOLL_MAX K_TE_X_ML_SOLL_MIN K_TE_ZU_LERN K_TE_T_LAA_INI K_TE_T_SPUEL_INI KL_TE_B_ABBR_VOL_SUM KL_TE_C_AEBG_MSA KL_TE_C_RF_MAX KL_TE_GW_LAM_DELTA_FETT KF_TE_TV_A KF_TE_TV_OFFS_OBEN K_TE_TV_A_OFFS K_TE_TV_MAX K_TE_X_ML_BETRIEB_OFFS K_TE_ZU_NORM K_TE_ZU_SA /end REF_CHARACTERISTIC
/end GROUP
/begin GROUP G_Other___Gearbox__SMG_DKG_ "Other - Gearbox (SMG/DKG)" ROOT /begin REF_CHARACTERISTIC KL_TGETR_NTC K_TGETR_CC_HIGH K_TGETR_CC_HYST K_TGETR_TAU /end REF_CHARACTERISTIC /end GROUP
/end MODULE
/end PROJECT
