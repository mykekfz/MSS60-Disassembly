ASAP2_VERSION 1 60
/begin PROJECT MSS60_V762_INJ "MSS60 (S65) V762 INJ CPU - generated 04.11.2026 from the reverse-engineered XDF"
/begin HEADER "Calibration description (characteristics from the XDF; measurements = V530 RAM names transferred to V762 addresses, confidence in each long identifier). Status tag in every long identifier: verified (checked against the code) / A2L-ref (placed from the V530 A2L) / EST (estimated) / unassigned (UNK placeholder)." VERSION "V762-RE-04112026" /end HEADER
/begin MODULE INJ "MSS60 V762 INJ"
/begin MOD_COMMON "" BYTE_ORDER MSB_FIRST ALIGNMENT_BYTE 1 ALIGNMENT_WORD 2 ALIGNMENT_LONG 4 /end MOD_COMMON
/begin CHARACTERISTIC UNK_PKS_06D58 "Unassigned constant read by INJ 4F930 [unassigned]" VALUE 0x76D58 RL_VAL_SW 0 CM_0000 -32768 32767 /end CHARACTERISTIC
/begin CHARACTERISTIC UNK_PKS_06D5A "Unassigned constant read by INJ 4F930 [unassigned]" VALUE 0x76D5A RL_VAL_SW 0 CM_0000 -32768 32767 /end CHARACTERISTIC
/begin CHARACTERISTIC UNK_PKS_06D5C "Unassigned constant read by INJ 4F930 [unassigned]" VALUE 0x76D5C RL_VAL_UW 0 CM_0000 0 65535 /end CHARACTERISTIC
/begin CHARACTERISTIC UNK_PKS_06D5E "Unassigned constant read by INJ 4F930 [unassigned]" VALUE 0x76D5E RL_VAL_UW 0 CM_0000 0 65535 /end CHARACTERISTIC
/begin CHARACTERISTIC UNK_PKS_06DD2 "Unassigned constant read by INJ 4FB34 [unassigned]" VALUE 0x76DD2 RL_VAL_UW 0 CM_0000 0 65535 /end CHARACTERISTIC
/begin CHARACTERISTIC UNK_PKS_06DD4 "Unassigned constant read by INJ 4FB34 [unassigned]" VALUE 0x76DD4 RL_VAL_UW 0 CM_0000 0 65535 /end CHARACTERISTIC
/begin CHARACTERISTIC UNK_PKS_06E0D "Unassigned constant read by INJ 11711C [unassigned]" VALUE 0x76E0D RL_VAL_UB 0 CM_0000 0 255 /end CHARACTERISTIC
/begin CHARACTERISTIC UNK_PKS_06E1A "Unassigned constant read by INJ 116AE4 [unassigned]" VALUE 0x76E1A RL_VAL_UB 0 CM_0000 0 255 /end CHARACTERISTIC
/begin CHARACTERISTIC UNK_PKS_06E1B "Unassigned constant read by INJ 116D7C [unassigned]" VALUE 0x76E1B RL_VAL_UB 0 CM_0000 0 255 /end CHARACTERISTIC
/begin CHARACTERISTIC UNK_PKS_06E1C "Unassigned constant read by INJ 116F94 [unassigned]" VALUE 0x76E1C RL_VAL_UB 0 CM_0000 0 255 /end CHARACTERISTIC
/begin CHARACTERISTIC UNK_PKS_06E1E "Unassigned constant read by INJ 4A5AC [unassigned]" VALUE 0x76E1E RL_VAL_SW 0 CM_0000 -32768 32767 /end CHARACTERISTIC
/begin CHARACTERISTIC UNK_PKS_06E20 "Unassigned constant read by INJ 50154 [unassigned]" VALUE 0x76E20 RL_VAL_UW 0 CM_0000 0 65535 /end CHARACTERISTIC
/begin CHARACTERISTIC UNK_PKS_06E22 "Unassigned constant read by INJ 117C24 [unassigned]" VALUE 0x76E22 RL_VAL_UW 0 CM_0000 0 65535 /end CHARACTERISTIC
/begin CHARACTERISTIC UNK_PKS_06E24 "Unassigned constant read by INJ 50CA4 [unassigned]" VALUE 0x76E24 RL_VAL_UB 0 CM_0000 0 255 /end CHARACTERISTIC
/begin CHARACTERISTIC UNK_PKS_06E25 "Unassigned constant read by INJ 50CA4 [unassigned]" VALUE 0x76E25 RL_VAL_UB 0 CM_0000 0 255 /end CHARACTERISTIC
/begin CHARACTERISTIC UNK_PKS_06E26 "Unassigned constant read by INJ 50CA4 [unassigned]" VALUE 0x76E26 RL_VAL_UB 0 CM_0000 0 255 /end CHARACTERISTIC
/begin CHARACTERISTIC UNK_PKS_06E28 "Unassigned constant read by INJ 11711C [unassigned]" VALUE 0x76E28 RL_VAL_UW 0 CM_0000 0 65535 /end CHARACTERISTIC
/begin CHARACTERISTIC UNK_PKS_06E2A "Unassigned constant read by INJ 11711C [unassigned]" VALUE 0x76E2A RL_VAL_UW 0 CM_0000 0 65535 /end CHARACTERISTIC
/begin CHARACTERISTIC UNK_PKS_06E2C "Unassigned constant read by INJ 11711C [unassigned]" VALUE 0x76E2C RL_VAL_UW 0 CM_0000 0 65535 /end CHARACTERISTIC
/begin CHARACTERISTIC UNK_PKS_06E2E "Unassigned constant read by INJ 11711C [unassigned]" VALUE 0x76E2E RL_VAL_SW 0 CM_0000 -32768 32767 /end CHARACTERISTIC
/begin CHARACTERISTIC UNK_PKS_06E30 "Unassigned constant read by INJ 116F94 [unassigned]" VALUE 0x76E30 RL_VAL_UW 0 CM_0000 0 65535 /end CHARACTERISTIC
/begin CHARACTERISTIC UNK_PKS_06E32 "Unassigned constant read by INJ 11711C [unassigned]" VALUE 0x76E32 RL_VAL_UB 0 CM_0257 0 127.5 /end CHARACTERISTIC
/begin CHARACTERISTIC UNK_PKS_06E36 "Unassigned constant read by INJ 11711C [unassigned]" VALUE 0x76E36 RL_VAL_SW 0 CM_0000 -32768 32767 /end CHARACTERISTIC
/begin CHARACTERISTIC UNK_PKS_06E3A "Unassigned constant read by INJ 11711C [unassigned]" VALUE 0x76E3A RL_VAL_UW 0 CM_0000 0 65535 /end CHARACTERISTIC
/begin CHARACTERISTIC UNK_PKS_06E3C "Unassigned constant read by INJ 116AE4 11711C [unassigned]" VALUE 0x76E3C RL_VAL_UW 0 CM_0000 0 65535 /end CHARACTERISTIC
/begin CHARACTERISTIC UNK_PKS_06E3E "Unassigned constant read by INJ 116AE4 11711C [unassigned]" VALUE 0x76E3E RL_VAL_UW 0 CM_0000 0 65535 /end CHARACTERISTIC
/begin CHARACTERISTIC UNK_PKS_06E40 "Unassigned constant read by INJ 116AE4 [unassigned]" VALUE 0x76E40 RL_VAL_UW 0 CM_0000 0 65535 /end CHARACTERISTIC
/begin CHARACTERISTIC UNK_PKS_06E42 "Unassigned constant read by INJ 116AE4 11711C [unassigned]" VALUE 0x76E42 RL_VAL_UW 0 CM_0000 0 65535 /end CHARACTERISTIC
/begin CHARACTERISTIC UNK_PKS_06E44 "Unassigned constant read by INJ 116AE4 11711C [unassigned]" VALUE 0x76E44 RL_VAL_UW 0 CM_0000 0 65535 /end CHARACTERISTIC
/begin CHARACTERISTIC UNK_PKS_06E46 "Unassigned constant read by INJ 11711C [unassigned]" VALUE 0x76E46 RL_VAL_UW 0 CM_0000 0 65535 /end CHARACTERISTIC
/begin CHARACTERISTIC UNK_PKS_06E48 "Unassigned constant read by INJ 116AE4 [unassigned]" VALUE 0x76E48 RL_VAL_SW 0 CM_0000 -32768 32767 /end CHARACTERISTIC
/begin CHARACTERISTIC UNK_PKS_06E54 "Unassigned constant read by INJ 116AE4 [unassigned]" VALUE 0x76E54 RL_VAL_SW 0 CM_0000 -32768 32767 /end CHARACTERISTIC
/begin CHARACTERISTIC UNK_PKS_06E56 "Unassigned constant read by INJ 116AE4 [unassigned]" VALUE 0x76E56 RL_VAL_SW 0 CM_0000 -32768 32767 /end CHARACTERISTIC
/begin CHARACTERISTIC UNK_PKS_06E58 "Unassigned constant read by INJ 116AE4 [unassigned]" VALUE 0x76E58 RL_VAL_SW 0 CM_0000 -32768 32767 /end CHARACTERISTIC
/begin CHARACTERISTIC UNK_PKS_06E5A "Unassigned constant read by INJ 116D7C [unassigned]" VALUE 0x76E5A RL_VAL_UW 0 CM_0000 0 65535 /end CHARACTERISTIC
/begin CHARACTERISTIC UNK_PKS_06E5C "Unassigned constant read by INJ 116D7C [unassigned]" VALUE 0x76E5C RL_VAL_UW 0 CM_0000 0 65535 /end CHARACTERISTIC
/begin CHARACTERISTIC UNK_PKS_06E5E "Unassigned constant read by INJ 116D7C [unassigned]" VALUE 0x76E5E RL_VAL_UW 0 CM_0000 0 65535 /end CHARACTERISTIC
/begin CHARACTERISTIC UNK_PKS_06E60 "Unassigned constant read by INJ 116D7C [unassigned]" VALUE 0x76E60 RL_VAL_UW 0 CM_0000 0 65535 /end CHARACTERISTIC
/begin CHARACTERISTIC UNK_PKS_06E62 "Unassigned constant read by INJ 11711C [unassigned]" VALUE 0x76E62 RL_VAL_UW 0 CM_0000 0 65535 /end CHARACTERISTIC
/begin CHARACTERISTIC UNK_PKS_06E64 "Unassigned constant read by INJ 11711C [unassigned]" VALUE 0x76E64 RL_VAL_SW 0 CM_0000 -32768 32767 /end CHARACTERISTIC
/begin CHARACTERISTIC UNK_PKS_06E6A "Unassigned constant read by INJ 116D7C [unassigned]" VALUE 0x76E6A RL_VAL_SW 0 CM_0000 -32768 32767 /end CHARACTERISTIC
/begin CHARACTERISTIC UNK_PKS_06E6C "Unassigned constant read by INJ 116D7C [unassigned]" VALUE 0x76E6C RL_VAL_SW 0 CM_0000 -32768 32767 /end CHARACTERISTIC
/begin CHARACTERISTIC UNK_PKS_06E6E "Unassigned constant read by INJ 116D7C [unassigned]" VALUE 0x76E6E RL_VAL_SW 0 CM_0000 -32768 32767 /end CHARACTERISTIC
/begin CHARACTERISTIC UNK_PKS_06E78 "Unassigned constant read by INJ 11711C [unassigned]" VALUE 0x76E78 RL_VAL_SW 0 CM_0000 -32768 32767 /end CHARACTERISTIC
/begin CHARACTERISTIC UNK_PKS_06E7A "Unassigned constant read by INJ 11711C [unassigned]" VALUE 0x76E7A RL_VAL_SW 0 CM_0000 -32768 32767 /end CHARACTERISTIC
/begin CHARACTERISTIC UNK_PKS_06E7C "Unassigned constant read by INJ 11711C [unassigned]" VALUE 0x76E7C RL_VAL_UB 0 CM_0000 0 255 /end CHARACTERISTIC
/begin CHARACTERISTIC UNK_PKS_06E7D "Unassigned constant read by INJ 11711C [unassigned]" VALUE 0x76E7D RL_VAL_UB 0 CM_0000 0 255 /end CHARACTERISTIC
/begin CHARACTERISTIC UNK_PKS_06E7E "Unassigned constant read by INJ 116F94 11711C [unassigned]" VALUE 0x76E7E RL_VAL_UW 0 CM_0000 0 65535 /end CHARACTERISTIC
/begin CHARACTERISTIC UNK_PKS_06E80 "Unassigned constant read by INJ 116F94 11711C [unassigned]" VALUE 0x76E80 RL_VAL_SW 0 CM_0000 -32768 32767 /end CHARACTERISTIC
/begin CHARACTERISTIC UNK_PKS_06E82 "Unassigned constant read by INJ 116F94 [unassigned]" VALUE 0x76E82 RL_VAL_SW 0 CM_0000 -32768 32767 /end CHARACTERISTIC
/begin CHARACTERISTIC UNK_PKS_06E84 "Unassigned constant read by INJ 11711C [unassigned]" VALUE 0x76E84 RL_VAL_SW 0 CM_0000 -32768 32767 /end CHARACTERISTIC
/begin CHARACTERISTIC UNK_PKS_06E86 "Unassigned constant read by INJ 11711C [unassigned]" VALUE 0x76E86 RL_VAL_SW 0 CM_0000 -32768 32767 /end CHARACTERISTIC
/begin CHARACTERISTIC UNK_PKS_06E88 "Unassigned constant read by INJ 11711C [unassigned]" VALUE 0x76E88 RL_VAL_UW 0 CM_0000 0 65535 /end CHARACTERISTIC
/begin CHARACTERISTIC UNK_PKS_06E8A "Unassigned constant read by INJ 116F94 41680 [unassigned]" VALUE 0x76E8A RL_VAL_UW 0 CM_0000 0 65535 /end CHARACTERISTIC
/begin CHARACTERISTIC UNK_PKS_06E8C "Unassigned constant read by INJ 11677C 11711C [unassigned]" VALUE 0x76E8C RL_VAL_SW 0 CM_0256 -3550 3003.5 /end CHARACTERISTIC
/begin CHARACTERISTIC UNK_LA_TRIM_04258 "Unassigned constant read by INJ 3CC5C [unassigned]" VALUE 0x74258 RL_VAL_UW 0 CM_0000 0 65535 /end CHARACTERISTIC
/begin CHARACTERISTIC UNK_LAVK_04928 "Unassigned constant read by INJ 3E6C8 [unassigned]" VALUE 0x74928 RL_VAL_UW 0 CM_0000 0 65535 /end CHARACTERISTIC
/begin CHARACTERISTIC UNK_NBEGR_06000 "Unassigned constant read by INJ 49A6C [unassigned]" VALUE 0x76000 RL_VAL_SW 0 CM_0000 -32768 32767 /end CHARACTERISTIC
/begin CHARACTERISTIC UNK_NBEGR_0603C "Unassigned constant read by INJ 4AB78 [unassigned]" VALUE 0x7603C RL_VAL_UB 0 CM_0000 0 255 /end CHARACTERISTIC
/begin CHARACTERISTIC UNK_NBEGR_0B672 "Unassigned constant read by INJ 13DFC0 13E2D4 13E344 [unassigned]" VALUE 0x7B672 RL_VAL_UB 0 CM_0000 0 255 /end CHARACTERISTIC
/begin CHARACTERISTIC UNK_NBEGR_0B674 "Unassigned constant read by INJ 13DFC0 [unassigned]" VALUE 0x7B674 RL_VAL_SW 0 CM_0002 -32768 32767 /end CHARACTERISTIC
/begin CHARACTERISTIC UNK_NBEGR_0B676 "Unassigned constant read by INJ 13D6D8 [unassigned]" VALUE 0x7B676 RL_VAL_SW 0 CM_0002 -32768 32767 /end CHARACTERISTIC
/begin CHARACTERISTIC UNK_NBEGR_0B678 "Unassigned constant read by INJ 13DFC0 [unassigned]" VALUE 0x7B678 RL_VAL_UB 0 CM_0000 0 255 /end CHARACTERISTIC
/begin CHARACTERISTIC UNK_NBEGR_0B679 "Unassigned constant read by INJ 13D6D8 [unassigned]" VALUE 0x7B679 RL_VAL_UB 0 CM_0000 0 255 /end CHARACTERISTIC
/begin CHARACTERISTIC UNK_NBEGR_0B67A "Unassigned constant read by INJ 64FF4 [unassigned]" VALUE 0x7B67A RL_VAL_UW 0 CM_0000 0 65535 /end CHARACTERISTIC
/begin CHARACTERISTIC UNK_SL_086E2 "Unassigned constant read by INJ 593E4 [unassigned]" VALUE 0x786E2 RL_VAL_UB 0 CM_0000 0 255 /end CHARACTERISTIC
/begin CHARACTERISTIC UNK_SL_086F4 "Unassigned constant read by INJ 5905C [unassigned]" VALUE 0x786F4 RL_VAL_SW 0 CM_0000 -32768 32767 /end CHARACTERISTIC
/begin CHARACTERISTIC UNK_SL_086F6 "Unassigned constant read by INJ 5945C [unassigned]" VALUE 0x786F6 RL_VAL_UW 0 CM_0233 0 1092.25 /end CHARACTERISTIC
/begin CHARACTERISTIC UNK_SL_086F8 "Unassigned constant read by INJ 5945C [unassigned]" VALUE 0x786F8 RL_VAL_SW 0 CM_0000 -32768 32767 /end CHARACTERISTIC
/begin CHARACTERISTIC UNK_SL_086FA "Unassigned constant read by INJ 5945C [unassigned]" VALUE 0x786FA RL_VAL_UW 0 CM_0000 0 65535 /end CHARACTERISTIC
/begin CHARACTERISTIC UNK_RD_INJ_00000 "Unidentified constant read directly by INJ 0x4fc,0x1dc8,0x10590 (chapter unknown) [unassigned]" VALUE 0x70000 RL_VAL_UL 0 CM_0000 0 4294967295 /end CHARACTERISTIC
/begin CHARACTERISTIC UNK_RD_INJ_00004 "Unidentified constant read directly by INJ 0x150e4 (chapter unknown) [unassigned]" VALUE 0x70004 RL_VAL_UL 0 CM_0000 0 4294967295 /end CHARACTERISTIC
/begin CHARACTERISTIC UNK_RD_INJ_00008 "Unidentified constant read directly by INJ 0x4fc,0x13810,0x150e4 (chapter unknown) [unassigned]" VALUE 0x70008 RL_VAL_UL 0 CM_0000 0 4294967295 /end CHARACTERISTIC
/begin CHARACTERISTIC UNK_RD_INJ_0000C "Unidentified constant read directly by INJ 0x10590,0x157c0 (chapter unknown) [unassigned]" VALUE 0x7000C RL_VAL_UL 0 CM_0000 0 4294967295 /end CHARACTERISTIC
/begin CHARACTERISTIC UNK_RD_INJ_00010 "Unidentified constant read directly by INJ 0x10590,0x157c0 (chapter unknown) [unassigned]" VALUE 0x70010 RL_VAL_UL 0 CM_0000 0 4294967295 /end CHARACTERISTIC
/begin CHARACTERISTIC UNK_RD_INJ_00014 "Unidentified constant read directly by INJ 0x13810 (chapter unknown) [unassigned]" VALUE 0x70014 RL_VAL_UL 0 CM_0000 0 4294967295 /end CHARACTERISTIC
/begin CHARACTERISTIC UNK_RD_INJ_00018 "Unidentified constant read directly by INJ 0x150e4,0x15d80 (chapter unknown) [unassigned]" VALUE 0x70018 RL_VAL_UL 0 CM_0000 0 4294967295 /end CHARACTERISTIC
/begin CHARACTERISTIC UNK_RD_INJ_0001C "Unidentified constant read directly by INJ 0x150e4,0x15700,0x15bec (chapter unknown) [unassigned]" VALUE 0x7001C RL_VAL_UL 0 CM_0000 0 4294967295 /end CHARACTERISTIC
/begin CHARACTERISTIC UNK_RD_INJ_00030 "Unidentified constant read directly by INJ 0x15700 (chapter unknown) [unassigned]" VALUE 0x70030 RL_VAL_UL 0 CM_0000 0 4294967295 /end CHARACTERISTIC
/begin CHARACTERISTIC UNK_RD_INJ_00080 "Unidentified constant read directly by INJ 0x13810,0x1451c (chapter unknown) [unassigned]" VALUE 0x70080 RL_VAL_UL 0 CM_0000 0 4294967295 /end CHARACTERISTIC
/begin CHARACTERISTIC UNK_RD_INJ_001C0 "Unidentified constant read directly by INJ 0x13810,0x31e3c,0x31ef8 (SK-Manager) [unassigned]" VALUE 0x701C0 RL_VAL_UL 0 CM_0000 0 4294967295 /end CHARACTERISTIC
/begin CHARACTERISTIC UNK_RD_INJ_001C4 "Unidentified constant read directly by INJ 0x13810,0x31ef8 (SK-Manager) [unassigned]" VALUE 0x701C4 RL_VAL_UL 0 CM_0000 0 4294967295 /end CHARACTERISTIC
/begin CHARACTERISTIC UNK_RD_INJ_001C8 "Unidentified constant read directly by INJ 0x13810,0x31ef8 (SK-Manager) [unassigned]" VALUE 0x701C8 RL_VAL_UL 0 CM_0000 0 4294967295 /end CHARACTERISTIC
/begin CHARACTERISTIC UNK_RD_INJ_00204 "Unidentified constant read directly by INJ 0x13810 (chapter unknown) [unassigned]" VALUE 0x70204 RL_VAL_UL 0 CM_0000 0 4294967295 /end CHARACTERISTIC
/begin CHARACTERISTIC UNK_RD_INJ_00208 "Unidentified constant read directly by INJ 0x13810 (chapter unknown) [unassigned]" VALUE 0x70208 RL_VAL_UL 0 CM_0000 0 4294967295 /end CHARACTERISTIC
/begin CHARACTERISTIC UNK_RD_INJ_0020C "Unidentified constant read directly by INJ 0x13810 (chapter unknown) [unassigned]" VALUE 0x7020C RL_VAL_UL 0 CM_0000 0 4294967295 /end CHARACTERISTIC
/begin CHARACTERISTIC UNK_RD_INJ_00290 "Unidentified constant read directly by INJ 0x67974 (chapter unknown) [unassigned]" VALUE 0x70290 RL_VAL_UB 0 CM_0000 0 255 /end CHARACTERISTIC
/begin CHARACTERISTIC UNK_RD_INJ_002A3 "Unidentified constant read directly by INJ 0x2930c,0xd0158 (Kraftstoffdruckregelung) [unassigned]" VALUE 0x702A3 RL_VAL_UB 0 CM_0000 0 255 /end CHARACTERISTIC
/begin CHARACTERISTIC UNK_RD_INJ_002A4 "Unidentified constant read directly by INJ 0xd0158 (Kraftstoffdruckregelung) [unassigned]" VALUE 0x702A4 RL_VAL_UB 0 CM_0000 0 255 /end CHARACTERISTIC
/begin CHARACTERISTIC UNK_RD_INJ_002A6 "Unidentified constant read directly by INJ 0x2930c,0xd0158 (Kraftstoffdruckregelung) [unassigned]" VALUE 0x702A6 RL_VAL_SW 0 CM_0000 -32768 32767 /end CHARACTERISTIC
/begin CHARACTERISTIC UNK_RD_INJ_002A8 "Unidentified constant read directly by INJ 0x2930c,0xd0158 (Kraftstoffdruckregelung) [unassigned]" VALUE 0x702A8 RL_VAL_SW 0 CM_0000 -32768 32767 /end CHARACTERISTIC
/begin CHARACTERISTIC UNK_RD_INJ_002AA "Unidentified constant read directly by INJ 0x2930c (chapter unknown) [unassigned]" VALUE 0x702AA RL_VAL_SW 0 CM_0000 -32768 32767 /end CHARACTERISTIC
/begin CHARACTERISTIC UNK_RD_INJ_002AC "Unidentified constant read directly by INJ 0xfa4a8 (chapter unknown) [unassigned]" VALUE 0x702AC RL_VAL_UB 0 CM_0000 0 255 /end CHARACTERISTIC
/begin CHARACTERISTIC UNK_RD_INJ_002AD "Unidentified constant read directly by INJ 0x2930c,0xd0158 (Kraftstoffdruckregelung) [unassigned]" VALUE 0x702AD RL_VAL_UB 0 CM_0000 0 255 /end CHARACTERISTIC
/begin CHARACTERISTIC UNK_RD_INJ_002B0 "Unidentified constant read directly by INJ 0x2930c,0xd0158 (Kraftstoffdruckregelung) [unassigned]" VALUE 0x702B0 RL_VAL_UL 0 CM_0000 0 4294967295 /end CHARACTERISTIC
/begin CHARACTERISTIC UNK_RD_INJ_002B4 "Unidentified constant read directly by INJ 0x2930c,0xd0158 (Kraftstoffdruckregelung) [unassigned]" VALUE 0x702B4 RL_VAL_UB 0 CM_0000 0 255 /end CHARACTERISTIC
/begin CHARACTERISTIC UNK_RD_INJ_002B6 "Unidentified constant read directly by INJ 0x2930c,0xd0158 (Kraftstoffdruckregelung) [unassigned]" VALUE 0x702B6 RL_VAL_UW 0 CM_0000 0 65535 /end CHARACTERISTIC
/begin CHARACTERISTIC UNK_RD_INJ_002B8 "Unidentified constant read directly by INJ 0x2930c (chapter unknown) [unassigned]" VALUE 0x702B8 RL_VAL_UB 0 CM_0000 0 255 /end CHARACTERISTIC
/begin CHARACTERISTIC UNK_RD_INJ_002CA "Unidentified constant read directly by INJ 0xd1600 (chapter unknown) [unassigned]" VALUE 0x702CA RL_VAL_UB 0 CM_0000 0 255 /end CHARACTERISTIC
/begin CHARACTERISTIC UNK_RD_INJ_002CB "Unidentified constant read directly by INJ 0xd1600 (chapter unknown) [unassigned]" VALUE 0x702CB RL_VAL_UB 0 CM_0000 0 255 /end CHARACTERISTIC
/begin CHARACTERISTIC UNK_RD_INJ_002CC "Unidentified constant read directly by INJ 0xd1600 (chapter unknown) [unassigned]" VALUE 0x702CC RL_VAL_SW 0 CM_0000 -32768 32767 /end CHARACTERISTIC
/begin CHARACTERISTIC UNK_RD_INJ_002CE "Unidentified constant read directly by INJ 0xd1600 (chapter unknown) [unassigned]" VALUE 0x702CE RL_VAL_SW 0 CM_0000 -32768 32767 /end CHARACTERISTIC
/begin CHARACTERISTIC UNK_RD_INJ_002D0 "Unidentified constant read directly by INJ 0xd1600 (chapter unknown) [unassigned]" VALUE 0x702D0 RL_VAL_SW 0 CM_0000 -32768 32767 /end CHARACTERISTIC
/begin CHARACTERISTIC UNK_RD_INJ_002D2 "Unidentified constant read directly by INJ 0xd1600 (chapter unknown) [unassigned]" VALUE 0x702D2 RL_VAL_SW 0 CM_0000 -32768 32767 /end CHARACTERISTIC
/begin CHARACTERISTIC UNK_RD_INJ_00316 "Unidentified constant read directly by INJ 0xd1600 (chapter unknown) [unassigned]" VALUE 0x70316 RL_VAL_UB 0 CM_0000 0 255 /end CHARACTERISTIC
/begin CHARACTERISTIC UNK_RD_INJ_00317 "Unidentified constant read directly by INJ 0xd1508 (chapter unknown) [unassigned]" VALUE 0x70317 RL_VAL_UB 0 CM_0000 0 255 /end CHARACTERISTIC
/begin CHARACTERISTIC UNK_RD_INJ_0051E "Unidentified constant read directly by INJ 0xd3c04 (chapter unknown) [unassigned]" VALUE 0x7051E RL_VAL_UB 0 CM_0000 0 255 /end CHARACTERISTIC
/begin CHARACTERISTIC UNK_RD_INJ_0051F "Unidentified constant read directly by INJ 0xd3c04 (chapter unknown) [unassigned]" VALUE 0x7051F RL_VAL_UB 0 CM_0000 0 255 /end CHARACTERISTIC
/begin CHARACTERISTIC UNK_RD_INJ_00521 "Unidentified constant read directly by INJ 0xd3c04 (chapter unknown) [unassigned]" VALUE 0x70521 RL_VAL_UB 0 CM_0000 0 255 /end CHARACTERISTIC
/begin CHARACTERISTIC UNK_RD_INJ_00522 "Unidentified constant read directly by INJ 0xd3c04 (chapter unknown) [unassigned]" VALUE 0x70522 RL_VAL_UB 0 CM_0000 0 255 /end CHARACTERISTIC
/begin CHARACTERISTIC UNK_RD_INJ_00523 "Unidentified constant read directly by INJ 0xd3c04 (chapter unknown) [unassigned]" VALUE 0x70523 RL_VAL_UB 0 CM_0000 0 255 /end CHARACTERISTIC
/begin CHARACTERISTIC UNK_RD_INJ_00524 "Unidentified constant read directly by INJ 0xd3c04 (chapter unknown) [unassigned]" VALUE 0x70524 RL_VAL_UB 0 CM_0000 0 255 /end CHARACTERISTIC
/begin CHARACTERISTIC UNK_RD_INJ_00525 "Unidentified constant read directly by INJ 0xd3c04 (chapter unknown) [unassigned]" VALUE 0x70525 RL_VAL_UB 0 CM_0000 0 255 /end CHARACTERISTIC
/begin CHARACTERISTIC UNK_RD_INJ_0054C "Unidentified constant read directly by INJ 0x2d11c (chapter unknown) [unassigned]" VALUE 0x7054C RL_VAL_UB 0 CM_0000 0 255 /end CHARACTERISTIC
/begin CHARACTERISTIC UNK_RD_INJ_00551 "Unidentified constant read directly by INJ 0x2ecc8 (chapter unknown) [unassigned]" VALUE 0x70551 RL_VAL_UB 0 CM_0000 0 255 /end CHARACTERISTIC
/begin CHARACTERISTIC UNK_RD_INJ_00554 "Unidentified constant read directly by INJ 0xdfc54,0xe12f4,0xe1f68 (chapter unknown) [unassigned]" VALUE 0x70554 RL_VAL_UW 0 CM_0000 0 65535 /end CHARACTERISTIC
/begin CHARACTERISTIC UNK_RD_INJ_00566 "Unidentified constant read directly by INJ 0xdfc54 (chapter unknown) [unassigned]" VALUE 0x70566 RL_VAL_UW 0 CM_0000 0 65535 /end CHARACTERISTIC
/begin CHARACTERISTIC UNK_RD_INJ_00568 "Unidentified constant read directly by INJ 0xdfc54 (chapter unknown) [unassigned]" VALUE 0x70568 RL_VAL_UW 0 CM_0000 0 65535 /end CHARACTERISTIC
/begin CHARACTERISTIC UNK_RD_INJ_0056A "Unidentified constant read directly by INJ 0xdfc54 (chapter unknown) [unassigned]" VALUE 0x7056A RL_VAL_UW 0 CM_0000 0 65535 /end CHARACTERISTIC
/begin CHARACTERISTIC UNK_RD_INJ_0056C "Unidentified constant read directly by INJ 0xdfc54 (chapter unknown) [unassigned]" VALUE 0x7056C RL_VAL_UW 0 CM_0000 0 65535 /end CHARACTERISTIC
/begin CHARACTERISTIC UNK_RD_INJ_0056E "Unidentified constant read directly by INJ 0xdfc54 (chapter unknown) [unassigned]" VALUE 0x7056E RL_VAL_UW 0 CM_0000 0 65535 /end CHARACTERISTIC
/begin CHARACTERISTIC UNK_RD_INJ_00570 "Unidentified constant read directly by INJ 0xd430c,0xdfc54 (chapter unknown) [unassigned]" VALUE 0x70570 RL_VAL_SW 0 CM_0000 -32768 32767 /end CHARACTERISTIC
/begin CHARACTERISTIC UNK_RD_INJ_00572 "Unidentified constant read directly by INJ 0xd0e98,0xdfc54 (chapter unknown) [unassigned]" VALUE 0x70572 RL_VAL_UW 0 CM_0000 0 65535 /end CHARACTERISTIC
/begin CHARACTERISTIC UNK_RD_INJ_00574 "Unidentified constant read directly by INJ 0xdfc54 (chapter unknown) [unassigned]" VALUE 0x70574 RL_VAL_UB 0 CM_0000 0 255 /end CHARACTERISTIC
/begin CHARACTERISTIC UNK_RD_INJ_00575 "Unidentified constant read directly by INJ 0xdfc54 (chapter unknown) [unassigned]" VALUE 0x70575 RL_VAL_UB 0 CM_0000 0 255 /end CHARACTERISTIC
/begin CHARACTERISTIC UNK_RD_INJ_00578 "Unidentified constant read directly by INJ 0xdfc54 (chapter unknown) [unassigned]" VALUE 0x70578 RL_VAL_UB 0 CM_0000 0 255 /end CHARACTERISTIC
/begin CHARACTERISTIC UNK_RD_INJ_0057A "Unidentified constant read directly by INJ 0xdfc54 (chapter unknown) [unassigned]" VALUE 0x7057A RL_VAL_UB 0 CM_0000 0 255 /end CHARACTERISTIC
/begin CHARACTERISTIC UNK_RD_INJ_005B4 "Unidentified constant read directly by INJ 0xdfc54 (chapter unknown) [unassigned]" VALUE 0x705B4 RL_VAL_UL 0 CM_0000 0 4294967295 /end CHARACTERISTIC
/begin CHARACTERISTIC UNK_RD_INJ_008D8 "Unidentified constant read directly by INJ 0xe1f68 (chapter unknown) [unassigned]" VALUE 0x708D8 RL_VAL_UL 0 CM_0000 0 4294967295 /end CHARACTERISTIC
/begin CHARACTERISTIC UNK_RD_INJ_008DC "Unidentified constant read directly by INJ 0xe1f68 (chapter unknown) [unassigned]" VALUE 0x708DC RL_VAL_UB 0 CM_0000 0 255 /end CHARACTERISTIC
/begin CHARACTERISTIC UNK_RD_INJ_008DE "Unidentified constant read directly by INJ 0xe27f0 (chapter unknown) [unassigned]" VALUE 0x708DE RL_VAL_SW 0 CM_0000 -32768 32767 /end CHARACTERISTIC
/begin CHARACTERISTIC UNK_RD_INJ_008E0 "Unidentified constant read directly by INJ 0xe27f0 (chapter unknown) [unassigned]" VALUE 0x708E0 RL_VAL_SW 0 CM_0000 -32768 32767 /end CHARACTERISTIC
/begin CHARACTERISTIC UNK_RD_INJ_008E2 "Unidentified constant read directly by INJ 0xe27f0 (chapter unknown) [unassigned]" VALUE 0x708E2 RL_VAL_SW 0 CM_0000 -32768 32767 /end CHARACTERISTIC
/begin CHARACTERISTIC UNK_RD_INJ_008E4 "Unidentified constant read directly by INJ 0xe27f0 (chapter unknown) [unassigned]" VALUE 0x708E4 RL_VAL_SW 0 CM_0000 -32768 32767 /end CHARACTERISTIC
/begin CHARACTERISTIC UNK_RD_INJ_008E6 "Unidentified constant read directly by INJ 0xe27f0 (chapter unknown) [unassigned]" VALUE 0x708E6 RL_VAL_SW 0 CM_0000 -32768 32767 /end CHARACTERISTIC
/begin CHARACTERISTIC UNK_RD_INJ_008E8 "Unidentified constant read directly by INJ 0xe27f0 (chapter unknown) [unassigned]" VALUE 0x708E8 RL_VAL_SW 0 CM_0000 -32768 32767 /end CHARACTERISTIC
/begin CHARACTERISTIC UNK_RD_INJ_008EA "Unidentified constant read directly by INJ 0xe27f0 (chapter unknown) [unassigned]" VALUE 0x708EA RL_VAL_SW 0 CM_0000 -32768 32767 /end CHARACTERISTIC
/begin CHARACTERISTIC UNK_RD_INJ_008EC "Unidentified constant read directly by INJ 0xe27f0 (chapter unknown) [unassigned]" VALUE 0x708EC RL_VAL_SW 0 CM_0000 -32768 32767 /end CHARACTERISTIC
/begin CHARACTERISTIC UNK_RD_INJ_008EE "Unidentified constant read directly by INJ 0xe27f0 (chapter unknown) [unassigned]" VALUE 0x708EE RL_VAL_SW 0 CM_0000 -32768 32767 /end CHARACTERISTIC
/begin CHARACTERISTIC UNK_RD_INJ_008F0 "Unidentified constant read directly by INJ 0xe27f0 (chapter unknown) [unassigned]" VALUE 0x708F0 RL_VAL_UB 0 CM_0000 0 255 /end CHARACTERISTIC
/begin CHARACTERISTIC UNK_RD_INJ_008F1 "Unidentified constant read directly by INJ 0xe27f0 (chapter unknown) [unassigned]" VALUE 0x708F1 RL_VAL_UB 0 CM_0000 0 255 /end CHARACTERISTIC
/begin CHARACTERISTIC UNK_RD_INJ_008F2 "Unidentified constant read directly by INJ 0xe27f0 (chapter unknown) [unassigned]" VALUE 0x708F2 RL_VAL_UB 0 CM_0000 0 255 /end CHARACTERISTIC
/begin CHARACTERISTIC UNK_RD_INJ_008F3 "Unidentified constant read directly by INJ 0xe27f0 (chapter unknown) [unassigned]" VALUE 0x708F3 RL_VAL_UB 0 CM_0000 0 255 /end CHARACTERISTIC
/begin CHARACTERISTIC UNK_RD_INJ_008F4 "Unidentified constant read directly by INJ 0xe27f0 (chapter unknown) [unassigned]" VALUE 0x708F4 RL_VAL_UB 0 CM_0000 0 255 /end CHARACTERISTIC
/begin CHARACTERISTIC UNK_RD_INJ_008F5 "Unidentified constant read directly by INJ 0xe27f0 (chapter unknown) [unassigned]" VALUE 0x708F5 RL_VAL_UB 0 CM_0000 0 255 /end CHARACTERISTIC
/begin CHARACTERISTIC UNK_RD_INJ_008F6 "Unidentified constant read directly by INJ 0xe27f0 (chapter unknown) [unassigned]" VALUE 0x708F6 RL_VAL_UB 0 CM_0000 0 255 /end CHARACTERISTIC
/begin CHARACTERISTIC UNK_RD_INJ_008F7 "Unidentified constant read directly by INJ 0xe27f0 (chapter unknown) [unassigned]" VALUE 0x708F7 RL_VAL_UB 0 CM_0000 0 255 /end CHARACTERISTIC
/begin CHARACTERISTIC UNK_RD_INJ_008F8 "Unidentified constant read directly by INJ 0xe27f0 (chapter unknown) [unassigned]" VALUE 0x708F8 RL_VAL_UB 0 CM_0000 0 255 /end CHARACTERISTIC
/begin CHARACTERISTIC UNK_RD_INJ_008F9 "Unidentified constant read directly by INJ 0xe27f0 (chapter unknown) [unassigned]" VALUE 0x708F9 RL_VAL_UB 0 CM_0000 0 255 /end CHARACTERISTIC
/begin CHARACTERISTIC UNK_RD_INJ_008FA "Unidentified constant read directly by INJ 0xe27f0 (chapter unknown) [unassigned]" VALUE 0x708FA RL_VAL_UB 0 CM_0000 0 255 /end CHARACTERISTIC
/begin CHARACTERISTIC UNK_RD_INJ_0090A "Unidentified constant read directly by INJ 0xe3df8 (chapter unknown) [unassigned]" VALUE 0x7090A RL_VAL_SW 0 CM_0000 -32768 32767 /end CHARACTERISTIC
/begin CHARACTERISTIC UNK_RD_INJ_0090C "Unidentified constant read directly by INJ 0xe3df8 (chapter unknown) [unassigned]" VALUE 0x7090C RL_VAL_SW 0 CM_0000 -32768 32767 /end CHARACTERISTIC
/begin CHARACTERISTIC UNK_RD_INJ_0090E "Unidentified constant read directly by INJ 0xe3df8 (chapter unknown) [unassigned]" VALUE 0x7090E RL_VAL_UW 0 CM_0000 0 65535 /end CHARACTERISTIC
/begin CHARACTERISTIC UNK_RD_INJ_00910 "Unidentified constant read directly by INJ 0xe3df8 (chapter unknown) [unassigned]" VALUE 0x70910 RL_VAL_UW 0 CM_0000 0 65535 /end CHARACTERISTIC
/begin CHARACTERISTIC UNK_RD_INJ_00912 "Unidentified constant read directly by INJ 0xe3df8 (chapter unknown) [unassigned]" VALUE 0x70912 RL_VAL_UW 0 CM_0000 0 65535 /end CHARACTERISTIC
/begin CHARACTERISTIC UNK_RD_INJ_00918 "Unidentified constant read directly by INJ 0xe3df8 (chapter unknown) [unassigned]" VALUE 0x70918 RL_VAL_UW 0 CM_0000 0 65535 /end CHARACTERISTIC
/begin CHARACTERISTIC UNK_RD_INJ_0091A "Unidentified constant read directly by INJ 0xe3df8 (chapter unknown) [unassigned]" VALUE 0x7091A RL_VAL_UW 0 CM_0000 0 65535 /end CHARACTERISTIC
/begin CHARACTERISTIC UNK_RD_INJ_0091C "Unidentified constant read directly by INJ 0xe3df8 (chapter unknown) [unassigned]" VALUE 0x7091C RL_VAL_UW 0 CM_0000 0 65535 /end CHARACTERISTIC
/begin CHARACTERISTIC UNK_RD_INJ_00921 "Unidentified constant read directly by INJ 0xe3df8 (chapter unknown) [unassigned]" VALUE 0x70921 RL_VAL_UB 0 CM_0000 0 255 /end CHARACTERISTIC
/begin CHARACTERISTIC UNK_RD_INJ_00925 "Unidentified constant read directly by INJ 0xe3df8 (chapter unknown) [unassigned]" VALUE 0x70925 RL_VAL_UB 0 CM_0000 0 255 /end CHARACTERISTIC
/begin CHARACTERISTIC UNK_RD_INJ_00928 "Unidentified constant read directly by INJ 0x32990,0x33218 (chapter unknown) [unassigned]" VALUE 0x70928 RL_VAL_SW 0 CM_0000 -32768 32767 /end CHARACTERISTIC
/begin CHARACTERISTIC UNK_RD_INJ_0092E "Unidentified constant read directly by INJ 0xe4e20 (chapter unknown) [unassigned]" VALUE 0x7092E RL_VAL_UB 0 CM_0000 0 255 /end CHARACTERISTIC
/begin CHARACTERISTIC UNK_RD_INJ_0092F "Unidentified constant read directly by INJ 0xe4e20 (chapter unknown) [unassigned]" VALUE 0x7092F RL_VAL_UB 0 CM_0000 0 255 /end CHARACTERISTIC
/begin CHARACTERISTIC UNK_RD_INJ_00A4A "Unidentified constant read directly by INJ 0xeaf4c (Qualit?tssensor) [unassigned]" VALUE 0x70A4A RL_VAL_UB 0 CM_0000 0 255 /end CHARACTERISTIC
/begin CHARACTERISTIC UNK_RD_INJ_00A4E "Unidentified constant read directly by INJ 0x34188 (chapter unknown) [unassigned]" VALUE 0x70A4E RL_VAL_UB 0 CM_0000 0 255 /end CHARACTERISTIC
/begin CHARACTERISTIC UNK_RD_INJ_00A4F "Unidentified constant read directly by INJ 0x34188 (chapter unknown) [unassigned]" VALUE 0x70A4F RL_VAL_UB 0 CM_0000 0 255 /end CHARACTERISTIC
/begin CHARACTERISTIC UNK_RD_INJ_00A52 "Unidentified constant read directly by INJ 0x34188 (chapter unknown) [unassigned]" VALUE 0x70A52 RL_VAL_UW 0 CM_0000 0 65535 /end CHARACTERISTIC
/begin CHARACTERISTIC UNK_RD_INJ_00A54 "Unidentified constant read directly by INJ 0x34188 (chapter unknown) [unassigned]" VALUE 0x70A54 RL_VAL_UW 0 CM_0000 0 65535 /end CHARACTERISTIC
/begin CHARACTERISTIC UNK_RD_INJ_02188 "Unidentified constant read directly by INJ 0xecbd0 (Elektrol?fteransteuerung) [unassigned]" VALUE 0x72188 RL_VAL_SW 0 CM_0000 -32768 32767 /end CHARACTERISTIC
/begin CHARACTERISTIC UNK_RD_INJ_0218A "Unidentified constant read directly by INJ 0xecbd0 (Elektrol?fteransteuerung) [unassigned]" VALUE 0x7218A RL_VAL_SW 0 CM_0000 -32768 32767 /end CHARACTERISTIC
/begin CHARACTERISTIC UNK_RD_INJ_021A6 "Unidentified constant read directly by INJ 0xd8aa4,0xefa64 (Ansauglufttemperatur) [unassigned]" VALUE 0x721A6 RL_VAL_UW 0 CM_0000 0 65535 /end CHARACTERISTIC
/begin CHARACTERISTIC UNK_RD_INJ_021AA "Unidentified constant read directly by INJ 0x346d0 (chapter unknown) [unassigned]" VALUE 0x721AA RL_VAL_UB 0 CM_0000 0 255 /end CHARACTERISTIC
/begin CHARACTERISTIC UNK_RD_INJ_021E2 "Unidentified constant read directly by INJ 0xf1c0c (chapter unknown) [unassigned]" VALUE 0x721E2 RL_VAL_SW 0 CM_0000 -32768 32767 /end CHARACTERISTIC
/begin CHARACTERISTIC UNK_RD_INJ_021E4 "Unidentified constant read directly by INJ 0xf1c0c (chapter unknown) [unassigned]" VALUE 0x721E4 RL_VAL_SW 0 CM_0000 -32768 32767 /end CHARACTERISTIC
/begin CHARACTERISTIC UNK_RD_INJ_021E6 "Unidentified constant read directly by INJ 0xf1c0c (chapter unknown) [unassigned]" VALUE 0x721E6 RL_VAL_SW 0 CM_0000 -32768 32767 /end CHARACTERISTIC
/begin CHARACTERISTIC UNK_RD_INJ_021E8 "Unidentified constant read directly by INJ 0x35ee8 (chapter unknown) [unassigned]" VALUE 0x721E8 RL_VAL_SW 0 CM_0000 -32768 32767 /end CHARACTERISTIC
/begin CHARACTERISTIC UNK_RD_INJ_021EA "Unidentified constant read directly by INJ 0x35ee8 (chapter unknown) [unassigned]" VALUE 0x721EA RL_VAL_SW 0 CM_0000 -32768 32767 /end CHARACTERISTIC
/begin CHARACTERISTIC UNK_RD_INJ_021EC "Unidentified constant read directly by INJ 0xf1c0c (chapter unknown) [unassigned]" VALUE 0x721EC RL_VAL_SW 0 CM_0000 -32768 32767 /end CHARACTERISTIC
/begin CHARACTERISTIC UNK_RD_INJ_021EE "Unidentified constant read directly by INJ 0xf1c0c (chapter unknown) [unassigned]" VALUE 0x721EE RL_VAL_SW 0 CM_0000 -32768 32767 /end CHARACTERISTIC
/begin CHARACTERISTIC UNK_RD_INJ_021F0 "Unidentified constant read directly by INJ 0xf1c0c (chapter unknown) [unassigned]" VALUE 0x721F0 RL_VAL_UW 0 CM_0000 0 65535 /end CHARACTERISTIC
/begin CHARACTERISTIC UNK_RD_INJ_021F2 "Unidentified constant read directly by INJ 0xf1c0c (chapter unknown) [unassigned]" VALUE 0x721F2 RL_VAL_UW 0 CM_0000 0 65535 /end CHARACTERISTIC
/begin CHARACTERISTIC UNK_RD_INJ_021F4 "Unidentified constant read directly by INJ 0xf1c0c (chapter unknown) [unassigned]" VALUE 0x721F4 RL_VAL_UW 0 CM_0000 0 65535 /end CHARACTERISTIC
/begin CHARACTERISTIC UNK_RD_INJ_021F6 "Unidentified constant read directly by INJ 0xf1c0c (chapter unknown) [unassigned]" VALUE 0x721F6 RL_VAL_UW 0 CM_0000 0 65535 /end CHARACTERISTIC
/begin CHARACTERISTIC UNK_RD_INJ_021F8 "Unidentified constant read directly by INJ 0x35ee8 (chapter unknown) [unassigned]" VALUE 0x721F8 RL_VAL_UW 0 CM_0000 0 65535 /end CHARACTERISTIC
/begin CHARACTERISTIC UNK_RD_INJ_021FA "Unidentified constant read directly by INJ 0xf1c0c (chapter unknown) [unassigned]" VALUE 0x721FA RL_VAL_UW 0 CM_0000 0 65535 /end CHARACTERISTIC
/begin CHARACTERISTIC UNK_RD_INJ_021FC "Unidentified constant read directly by INJ 0xf1c0c (chapter unknown) [unassigned]" VALUE 0x721FC RL_VAL_UW 0 CM_0000 0 65535 /end CHARACTERISTIC
/begin CHARACTERISTIC UNK_RD_INJ_021FE "Unidentified constant read directly by INJ 0xf1c0c (chapter unknown) [unassigned]" VALUE 0x721FE RL_VAL_UW 0 CM_0000 0 65535 /end CHARACTERISTIC
/begin CHARACTERISTIC UNK_RD_INJ_02200 "Unidentified constant read directly by INJ 0xf1c0c (chapter unknown) [unassigned]" VALUE 0x72200 RL_VAL_UW 0 CM_0000 0 65535 /end CHARACTERISTIC
/begin CHARACTERISTIC UNK_RD_INJ_02202 "Unidentified constant read directly by INJ 0xf1c0c (chapter unknown) [unassigned]" VALUE 0x72202 RL_VAL_UW 0 CM_0000 0 65535 /end CHARACTERISTIC
/begin CHARACTERISTIC UNK_RD_INJ_02204 "Unidentified constant read directly by INJ 0xf1c0c (chapter unknown) [unassigned]" VALUE 0x72204 RL_VAL_UW 0 CM_0000 0 65535 /end CHARACTERISTIC
/begin CHARACTERISTIC UNK_RD_INJ_02206 "Unidentified constant read directly by INJ 0xf1c0c (chapter unknown) [unassigned]" VALUE 0x72206 RL_VAL_UB 0 CM_0000 0 255 /end CHARACTERISTIC
/begin CHARACTERISTIC UNK_RD_INJ_02207 "Unidentified constant read directly by INJ 0xf1c0c (chapter unknown) [unassigned]" VALUE 0x72207 RL_VAL_UB 0 CM_0000 0 255 /end CHARACTERISTIC
/begin CHARACTERISTIC UNK_RD_INJ_028E4 "Unidentified constant read directly by INJ 0xf71e4 (chapter unknown) [unassigned]" VALUE 0x728E4 RL_VAL_SW 0 CM_0000 -32768 32767 /end CHARACTERISTIC
/begin CHARACTERISTIC UNK_RD_INJ_028E6 "Unidentified constant read directly by INJ 0xf71e4 (chapter unknown) [unassigned]" VALUE 0x728E6 RL_VAL_SW 0 CM_0000 -32768 32767 /end CHARACTERISTIC
/begin CHARACTERISTIC UNK_RD_INJ_028E8 "Unidentified constant read directly by INJ 0xf71e4 (chapter unknown) [unassigned]" VALUE 0x728E8 RL_VAL_SW 0 CM_0000 -32768 32767 /end CHARACTERISTIC
/begin CHARACTERISTIC UNK_RD_INJ_028EA "Unidentified constant read directly by INJ 0xf79e0 (chapter unknown) [unassigned]" VALUE 0x728EA RL_VAL_UB 0 CM_0000 0 255 /end CHARACTERISTIC
/begin CHARACTERISTIC UNK_RD_INJ_028EB "Unidentified constant read directly by INJ 0xf79e0 (chapter unknown) [unassigned]" VALUE 0x728EB RL_VAL_UB 0 CM_0000 0 255 /end CHARACTERISTIC
/begin CHARACTERISTIC UNK_RD_INJ_028EC "Unidentified constant read directly by INJ 0xf79e0 (chapter unknown) [unassigned]" VALUE 0x728EC RL_VAL_UB 0 CM_0000 0 255 /end CHARACTERISTIC
/begin CHARACTERISTIC UNK_RD_INJ_028ED "Unidentified constant read directly by INJ 0xf79e0 (chapter unknown) [unassigned]" VALUE 0x728ED RL_VAL_UB 0 CM_0000 0 255 /end CHARACTERISTIC
/begin CHARACTERISTIC UNK_RD_INJ_028F2 "Unidentified constant read directly by INJ 0xf79e0 (chapter unknown) [unassigned]" VALUE 0x728F2 RL_VAL_SW 0 CM_0000 -32768 32767 /end CHARACTERISTIC
/begin CHARACTERISTIC UNK_RD_INJ_028F4 "Unidentified constant read directly by INJ 0xf79e0 (chapter unknown) [unassigned]" VALUE 0x728F4 RL_VAL_SW 0 CM_0000 -32768 32767 /end CHARACTERISTIC
/begin CHARACTERISTIC UNK_RD_INJ_028F6 "Unidentified constant read directly by INJ 0xf79e0 (chapter unknown) [unassigned]" VALUE 0x728F6 RL_VAL_UW 0 CM_0000 0 65535 /end CHARACTERISTIC
/begin CHARACTERISTIC UNK_RD_INJ_028F8 "Unidentified constant read directly by INJ 0xf79e0 (chapter unknown) [unassigned]" VALUE 0x728F8 RL_VAL_UW 0 CM_0000 0 65535 /end CHARACTERISTIC
/begin CHARACTERISTIC UNK_RD_INJ_028FA "Unidentified constant read directly by INJ 0xf79e0 (chapter unknown) [unassigned]" VALUE 0x728FA RL_VAL_UW 0 CM_0000 0 65535 /end CHARACTERISTIC
/begin CHARACTERISTIC UNK_RD_INJ_028FC "Unidentified constant read directly by INJ 0xf79e0 (chapter unknown) [unassigned]" VALUE 0x728FC RL_VAL_UB 0 CM_0000 0 255 /end CHARACTERISTIC
/begin CHARACTERISTIC UNK_RD_INJ_028FD "Unidentified constant read directly by INJ 0xf79e0 (chapter unknown) [unassigned]" VALUE 0x728FD RL_VAL_UB 0 CM_0000 0 255 /end CHARACTERISTIC
/begin CHARACTERISTIC UNK_RD_INJ_028FE "Unidentified constant read directly by INJ 0xf79e0 (chapter unknown) [unassigned]" VALUE 0x728FE RL_VAL_UB 0 CM_0000 0 255 /end CHARACTERISTIC
/begin CHARACTERISTIC UNK_RD_INJ_028FF "Unidentified constant read directly by INJ 0xf79e0 (chapter unknown) [unassigned]" VALUE 0x728FF RL_VAL_UB 0 CM_0000 0 255 /end CHARACTERISTIC
/begin CHARACTERISTIC UNK_RD_INJ_02900 "Unidentified constant read directly by INJ 0xf79e0 (chapter unknown) [unassigned]" VALUE 0x72900 RL_VAL_UB 0 CM_0000 0 255 /end CHARACTERISTIC
/begin CHARACTERISTIC UNK_RD_INJ_02901 "Unidentified constant read directly by INJ 0xf79e0 (chapter unknown) [unassigned]" VALUE 0x72901 RL_VAL_UB 0 CM_0000 0 255 /end CHARACTERISTIC
/begin CHARACTERISTIC UNK_RD_INJ_02902 "Unidentified constant read directly by INJ 0xf79e0 (chapter unknown) [unassigned]" VALUE 0x72902 RL_VAL_UB 0 CM_0000 0 255 /end CHARACTERISTIC
/begin CHARACTERISTIC UNK_RD_INJ_02903 "Unidentified constant read directly by INJ 0xf79e0 (chapter unknown) [unassigned]" VALUE 0x72903 RL_VAL_UB 0 CM_0000 0 255 /end CHARACTERISTIC
/begin CHARACTERISTIC UNK_RD_INJ_02904 "Unidentified constant read directly by INJ 0xf79e0 (chapter unknown) [unassigned]" VALUE 0x72904 RL_VAL_UB 0 CM_0000 0 255 /end CHARACTERISTIC
/begin CHARACTERISTIC UNK_RD_INJ_02905 "Unidentified constant read directly by INJ 0xf79e0 (chapter unknown) [unassigned]" VALUE 0x72905 RL_VAL_UB 0 CM_0000 0 255 /end CHARACTERISTIC
/begin CHARACTERISTIC UNK_RD_INJ_02906 "Unidentified constant read directly by INJ 0xf79e0 (chapter unknown) [unassigned]" VALUE 0x72906 RL_VAL_UB 0 CM_0000 0 255 /end CHARACTERISTIC
/begin CHARACTERISTIC UNK_RD_INJ_02907 "Unidentified constant read directly by INJ 0xf79e0 (chapter unknown) [unassigned]" VALUE 0x72907 RL_VAL_UB 0 CM_0000 0 255 /end CHARACTERISTIC
/begin CHARACTERISTIC UNK_RD_INJ_02908 "Unidentified constant read directly by INJ 0xf79e0 (chapter unknown) [unassigned]" VALUE 0x72908 RL_VAL_UB 0 CM_0000 0 255 /end CHARACTERISTIC
/begin CHARACTERISTIC UNK_RD_INJ_02916 "Unidentified constant read directly by INJ 0xf90a4 (chapter unknown) [unassigned]" VALUE 0x72916 RL_VAL_UW 0 CM_0000 0 65535 /end CHARACTERISTIC
/begin CHARACTERISTIC UNK_RD_INJ_02918 "Unidentified constant read directly by INJ 0xf8034 (chapter unknown) [unassigned]" VALUE 0x72918 RL_VAL_SW 0 CM_0000 -32768 32767 /end CHARACTERISTIC
/begin CHARACTERISTIC UNK_RD_INJ_0291A "Unidentified constant read directly by INJ 0xf8034 (chapter unknown) [unassigned]" VALUE 0x7291A RL_VAL_SW 0 CM_0000 -32768 32767 /end CHARACTERISTIC
/begin CHARACTERISTIC UNK_RD_INJ_0291C "Unidentified constant read directly by INJ 0xf8034 (chapter unknown) [unassigned]" VALUE 0x7291C RL_VAL_UW 0 CM_0000 0 65535 /end CHARACTERISTIC
/begin CHARACTERISTIC UNK_RD_INJ_0291E "Unidentified constant read directly by INJ 0xf8034 (chapter unknown) [unassigned]" VALUE 0x7291E RL_VAL_UB 0 CM_0000 0 255 /end CHARACTERISTIC
/begin CHARACTERISTIC UNK_RD_INJ_0291F "Unidentified constant read directly by INJ 0xf8034 (chapter unknown) [unassigned]" VALUE 0x7291F RL_VAL_UB 0 CM_0000 0 255 /end CHARACTERISTIC
/begin CHARACTERISTIC UNK_RD_INJ_02923 "Unidentified constant read directly by INJ 0xf90a4 (chapter unknown) [unassigned]" VALUE 0x72923 RL_VAL_UB 0 CM_0000 0 255 /end CHARACTERISTIC
/begin CHARACTERISTIC UNK_RD_INJ_02924 "Unidentified constant read directly by INJ 0xf8034 (chapter unknown) [unassigned]" VALUE 0x72924 RL_VAL_UB 0 CM_0000 0 255 /end CHARACTERISTIC
/begin CHARACTERISTIC UNK_RD_INJ_02925 "Unidentified constant read directly by INJ 0xf90a4 (chapter unknown) [unassigned]" VALUE 0x72925 RL_VAL_UB 0 CM_0000 0 255 /end CHARACTERISTIC
/begin CHARACTERISTIC UNK_RD_INJ_02926 "Unidentified constant read directly by INJ 0xf9750 (chapter unknown) [unassigned]" VALUE 0x72926 RL_VAL_SW 0 CM_0000 -32768 32767 /end CHARACTERISTIC
/begin CHARACTERISTIC UNK_RD_INJ_02928 "Unidentified constant read directly by INJ 0xf9750 (chapter unknown) [unassigned]" VALUE 0x72928 RL_VAL_SW 0 CM_0000 -32768 32767 /end CHARACTERISTIC
/begin CHARACTERISTIC UNK_RD_INJ_0292A "Unidentified constant read directly by INJ 0xf9750 (chapter unknown) [unassigned]" VALUE 0x7292A RL_VAL_UW 0 CM_0000 0 65535 /end CHARACTERISTIC
/begin CHARACTERISTIC UNK_RD_INJ_0292C "Unidentified constant read directly by INJ 0xf9750 (chapter unknown) [unassigned]" VALUE 0x7292C RL_VAL_UB 0 CM_0000 0 255 /end CHARACTERISTIC
/begin CHARACTERISTIC UNK_RD_INJ_0292D "Unidentified constant read directly by INJ 0xf9750 (chapter unknown) [unassigned]" VALUE 0x7292D RL_VAL_UB 0 CM_0000 0 255 /end CHARACTERISTIC
/begin CHARACTERISTIC UNK_RD_INJ_0292E "Unidentified constant read directly by INJ 0xf9750 (chapter unknown) [unassigned]" VALUE 0x7292E RL_VAL_UB 0 CM_0000 0 255 /end CHARACTERISTIC
/begin CHARACTERISTIC UNK_RD_INJ_03A36 "Unidentified constant read directly by INJ 0x364a0,0x36524 (chapter unknown) [unassigned]" VALUE 0x73A36 RL_VAL_SW 0 CM_0000 -32768 32767 /end CHARACTERISTIC
/begin CHARACTERISTIC UNK_RD_INJ_03A38 "Unidentified constant read directly by INJ 0x36524 (chapter unknown) [unassigned]" VALUE 0x73A38 RL_VAL_SW 0 CM_0000 -32768 32767 /end CHARACTERISTIC
/begin CHARACTERISTIC UNK_RD_INJ_03A3A "Unidentified constant read directly by INJ 0xf9908 (chapter unknown) [unassigned]" VALUE 0x73A3A RL_VAL_SW 0 CM_0000 -32768 32767 /end CHARACTERISTIC
/begin CHARACTERISTIC UNK_RD_INJ_03A3C "Unidentified constant read directly by INJ 0xf9908 (chapter unknown) [unassigned]" VALUE 0x73A3C RL_VAL_UW 0 CM_0000 0 65535 /end CHARACTERISTIC
/begin CHARACTERISTIC UNK_RD_INJ_03A3E "Unidentified constant read directly by INJ 0xf9908 (chapter unknown) [unassigned]" VALUE 0x73A3E RL_VAL_UW 0 CM_0000 0 65535 /end CHARACTERISTIC
/begin CHARACTERISTIC UNK_RD_INJ_03A40 "Unidentified constant read directly by INJ 0x36524 (chapter unknown) [unassigned]" VALUE 0x73A40 RL_VAL_UW 0 CM_0000 0 65535 /end CHARACTERISTIC
/begin CHARACTERISTIC UNK_RD_INJ_03A42 "Unidentified constant read directly by INJ 0xf9908 (chapter unknown) [unassigned]" VALUE 0x73A42 RL_VAL_UW 0 CM_0000 0 65535 /end CHARACTERISTIC
/begin CHARACTERISTIC UNK_RD_INJ_03A44 "Unidentified constant read directly by INJ 0xf9908 (chapter unknown) [unassigned]" VALUE 0x73A44 RL_VAL_UW 0 CM_0000 0 65535 /end CHARACTERISTIC
/begin CHARACTERISTIC UNK_RD_INJ_03A46 "Unidentified constant read directly by INJ 0x36524 (chapter unknown) [unassigned]" VALUE 0x73A46 RL_VAL_UB 0 CM_0000 0 255 /end CHARACTERISTIC
/begin CHARACTERISTIC UNK_RD_INJ_03A47 "Unidentified constant read directly by INJ 0xf9908 (chapter unknown) [unassigned]" VALUE 0x73A47 RL_VAL_UB 0 CM_0000 0 255 /end CHARACTERISTIC
/begin CHARACTERISTIC UNK_RD_INJ_03A48 "Unidentified constant read directly by INJ 0x36524 (chapter unknown) [unassigned]" VALUE 0x73A48 RL_VAL_UB 0 CM_0000 0 255 /end CHARACTERISTIC
/begin CHARACTERISTIC UNK_RD_INJ_03A49 "Unidentified constant read directly by INJ 0xf9908 (chapter unknown) [unassigned]" VALUE 0x73A49 RL_VAL_UB 0 CM_0000 0 255 /end CHARACTERISTIC
/begin CHARACTERISTIC UNK_RD_INJ_03A4A "Unidentified constant read directly by INJ 0xf9908 (chapter unknown) [unassigned]" VALUE 0x73A4A RL_VAL_UB 0 CM_0000 0 255 /end CHARACTERISTIC
/begin CHARACTERISTIC UNK_RD_INJ_03C46 "Unidentified constant read directly by INJ 0x3792c (chapter unknown) [unassigned]" VALUE 0x73C46 RL_VAL_UB 0 CM_0000 0 255 /end CHARACTERISTIC
/begin CHARACTERISTIC UNK_RD_INJ_03C47 "Unidentified constant read directly by INJ 0x3792c (chapter unknown) [unassigned]" VALUE 0x73C47 RL_VAL_UB 0 CM_0000 0 255 /end CHARACTERISTIC
/begin CHARACTERISTIC UNK_RD_INJ_03C48 "Unidentified constant read directly by INJ 0x3792c (chapter unknown) [unassigned]" VALUE 0x73C48 RL_VAL_UB 0 CM_0000 0 255 /end CHARACTERISTIC
/begin CHARACTERISTIC UNK_RD_INJ_03C4A "Unidentified constant read directly by INJ 0xfa044 (chapter unknown) [unassigned]" VALUE 0x73C4A RL_VAL_SW 0 CM_0000 -32768 32767 /end CHARACTERISTIC
/begin CHARACTERISTIC UNK_RD_INJ_03C4C "Unidentified constant read directly by INJ 0xfa044 (chapter unknown) [unassigned]" VALUE 0x73C4C RL_VAL_SW 0 CM_0000 -32768 32767 /end CHARACTERISTIC
/begin CHARACTERISTIC UNK_RD_INJ_03C4E "Unidentified constant read directly by INJ 0xfa044 (chapter unknown) [unassigned]" VALUE 0x73C4E RL_VAL_SW 0 CM_0000 -32768 32767 /end CHARACTERISTIC
/begin CHARACTERISTIC UNK_RD_INJ_03C50 "Unidentified constant read directly by INJ 0xfa044 (chapter unknown) [unassigned]" VALUE 0x73C50 RL_VAL_SW 0 CM_0000 -32768 32767 /end CHARACTERISTIC
/begin CHARACTERISTIC UNK_RD_INJ_03C52 "Unidentified constant read directly by INJ 0xfa044 (chapter unknown) [unassigned]" VALUE 0x73C52 RL_VAL_SW 0 CM_0000 -32768 32767 /end CHARACTERISTIC
/begin CHARACTERISTIC UNK_RD_INJ_03C54 "Unidentified constant read directly by INJ 0xfa044 (chapter unknown) [unassigned]" VALUE 0x73C54 RL_VAL_SW 0 CM_0000 -32768 32767 /end CHARACTERISTIC
/begin CHARACTERISTIC UNK_RD_INJ_03C56 "Unidentified constant read directly by INJ 0xfa044 (chapter unknown) [unassigned]" VALUE 0x73C56 RL_VAL_SW 0 CM_0000 -32768 32767 /end CHARACTERISTIC
/begin CHARACTERISTIC UNK_RD_INJ_03C58 "Unidentified constant read directly by INJ 0xfa044 (chapter unknown) [unassigned]" VALUE 0x73C58 RL_VAL_UW 0 CM_0000 0 65535 /end CHARACTERISTIC
/begin CHARACTERISTIC UNK_RD_INJ_03C5A "Unidentified constant read directly by INJ 0xfa044 (chapter unknown) [unassigned]" VALUE 0x73C5A RL_VAL_UW 0 CM_0000 0 65535 /end CHARACTERISTIC
/begin CHARACTERISTIC UNK_RD_INJ_03C5C "Unidentified constant read directly by INJ 0xfa044 (chapter unknown) [unassigned]" VALUE 0x73C5C RL_VAL_UW 0 CM_0000 0 65535 /end CHARACTERISTIC
/begin CHARACTERISTIC UNK_RD_INJ_03C5E "Unidentified constant read directly by INJ 0xfa044 (chapter unknown) [unassigned]" VALUE 0x73C5E RL_VAL_UW 0 CM_0000 0 65535 /end CHARACTERISTIC
/begin CHARACTERISTIC UNK_RD_INJ_03C60 "Unidentified constant read directly by INJ 0xfa044 (chapter unknown) [unassigned]" VALUE 0x73C60 RL_VAL_UB 0 CM_0000 0 255 /end CHARACTERISTIC
/begin CHARACTERISTIC UNK_RD_INJ_03C61 "Unidentified constant read directly by INJ 0xfa044 (chapter unknown) [unassigned]" VALUE 0x73C61 RL_VAL_UB 0 CM_0000 0 255 /end CHARACTERISTIC
/begin CHARACTERISTIC UNK_RD_INJ_03C62 "Unidentified constant read directly by INJ 0xfa044 (chapter unknown) [unassigned]" VALUE 0x73C62 RL_VAL_UB 0 CM_0000 0 255 /end CHARACTERISTIC
/begin CHARACTERISTIC UNK_RD_INJ_03C63 "Unidentified constant read directly by INJ 0xfa044 (chapter unknown) [unassigned]" VALUE 0x73C63 RL_VAL_UB 0 CM_0000 0 255 /end CHARACTERISTIC
/begin CHARACTERISTIC UNK_RD_INJ_03E06 "Unidentified constant read directly by INJ 0xfa4a8 (chapter unknown) [unassigned]" VALUE 0x73E06 RL_VAL_UB 0 CM_0000 0 255 /end CHARACTERISTIC
/begin CHARACTERISTIC UNK_RD_INJ_03E07 "Unidentified constant read directly by INJ 0xfa4a8 (chapter unknown) [unassigned]" VALUE 0x73E07 RL_VAL_UB 0 CM_0000 0 255 /end CHARACTERISTIC
/begin CHARACTERISTIC UNK_RD_INJ_03E08 "Unidentified constant read directly by INJ 0xfa4a8 (chapter unknown) [unassigned]" VALUE 0x73E08 RL_VAL_UB 0 CM_0000 0 255 /end CHARACTERISTIC
/begin CHARACTERISTIC UNK_RD_INJ_03E09 "Unidentified constant read directly by INJ 0xfa4a8 (chapter unknown) [unassigned]" VALUE 0x73E09 RL_VAL_UB 0 CM_0000 0 255 /end CHARACTERISTIC
/begin CHARACTERISTIC UNK_RD_INJ_03E0A "Unidentified constant read directly by INJ 0xfa4a8 (chapter unknown) [unassigned]" VALUE 0x73E0A RL_VAL_UB 0 CM_0000 0 255 /end CHARACTERISTIC
/begin CHARACTERISTIC UNK_RD_INJ_03E0B "Unidentified constant read directly by INJ 0xfa4a8 (chapter unknown) [unassigned]" VALUE 0x73E0B RL_VAL_UB 0 CM_0000 0 255 /end CHARACTERISTIC
/begin CHARACTERISTIC UNK_RD_INJ_03E0C "Unidentified constant read directly by INJ 0xfa4a8 (chapter unknown) [unassigned]" VALUE 0x73E0C RL_VAL_UB 0 CM_0000 0 255 /end CHARACTERISTIC
/begin CHARACTERISTIC UNK_RD_INJ_03E0D "Unidentified constant read directly by INJ 0xfa4a8 (chapter unknown) [unassigned]" VALUE 0x73E0D RL_VAL_UB 0 CM_0000 0 255 /end CHARACTERISTIC
/begin CHARACTERISTIC UNK_RD_INJ_03E0E "Unidentified constant read directly by INJ 0xfa4a8 (chapter unknown) [unassigned]" VALUE 0x73E0E RL_VAL_UB 0 CM_0000 0 255 /end CHARACTERISTIC
/begin CHARACTERISTIC UNK_RD_INJ_03E0F "Unidentified constant read directly by INJ 0xfa4a8 (chapter unknown) [unassigned]" VALUE 0x73E0F RL_VAL_UB 0 CM_0000 0 255 /end CHARACTERISTIC
/begin CHARACTERISTIC UNK_RD_INJ_03E10 "Unidentified constant read directly by INJ 0xfa4a8 (chapter unknown) [unassigned]" VALUE 0x73E10 RL_VAL_UB 0 CM_0000 0 255 /end CHARACTERISTIC
/begin CHARACTERISTIC UNK_RD_INJ_03E11 "Unidentified constant read directly by INJ 0xfa4a8 (chapter unknown) [unassigned]" VALUE 0x73E11 RL_VAL_UB 0 CM_0000 0 255 /end CHARACTERISTIC
/begin CHARACTERISTIC UNK_RD_INJ_03E12 "Unidentified constant read directly by INJ 0xfa4a8 (chapter unknown) [unassigned]" VALUE 0x73E12 RL_VAL_SW 0 CM_0000 -32768 32767 /end CHARACTERISTIC
/begin CHARACTERISTIC UNK_RD_INJ_03E14 "Unidentified constant read directly by INJ 0xfa4a8 (chapter unknown) [unassigned]" VALUE 0x73E14 RL_VAL_SW 0 CM_0000 -32768 32767 /end CHARACTERISTIC
/begin CHARACTERISTIC UNK_RD_INJ_03E16 "Unidentified constant read directly by INJ 0xfa4a8 (chapter unknown) [unassigned]" VALUE 0x73E16 RL_VAL_SW 0 CM_0000 -32768 32767 /end CHARACTERISTIC
/begin CHARACTERISTIC UNK_RD_INJ_03E18 "Unidentified constant read directly by INJ 0xfa4a8 (chapter unknown) [unassigned]" VALUE 0x73E18 RL_VAL_SW 0 CM_0000 -32768 32767 /end CHARACTERISTIC
/begin CHARACTERISTIC UNK_RD_INJ_03E1A "Unidentified constant read directly by INJ 0xfa4a8 (chapter unknown) [unassigned]" VALUE 0x73E1A RL_VAL_SW 0 CM_0000 -32768 32767 /end CHARACTERISTIC
/begin CHARACTERISTIC UNK_RD_INJ_03E1C "Unidentified constant read directly by INJ 0xfa4a8 (chapter unknown) [unassigned]" VALUE 0x73E1C RL_VAL_SW 0 CM_0000 -32768 32767 /end CHARACTERISTIC
/begin CHARACTERISTIC UNK_RD_INJ_04000 "Unidentified constant read directly by INJ 0xfb024 (chapter unknown) [unassigned]" VALUE 0x74000 RL_VAL_UB 0 CM_0000 0 255 /end CHARACTERISTIC
/begin CHARACTERISTIC UNK_RD_INJ_04001 "Unidentified constant read directly by INJ 0xfb024 (chapter unknown) [unassigned]" VALUE 0x74001 RL_VAL_UB 0 CM_0000 0 255 /end CHARACTERISTIC
/begin CHARACTERISTIC UNK_RD_INJ_04002 "Unidentified constant read directly by INJ 0xfb024 (chapter unknown) [unassigned]" VALUE 0x74002 RL_VAL_UB 0 CM_0000 0 255 /end CHARACTERISTIC
/begin CHARACTERISTIC UNK_RD_INJ_04003 "Unidentified constant read directly by INJ 0xfb024 (chapter unknown) [unassigned]" VALUE 0x74003 RL_VAL_UB 0 CM_0000 0 255 /end CHARACTERISTIC
/begin CHARACTERISTIC UNK_RD_INJ_04004 "Unidentified constant read directly by INJ 0xfb024 (chapter unknown) [unassigned]" VALUE 0x74004 RL_VAL_UB 0 CM_0000 0 255 /end CHARACTERISTIC
/begin CHARACTERISTIC UNK_RD_INJ_04005 "Unidentified constant read directly by INJ 0xfb024 (chapter unknown) [unassigned]" VALUE 0x74005 RL_VAL_UB 0 CM_0000 0 255 /end CHARACTERISTIC
/begin CHARACTERISTIC UNK_RD_INJ_04006 "Unidentified constant read directly by INJ 0xfb024 (chapter unknown) [unassigned]" VALUE 0x74006 RL_VAL_UB 0 CM_0000 0 255 /end CHARACTERISTIC
/begin CHARACTERISTIC UNK_RD_INJ_04007 "Unidentified constant read directly by INJ 0xfb024 (chapter unknown) [unassigned]" VALUE 0x74007 RL_VAL_UB 0 CM_0000 0 255 /end CHARACTERISTIC
/begin CHARACTERISTIC UNK_RD_INJ_04008 "Unidentified constant read directly by INJ 0xfb024 (chapter unknown) [unassigned]" VALUE 0x74008 RL_VAL_UB 0 CM_0000 0 255 /end CHARACTERISTIC
/begin CHARACTERISTIC UNK_RD_INJ_04009 "Unidentified constant read directly by INJ 0xfb024 (chapter unknown) [unassigned]" VALUE 0x74009 RL_VAL_UB 0 CM_0000 0 255 /end CHARACTERISTIC
/begin CHARACTERISTIC UNK_RD_INJ_0400A "Unidentified constant read directly by INJ 0xfa4a8,0xfb024 (chapter unknown) [unassigned]" VALUE 0x7400A RL_VAL_UB 0 CM_0000 0 255 /end CHARACTERISTIC
/begin CHARACTERISTIC UNK_RD_INJ_0400B "Unidentified constant read directly by INJ 0xfb024 (chapter unknown) [unassigned]" VALUE 0x7400B RL_VAL_UB 0 CM_0000 0 255 /end CHARACTERISTIC
/begin CHARACTERISTIC UNK_RD_INJ_0400C "Unidentified constant read directly by INJ 0xfa4a8 (chapter unknown) [unassigned]" VALUE 0x7400C RL_VAL_UB 0 CM_0000 0 255 /end CHARACTERISTIC
/begin CHARACTERISTIC UNK_RD_INJ_0400D "Unidentified constant read directly by INJ 0xfa4a8 (chapter unknown) [unassigned]" VALUE 0x7400D RL_VAL_UB 0 CM_0000 0 255 /end CHARACTERISTIC
/begin CHARACTERISTIC UNK_RD_INJ_0400E "Unidentified constant read directly by INJ 0xfb024 (chapter unknown) [unassigned]" VALUE 0x7400E RL_VAL_UB 0 CM_0000 0 255 /end CHARACTERISTIC
/begin CHARACTERISTIC UNK_RD_INJ_04010 "Unidentified constant read directly by INJ 0xfb024 (chapter unknown) [unassigned]" VALUE 0x74010 RL_VAL_SW 0 CM_0000 -32768 32767 /end CHARACTERISTIC
/begin CHARACTERISTIC UNK_RD_INJ_04012 "Unidentified constant read directly by INJ 0xfb024 (chapter unknown) [unassigned]" VALUE 0x74012 RL_VAL_SW 0 CM_0000 -32768 32767 /end CHARACTERISTIC
/begin CHARACTERISTIC UNK_RD_INJ_04014 "Unidentified constant read directly by INJ 0xfb024 (chapter unknown) [unassigned]" VALUE 0x74014 RL_VAL_SW 0 CM_0000 -32768 32767 /end CHARACTERISTIC
/begin CHARACTERISTIC UNK_RD_INJ_04016 "Unidentified constant read directly by INJ 0xfb024 (chapter unknown) [unassigned]" VALUE 0x74016 RL_VAL_SW 0 CM_0000 -32768 32767 /end CHARACTERISTIC
/begin CHARACTERISTIC UNK_RD_INJ_04018 "Unidentified constant read directly by INJ 0xfa4a8,0xfb024 (chapter unknown) [unassigned]" VALUE 0x74018 RL_VAL_UW 0 CM_0000 0 65535 /end CHARACTERISTIC
/begin CHARACTERISTIC UNK_RD_INJ_0401A "Unidentified constant read directly by INJ 0xfb024 (chapter unknown) [unassigned]" VALUE 0x7401A RL_VAL_UW 0 CM_0000 0 65535 /end CHARACTERISTIC
/begin CHARACTERISTIC UNK_RD_INJ_0401C "Unidentified constant read directly by INJ 0xfa4a8,0xfb024 (chapter unknown) [unassigned]" VALUE 0x7401C RL_VAL_UW 0 CM_0000 0 65535 /end CHARACTERISTIC
/begin CHARACTERISTIC UNK_RD_INJ_0401E "Unidentified constant read directly by INJ 0xfa4a8,0xfb024 (chapter unknown) [unassigned]" VALUE 0x7401E RL_VAL_UW 0 CM_0000 0 65535 /end CHARACTERISTIC
/begin CHARACTERISTIC UNK_RD_INJ_04020 "Unidentified constant read directly by INJ 0xfa4a8,0xfb024 (chapter unknown) [unassigned]" VALUE 0x74020 RL_VAL_UW 0 CM_0000 0 65535 /end CHARACTERISTIC
/begin CHARACTERISTIC UNK_RD_INJ_04022 "Unidentified constant read directly by INJ 0xfb024 (chapter unknown) [unassigned]" VALUE 0x74022 RL_VAL_UW 0 CM_0000 0 65535 /end CHARACTERISTIC
/begin CHARACTERISTIC UNK_RD_INJ_04024 "Unidentified constant read directly by INJ 0xfb024 (chapter unknown) [unassigned]" VALUE 0x74024 RL_VAL_UW 0 CM_0000 0 65535 /end CHARACTERISTIC
/begin CHARACTERISTIC UNK_RD_INJ_04026 "Unidentified constant read directly by INJ 0xfb024 (chapter unknown) [unassigned]" VALUE 0x74026 RL_VAL_UW 0 CM_0000 0 65535 /end CHARACTERISTIC
/begin CHARACTERISTIC UNK_RD_INJ_04028 "Unidentified constant read directly by INJ 0xfb024 (chapter unknown) [unassigned]" VALUE 0x74028 RL_VAL_SW 0 CM_0000 -32768 32767 /end CHARACTERISTIC
/begin CHARACTERISTIC UNK_RD_INJ_0402A "Unidentified constant read directly by INJ 0xfb024 (chapter unknown) [unassigned]" VALUE 0x7402A RL_VAL_SW 0 CM_0000 -32768 32767 /end CHARACTERISTIC
/begin CHARACTERISTIC UNK_RD_INJ_0402C "Unidentified constant read directly by INJ 0xfb024 (chapter unknown) [unassigned]" VALUE 0x7402C RL_VAL_SW 0 CM_0000 -32768 32767 /end CHARACTERISTIC
/begin CHARACTERISTIC UNK_RD_INJ_0402E "Unidentified constant read directly by INJ 0xfb024 (chapter unknown) [unassigned]" VALUE 0x7402E RL_VAL_SW 0 CM_0000 -32768 32767 /end CHARACTERISTIC
/begin CHARACTERISTIC UNK_RD_INJ_04030 "Unidentified constant read directly by INJ 0xfa4a8,0xfb868 (chapter unknown) [unassigned]" VALUE 0x74030 RL_VAL_UB 0 CM_0000 0 255 /end CHARACTERISTIC
/begin CHARACTERISTIC UNK_RD_INJ_04031 "Unidentified constant read directly by INJ 0xfb868 (chapter unknown) [unassigned]" VALUE 0x74031 RL_VAL_UB 0 CM_0000 0 255 /end CHARACTERISTIC
/begin CHARACTERISTIC UNK_RD_INJ_04032 "Unidentified constant read directly by INJ 0xfb868 (chapter unknown) [unassigned]" VALUE 0x74032 RL_VAL_UB 0 CM_0000 0 255 /end CHARACTERISTIC
/begin CHARACTERISTIC UNK_RD_INJ_04033 "Unidentified constant read directly by INJ 0xfb868 (chapter unknown) [unassigned]" VALUE 0x74033 RL_VAL_UB 0 CM_0000 0 255 /end CHARACTERISTIC
/begin CHARACTERISTIC UNK_RD_INJ_04034 "Unidentified constant read directly by INJ 0xfa4a8,0xfb868 (chapter unknown) [unassigned]" VALUE 0x74034 RL_VAL_UB 0 CM_0000 0 255 /end CHARACTERISTIC
/begin CHARACTERISTIC UNK_RD_INJ_04035 "Unidentified constant read directly by INJ 0xfb868,0x107d10 (chapter unknown) [unassigned]" VALUE 0x74035 RL_VAL_UB 0 CM_0000 0 255 /end CHARACTERISTIC
/begin CHARACTERISTIC UNK_RD_INJ_04036 "Unidentified constant read directly by INJ 0xfb868 (chapter unknown) [unassigned]" VALUE 0x74036 RL_VAL_UB 0 CM_0000 0 255 /end CHARACTERISTIC
/begin CHARACTERISTIC UNK_RD_INJ_04037 "Unidentified constant read directly by INJ 0xfb868 (chapter unknown) [unassigned]" VALUE 0x74037 RL_VAL_UB 0 CM_0000 0 255 /end CHARACTERISTIC
/begin CHARACTERISTIC UNK_RD_INJ_04038 "Unidentified constant read directly by INJ 0xfa4a8,0xfb868,0x107d10 (chapter unknown) [unassigned]" VALUE 0x74038 RL_VAL_UB 0 CM_0000 0 255 /end CHARACTERISTIC
/begin CHARACTERISTIC UNK_RD_INJ_04039 "Unidentified constant read directly by INJ 0xfb868 (chapter unknown) [unassigned]" VALUE 0x74039 RL_VAL_UB 0 CM_0000 0 255 /end CHARACTERISTIC
/begin CHARACTERISTIC UNK_RD_INJ_0403A "Unidentified constant read directly by INJ 0xfb868 (chapter unknown) [unassigned]" VALUE 0x7403A RL_VAL_UB 0 CM_0000 0 255 /end CHARACTERISTIC
/begin CHARACTERISTIC UNK_RD_INJ_0403C "Unidentified constant read directly by INJ 0xfb868 (chapter unknown) [unassigned]" VALUE 0x7403C RL_VAL_SW 0 CM_0000 -32768 32767 /end CHARACTERISTIC
/begin CHARACTERISTIC UNK_RD_INJ_0403E "Unidentified constant read directly by INJ 0xfb868 (chapter unknown) [unassigned]" VALUE 0x7403E RL_VAL_SW 0 CM_0000 -32768 32767 /end CHARACTERISTIC
/begin CHARACTERISTIC UNK_RD_INJ_04040 "Unidentified constant read directly by INJ 0xfb868 (chapter unknown) [unassigned]" VALUE 0x74040 RL_VAL_SW 0 CM_0000 -32768 32767 /end CHARACTERISTIC
/begin CHARACTERISTIC UNK_RD_INJ_04042 "Unidentified constant read directly by INJ 0xfb868 (chapter unknown) [unassigned]" VALUE 0x74042 RL_VAL_SW 0 CM_0000 -32768 32767 /end CHARACTERISTIC
/begin CHARACTERISTIC UNK_RD_INJ_04044 "Unidentified constant read directly by INJ 0xfb868 (chapter unknown) [unassigned]" VALUE 0x74044 RL_VAL_SW 0 CM_0000 -32768 32767 /end CHARACTERISTIC
/begin CHARACTERISTIC UNK_RD_INJ_04046 "Unidentified constant read directly by INJ 0xfb868 (chapter unknown) [unassigned]" VALUE 0x74046 RL_VAL_SW 0 CM_0000 -32768 32767 /end CHARACTERISTIC
/begin CHARACTERISTIC UNK_RD_INJ_04048 "Unidentified constant read directly by INJ 0xfb868 (chapter unknown) [unassigned]" VALUE 0x74048 RL_VAL_SW 0 CM_0000 -32768 32767 /end CHARACTERISTIC
/begin CHARACTERISTIC UNK_RD_INJ_0404A "Unidentified constant read directly by INJ 0xfb868 (chapter unknown) [unassigned]" VALUE 0x7404A RL_VAL_SW 0 CM_0000 -32768 32767 /end CHARACTERISTIC
/begin CHARACTERISTIC UNK_RD_INJ_0404C "Unidentified constant read directly by INJ 0xfa4a8,0xfb868 (chapter unknown) [unassigned]" VALUE 0x7404C RL_VAL_SW 0 CM_0000 -32768 32767 /end CHARACTERISTIC
/begin CHARACTERISTIC UNK_RD_INJ_040C2 "Unidentified constant read directly by INJ 0xfb868 (chapter unknown) [unassigned]" VALUE 0x740C2 RL_VAL_UB 0 CM_0000 0 255 /end CHARACTERISTIC
/begin CHARACTERISTIC UNK_RD_INJ_040C3 "Unidentified constant read directly by INJ 0xfb868 (chapter unknown) [unassigned]" VALUE 0x740C3 RL_VAL_UB 0 CM_0000 0 255 /end CHARACTERISTIC
/begin CHARACTERISTIC UNK_RD_INJ_040C4 "Unidentified constant read directly by INJ 0xfb868 (chapter unknown) [unassigned]" VALUE 0x740C4 RL_VAL_SW 0 CM_0000 -32768 32767 /end CHARACTERISTIC
/begin CHARACTERISTIC UNK_RD_INJ_040C6 "Unidentified constant read directly by INJ 0xfb868 (chapter unknown) [unassigned]" VALUE 0x740C6 RL_VAL_UW 0 CM_0000 0 65535 /end CHARACTERISTIC
/begin CHARACTERISTIC UNK_RD_INJ_040C8 "Unidentified constant read directly by INJ 0xfb868 (chapter unknown) [unassigned]" VALUE 0x740C8 RL_VAL_UW 0 CM_0000 0 65535 /end CHARACTERISTIC
/begin CHARACTERISTIC UNK_RD_INJ_040CA "Unidentified constant read directly by INJ 0xfb868 (chapter unknown) [unassigned]" VALUE 0x740CA RL_VAL_UW 0 CM_0000 0 65535 /end CHARACTERISTIC
/begin CHARACTERISTIC UNK_RD_INJ_040CC "Unidentified constant read directly by INJ 0xfb024,0xfb868 (chapter unknown) [unassigned]" VALUE 0x740CC RL_VAL_UW 0 CM_0000 0 65535 /end CHARACTERISTIC
/begin CHARACTERISTIC UNK_RD_INJ_040CE "Unidentified constant read directly by INJ 0xfb868 (chapter unknown) [unassigned]" VALUE 0x740CE RL_VAL_SW 0 CM_0000 -32768 32767 /end CHARACTERISTIC
/begin CHARACTERISTIC UNK_RD_INJ_040D0 "Unidentified constant read directly by INJ 0xfb868 (chapter unknown) [unassigned]" VALUE 0x740D0 RL_VAL_SW 0 CM_0000 -32768 32767 /end CHARACTERISTIC
/begin CHARACTERISTIC UNK_RD_INJ_040D2 "Unidentified constant read directly by INJ 0xfb868 (chapter unknown) [unassigned]" VALUE 0x740D2 RL_VAL_SW 0 CM_0000 -32768 32767 /end CHARACTERISTIC
/begin CHARACTERISTIC UNK_RD_INJ_040D4 "Unidentified constant read directly by INJ 0xfb868 (chapter unknown) [unassigned]" VALUE 0x740D4 RL_VAL_SW 0 CM_0000 -32768 32767 /end CHARACTERISTIC
/begin CHARACTERISTIC UNK_RD_INJ_040D6 "Unidentified constant read directly by INJ 0xfb868 (chapter unknown) [unassigned]" VALUE 0x740D6 RL_VAL_SW 0 CM_0000 -32768 32767 /end CHARACTERISTIC
/begin CHARACTERISTIC UNK_RD_INJ_040D8 "Unidentified constant read directly by INJ 0xfb868 (chapter unknown) [unassigned]" VALUE 0x740D8 RL_VAL_SW 0 CM_0000 -32768 32767 /end CHARACTERISTIC
/begin CHARACTERISTIC UNK_RD_INJ_040DA "Unidentified constant read directly by INJ 0xfb868 (chapter unknown) [unassigned]" VALUE 0x740DA RL_VAL_SW 0 CM_0000 -32768 32767 /end CHARACTERISTIC
/begin CHARACTERISTIC UNK_RD_INJ_040DC "Unidentified constant read directly by INJ 0xfb868 (chapter unknown) [unassigned]" VALUE 0x740DC RL_VAL_SW 0 CM_0000 -32768 32767 /end CHARACTERISTIC
/begin CHARACTERISTIC UNK_RD_INJ_040DE "Unidentified constant read directly by INJ 0xfb868 (chapter unknown) [unassigned]" VALUE 0x740DE RL_VAL_SW 0 CM_0000 -32768 32767 /end CHARACTERISTIC
/begin CHARACTERISTIC UNK_RD_INJ_040E0 "Unidentified constant read directly by INJ 0xfb868 (chapter unknown) [unassigned]" VALUE 0x740E0 RL_VAL_SW 0 CM_0000 -32768 32767 /end CHARACTERISTIC
/begin CHARACTERISTIC UNK_RD_INJ_040E2 "Unidentified constant read directly by INJ 0xfb868 (chapter unknown) [unassigned]" VALUE 0x740E2 RL_VAL_SW 0 CM_0000 -32768 32767 /end CHARACTERISTIC
/begin CHARACTERISTIC UNK_RD_INJ_040E4 "Unidentified constant read directly by INJ 0xfb868 (chapter unknown) [unassigned]" VALUE 0x740E4 RL_VAL_SW 0 CM_0000 -32768 32767 /end CHARACTERISTIC
/begin CHARACTERISTIC UNK_RD_INJ_040E6 "Unidentified constant read directly by INJ 0xfb868 (chapter unknown) [unassigned]" VALUE 0x740E6 RL_VAL_SW 0 CM_0000 -32768 32767 /end CHARACTERISTIC
/begin CHARACTERISTIC UNK_RD_INJ_040E8 "Unidentified constant read directly by INJ 0xfb868 (chapter unknown) [unassigned]" VALUE 0x740E8 RL_VAL_SW 0 CM_0000 -32768 32767 /end CHARACTERISTIC
/begin CHARACTERISTIC UNK_RD_INJ_040EA "Unidentified constant read directly by INJ 0xfb868 (chapter unknown) [unassigned]" VALUE 0x740EA RL_VAL_SW 0 CM_0000 -32768 32767 /end CHARACTERISTIC
/begin CHARACTERISTIC UNK_RD_INJ_040EC "Unidentified constant read directly by INJ 0xfb868 (chapter unknown) [unassigned]" VALUE 0x740EC RL_VAL_UW 0 CM_0000 0 65535 /end CHARACTERISTIC
/begin CHARACTERISTIC UNK_RD_INJ_040EE "Unidentified constant read directly by INJ 0xfb868 (chapter unknown) [unassigned]" VALUE 0x740EE RL_VAL_UW 0 CM_0000 0 65535 /end CHARACTERISTIC
/begin CHARACTERISTIC UNK_RD_INJ_040F0 "Unidentified constant read directly by INJ 0xfb024,0xfb868 (chapter unknown) [unassigned]" VALUE 0x740F0 RL_VAL_UW 0 CM_0000 0 65535 /end CHARACTERISTIC
/begin CHARACTERISTIC UNK_RD_INJ_040F2 "Unidentified constant read directly by INJ 0xfb024,0xfb868 (chapter unknown) [unassigned]" VALUE 0x740F2 RL_VAL_UW 0 CM_0000 0 65535 /end CHARACTERISTIC
/begin CHARACTERISTIC UNK_RD_INJ_040F4 "Unidentified constant read directly by INJ 0xfb024,0xfb868 (chapter unknown) [unassigned]" VALUE 0x740F4 RL_VAL_UW 0 CM_0000 0 65535 /end CHARACTERISTIC
/begin CHARACTERISTIC UNK_RD_INJ_040F6 "Unidentified constant read directly by INJ 0xfb024,0xfb868 (chapter unknown) [unassigned]" VALUE 0x740F6 RL_VAL_UW 0 CM_0000 0 65535 /end CHARACTERISTIC
/begin CHARACTERISTIC UNK_RD_INJ_040F8 "Unidentified constant read directly by INJ 0x3832c (chapter unknown) [unassigned]" VALUE 0x740F8 RL_VAL_UB 0 CM_0000 0 255 /end CHARACTERISTIC
/begin CHARACTERISTIC UNK_RD_INJ_040F9 "Unidentified constant read directly by INJ 0x3832c (chapter unknown) [unassigned]" VALUE 0x740F9 RL_VAL_UB 0 CM_0000 0 255 /end CHARACTERISTIC
/begin CHARACTERISTIC UNK_RD_INJ_040FA "Unidentified constant read directly by INJ 0x3832c (chapter unknown) [unassigned]" VALUE 0x740FA RL_VAL_UW 0 CM_0000 0 65535 /end CHARACTERISTIC
/begin CHARACTERISTIC UNK_RD_INJ_040FC "Unidentified constant read directly by INJ 0x3832c (chapter unknown) [unassigned]" VALUE 0x740FC RL_VAL_SW 0 CM_0000 -32768 32767 /end CHARACTERISTIC
/begin CHARACTERISTIC UNK_RD_INJ_041D8 "Unidentified constant read directly by INJ 0xfce90,0xfd38c (chapter unknown) [unassigned]" VALUE 0x741D8 RL_VAL_UB 0 CM_0000 0 255 /end CHARACTERISTIC
/begin CHARACTERISTIC UNK_RD_INJ_041DB "Unidentified constant read directly by INJ 0xfd38c (chapter unknown) [unassigned]" VALUE 0x741DB RL_VAL_UB 0 CM_0000 0 255 /end CHARACTERISTIC
/begin CHARACTERISTIC UNK_RD_INJ_041DF "Unidentified constant read directly by INJ 0xfce90 (chapter unknown) [unassigned]" VALUE 0x741DF RL_VAL_UB 0 CM_0000 0 255 /end CHARACTERISTIC
/begin CHARACTERISTIC UNK_RD_INJ_041E0 "Unidentified constant read directly by INJ 0xfce90 (chapter unknown) [unassigned]" VALUE 0x741E0 RL_VAL_UB 0 CM_0000 0 255 /end CHARACTERISTIC
/begin CHARACTERISTIC UNK_RD_INJ_041E1 "Unidentified constant read directly by INJ 0xfce90 (chapter unknown) [unassigned]" VALUE 0x741E1 RL_VAL_UB 0 CM_0000 0 255 /end CHARACTERISTIC
/begin CHARACTERISTIC UNK_RD_INJ_041E2 "Unidentified constant read directly by INJ 0xfce90 (chapter unknown) [unassigned]" VALUE 0x741E2 RL_VAL_UB 0 CM_0000 0 255 /end CHARACTERISTIC
/begin CHARACTERISTIC UNK_RD_INJ_041EA "Unidentified constant read directly by INJ 0x3b7a4 (chapter unknown) [unassigned]" VALUE 0x741EA RL_VAL_UW 0 CM_0000 0 65535 /end CHARACTERISTIC
/begin CHARACTERISTIC UNK_RD_INJ_05764 "Unidentified constant read directly by INJ 0x430ac (NKAT-Sondensignal) [unassigned]" VALUE 0x75764 RL_VAL_SW 0 CM_0000 -32768 32767 /end CHARACTERISTIC
/begin CHARACTERISTIC UNK_RD_INJ_0577C "Unidentified constant read directly by INJ 0x43e9c,0x10371c (chapter unknown) [unassigned]" VALUE 0x7577C RL_VAL_SW 0 CM_0000 -32768 32767 /end CHARACTERISTIC
/begin CHARACTERISTIC UNK_RD_INJ_0577E "Unidentified constant read directly by INJ 0x43e9c,0x10371c (chapter unknown) [unassigned]" VALUE 0x7577E RL_VAL_UW 0 CM_0000 0 65535 /end CHARACTERISTIC
/begin CHARACTERISTIC UNK_RD_INJ_05780 "Unidentified constant read directly by INJ 0x43e9c,0x10371c (chapter unknown) [unassigned]" VALUE 0x75780 RL_VAL_UW 0 CM_0000 0 65535 /end CHARACTERISTIC
/begin CHARACTERISTIC UNK_RD_INJ_0578E "Unidentified constant read directly by INJ 0x10371c (chapter unknown) [unassigned]" VALUE 0x7578E RL_VAL_UB 0 CM_0000 0 255 /end CHARACTERISTIC
/begin CHARACTERISTIC UNK_RD_INJ_05790 "Unidentified constant read directly by INJ 0x4392c,0x10371c (chapter unknown) [unassigned]" VALUE 0x75790 RL_VAL_UW 0 CM_0000 0 65535 /end CHARACTERISTIC
/begin CHARACTERISTIC UNK_RD_INJ_05792 "Unidentified constant read directly by INJ 0x4392c (chapter unknown) [unassigned]" VALUE 0x75792 RL_VAL_UW 0 CM_0000 0 65535 /end CHARACTERISTIC
/begin CHARACTERISTIC UNK_RD_INJ_05794 "Unidentified constant read directly by INJ 0x4392c (chapter unknown) [unassigned]" VALUE 0x75794 RL_VAL_UW 0 CM_0000 0 65535 /end CHARACTERISTIC
/begin CHARACTERISTIC UNK_RD_INJ_05796 "Unidentified constant read directly by INJ 0x10371c (chapter unknown) [unassigned]" VALUE 0x75796 RL_VAL_SW 0 CM_0000 -32768 32767 /end CHARACTERISTIC
/begin CHARACTERISTIC UNK_RD_INJ_05798 "Unidentified constant read directly by INJ 0x10371c (chapter unknown) [unassigned]" VALUE 0x75798 RL_VAL_SW 0 CM_0000 -32768 32767 /end CHARACTERISTIC
/begin CHARACTERISTIC UNK_RD_INJ_057A2 "Unidentified constant read directly by INJ 0x10371c (chapter unknown) [unassigned]" VALUE 0x757A2 RL_VAL_UW 0 CM_0000 0 65535 /end CHARACTERISTIC
/begin CHARACTERISTIC UNK_RD_INJ_057AA "Unidentified constant read directly by INJ 0x43e9c (chapter unknown) [unassigned]" VALUE 0x757AA RL_VAL_UB 0 CM_0000 0 255 /end CHARACTERISTIC
/begin CHARACTERISTIC UNK_RD_INJ_057AB "Unidentified constant read directly by INJ 0x43e9c (chapter unknown) [unassigned]" VALUE 0x757AB RL_VAL_UB 0 CM_0000 0 255 /end CHARACTERISTIC
/begin CHARACTERISTIC UNK_RD_INJ_057AC "Unidentified constant read directly by INJ 0x43e9c (chapter unknown) [unassigned]" VALUE 0x757AC RL_VAL_UB 0 CM_0000 0 255 /end CHARACTERISTIC
/begin CHARACTERISTIC UNK_RD_INJ_057AE "Unidentified constant read directly by INJ 0x43e9c (chapter unknown) [unassigned]" VALUE 0x757AE RL_VAL_UW 0 CM_0000 0 65535 /end CHARACTERISTIC
/begin CHARACTERISTIC UNK_RD_INJ_057BA "Unidentified constant read directly by INJ 0x10371c (chapter unknown) [unassigned]" VALUE 0x757BA RL_VAL_UW 0 CM_0000 0 65535 /end CHARACTERISTIC
/begin CHARACTERISTIC UNK_RD_INJ_057BC "Unidentified constant read directly by INJ 0x44448 (chapter unknown) [unassigned]" VALUE 0x757BC RL_VAL_UB 0 CM_0000 0 255 /end CHARACTERISTIC
/begin CHARACTERISTIC UNK_RD_INJ_057BE "Unidentified constant read directly by INJ 0x44448 (chapter unknown) [unassigned]" VALUE 0x757BE RL_VAL_UW 0 CM_0000 0 65535 /end CHARACTERISTIC
/begin CHARACTERISTIC UNK_RD_INJ_057C0 "Unidentified constant read directly by INJ 0x44448 (chapter unknown) [unassigned]" VALUE 0x757C0 RL_VAL_UW 0 CM_0000 0 65535 /end CHARACTERISTIC
/begin CHARACTERISTIC UNK_RD_INJ_057C2 "Unidentified constant read directly by INJ 0x44448 (chapter unknown) [unassigned]" VALUE 0x757C2 RL_VAL_UB 0 CM_0000 0 255 /end CHARACTERISTIC
/begin CHARACTERISTIC UNK_RD_INJ_057C4 "Unidentified constant read directly by INJ 0x44448 (chapter unknown) [unassigned]" VALUE 0x757C4 RL_VAL_UW 0 CM_0000 0 65535 /end CHARACTERISTIC
/begin CHARACTERISTIC UNK_RD_INJ_057C6 "Unidentified constant read directly by INJ 0x43e9c (chapter unknown) [unassigned]" VALUE 0x757C6 RL_VAL_UW 0 CM_0000 0 65535 /end CHARACTERISTIC
/begin CHARACTERISTIC UNK_RD_INJ_05916 "Unidentified constant read directly by INJ 0x62c74 (chapter unknown) [unassigned]" VALUE 0x75916 RL_VAL_UB 0 CM_0000 0 255 /end CHARACTERISTIC
/begin CHARACTERISTIC UNK_RD_INJ_0596E "Unidentified constant read directly by INJ 0x45ad4 (chapter unknown) [unassigned]" VALUE 0x7596E RL_VAL_UB 0 CM_0000 0 255 /end CHARACTERISTIC
/begin CHARACTERISTIC UNK_RD_INJ_0596F "Unidentified constant read directly by INJ 0x45ad4 (chapter unknown) [unassigned]" VALUE 0x7596F RL_VAL_UB 0 CM_0000 0 255 /end CHARACTERISTIC
/begin CHARACTERISTIC UNK_RD_INJ_05970 "Unidentified constant read directly by INJ 0x45ad4 (chapter unknown) [unassigned]" VALUE 0x75970 RL_VAL_UW 0 CM_0000 0 65535 /end CHARACTERISTIC
/begin CHARACTERISTIC UNK_RD_INJ_05B2E "Unidentified constant read directly by INJ 0x109424 (chapter unknown) [unassigned]" VALUE 0x75B2E RL_VAL_UB 0 CM_0000 0 255 /end CHARACTERISTIC
/begin CHARACTERISTIC UNK_RD_INJ_05B2F "Unidentified constant read directly by INJ 0x109424 (chapter unknown) [unassigned]" VALUE 0x75B2F RL_VAL_UB 0 CM_0000 0 255 /end CHARACTERISTIC
/begin CHARACTERISTIC UNK_RD_INJ_05B30 "Unidentified constant read directly by INJ 0x109424 (chapter unknown) [unassigned]" VALUE 0x75B30 RL_VAL_UB 0 CM_0000 0 255 /end CHARACTERISTIC
/begin CHARACTERISTIC UNK_RD_INJ_05B31 "Unidentified constant read directly by INJ 0x109424 (chapter unknown) [unassigned]" VALUE 0x75B31 RL_VAL_UB 0 CM_0000 0 255 /end CHARACTERISTIC
/begin CHARACTERISTIC UNK_RD_INJ_05B32 "Unidentified constant read directly by INJ 0x109424 (chapter unknown) [unassigned]" VALUE 0x75B32 RL_VAL_UB 0 CM_0000 0 255 /end CHARACTERISTIC
/begin CHARACTERISTIC UNK_RD_INJ_05B33 "Unidentified constant read directly by INJ 0x109424 (chapter unknown) [unassigned]" VALUE 0x75B33 RL_VAL_UB 0 CM_0000 0 255 /end CHARACTERISTIC
/begin CHARACTERISTIC UNK_RD_INJ_05B34 "Unidentified constant read directly by INJ 0x109424 (chapter unknown) [unassigned]" VALUE 0x75B34 RL_VAL_UB 0 CM_0000 0 255 /end CHARACTERISTIC
/begin CHARACTERISTIC UNK_RD_INJ_05B35 "Unidentified constant read directly by INJ 0x109424 (chapter unknown) [unassigned]" VALUE 0x75B35 RL_VAL_UB 0 CM_0000 0 255 /end CHARACTERISTIC
/begin CHARACTERISTIC UNK_RD_INJ_05B36 "Unidentified constant read directly by INJ 0x109424 (chapter unknown) [unassigned]" VALUE 0x75B36 RL_VAL_UB 0 CM_0000 0 255 /end CHARACTERISTIC
/begin CHARACTERISTIC UNK_RD_INJ_05B37 "Unidentified constant read directly by INJ 0x109424 (chapter unknown) [unassigned]" VALUE 0x75B37 RL_VAL_UB 0 CM_0000 0 255 /end CHARACTERISTIC
/begin CHARACTERISTIC UNK_RD_INJ_05B3E "Unidentified constant read directly by INJ 0x109424 (chapter unknown) [unassigned]" VALUE 0x75B3E RL_VAL_UB 0 CM_0000 0 255 /end CHARACTERISTIC
/begin CHARACTERISTIC UNK_RD_INJ_05B43 "Unidentified constant read directly by INJ 0x109424 (chapter unknown) [unassigned]" VALUE 0x75B43 RL_VAL_UB 0 CM_0000 0 255 /end CHARACTERISTIC
/begin CHARACTERISTIC UNK_MDRV_ALT_OVERRIDE "Unidentified constant read directly by INJ 0x470a0,0x10c84c,0x10cb50 (chapter unknown) [unassigned]" VALUE 0x75EAD RL_VAL_UB 0 CM_0000 0 255 /end CHARACTERISTIC
/begin CHARACTERISTIC UNK_RD_INJ_05EAE "Unidentified constant read directly by INJ 0x470a0 (chapter unknown) [unassigned]" VALUE 0x75EAE RL_VAL_UB 0 CM_0000 0 255 /end CHARACTERISTIC
/begin CHARACTERISTIC UNK_MDRV_ALT_DSC "Unidentified constant read directly by INJ 0x2fc84,0x470a0,0x10c84c (chapter unknown) [unassigned]" VALUE 0x75EB0 RL_VAL_UB 0 CM_0000 0 255 /end CHARACTERISTIC
/begin CHARACTERISTIC UNK_MDRV_ALT_MOD_SMG "Unidentified constant read directly by INJ 0x2fc84,0x470a0,0x10c84c (chapter unknown) [unassigned]" VALUE 0x75EB2 RL_VAL_UB 0 CM_0000 0 255 /end CHARACTERISTIC
/begin CHARACTERISTIC UNK_MDRV_ALT_STG_SMG "Unidentified constant read directly by INJ 0x2fc84,0x470a0,0x10c84c (chapter unknown) [unassigned]" VALUE 0x75EB4 RL_VAL_UB 0 CM_0000 0 255 /end CHARACTERISTIC
/begin CHARACTERISTIC UNK_MDRV_ALT_ENG "Unidentified constant read directly by INJ 0x2fc84,0x470a0,0x10c84c (chapter unknown) [unassigned]" VALUE 0x75EB6 RL_VAL_UB 0 CM_0000 0 255 /end CHARACTERISTIC
/begin CHARACTERISTIC UNK_MDRV_ALT_EDCK "Unidentified constant read directly by INJ 0x2fc84,0x470a0,0x10c84c (chapter unknown) [unassigned]" VALUE 0x75EB8 RL_VAL_UB 0 CM_0000 0 255 /end CHARACTERISTIC
/begin CHARACTERISTIC UNK_MDRV_ALT_EPAS "Unidentified constant read directly by INJ 0x2fc84,0x470a0,0x10c84c (chapter unknown) [unassigned]" VALUE 0x75EBC RL_VAL_UB 0 CM_0000 0 255 /end CHARACTERISTIC
/begin CHARACTERISTIC UNK_MDRV_ALT_SHLI "Unidentified constant read directly by INJ 0x2fc84,0x470a0,0x10c84c (chapter unknown) [unassigned]" VALUE 0x75EBE RL_VAL_UB 0 CM_0000 0 255 /end CHARACTERISTIC
/begin CHARACTERISTIC UNK_RD_INJ_05EC6 "Unidentified constant read directly by INJ 0x470a0 (chapter unknown) [unassigned]" VALUE 0x75EC6 RL_VAL_UW 0 CM_0000 0 65535 /end CHARACTERISTIC
/begin CHARACTERISTIC UNK_RD_INJ_05EC8 "Unidentified constant read directly by INJ 0x47d68,0x10cb50 (chapter unknown) [unassigned]" VALUE 0x75EC8 RL_VAL_UB 0 CM_0000 0 255 /end CHARACTERISTIC
/begin CHARACTERISTIC UNK_RD_INJ_067C8 "Unidentified constant read directly by INJ 0x11144c (chapter unknown) [unassigned]" VALUE 0x767C8 RL_VAL_UB 0 CM_0000 0 255 /end CHARACTERISTIC
/begin CHARACTERISTIC UNK_RD_INJ_067CA "Unidentified constant read directly by INJ 0x11144c (chapter unknown) [unassigned]" VALUE 0x767CA RL_VAL_SW 0 CM_0000 -32768 32767 /end CHARACTERISTIC
/begin CHARACTERISTIC UNK_RD_INJ_067CC "Unidentified constant read directly by INJ 0x11144c (chapter unknown) [unassigned]" VALUE 0x767CC RL_VAL_SW 0 CM_0000 -32768 32767 /end CHARACTERISTIC
/begin CHARACTERISTIC UNK_RD_INJ_067CE "Unidentified constant read directly by INJ 0x11144c (chapter unknown) [unassigned]" VALUE 0x767CE RL_VAL_SW 0 CM_0000 -32768 32767 /end CHARACTERISTIC
/begin CHARACTERISTIC UNK_RD_INJ_067D0 "Unidentified constant read directly by INJ 0x11144c (chapter unknown) [unassigned]" VALUE 0x767D0 RL_VAL_SW 0 CM_0000 -32768 32767 /end CHARACTERISTIC
/begin CHARACTERISTIC UNK_RD_INJ_067D2 "Unidentified constant read directly by INJ 0x11144c (chapter unknown) [unassigned]" VALUE 0x767D2 RL_VAL_SW 0 CM_0000 -32768 32767 /end CHARACTERISTIC
/begin CHARACTERISTIC UNK_RD_INJ_067D4 "Unidentified constant read directly by INJ 0x11144c (chapter unknown) [unassigned]" VALUE 0x767D4 RL_VAL_SW 0 CM_0000 -32768 32767 /end CHARACTERISTIC
/begin CHARACTERISTIC UNK_RD_INJ_067D6 "Unidentified constant read directly by INJ 0x11144c (chapter unknown) [unassigned]" VALUE 0x767D6 RL_VAL_SW 0 CM_0000 -32768 32767 /end CHARACTERISTIC
/begin CHARACTERISTIC UNK_RD_INJ_067D8 "Unidentified constant read directly by INJ 0x11144c (chapter unknown) [unassigned]" VALUE 0x767D8 RL_VAL_UW 0 CM_0000 0 65535 /end CHARACTERISTIC
/begin CHARACTERISTIC UNK_RD_INJ_067DA "Unidentified constant read directly by INJ 0x11144c (chapter unknown) [unassigned]" VALUE 0x767DA RL_VAL_SW 0 CM_0000 -32768 32767 /end CHARACTERISTIC
/begin CHARACTERISTIC UNK_RD_INJ_067DC "Unidentified constant read directly by INJ 0x11144c (chapter unknown) [unassigned]" VALUE 0x767DC RL_VAL_SW 0 CM_0000 -32768 32767 /end CHARACTERISTIC
/begin CHARACTERISTIC UNK_RD_INJ_067DE "Unidentified constant read directly by INJ 0x11144c (chapter unknown) [unassigned]" VALUE 0x767DE RL_VAL_SW 0 CM_0000 -32768 32767 /end CHARACTERISTIC
/begin CHARACTERISTIC UNK_RD_INJ_067E0 "Unidentified constant read directly by INJ 0x11144c (chapter unknown) [unassigned]" VALUE 0x767E0 RL_VAL_UW 0 CM_0000 0 65535 /end CHARACTERISTIC
/begin CHARACTERISTIC UNK_RD_INJ_06BD0 "Unidentified constant read directly by INJ 0x4f1dc (chapter unknown) [unassigned]" VALUE 0x76BD0 RL_VAL_UB 0 CM_0000 0 255 /end CHARACTERISTIC
/begin CHARACTERISTIC UNK_RD_INJ_06BD4 "Unidentified constant read directly by INJ 0x114ebc (chapter unknown) [unassigned]" VALUE 0x76BD4 RL_VAL_SW 0 CM_0000 -32768 32767 /end CHARACTERISTIC
/begin CHARACTERISTIC UNK_RD_INJ_06BD6 "Unidentified constant read directly by INJ 0x114ebc (chapter unknown) [unassigned]" VALUE 0x76BD6 RL_VAL_SW 0 CM_0000 -32768 32767 /end CHARACTERISTIC
/begin CHARACTERISTIC UNK_RD_INJ_06BD8 "Unidentified constant read directly by INJ 0x114ebc (chapter unknown) [unassigned]" VALUE 0x76BD8 RL_VAL_SW 0 CM_0000 -32768 32767 /end CHARACTERISTIC
/begin CHARACTERISTIC UNK_RD_INJ_06BDA "Unidentified constant read directly by INJ 0x114ebc (chapter unknown) [unassigned]" VALUE 0x76BDA RL_VAL_SW 0 CM_0000 -32768 32767 /end CHARACTERISTIC
/begin CHARACTERISTIC UNK_RD_INJ_06BF0 "Unidentified constant read directly by INJ 0x114ebc (chapter unknown) [unassigned]" VALUE 0x76BF0 RL_VAL_UW 0 CM_0000 0 65535 /end CHARACTERISTIC
/begin CHARACTERISTIC UNK_RD_INJ_06BF2 "Unidentified constant read directly by INJ 0x4f2b4 (chapter unknown) [unassigned]" VALUE 0x76BF2 RL_VAL_UW 0 CM_0000 0 65535 /end CHARACTERISTIC
/begin CHARACTERISTIC UNK_RD_INJ_06BF6 "Unidentified constant read directly by INJ 0x114ebc (chapter unknown) [unassigned]" VALUE 0x76BF6 RL_VAL_UB 0 CM_0000 0 255 /end CHARACTERISTIC
/begin CHARACTERISTIC UNK_RD_INJ_06BF7 "Unidentified constant read directly by INJ 0x114ebc (chapter unknown) [unassigned]" VALUE 0x76BF7 RL_VAL_UB 0 CM_0000 0 255 /end CHARACTERISTIC
/begin CHARACTERISTIC UNK_RD_INJ_06BF8 "Unidentified constant read directly by INJ 0x114ebc (chapter unknown) [unassigned]" VALUE 0x76BF8 RL_VAL_UB 0 CM_0000 0 255 /end CHARACTERISTIC
/begin CHARACTERISTIC UNK_RD_INJ_06BFB "Unidentified constant read directly by INJ 0x4f2b4 (chapter unknown) [unassigned]" VALUE 0x76BFB RL_VAL_UB 0 CM_0000 0 255 /end CHARACTERISTIC
/begin CHARACTERISTIC UNK_RD_INJ_06C00 "Unidentified constant read directly by INJ 0x4f2b4 (chapter unknown) [unassigned]" VALUE 0x76C00 RL_VAL_UB 0 CM_0000 0 255 /end CHARACTERISTIC
/begin CHARACTERISTIC UNK_RD_INJ_06C01 "Unidentified constant read directly by INJ 0x4f2b4 (chapter unknown) [unassigned]" VALUE 0x76C01 RL_VAL_UB 0 CM_0000 0 255 /end CHARACTERISTIC
/begin CHARACTERISTIC UNK_RD_INJ_06C02 "Unidentified constant read directly by INJ 0x114ebc (chapter unknown) [unassigned]" VALUE 0x76C02 RL_VAL_UB 0 CM_0000 0 255 /end CHARACTERISTIC
/begin CHARACTERISTIC UNK_RD_INJ_06DFC "Unidentified constant read directly by INJ 0x11711c (Kraftstoffdruckregelung) [unassigned]" VALUE 0x76DFC RL_VAL_SW 0 CM_0000 -32768 32767 /end CHARACTERISTIC
/begin CHARACTERISTIC UNK_RD_INJ_06DFE "Unidentified constant read directly by INJ 0x11711c (Kraftstoffdruckregelung) [unassigned]" VALUE 0x76DFE RL_VAL_SW 0 CM_0000 -32768 32767 /end CHARACTERISTIC
/begin CHARACTERISTIC UNK_RD_INJ_06E00 "Unidentified constant read directly by INJ 0x11711c (Kraftstoffdruckregelung) [unassigned]" VALUE 0x76E00 RL_VAL_SW 0 CM_0000 -32768 32767 /end CHARACTERISTIC
/begin CHARACTERISTIC UNK_RD_INJ_06E02 "Unidentified constant read directly by INJ 0x11711c (Kraftstoffdruckregelung) [unassigned]" VALUE 0x76E02 RL_VAL_SW 0 CM_0000 -32768 32767 /end CHARACTERISTIC
/begin CHARACTERISTIC UNK_RD_INJ_06E04 "Unidentified constant read directly by INJ 0x11711c (Kraftstoffdruckregelung) [unassigned]" VALUE 0x76E04 RL_VAL_SW 0 CM_0000 -32768 32767 /end CHARACTERISTIC
/begin CHARACTERISTIC UNK_RD_INJ_06E06 "Unidentified constant read directly by INJ 0x11711c (Kraftstoffdruckregelung) [unassigned]" VALUE 0x76E06 RL_VAL_SW 0 CM_0000 -32768 32767 /end CHARACTERISTIC
/begin CHARACTERISTIC UNK_RD_INJ_06E08 "Unidentified constant read directly by INJ 0x11711c (Kraftstoffdruckregelung) [unassigned]" VALUE 0x76E08 RL_VAL_SW 0 CM_0000 -32768 32767 /end CHARACTERISTIC
/begin CHARACTERISTIC UNK_RD_INJ_06E0A "Unidentified constant read directly by INJ 0x11711c (Kraftstoffdruckregelung) [unassigned]" VALUE 0x76E0A RL_VAL_SW 0 CM_0000 -32768 32767 /end CHARACTERISTIC
/begin CHARACTERISTIC UNK_RD_INJ_06E0C "Unidentified constant read directly by INJ 0x11711c (Kraftstoffdruckregelung) [unassigned]" VALUE 0x76E0C RL_VAL_UB 0 CM_0000 0 255 /end CHARACTERISTIC
/begin CHARACTERISTIC UNK_RD_INJ_07296 "Unidentified constant read directly by INJ 0x117d70 (Katalysatorschutz) [unassigned]" VALUE 0x77296 RL_VAL_SW 0 CM_0000 -32768 32767 /end CHARACTERISTIC
/begin CHARACTERISTIC UNK_RD_INJ_072A6 "Unidentified constant read directly by INJ 0x117d70 (Katalysatorschutz) [unassigned]" VALUE 0x772A6 RL_VAL_UB 0 CM_0000 0 255 /end CHARACTERISTIC
/begin CHARACTERISTIC UNK_RD_INJ_072B7 "Unidentified constant read directly by INJ 0x117d70 (Katalysatorschutz) [unassigned]" VALUE 0x772B7 RL_VAL_UB 0 CM_0000 0 255 /end CHARACTERISTIC
/begin CHARACTERISTIC UNK_RD_INJ_073F2 "Unidentified constant read directly by INJ 0x118f30 (chapter unknown) [unassigned]" VALUE 0x773F2 RL_VAL_UW 0 CM_0000 0 65535 /end CHARACTERISTIC
/begin CHARACTERISTIC UNK_RD_INJ_073F4 "Unidentified constant read directly by INJ 0x118f30 (chapter unknown) [unassigned]" VALUE 0x773F4 RL_VAL_UW 0 CM_0000 0 65535 /end CHARACTERISTIC
/begin CHARACTERISTIC UNK_RD_INJ_073F6 "Unidentified constant read directly by INJ 0x118f30 (chapter unknown) [unassigned]" VALUE 0x773F6 RL_VAL_UW 0 CM_0000 0 65535 /end CHARACTERISTIC
/begin CHARACTERISTIC UNK_RD_INJ_073F8 "Unidentified constant read directly by INJ 0x118f30 (chapter unknown) [unassigned]" VALUE 0x773F8 RL_VAL_UW 0 CM_0000 0 65535 /end CHARACTERISTIC
/begin CHARACTERISTIC UNK_RD_INJ_073FA "Unidentified constant read directly by INJ 0x118f30 (chapter unknown) [unassigned]" VALUE 0x773FA RL_VAL_UB 0 CM_0000 0 255 /end CHARACTERISTIC
/begin CHARACTERISTIC UNK_RD_INJ_0740A "Unidentified constant read directly by INJ 0x118f30 (chapter unknown) [unassigned]" VALUE 0x7740A RL_VAL_UB 0 CM_0000 0 255 /end CHARACTERISTIC
/begin CHARACTERISTIC UNK_RD_INJ_0740B "Unidentified constant read directly by INJ 0x118f30 (chapter unknown) [unassigned]" VALUE 0x7740B RL_VAL_UB 0 CM_0000 0 255 /end CHARACTERISTIC
/begin CHARACTERISTIC UNK_RD_INJ_0740C "Unidentified constant read directly by INJ 0x118f30 (chapter unknown) [unassigned]" VALUE 0x7740C RL_VAL_UB 0 CM_0000 0 255 /end CHARACTERISTIC
/begin CHARACTERISTIC UNK_RD_INJ_0740D "Unidentified constant read directly by INJ 0x118f30 (chapter unknown) [unassigned]" VALUE 0x7740D RL_VAL_UB 0 CM_0000 0 255 /end CHARACTERISTIC
/begin CHARACTERISTIC UNK_RD_INJ_0740E "Unidentified constant read directly by INJ 0x118f30 (chapter unknown) [unassigned]" VALUE 0x7740E RL_VAL_UB 0 CM_0000 0 255 /end CHARACTERISTIC
/begin CHARACTERISTIC UNK_RD_INJ_0740F "Unidentified constant read directly by INJ 0x118f30 (chapter unknown) [unassigned]" VALUE 0x7740F RL_VAL_UB 0 CM_0000 0 255 /end CHARACTERISTIC
/begin CHARACTERISTIC UNK_RD_INJ_07540 "Unidentified constant read directly by INJ 0x11c1e8 (chapter unknown) [unassigned]" VALUE 0x77540 RL_VAL_UB 0 CM_0000 0 255 /end CHARACTERISTIC
/begin CHARACTERISTIC UNK_RD_INJ_07541 "Unidentified constant read directly by INJ 0x11c1e8 (chapter unknown) [unassigned]" VALUE 0x77541 RL_VAL_UB 0 CM_0000 0 255 /end CHARACTERISTIC
/begin CHARACTERISTIC UNK_RD_INJ_07542 "Unidentified constant read directly by INJ 0x11c1e8 (chapter unknown) [unassigned]" VALUE 0x77542 RL_VAL_UB 0 CM_0000 0 255 /end CHARACTERISTIC
/begin CHARACTERISTIC UNK_RD_INJ_07543 "Unidentified constant read directly by INJ 0x11c1e8 (chapter unknown) [unassigned]" VALUE 0x77543 RL_VAL_UB 0 CM_0000 0 255 /end CHARACTERISTIC
/begin CHARACTERISTIC UNK_RD_INJ_07544 "Unidentified constant read directly by INJ 0x11c1e8 (chapter unknown) [unassigned]" VALUE 0x77544 RL_VAL_UB 0 CM_0000 0 255 /end CHARACTERISTIC
/begin CHARACTERISTIC UNK_RD_INJ_07545 "Unidentified constant read directly by INJ 0x11c1e8 (chapter unknown) [unassigned]" VALUE 0x77545 RL_VAL_UB 0 CM_0000 0 255 /end CHARACTERISTIC
/begin CHARACTERISTIC UNK_RD_INJ_07546 "Unidentified constant read directly by INJ 0x11c1e8 (chapter unknown) [unassigned]" VALUE 0x77546 RL_VAL_UB 0 CM_0000 0 255 /end CHARACTERISTIC
/begin CHARACTERISTIC UNK_RD_INJ_07547 "Unidentified constant read directly by INJ 0x11c1e8 (chapter unknown) [unassigned]" VALUE 0x77547 RL_VAL_UB 0 CM_0000 0 255 /end CHARACTERISTIC
/begin CHARACTERISTIC UNK_RD_INJ_07548 "Unidentified constant read directly by INJ 0x11c1e8 (chapter unknown) [unassigned]" VALUE 0x77548 RL_VAL_SW 0 CM_0000 -32768 32767 /end CHARACTERISTIC
/begin CHARACTERISTIC UNK_RD_INJ_0754A "Unidentified constant read directly by INJ 0x11c1e8 (chapter unknown) [unassigned]" VALUE 0x7754A RL_VAL_SW 0 CM_0000 -32768 32767 /end CHARACTERISTIC
/begin CHARACTERISTIC UNK_RD_INJ_0754C "Unidentified constant read directly by INJ 0x11c1e8 (chapter unknown) [unassigned]" VALUE 0x7754C RL_VAL_SW 0 CM_0000 -32768 32767 /end CHARACTERISTIC
/begin CHARACTERISTIC UNK_RD_INJ_0754E "Unidentified constant read directly by INJ 0x11c1e8 (chapter unknown) [unassigned]" VALUE 0x7754E RL_VAL_UW 0 CM_0000 0 65535 /end CHARACTERISTIC
/begin CHARACTERISTIC UNK_RD_INJ_07550 "Unidentified constant read directly by INJ 0x11c1e8 (chapter unknown) [unassigned]" VALUE 0x77550 RL_VAL_UW 0 CM_0000 0 65535 /end CHARACTERISTIC
/begin CHARACTERISTIC UNK_RD_INJ_07552 "Unidentified constant read directly by INJ 0x11c1e8 (chapter unknown) [unassigned]" VALUE 0x77552 RL_VAL_UW 0 CM_0000 0 65535 /end CHARACTERISTIC
/begin CHARACTERISTIC UNK_RD_INJ_07554 "Unidentified constant read directly by INJ 0x11c1e8 (chapter unknown) [unassigned]" VALUE 0x77554 RL_VAL_UW 0 CM_0000 0 65535 /end CHARACTERISTIC
/begin CHARACTERISTIC UNK_RD_INJ_07556 "Unidentified constant read directly by INJ 0x11c1e8 (chapter unknown) [unassigned]" VALUE 0x77556 RL_VAL_UW 0 CM_0000 0 65535 /end CHARACTERISTIC
/begin CHARACTERISTIC UNK_RD_INJ_07558 "Unidentified constant read directly by INJ 0x11c1e8 (chapter unknown) [unassigned]" VALUE 0x77558 RL_VAL_UW 0 CM_0000 0 65535 /end CHARACTERISTIC
/begin CHARACTERISTIC UNK_RD_INJ_0755A "Unidentified constant read directly by INJ 0x11c1e8 (chapter unknown) [unassigned]" VALUE 0x7755A RL_VAL_UW 0 CM_0000 0 65535 /end CHARACTERISTIC
/begin CHARACTERISTIC UNK_RD_INJ_0755C "Unidentified constant read directly by INJ 0x11c1e8 (chapter unknown) [unassigned]" VALUE 0x7755C RL_VAL_UW 0 CM_0000 0 65535 /end CHARACTERISTIC
/begin CHARACTERISTIC UNK_RD_INJ_0755E "Unidentified constant read directly by INJ 0x11c1e8 (chapter unknown) [unassigned]" VALUE 0x7755E RL_VAL_UB 0 CM_0000 0 255 /end CHARACTERISTIC
/begin CHARACTERISTIC UNK_RD_INJ_0755F "Unidentified constant read directly by INJ 0x11c1e8 (chapter unknown) [unassigned]" VALUE 0x7755F RL_VAL_UB 0 CM_0000 0 255 /end CHARACTERISTIC
/begin CHARACTERISTIC UNK_RD_INJ_07560 "Unidentified constant read directly by INJ 0x11c1e8 (chapter unknown) [unassigned]" VALUE 0x77560 RL_VAL_UB 0 CM_0000 0 255 /end CHARACTERISTIC
/begin CHARACTERISTIC UNK_RD_INJ_07561 "Unidentified constant read directly by INJ 0x11c1e8 (chapter unknown) [unassigned]" VALUE 0x77561 RL_VAL_UB 0 CM_0000 0 255 /end CHARACTERISTIC
/begin CHARACTERISTIC UNK_RD_INJ_07564 "Unidentified constant read directly by INJ 0x11c870 (chapter unknown) [unassigned]" VALUE 0x77564 RL_VAL_UW 0 CM_0000 0 65535 /end CHARACTERISTIC
/begin CHARACTERISTIC UNK_RD_INJ_07566 "Unidentified constant read directly by INJ 0x11c870 (chapter unknown) [unassigned]" VALUE 0x77566 RL_VAL_UB 0 CM_0000 0 255 /end CHARACTERISTIC
/begin CHARACTERISTIC UNK_RD_INJ_07567 "Unidentified constant read directly by INJ 0x11c870 (chapter unknown) [unassigned]" VALUE 0x77567 RL_VAL_UB 0 CM_0000 0 255 /end CHARACTERISTIC
/begin CHARACTERISTIC UNK_RD_INJ_07568 "Unidentified constant read directly by INJ 0x11c870 (chapter unknown) [unassigned]" VALUE 0x77568 RL_VAL_UB 0 CM_0000 0 255 /end CHARACTERISTIC
/begin CHARACTERISTIC UNK_RD_INJ_07569 "Unidentified constant read directly by INJ 0x11c870 (chapter unknown) [unassigned]" VALUE 0x77569 RL_VAL_UB 0 CM_0000 0 255 /end CHARACTERISTIC
/begin CHARACTERISTIC UNK_RD_INJ_0756A "Unidentified constant read directly by INJ 0x11c870 (chapter unknown) [unassigned]" VALUE 0x7756A RL_VAL_SW 0 CM_0000 -32768 32767 /end CHARACTERISTIC
/begin CHARACTERISTIC UNK_RD_INJ_0756C "Unidentified constant read directly by INJ 0x11c870 (chapter unknown) [unassigned]" VALUE 0x7756C RL_VAL_SW 0 CM_0000 -32768 32767 /end CHARACTERISTIC
/begin CHARACTERISTIC UNK_RD_INJ_0756E "Unidentified constant read directly by INJ 0x11c870 (chapter unknown) [unassigned]" VALUE 0x7756E RL_VAL_SW 0 CM_0000 -32768 32767 /end CHARACTERISTIC
/begin CHARACTERISTIC UNK_RD_INJ_07570 "Unidentified constant read directly by INJ 0x11c870 (chapter unknown) [unassigned]" VALUE 0x77570 RL_VAL_SW 0 CM_0000 -32768 32767 /end CHARACTERISTIC
/begin CHARACTERISTIC UNK_RD_INJ_07572 "Unidentified constant read directly by INJ 0x11c870 (chapter unknown) [unassigned]" VALUE 0x77572 RL_VAL_SW 0 CM_0000 -32768 32767 /end CHARACTERISTIC
/begin CHARACTERISTIC UNK_RD_INJ_07574 "Unidentified constant read directly by INJ 0x11c870 (chapter unknown) [unassigned]" VALUE 0x77574 RL_VAL_UL 0 CM_0000 0 4294967295 /end CHARACTERISTIC
/begin CHARACTERISTIC UNK_RD_INJ_07578 "Unidentified constant read directly by INJ 0x11c870 (chapter unknown) [unassigned]" VALUE 0x77578 RL_VAL_UB 0 CM_0000 0 255 /end CHARACTERISTIC
/begin CHARACTERISTIC UNK_RD_INJ_07579 "Unidentified constant read directly by INJ 0x11c870 (chapter unknown) [unassigned]" VALUE 0x77579 RL_VAL_UB 0 CM_0000 0 255 /end CHARACTERISTIC
/begin CHARACTERISTIC UNK_RD_INJ_0757A "Unidentified constant read directly by INJ 0x11e2a8 (chapter unknown) [unassigned]" VALUE 0x7757A RL_VAL_UW 0 CM_0000 0 65535 /end CHARACTERISTIC
/begin CHARACTERISTIC UNK_RD_INJ_07590 "Unidentified constant read directly by INJ 0x11e2a8 (chapter unknown) [unassigned]" VALUE 0x77590 RL_VAL_UW 0 CM_0000 0 65535 /end CHARACTERISTIC
/begin CHARACTERISTIC UNK_RD_INJ_07592 "Unidentified constant read directly by INJ 0x11e2a8 (chapter unknown) [unassigned]" VALUE 0x77592 RL_VAL_UW 0 CM_0000 0 65535 /end CHARACTERISTIC
/begin CHARACTERISTIC UNK_RD_INJ_07596 "Unidentified constant read directly by INJ 0x11e2a8 (chapter unknown) [unassigned]" VALUE 0x77596 RL_VAL_UW 0 CM_0000 0 65535 /end CHARACTERISTIC
/begin CHARACTERISTIC UNK_RD_INJ_0759A "Unidentified constant read directly by INJ 0x11e2a8 (chapter unknown) [unassigned]" VALUE 0x7759A RL_VAL_UW 0 CM_0000 0 65535 /end CHARACTERISTIC
/begin CHARACTERISTIC UNK_RD_INJ_075A4 "Unidentified constant read directly by INJ 0x11e2a8 (chapter unknown) [unassigned]" VALUE 0x775A4 RL_VAL_UW 0 CM_0000 0 65535 /end CHARACTERISTIC
/begin CHARACTERISTIC UNK_RD_INJ_075A6 "Unidentified constant read directly by INJ 0x11e2a8 (chapter unknown) [unassigned]" VALUE 0x775A6 RL_VAL_UB 0 CM_0000 0 255 /end CHARACTERISTIC
/begin CHARACTERISTIC UNK_RD_INJ_075AE "Unidentified constant read directly by INJ 0x11e2a8 (chapter unknown) [unassigned]" VALUE 0x775AE RL_VAL_UB 0 CM_0000 0 255 /end CHARACTERISTIC
/begin CHARACTERISTIC UNK_RD_INJ_075AF "Unidentified constant read directly by INJ 0x11e2a8 (chapter unknown) [unassigned]" VALUE 0x775AF RL_VAL_UB 0 CM_0000 0 255 /end CHARACTERISTIC
/begin CHARACTERISTIC UNK_RD_INJ_075C2 "Unidentified constant read directly by INJ 0x11e2a8 (chapter unknown) [unassigned]" VALUE 0x775C2 RL_VAL_UB 0 CM_0000 0 255 /end CHARACTERISTIC
/begin CHARACTERISTIC UNK_RD_INJ_075C3 "Unidentified constant read directly by INJ 0x11e2a8 (chapter unknown) [unassigned]" VALUE 0x775C3 RL_VAL_UB 0 CM_0000 0 255 /end CHARACTERISTIC
/begin CHARACTERISTIC UNK_RD_INJ_075C8 "Unidentified constant read directly by INJ 0x11e2a8 (chapter unknown) [unassigned]" VALUE 0x775C8 RL_VAL_UB 0 CM_0000 0 255 /end CHARACTERISTIC
/begin CHARACTERISTIC UNK_RD_INJ_075CB "Unidentified constant read directly by INJ 0x11e2a8 (chapter unknown) [unassigned]" VALUE 0x775CB RL_VAL_UB 0 CM_0000 0 255 /end CHARACTERISTIC
/begin CHARACTERISTIC UNK_RD_INJ_075CC "Unidentified constant read directly by INJ 0x11e2a8 (chapter unknown) [unassigned]" VALUE 0x775CC RL_VAL_UB 0 CM_0000 0 255 /end CHARACTERISTIC
/begin CHARACTERISTIC UNK_RD_INJ_075CD "Unidentified constant read directly by INJ 0x11e2a8 (chapter unknown) [unassigned]" VALUE 0x775CD RL_VAL_UB 0 CM_0000 0 255 /end CHARACTERISTIC
/begin CHARACTERISTIC UNK_RD_INJ_075CE "Unidentified constant read directly by INJ 0x11e2a8 (chapter unknown) [unassigned]" VALUE 0x775CE RL_VAL_UB 0 CM_0000 0 255 /end CHARACTERISTIC
/begin CHARACTERISTIC UNK_RD_INJ_075D0 "Unidentified constant read directly by INJ 0x11e2a8 (chapter unknown) [unassigned]" VALUE 0x775D0 RL_VAL_UB 0 CM_0000 0 255 /end CHARACTERISTIC
/begin CHARACTERISTIC UNK_RD_INJ_075D5 "Unidentified constant read directly by INJ 0x11e2a8 (chapter unknown) [unassigned]" VALUE 0x775D5 RL_VAL_UB 0 CM_0000 0 255 /end CHARACTERISTIC
/begin CHARACTERISTIC UNK_RD_INJ_0778A "Unidentified constant read directly by INJ 0x120ffc (Powermanagement) [unassigned]" VALUE 0x7778A RL_VAL_UB 0 CM_0000 0 255 /end CHARACTERISTIC
/begin CHARACTERISTIC UNK_RD_INJ_07964 "Unidentified constant read directly by INJ 0x51448 (chapter unknown) [unassigned]" VALUE 0x77964 RL_VAL_UW 0 CM_0000 0 65535 /end CHARACTERISTIC
/begin CHARACTERISTIC UNK_RD_INJ_07966 "Unidentified constant read directly by INJ 0x51448 (chapter unknown) [unassigned]" VALUE 0x77966 RL_VAL_UW 0 CM_0000 0 65535 /end CHARACTERISTIC
/begin CHARACTERISTIC UNK_PMV_REQ03_U_OFFS "Unidentified constant read directly by INJ 0x51684 (chapter unknown) [unassigned]" VALUE 0x779D2 RL_VAL_UB 0 CM_0000 0 255 /end CHARACTERISTIC
/begin CHARACTERISTIC UNK_PMV_REQ04_U_OFFS "Unidentified constant read directly by INJ 0x51684 (chapter unknown) [unassigned]" VALUE 0x779D3 RL_VAL_UB 0 CM_0000 0 255 /end CHARACTERISTIC
/begin CHARACTERISTIC UNK_PMV_REQ05_U_OFFS "Unidentified constant read directly by INJ 0x51684 (chapter unknown) [unassigned]" VALUE 0x779D4 RL_VAL_UB 0 CM_0000 0 255 /end CHARACTERISTIC
/begin CHARACTERISTIC UNK_PMV_CH6_COND2 "Unidentified constant read directly by INJ 0x51684 (chapter unknown) [unassigned]" VALUE 0x779D6 RL_VAL_SW 0 CM_0000 -32768 32767 /end CHARACTERISTIC
/begin CHARACTERISTIC UNK_PMV_START_COND "Unidentified constant read directly by INJ 0x51684 (chapter unknown) [unassigned]" VALUE 0x779D8 RL_VAL_UW 0 CM_0000 0 65535 /end CHARACTERISTIC
/begin CHARACTERISTIC UNK_PMV_REQ03_T_HOLD "Unidentified constant read directly by INJ 0x51684 (chapter unknown) [unassigned]" VALUE 0x779DA RL_VAL_UW 0 CM_0000 0 65535 /end CHARACTERISTIC
/begin CHARACTERISTIC UNK_PMV_REQ04_T_HOLD "Unidentified constant read directly by INJ 0x51684 (chapter unknown) [unassigned]" VALUE 0x779DC RL_VAL_UW 0 CM_0000 0 65535 /end CHARACTERISTIC
/begin CHARACTERISTIC UNK_PMV_REQ05_T_HOLD "Unidentified constant read directly by INJ 0x51684 (chapter unknown) [unassigned]" VALUE 0x779DE RL_VAL_UW 0 CM_0000 0 65535 /end CHARACTERISTIC
/begin CHARACTERISTIC UNK_PMV_REQ06_T_HOLD "Unidentified constant read directly by INJ 0x51684 (chapter unknown) [unassigned]" VALUE 0x779E0 RL_VAL_UW 0 CM_0000 0 65535 /end CHARACTERISTIC
/begin CHARACTERISTIC UNK_PMV_REQ12_T_HOLD "Unidentified constant read directly by INJ 0x1225ec (chapter unknown) [unassigned]" VALUE 0x779E2 RL_VAL_UW 0 CM_0000 0 65535 /end CHARACTERISTIC
/begin CHARACTERISTIC UNK_PMV_REQ09_T_HOLD "Unidentified constant read directly by INJ 0x1225ec (chapter unknown) [unassigned]" VALUE 0x779E4 RL_VAL_UW 0 CM_0000 0 65535 /end CHARACTERISTIC
/begin CHARACTERISTIC UNK_PMV_REQ11_T_HOLD "Unidentified constant read directly by INJ 0x1225ec (chapter unknown) [unassigned]" VALUE 0x779E6 RL_VAL_UW 0 CM_0000 0 65535 /end CHARACTERISTIC
/begin CHARACTERISTIC UNK_PMV_REQ10_T_HOLD "Unidentified constant read directly by INJ 0x1225ec (chapter unknown) [unassigned]" VALUE 0x779E8 RL_VAL_UW 0 CM_0000 0 65535 /end CHARACTERISTIC
/begin CHARACTERISTIC UNK_PMV_REQ13_T_HOLD "Unidentified constant read directly by INJ 0x1225ec (chapter unknown) [unassigned]" VALUE 0x779EA RL_VAL_UW 0 CM_0000 0 65535 /end CHARACTERISTIC
/begin CHARACTERISTIC UNK_PMV_REQ15_T_HOLD "Unidentified constant read directly by INJ 0x1225ec (chapter unknown) [unassigned]" VALUE 0x779EC RL_VAL_UW 0 CM_0000 0 65535 /end CHARACTERISTIC
/begin CHARACTERISTIC UNK_PMV_REQ17_T_HOLD "Unidentified constant read directly by INJ 0x1225ec (chapter unknown) [unassigned]" VALUE 0x779EE RL_VAL_UW 0 CM_0000 0 65535 /end CHARACTERISTIC
/begin CHARACTERISTIC UNK_PMV_REQ19_T_HOLD "Unidentified constant read directly by INJ 0x1225ec (chapter unknown) [unassigned]" VALUE 0x779F0 RL_VAL_UW 0 CM_0000 0 65535 /end CHARACTERISTIC
/begin CHARACTERISTIC UNK_PMV_REQ21_T_HOLD "Unidentified constant read directly by INJ 0x1225ec (chapter unknown) [unassigned]" VALUE 0x779F2 RL_VAL_UW 0 CM_0000 0 65535 /end CHARACTERISTIC
/begin CHARACTERISTIC UNK_PMV_REQ08_T_HOLD "Unidentified constant read directly by INJ 0x1225ec (chapter unknown) [unassigned]" VALUE 0x779F4 RL_VAL_UW 0 CM_0000 0 65535 /end CHARACTERISTIC
/begin CHARACTERISTIC UNK_PMV_CH6_T "Unidentified constant read directly by INJ 0x51684 (chapter unknown) [unassigned]" VALUE 0x779F6 RL_VAL_UW 0 CM_0000 0 65535 /end CHARACTERISTIC
/begin CHARACTERISTIC UNK_PMV_CH6_COND "Unidentified constant read directly by INJ 0x51684 (chapter unknown) [unassigned]" VALUE 0x779F8 RL_VAL_UW 0 CM_0000 0 65535 /end CHARACTERISTIC
/begin CHARACTERISTIC UNK_PMV_START_T "Unidentified constant read directly by INJ 0x51684 (chapter unknown) [unassigned]" VALUE 0x779FA RL_VAL_UW 0 CM_0000 0 65535 /end CHARACTERISTIC
/begin CHARACTERISTIC UNK_PMV_START_CNT_STEP "Unidentified constant read directly by INJ 0x51684 (chapter unknown) [unassigned]" VALUE 0x779FC RL_VAL_UB 0 CM_0000 0 255 /end CHARACTERISTIC
/begin CHARACTERISTIC UNK_PMV_START_CNT_MAX "Unidentified constant read directly by INJ 0x51684 (chapter unknown) [unassigned]" VALUE 0x779FD RL_VAL_UB 0 CM_0000 0 255 /end CHARACTERISTIC
/begin CHARACTERISTIC UNK_PMV_START_U_MAX "Unidentified constant read directly by INJ 0x51684 (chapter unknown) [unassigned]" VALUE 0x779FE RL_VAL_UB 0 CM_0000 0 255 /end CHARACTERISTIC
/begin CHARACTERISTIC UNK_PMV_REQ03_PRIO "Unidentified constant read directly by INJ 0x51684 (chapter unknown) [unassigned]" VALUE 0x779FF RL_VAL_UB 0 CM_0000 0 255 /end CHARACTERISTIC
/begin CHARACTERISTIC UNK_PMV_START_PRIO_A "Unidentified constant read directly by INJ 0x51684 (chapter unknown) [unassigned]" VALUE 0x77A00 RL_VAL_UB 0 CM_0000 0 255 /end CHARACTERISTIC
/begin CHARACTERISTIC UNK_PMV_FLAG_PRIO_A "Unidentified constant read directly by INJ 0x1225ec (chapter unknown) [unassigned]" VALUE 0x77A01 RL_VAL_UB 0 CM_0000 0 255 /end CHARACTERISTIC
/begin CHARACTERISTIC UNK_PMV_REQ02_PRIO "Unidentified constant read directly by INJ 0x51684 (chapter unknown) [unassigned]" VALUE 0x77A02 RL_VAL_UB 0 CM_0000 0 255 /end CHARACTERISTIC
/begin CHARACTERISTIC UNK_PMV_REQ01_PRIO "Unidentified constant read directly by INJ 0x51684 (chapter unknown) [unassigned]" VALUE 0x77A03 RL_VAL_UB 0 CM_0000 0 255 /end CHARACTERISTIC
/begin CHARACTERISTIC UNK_PMV_REQ04_PRIO "Unidentified constant read directly by INJ 0x51684 (chapter unknown) [unassigned]" VALUE 0x77A04 RL_VAL_UB 0 CM_0000 0 255 /end CHARACTERISTIC
/begin CHARACTERISTIC UNK_PMV_REQ06_PRIO "Unidentified constant read directly by INJ 0x51684 (chapter unknown) [unassigned]" VALUE 0x77A05 RL_VAL_UB 0 CM_0000 0 255 /end CHARACTERISTIC
/begin CHARACTERISTIC UNK_PMV_REQ05_PRIO "Unidentified constant read directly by INJ 0x51684 (chapter unknown) [unassigned]" VALUE 0x77A06 RL_VAL_UB 0 CM_0000 0 255 /end CHARACTERISTIC
/begin CHARACTERISTIC UNK_PMV_REQ12_PRIO "Unidentified constant read directly by INJ 0x1225ec (chapter unknown) [unassigned]" VALUE 0x77A07 RL_VAL_UB 0 CM_0000 0 255 /end CHARACTERISTIC
/begin CHARACTERISTIC UNK_PMV_REQ09_PRIO "Unidentified constant read directly by INJ 0x1225ec (chapter unknown) [unassigned]" VALUE 0x77A08 RL_VAL_UB 0 CM_0000 0 255 /end CHARACTERISTIC
/begin CHARACTERISTIC UNK_PMV_REQ11_PRIO "Unidentified constant read directly by INJ 0x1225ec (chapter unknown) [unassigned]" VALUE 0x77A09 RL_VAL_UB 0 CM_0000 0 255 /end CHARACTERISTIC
/begin CHARACTERISTIC UNK_PMV_REQ10_PRIO "Unidentified constant read directly by INJ 0x1225ec (chapter unknown) [unassigned]" VALUE 0x77A0A RL_VAL_UB 0 CM_0000 0 255 /end CHARACTERISTIC
/begin CHARACTERISTIC UNK_PMV_REQ13_PRIO "Unidentified constant read directly by INJ 0x1225ec (chapter unknown) [unassigned]" VALUE 0x77A0B RL_VAL_UB 0 CM_0000 0 255 /end CHARACTERISTIC
/begin CHARACTERISTIC UNK_PMV_REQ14_PRIO "Unidentified constant read directly by INJ 0x1225ec (chapter unknown) [unassigned]" VALUE 0x77A0C RL_VAL_UB 0 CM_0000 0 255 /end CHARACTERISTIC
/begin CHARACTERISTIC UNK_PMV_REQ15_PRIO "Unidentified constant read directly by INJ 0x1225ec (chapter unknown) [unassigned]" VALUE 0x77A0D RL_VAL_UB 0 CM_0000 0 255 /end CHARACTERISTIC
/begin CHARACTERISTIC UNK_PMV_REQ16_PRIO "Unidentified constant read directly by INJ 0x1225ec (chapter unknown) [unassigned]" VALUE 0x77A0E RL_VAL_UB 0 CM_0000 0 255 /end CHARACTERISTIC
/begin CHARACTERISTIC UNK_PMV_REQ17_PRIO "Unidentified constant read directly by INJ 0x1225ec (chapter unknown) [unassigned]" VALUE 0x77A0F RL_VAL_UB 0 CM_0000 0 255 /end CHARACTERISTIC
/begin CHARACTERISTIC UNK_PMV_REQ18_PRIO "Unidentified constant read directly by INJ 0x1225ec (chapter unknown) [unassigned]" VALUE 0x77A10 RL_VAL_UB 0 CM_0000 0 255 /end CHARACTERISTIC
/begin CHARACTERISTIC UNK_PMV_REQ19_PRIO "Unidentified constant read directly by INJ 0x1225ec (chapter unknown) [unassigned]" VALUE 0x77A11 RL_VAL_UB 0 CM_0000 0 255 /end CHARACTERISTIC
/begin CHARACTERISTIC UNK_PMV_REQ20_PRIO "Unidentified constant read directly by INJ 0x1225ec (chapter unknown) [unassigned]" VALUE 0x77A12 RL_VAL_UB 0 CM_0000 0 255 /end CHARACTERISTIC
/begin CHARACTERISTIC UNK_PMV_REQ21_PRIO "Unidentified constant read directly by INJ 0x1225ec (chapter unknown) [unassigned]" VALUE 0x77A13 RL_VAL_UB 0 CM_0000 0 255 /end CHARACTERISTIC
/begin CHARACTERISTIC UNK_PMV_REQ22_PRIO "Unidentified constant read directly by INJ 0x1225ec (chapter unknown) [unassigned]" VALUE 0x77A14 RL_VAL_UB 0 CM_0000 0 255 /end CHARACTERISTIC
/begin CHARACTERISTIC UNK_PMV_REQ08_PRIO "Unidentified constant read directly by INJ 0x1225ec (chapter unknown) [unassigned]" VALUE 0x77A15 RL_VAL_UB 0 CM_0000 0 255 /end CHARACTERISTIC
/begin CHARACTERISTIC UNK_PMV_REQ07_PRIO "Unidentified constant read directly by INJ 0x1225ec (chapter unknown) [unassigned]" VALUE 0x77A16 RL_VAL_UB 0 CM_0000 0 255 /end CHARACTERISTIC
/begin CHARACTERISTIC UNK_PMV_REQ06_U_OFFS "Unidentified constant read directly by INJ 0x51684 (chapter unknown) [unassigned]" VALUE 0x77A17 RL_VAL_UB 0 CM_0000 0 255 /end CHARACTERISTIC
/begin CHARACTERISTIC UNK_PMV_REQ01_U_OFFS "Unidentified constant read directly by INJ 0x51684 (chapter unknown) [unassigned]" VALUE 0x77A18 RL_VAL_UB 0 CM_0000 0 255 /end CHARACTERISTIC
/begin CHARACTERISTIC UNK_PMV_REQ11_U_OFFS "Unidentified constant read directly by INJ 0x1225ec (chapter unknown) [unassigned]" VALUE 0x77A19 RL_VAL_UB 0 CM_0000 0 255 /end CHARACTERISTIC
/begin CHARACTERISTIC UNK_PMV_REQ09_U_OFFS "Unidentified constant read directly by INJ 0x1225ec (chapter unknown) [unassigned]" VALUE 0x77A1A RL_VAL_UB 0 CM_0000 0 255 /end CHARACTERISTIC
/begin CHARACTERISTIC UNK_PMV_REQ13_U_OFFS "Unidentified constant read directly by INJ 0x1225ec (chapter unknown) [unassigned]" VALUE 0x77A1B RL_VAL_UB 0 CM_0000 0 255 /end CHARACTERISTIC
/begin CHARACTERISTIC UNK_PMV_REQ14_U_OFFS "Unidentified constant read directly by INJ 0x1225ec (chapter unknown) [unassigned]" VALUE 0x77A1C RL_VAL_UB 0 CM_0000 0 255 /end CHARACTERISTIC
/begin CHARACTERISTIC UNK_PMV_REQ15_U_OFFS "Unidentified constant read directly by INJ 0x1225ec (chapter unknown) [unassigned]" VALUE 0x77A1D RL_VAL_UB 0 CM_0000 0 255 /end CHARACTERISTIC
/begin CHARACTERISTIC UNK_PMV_REQ16_U_OFFS "Unidentified constant read directly by INJ 0x1225ec (chapter unknown) [unassigned]" VALUE 0x77A1E RL_VAL_UB 0 CM_0000 0 255 /end CHARACTERISTIC
/begin CHARACTERISTIC UNK_PMV_REQ17_U_OFFS "Unidentified constant read directly by INJ 0x1225ec (chapter unknown) [unassigned]" VALUE 0x77A1F RL_VAL_UB 0 CM_0000 0 255 /end CHARACTERISTIC
/begin CHARACTERISTIC UNK_PMV_REQ18_U_OFFS "Unidentified constant read directly by INJ 0x1225ec (chapter unknown) [unassigned]" VALUE 0x77A20 RL_VAL_UB 0 CM_0000 0 255 /end CHARACTERISTIC
/begin CHARACTERISTIC UNK_PMV_REQ19_U_OFFS "Unidentified constant read directly by INJ 0x1225ec (chapter unknown) [unassigned]" VALUE 0x77A21 RL_VAL_UB 0 CM_0000 0 255 /end CHARACTERISTIC
/begin CHARACTERISTIC UNK_PMV_REQ07_U_OFFS "Unidentified constant read directly by INJ 0x1225ec (chapter unknown) [unassigned]" VALUE 0x77A22 RL_VAL_UB 0 CM_0000 0 255 /end CHARACTERISTIC
/begin CHARACTERISTIC UNK_PMV_REQ20_U_OFFS "Unidentified constant read directly by INJ 0x1225ec (chapter unknown) [unassigned]" VALUE 0x77A23 RL_VAL_UB 0 CM_0000 0 255 /end CHARACTERISTIC
/begin CHARACTERISTIC UNK_PMV_REQ21_U_OFFS "Unidentified constant read directly by INJ 0x1225ec (chapter unknown) [unassigned]" VALUE 0x77A24 RL_VAL_UB 0 CM_0000 0 255 /end CHARACTERISTIC
/begin CHARACTERISTIC UNK_PMV_REQ22_U_OFFS "Unidentified constant read directly by INJ 0x1225ec (chapter unknown) [unassigned]" VALUE 0x77A25 RL_VAL_UB 0 CM_0000 0 255 /end CHARACTERISTIC
/begin CHARACTERISTIC UNK_PMV_REQ02_U_OFFS "Unidentified constant read directly by INJ 0x51684 (chapter unknown) [unassigned]" VALUE 0x77A26 RL_VAL_UB 0 CM_0000 0 255 /end CHARACTERISTIC
/begin CHARACTERISTIC UNK_PMV_REQ08_U_OFFS "Unidentified constant read directly by INJ 0x1225ec (chapter unknown) [unassigned]" VALUE 0x77A27 RL_VAL_UB 0 CM_0000 0 255 /end CHARACTERISTIC
/begin CHARACTERISTIC UNK_PMV_REQ10_U_OFFS "Unidentified constant read directly by INJ 0x1225ec (chapter unknown) [unassigned]" VALUE 0x77A28 RL_VAL_UB 0 CM_0000 0 255 /end CHARACTERISTIC
/begin CHARACTERISTIC UNK_PMV_REQ12_U_OFFS "Unidentified constant read directly by INJ 0x1225ec (chapter unknown) [unassigned]" VALUE 0x77A29 RL_VAL_UB 0 CM_0000 0 255 /end CHARACTERISTIC
/begin CHARACTERISTIC UNK_PMV_UBATT_OFFS "Unidentified constant read directly by INJ 0x51684 (chapter unknown) [unassigned]" VALUE 0x77A2A RL_VAL_UB 0 CM_0000 0 255 /end CHARACTERISTIC
/begin CHARACTERISTIC UNK_PMV_U_MARGIN "Unidentified constant read directly by INJ 0x51684,0x1225ec (chapter unknown) [unassigned]" VALUE 0x77A2B RL_VAL_UB 0 CM_0000 0 255 /end CHARACTERISTIC
/begin CHARACTERISTIC UNK_PMV_START_PRIO_B "Unidentified constant read directly by INJ 0x51684 (chapter unknown) [unassigned]" VALUE 0x77A2C RL_VAL_UB 0 CM_0000 0 255 /end CHARACTERISTIC
/begin CHARACTERISTIC UNK_PMV_FLAG_PRIO_B "Unidentified constant read directly by INJ 0x1225ec (chapter unknown) [unassigned]" VALUE 0x77A2D RL_VAL_UB 0 CM_0000 0 255 /end CHARACTERISTIC
/begin CHARACTERISTIC UNK_PMV_CH6_U_OFFS2 "Unidentified constant read directly by INJ 0x51684 (chapter unknown) [unassigned]" VALUE 0x77A2E RL_VAL_UB 0 CM_0000 0 255 /end CHARACTERISTIC
/begin CHARACTERISTIC UNK_PMV_CH6_ENABLE "Unidentified constant read directly by INJ 0x51684 (chapter unknown) [unassigned]" VALUE 0x77A2F RL_VAL_UB 0 CM_0000 0 255 /end CHARACTERISTIC
/begin CHARACTERISTIC UNK_PMV_CH6_SW "Unidentified constant read directly by INJ 0x51684 (chapter unknown) [unassigned]" VALUE 0x77A30 RL_VAL_UB 0 CM_0000 0 255 /end CHARACTERISTIC
/begin CHARACTERISTIC UNK_PMV_CH6_SW2 "Unidentified constant read directly by INJ 0x51684 (chapter unknown) [unassigned]" VALUE 0x77A31 RL_VAL_UB 0 CM_0000 0 255 /end CHARACTERISTIC
/begin CHARACTERISTIC UNK_RD_INJ_07A32 "Unidentified constant read directly by INJ 0x521f8 (chapter unknown) [unassigned]" VALUE 0x77A32 RL_VAL_UB 0 CM_0000 0 255 /end CHARACTERISTIC
/begin CHARACTERISTIC UNK_RD_INJ_07A34 "Unidentified constant read directly by INJ 0x123150 (chapter unknown) [unassigned]" VALUE 0x77A34 RL_VAL_SW 0 CM_0000 -32768 32767 /end CHARACTERISTIC
/begin CHARACTERISTIC UNK_RD_INJ_07A36 "Unidentified constant read directly by INJ 0x123150 (chapter unknown) [unassigned]" VALUE 0x77A36 RL_VAL_SW 0 CM_0000 -32768 32767 /end CHARACTERISTIC
/begin CHARACTERISTIC UNK_RD_INJ_07A38 "Unidentified constant read directly by INJ 0x123150 (chapter unknown) [unassigned]" VALUE 0x77A38 RL_VAL_SW 0 CM_0000 -32768 32767 /end CHARACTERISTIC
/begin CHARACTERISTIC UNK_RD_INJ_07A3A "Unidentified constant read directly by INJ 0x123150 (chapter unknown) [unassigned]" VALUE 0x77A3A RL_VAL_UW 0 CM_0000 0 65535 /end CHARACTERISTIC
/begin CHARACTERISTIC UNK_RD_INJ_07A3C "Unidentified constant read directly by INJ 0x123150 (chapter unknown) [unassigned]" VALUE 0x77A3C RL_VAL_UB 0 CM_0000 0 255 /end CHARACTERISTIC
/begin CHARACTERISTIC UNK_RD_INJ_07A3D "Unidentified constant read directly by INJ 0x123150 (chapter unknown) [unassigned]" VALUE 0x77A3D RL_VAL_UB 0 CM_0000 0 255 /end CHARACTERISTIC
/begin CHARACTERISTIC UNK_RD_INJ_07A3E "Unidentified constant read directly by INJ 0x123150 (chapter unknown) [unassigned]" VALUE 0x77A3E RL_VAL_UB 0 CM_0000 0 255 /end CHARACTERISTIC
/begin CHARACTERISTIC UNK_RD_INJ_07A3F "Unidentified constant read directly by INJ 0x123150 (chapter unknown) [unassigned]" VALUE 0x77A3F RL_VAL_UB 0 CM_0000 0 255 /end CHARACTERISTIC
/begin CHARACTERISTIC UNK_RD_INJ_07A40 "Unidentified constant read directly by INJ 0x521f8 (chapter unknown) [unassigned]" VALUE 0x77A40 RL_VAL_UB 0 CM_0000 0 255 /end CHARACTERISTIC
/begin CHARACTERISTIC UNK_RD_INJ_07A42 "Unidentified constant read directly by INJ 0x123150 (chapter unknown) [unassigned]" VALUE 0x77A42 RL_VAL_UW 0 CM_0000 0 65535 /end CHARACTERISTIC
/begin CHARACTERISTIC UNK_RD_INJ_07A44 "Unidentified constant read directly by INJ 0x123150 (chapter unknown) [unassigned]" VALUE 0x77A44 RL_VAL_UW 0 CM_0000 0 65535 /end CHARACTERISTIC
/begin CHARACTERISTIC UNK_RD_INJ_07A46 "Unidentified constant read directly by INJ 0x123150 (chapter unknown) [unassigned]" VALUE 0x77A46 RL_VAL_UW 0 CM_0000 0 65535 /end CHARACTERISTIC
/begin CHARACTERISTIC UNK_RD_INJ_07A48 "Unidentified constant read directly by INJ 0x123150 (chapter unknown) [unassigned]" VALUE 0x77A48 RL_VAL_UW 0 CM_0000 0 65535 /end CHARACTERISTIC
/begin CHARACTERISTIC UNK_RD_INJ_07A4A "Unidentified constant read directly by INJ 0x521f8 (chapter unknown) [unassigned]" VALUE 0x77A4A RL_VAL_UW 0 CM_0000 0 65535 /end CHARACTERISTIC
/begin CHARACTERISTIC UNK_RD_INJ_07A4C "Unidentified constant read directly by INJ 0x521f8 (chapter unknown) [unassigned]" VALUE 0x77A4C RL_VAL_UW 0 CM_0000 0 65535 /end CHARACTERISTIC
/begin CHARACTERISTIC UNK_RD_INJ_07A4E "Unidentified constant read directly by INJ 0x123150 (chapter unknown) [unassigned]" VALUE 0x77A4E RL_VAL_UW 0 CM_0000 0 65535 /end CHARACTERISTIC
/begin CHARACTERISTIC UNK_RD_INJ_07A50 "Unidentified constant read directly by INJ 0x123150 (chapter unknown) [unassigned]" VALUE 0x77A50 RL_VAL_UB 0 CM_0000 0 255 /end CHARACTERISTIC
/begin CHARACTERISTIC UNK_RD_INJ_07A51 "Unidentified constant read directly by INJ 0x123150 (chapter unknown) [unassigned]" VALUE 0x77A51 RL_VAL_UB 0 CM_0000 0 255 /end CHARACTERISTIC
/begin CHARACTERISTIC UNK_RD_INJ_07A52 "Unidentified constant read directly by INJ 0x123150 (chapter unknown) [unassigned]" VALUE 0x77A52 RL_VAL_UB 0 CM_0000 0 255 /end CHARACTERISTIC
/begin CHARACTERISTIC UNK_RD_INJ_07A53 "Unidentified constant read directly by INJ 0x123150 (chapter unknown) [unassigned]" VALUE 0x77A53 RL_VAL_UB 0 CM_0000 0 255 /end CHARACTERISTIC
/begin CHARACTERISTIC UNK_RD_INJ_07A54 "Unidentified constant read directly by INJ 0x123150 (chapter unknown) [unassigned]" VALUE 0x77A54 RL_VAL_UB 0 CM_0000 0 255 /end CHARACTERISTIC
/begin CHARACTERISTIC UNK_RD_INJ_07A55 "Unidentified constant read directly by INJ 0x123150 (chapter unknown) [unassigned]" VALUE 0x77A55 RL_VAL_UB 0 CM_0000 0 255 /end CHARACTERISTIC
/begin CHARACTERISTIC UNK_RD_INJ_07A56 "Unidentified constant read directly by INJ 0x521f8 (chapter unknown) [unassigned]" VALUE 0x77A56 RL_VAL_UB 0 CM_0000 0 255 /end CHARACTERISTIC
/begin CHARACTERISTIC UNK_RD_INJ_07A57 "Unidentified constant read directly by INJ 0x123150 (chapter unknown) [unassigned]" VALUE 0x77A57 RL_VAL_UB 0 CM_0000 0 255 /end CHARACTERISTIC
/begin CHARACTERISTIC UNK_RD_INJ_07A58 "Unidentified constant read directly by INJ 0x521f8 (chapter unknown) [unassigned]" VALUE 0x77A58 RL_VAL_UB 0 CM_0000 0 255 /end CHARACTERISTIC
/begin CHARACTERISTIC UNK_RD_INJ_07A59 "Unidentified constant read directly by INJ 0x521f8 (chapter unknown) [unassigned]" VALUE 0x77A59 RL_VAL_UB 0 CM_0000 0 255 /end CHARACTERISTIC
/begin CHARACTERISTIC UNK_RD_INJ_07A5B "Unidentified constant read directly by INJ 0x123150 (chapter unknown) [unassigned]" VALUE 0x77A5B RL_VAL_UB 0 CM_0000 0 255 /end CHARACTERISTIC
/begin CHARACTERISTIC UNK_RD_INJ_07A5D "Unidentified constant read directly by INJ 0x521f8 (chapter unknown) [unassigned]" VALUE 0x77A5D RL_VAL_UB 0 CM_0000 0 255 /end CHARACTERISTIC
/begin CHARACTERISTIC UNK_RD_INJ_07A5E "Unidentified constant read directly by INJ 0x521f8 (chapter unknown) [unassigned]" VALUE 0x77A5E RL_VAL_UB 0 CM_0000 0 255 /end CHARACTERISTIC
/begin CHARACTERISTIC UNK_RD_INJ_07A5F "Unidentified constant read directly by INJ 0x123150 (chapter unknown) [unassigned]" VALUE 0x77A5F RL_VAL_UB 0 CM_0000 0 255 /end CHARACTERISTIC
/begin CHARACTERISTIC UNK_RD_INJ_07A70 "Unidentified constant read directly by INJ 0x1238c0 (chapter unknown) [unassigned]" VALUE 0x77A70 RL_VAL_UW 0 CM_0000 0 65535 /end CHARACTERISTIC
/begin CHARACTERISTIC UNK_RD_INJ_07A72 "Unidentified constant read directly by INJ 0x1238c0 (chapter unknown) [unassigned]" VALUE 0x77A72 RL_VAL_UW 0 CM_0000 0 65535 /end CHARACTERISTIC
/begin CHARACTERISTIC UNK_RD_INJ_07A74 "Unidentified constant read directly by INJ 0x1238c0 (chapter unknown) [unassigned]" VALUE 0x77A74 RL_VAL_UW 0 CM_0000 0 65535 /end CHARACTERISTIC
/begin CHARACTERISTIC UNK_RD_INJ_07A76 "Unidentified constant read directly by INJ 0x1238c0 (chapter unknown) [unassigned]" VALUE 0x77A76 RL_VAL_UB 0 CM_0000 0 255 /end CHARACTERISTIC
/begin CHARACTERISTIC UNK_RD_INJ_07A77 "Unidentified constant read directly by INJ 0x1238c0 (chapter unknown) [unassigned]" VALUE 0x77A77 RL_VAL_UB 0 CM_0000 0 255 /end CHARACTERISTIC
/begin CHARACTERISTIC UNK_RD_INJ_07A78 "Unidentified constant read directly by INJ 0x123cac (chapter unknown) [unassigned]" VALUE 0x77A78 RL_VAL_UW 0 CM_0000 0 65535 /end CHARACTERISTIC
/begin CHARACTERISTIC UNK_RD_INJ_07A7E "Unidentified constant read directly by INJ 0x123cac (chapter unknown) [unassigned]" VALUE 0x77A7E RL_VAL_UB 0 CM_0000 0 255 /end CHARACTERISTIC
/begin CHARACTERISTIC UNK_RD_INJ_07A7F "Unidentified constant read directly by INJ 0x51684,0x123cac (chapter unknown) [unassigned]" VALUE 0x77A7F RL_VAL_UB 0 CM_0000 0 255 /end CHARACTERISTIC
/begin CHARACTERISTIC UNK_RD_INJ_07AB6 "Unidentified constant read directly by INJ 0x123cac (chapter unknown) [unassigned]" VALUE 0x77AB6 RL_VAL_UW 0 CM_0000 0 65535 /end CHARACTERISTIC
/begin CHARACTERISTIC UNK_RD_INJ_07AB8 "Unidentified constant read directly by INJ 0x123cac (chapter unknown) [unassigned]" VALUE 0x77AB8 RL_VAL_UW 0 CM_0000 0 65535 /end CHARACTERISTIC
/begin CHARACTERISTIC UNK_RD_INJ_07ABA "Unidentified constant read directly by INJ 0x123cac (chapter unknown) [unassigned]" VALUE 0x77ABA RL_VAL_UW 0 CM_0000 0 65535 /end CHARACTERISTIC
/begin CHARACTERISTIC UNK_RD_INJ_07ABC "Unidentified constant read directly by INJ 0x123cac (chapter unknown) [unassigned]" VALUE 0x77ABC RL_VAL_UB 0 CM_0000 0 255 /end CHARACTERISTIC
/begin CHARACTERISTIC UNK_RD_INJ_07ABD "Unidentified constant read directly by INJ 0x123cac (chapter unknown) [unassigned]" VALUE 0x77ABD RL_VAL_UB 0 CM_0000 0 255 /end CHARACTERISTIC
/begin CHARACTERISTIC UNK_RD_INJ_07ABE "Unidentified constant read directly by INJ 0x123cac (chapter unknown) [unassigned]" VALUE 0x77ABE RL_VAL_UB 0 CM_0000 0 255 /end CHARACTERISTIC
/begin CHARACTERISTIC UNK_RD_INJ_07ABF "Unidentified constant read directly by INJ 0x123cac (chapter unknown) [unassigned]" VALUE 0x77ABF RL_VAL_UB 0 CM_0000 0 255 /end CHARACTERISTIC
/begin CHARACTERISTIC UNK_RD_INJ_07AC1 "Unidentified constant read directly by INJ 0x123cac (chapter unknown) [unassigned]" VALUE 0x77AC1 RL_VAL_UB 0 CM_0000 0 255 /end CHARACTERISTIC
/begin CHARACTERISTIC UNK_RD_INJ_07AC2 "Unidentified constant read directly by INJ 0x123cac (chapter unknown) [unassigned]" VALUE 0x77AC2 RL_VAL_UB 0 CM_0000 0 255 /end CHARACTERISTIC
/begin CHARACTERISTIC UNK_RD_INJ_07AC3 "Unidentified constant read directly by INJ 0x123cac (chapter unknown) [unassigned]" VALUE 0x77AC3 RL_VAL_UB 0 CM_0000 0 255 /end CHARACTERISTIC
/begin CHARACTERISTIC UNK_RD_INJ_07AC4 "Unidentified constant read directly by INJ 0x123cac (chapter unknown) [unassigned]" VALUE 0x77AC4 RL_VAL_UB 0 CM_0000 0 255 /end CHARACTERISTIC
/begin CHARACTERISTIC UNK_RD_INJ_07AC5 "Unidentified constant read directly by INJ 0x123cac (chapter unknown) [unassigned]" VALUE 0x77AC5 RL_VAL_UB 0 CM_0000 0 255 /end CHARACTERISTIC
/begin CHARACTERISTIC UNK_RD_INJ_07AC6 "Unidentified constant read directly by INJ 0x123cac (chapter unknown) [unassigned]" VALUE 0x77AC6 RL_VAL_UB 0 CM_0000 0 255 /end CHARACTERISTIC
/begin CHARACTERISTIC UNK_RD_INJ_07AC7 "Unidentified constant read directly by INJ 0x123cac (chapter unknown) [unassigned]" VALUE 0x77AC7 RL_VAL_UB 0 CM_0000 0 255 /end CHARACTERISTIC
/begin CHARACTERISTIC UNK_RD_INJ_07AC8 "Unidentified constant read directly by INJ 0x123cac (chapter unknown) [unassigned]" VALUE 0x77AC8 RL_VAL_UB 0 CM_0000 0 255 /end CHARACTERISTIC
/begin CHARACTERISTIC UNK_RD_INJ_07AC9 "Unidentified constant read directly by INJ 0x123cac (chapter unknown) [unassigned]" VALUE 0x77AC9 RL_VAL_UB 0 CM_0000 0 255 /end CHARACTERISTIC
/begin CHARACTERISTIC UNK_RD_INJ_07ACA "Unidentified constant read directly by INJ 0x123cac (chapter unknown) [unassigned]" VALUE 0x77ACA RL_VAL_UB 0 CM_0000 0 255 /end CHARACTERISTIC
/begin CHARACTERISTIC UNK_RD_INJ_07ACB "Unidentified constant read directly by INJ 0x123cac (chapter unknown) [unassigned]" VALUE 0x77ACB RL_VAL_UB 0 CM_0000 0 255 /end CHARACTERISTIC
/begin CHARACTERISTIC UNK_RD_INJ_07ACC "Unidentified constant read directly by INJ 0x123cac (chapter unknown) [unassigned]" VALUE 0x77ACC RL_VAL_UB 0 CM_0000 0 255 /end CHARACTERISTIC
/begin CHARACTERISTIC UNK_RD_INJ_07ACD "Unidentified constant read directly by INJ 0x123cac (chapter unknown) [unassigned]" VALUE 0x77ACD RL_VAL_UB 0 CM_0000 0 255 /end CHARACTERISTIC
/begin CHARACTERISTIC UNK_RD_INJ_07ACE "Unidentified constant read directly by INJ 0x123cac (chapter unknown) [unassigned]" VALUE 0x77ACE RL_VAL_UB 0 CM_0000 0 255 /end CHARACTERISTIC
/begin CHARACTERISTIC UNK_RD_INJ_07AD0 "Unidentified constant read directly by INJ 0x123cac (chapter unknown) [unassigned]" VALUE 0x77AD0 RL_VAL_UB 0 CM_0000 0 255 /end CHARACTERISTIC
/begin CHARACTERISTIC UNK_RD_INJ_07AD1 "Unidentified constant read directly by INJ 0x123cac (chapter unknown) [unassigned]" VALUE 0x77AD1 RL_VAL_UB 0 CM_0000 0 255 /end CHARACTERISTIC
/begin CHARACTERISTIC UNK_RD_INJ_07AD2 "Unidentified constant read directly by INJ 0x123cac (chapter unknown) [unassigned]" VALUE 0x77AD2 RL_VAL_UB 0 CM_0000 0 255 /end CHARACTERISTIC
/begin CHARACTERISTIC UNK_RD_INJ_07AD3 "Unidentified constant read directly by INJ 0x123cac (chapter unknown) [unassigned]" VALUE 0x77AD3 RL_VAL_UB 0 CM_0000 0 255 /end CHARACTERISTIC
/begin CHARACTERISTIC UNK_RD_INJ_07AD4 "Unidentified constant read directly by INJ 0x123cac (chapter unknown) [unassigned]" VALUE 0x77AD4 RL_VAL_UB 0 CM_0000 0 255 /end CHARACTERISTIC
/begin CHARACTERISTIC UNK_RD_INJ_07AD5 "Unidentified constant read directly by INJ 0x123cac (chapter unknown) [unassigned]" VALUE 0x77AD5 RL_VAL_UB 0 CM_0000 0 255 /end CHARACTERISTIC
/begin CHARACTERISTIC UNK_RD_INJ_07AD6 "Unidentified constant read directly by INJ 0x123cac (chapter unknown) [unassigned]" VALUE 0x77AD6 RL_VAL_UB 0 CM_0000 0 255 /end CHARACTERISTIC
/begin CHARACTERISTIC UNK_RD_INJ_07AD7 "Unidentified constant read directly by INJ 0x123cac (chapter unknown) [unassigned]" VALUE 0x77AD7 RL_VAL_UB 0 CM_0000 0 255 /end CHARACTERISTIC
/begin CHARACTERISTIC UNK_RD_INJ_07AD8 "Unidentified constant read directly by INJ 0x123cac (chapter unknown) [unassigned]" VALUE 0x77AD8 RL_VAL_UB 0 CM_0000 0 255 /end CHARACTERISTIC
/begin CHARACTERISTIC UNK_RD_INJ_07AD9 "Unidentified constant read directly by INJ 0x123cac (chapter unknown) [unassigned]" VALUE 0x77AD9 RL_VAL_UB 0 CM_0000 0 255 /end CHARACTERISTIC
/begin CHARACTERISTIC UNK_RD_INJ_07ADA "Unidentified constant read directly by INJ 0x123cac (chapter unknown) [unassigned]" VALUE 0x77ADA RL_VAL_UB 0 CM_0000 0 255 /end CHARACTERISTIC
/begin CHARACTERISTIC UNK_RD_INJ_07ADB "Unidentified constant read directly by INJ 0x123cac (chapter unknown) [unassigned]" VALUE 0x77ADB RL_VAL_UB 0 CM_0000 0 255 /end CHARACTERISTIC
/begin CHARACTERISTIC UNK_RD_INJ_07ADC "Unidentified constant read directly by INJ 0x123cac (chapter unknown) [unassigned]" VALUE 0x77ADC RL_VAL_UB 0 CM_0000 0 255 /end CHARACTERISTIC
/begin CHARACTERISTIC UNK_RD_INJ_07ADD "Unidentified constant read directly by INJ 0x123cac (chapter unknown) [unassigned]" VALUE 0x77ADD RL_VAL_UB 0 CM_0000 0 255 /end CHARACTERISTIC
/begin CHARACTERISTIC UNK_RD_INJ_07ADE "Unidentified constant read directly by INJ 0x123cac (chapter unknown) [unassigned]" VALUE 0x77ADE RL_VAL_UB 0 CM_0000 0 255 /end CHARACTERISTIC
/begin CHARACTERISTIC UNK_RD_INJ_07ADF "Unidentified constant read directly by INJ 0x123cac (chapter unknown) [unassigned]" VALUE 0x77ADF RL_VAL_UB 0 CM_0000 0 255 /end CHARACTERISTIC
/begin CHARACTERISTIC UNK_RD_INJ_07AE0 "Unidentified constant read directly by INJ 0x123cac (chapter unknown) [unassigned]" VALUE 0x77AE0 RL_VAL_UB 0 CM_0000 0 255 /end CHARACTERISTIC
/begin CHARACTERISTIC UNK_RD_INJ_07AE1 "Unidentified constant read directly by INJ 0x123cac (chapter unknown) [unassigned]" VALUE 0x77AE1 RL_VAL_UB 0 CM_0000 0 255 /end CHARACTERISTIC
/begin CHARACTERISTIC UNK_RD_INJ_07AE2 "Unidentified constant read directly by INJ 0x123cac (chapter unknown) [unassigned]" VALUE 0x77AE2 RL_VAL_UB 0 CM_0000 0 255 /end CHARACTERISTIC
/begin CHARACTERISTIC UNK_RD_INJ_07AE3 "Unidentified constant read directly by INJ 0x123cac (chapter unknown) [unassigned]" VALUE 0x77AE3 RL_VAL_UB 0 CM_0000 0 255 /end CHARACTERISTIC
/begin CHARACTERISTIC UNK_RD_INJ_07AE4 "Unidentified constant read directly by INJ 0x123cac (chapter unknown) [unassigned]" VALUE 0x77AE4 RL_VAL_UB 0 CM_0000 0 255 /end CHARACTERISTIC
/begin CHARACTERISTIC UNK_RD_INJ_07AE5 "Unidentified constant read directly by INJ 0x123cac (chapter unknown) [unassigned]" VALUE 0x77AE5 RL_VAL_UB 0 CM_0000 0 255 /end CHARACTERISTIC
/begin CHARACTERISTIC UNK_RD_INJ_07AE6 "Unidentified constant read directly by INJ 0x123cac (chapter unknown) [unassigned]" VALUE 0x77AE6 RL_VAL_UB 0 CM_0000 0 255 /end CHARACTERISTIC
/begin CHARACTERISTIC UNK_RD_INJ_07AE7 "Unidentified constant read directly by INJ 0x123cac (chapter unknown) [unassigned]" VALUE 0x77AE7 RL_VAL_UB 0 CM_0000 0 255 /end CHARACTERISTIC
/begin CHARACTERISTIC UNK_RD_INJ_07AE8 "Unidentified constant read directly by INJ 0x123cac (chapter unknown) [unassigned]" VALUE 0x77AE8 RL_VAL_UB 0 CM_0000 0 255 /end CHARACTERISTIC
/begin CHARACTERISTIC UNK_RD_INJ_07AE9 "Unidentified constant read directly by INJ 0x123cac (chapter unknown) [unassigned]" VALUE 0x77AE9 RL_VAL_UB 0 CM_0000 0 255 /end CHARACTERISTIC
/begin CHARACTERISTIC UNK_RD_INJ_07AEA "Unidentified constant read directly by INJ 0x123cac (chapter unknown) [unassigned]" VALUE 0x77AEA RL_VAL_UB 0 CM_0000 0 255 /end CHARACTERISTIC
/begin CHARACTERISTIC UNK_RD_INJ_07AEB "Unidentified constant read directly by INJ 0x123cac (chapter unknown) [unassigned]" VALUE 0x77AEB RL_VAL_UB 0 CM_0000 0 255 /end CHARACTERISTIC
/begin CHARACTERISTIC UNK_RD_INJ_07AEC "Unidentified constant read directly by INJ 0x123cac (chapter unknown) [unassigned]" VALUE 0x77AEC RL_VAL_UB 0 CM_0000 0 255 /end CHARACTERISTIC
/begin CHARACTERISTIC UNK_RD_INJ_07AED "Unidentified constant read directly by INJ 0x123cac (chapter unknown) [unassigned]" VALUE 0x77AED RL_VAL_UB 0 CM_0000 0 255 /end CHARACTERISTIC
/begin CHARACTERISTIC UNK_RD_INJ_07AEE "Unidentified constant read directly by INJ 0x123cac (chapter unknown) [unassigned]" VALUE 0x77AEE RL_VAL_UB 0 CM_0000 0 255 /end CHARACTERISTIC
/begin CHARACTERISTIC UNK_RD_INJ_07AF1 "Unidentified constant read directly by INJ 0x123cac (chapter unknown) [unassigned]" VALUE 0x77AF1 RL_VAL_UB 0 CM_0000 0 255 /end CHARACTERISTIC
/begin CHARACTERISTIC UNK_RD_INJ_07AF2 "Unidentified constant read directly by INJ 0x123cac (chapter unknown) [unassigned]" VALUE 0x77AF2 RL_VAL_UB 0 CM_0000 0 255 /end CHARACTERISTIC
/begin CHARACTERISTIC UNK_RD_INJ_07AF3 "Unidentified constant read directly by INJ 0x123cac (chapter unknown) [unassigned]" VALUE 0x77AF3 RL_VAL_UB 0 CM_0000 0 255 /end CHARACTERISTIC
/begin CHARACTERISTIC UNK_RD_INJ_07AF4 "Unidentified constant read directly by INJ 0x123cac (chapter unknown) [unassigned]" VALUE 0x77AF4 RL_VAL_UB 0 CM_0000 0 255 /end CHARACTERISTIC
/begin CHARACTERISTIC UNK_RD_INJ_07AF5 "Unidentified constant read directly by INJ 0x123cac (chapter unknown) [unassigned]" VALUE 0x77AF5 RL_VAL_UB 0 CM_0000 0 255 /end CHARACTERISTIC
/begin CHARACTERISTIC UNK_RD_INJ_07AF6 "Unidentified constant read directly by INJ 0x123cac (chapter unknown) [unassigned]" VALUE 0x77AF6 RL_VAL_UB 0 CM_0000 0 255 /end CHARACTERISTIC
/begin CHARACTERISTIC UNK_RD_INJ_07AF7 "Unidentified constant read directly by INJ 0x123cac (chapter unknown) [unassigned]" VALUE 0x77AF7 RL_VAL_UB 0 CM_0000 0 255 /end CHARACTERISTIC
/begin CHARACTERISTIC UNK_RD_INJ_07AF8 "Unidentified constant read directly by INJ 0x123cac (chapter unknown) [unassigned]" VALUE 0x77AF8 RL_VAL_UB 0 CM_0000 0 255 /end CHARACTERISTIC
/begin CHARACTERISTIC UNK_RD_INJ_07AF9 "Unidentified constant read directly by INJ 0x123cac (chapter unknown) [unassigned]" VALUE 0x77AF9 RL_VAL_UB 0 CM_0000 0 255 /end CHARACTERISTIC
/begin CHARACTERISTIC UNK_RD_INJ_07AFA "Unidentified constant read directly by INJ 0x123cac (chapter unknown) [unassigned]" VALUE 0x77AFA RL_VAL_UB 0 CM_0000 0 255 /end CHARACTERISTIC
/begin CHARACTERISTIC UNK_RD_INJ_07AFB "Unidentified constant read directly by INJ 0x123cac (chapter unknown) [unassigned]" VALUE 0x77AFB RL_VAL_UB 0 CM_0000 0 255 /end CHARACTERISTIC
/begin CHARACTERISTIC UNK_RD_INJ_07AFC "Unidentified constant read directly by INJ 0x123cac (chapter unknown) [unassigned]" VALUE 0x77AFC RL_VAL_UB 0 CM_0000 0 255 /end CHARACTERISTIC
/begin CHARACTERISTIC UNK_RD_INJ_07AFD "Unidentified constant read directly by INJ 0x123cac (chapter unknown) [unassigned]" VALUE 0x77AFD RL_VAL_UB 0 CM_0000 0 255 /end CHARACTERISTIC
/begin CHARACTERISTIC UNK_RD_INJ_07AFE "Unidentified constant read directly by INJ 0x123cac (chapter unknown) [unassigned]" VALUE 0x77AFE RL_VAL_UB 0 CM_0000 0 255 /end CHARACTERISTIC
/begin CHARACTERISTIC UNK_RD_INJ_07AFF "Unidentified constant read directly by INJ 0x123cac (chapter unknown) [unassigned]" VALUE 0x77AFF RL_VAL_UB 0 CM_0000 0 255 /end CHARACTERISTIC
/begin CHARACTERISTIC UNK_RD_INJ_07B00 "Unidentified constant read directly by INJ 0x123cac (chapter unknown) [unassigned]" VALUE 0x77B00 RL_VAL_UB 0 CM_0000 0 255 /end CHARACTERISTIC
/begin CHARACTERISTIC UNK_RD_INJ_07B01 "Unidentified constant read directly by INJ 0x123cac (chapter unknown) [unassigned]" VALUE 0x77B01 RL_VAL_UB 0 CM_0000 0 255 /end CHARACTERISTIC
/begin CHARACTERISTIC UNK_RD_INJ_07B02 "Unidentified constant read directly by INJ 0x123cac (chapter unknown) [unassigned]" VALUE 0x77B02 RL_VAL_UB 0 CM_0000 0 255 /end CHARACTERISTIC
/begin CHARACTERISTIC UNK_RD_INJ_07B03 "Unidentified constant read directly by INJ 0x123cac (chapter unknown) [unassigned]" VALUE 0x77B03 RL_VAL_UB 0 CM_0000 0 255 /end CHARACTERISTIC
/begin CHARACTERISTIC UNK_RD_INJ_07B04 "Unidentified constant read directly by INJ 0x123cac (chapter unknown) [unassigned]" VALUE 0x77B04 RL_VAL_UB 0 CM_0000 0 255 /end CHARACTERISTIC
/begin CHARACTERISTIC UNK_RD_INJ_07B05 "Unidentified constant read directly by INJ 0x123cac (chapter unknown) [unassigned]" VALUE 0x77B05 RL_VAL_UB 0 CM_0000 0 255 /end CHARACTERISTIC
/begin CHARACTERISTIC UNK_RD_INJ_07B06 "Unidentified constant read directly by INJ 0x123cac (chapter unknown) [unassigned]" VALUE 0x77B06 RL_VAL_UB 0 CM_0000 0 255 /end CHARACTERISTIC
/begin CHARACTERISTIC UNK_RD_INJ_07EC0 "Unidentified constant read directly by INJ 0x126324 (chapter unknown) [unassigned]" VALUE 0x77EC0 RL_VAL_UL 0 CM_0000 0 4294967295 /end CHARACTERISTIC
/begin CHARACTERISTIC UNK_RD_INJ_07EC4 "Unidentified constant read directly by INJ 0x126324 (chapter unknown) [unassigned]" VALUE 0x77EC4 RL_VAL_UL 0 CM_0000 0 4294967295 /end CHARACTERISTIC
/begin CHARACTERISTIC UNK_RD_INJ_07EC8 "Unidentified constant read directly by INJ 0x126324 (chapter unknown) [unassigned]" VALUE 0x77EC8 RL_VAL_UL 0 CM_0000 0 4294967295 /end CHARACTERISTIC
/begin CHARACTERISTIC UNK_RD_INJ_07ECC "Unidentified constant read directly by INJ 0x126324 (chapter unknown) [unassigned]" VALUE 0x77ECC RL_VAL_UL 0 CM_0000 0 4294967295 /end CHARACTERISTIC
/begin CHARACTERISTIC UNK_RD_INJ_07ED4 "Unidentified constant read directly by INJ 0x126324 (chapter unknown) [unassigned]" VALUE 0x77ED4 RL_VAL_SW 0 CM_0000 -32768 32767 /end CHARACTERISTIC
/begin CHARACTERISTIC UNK_RD_INJ_07ED6 "Unidentified constant read directly by INJ 0x126324 (chapter unknown) [unassigned]" VALUE 0x77ED6 RL_VAL_SW 0 CM_0000 -32768 32767 /end CHARACTERISTIC
/begin CHARACTERISTIC UNK_RD_INJ_07ED8 "Unidentified constant read directly by INJ 0x126324 (chapter unknown) [unassigned]" VALUE 0x77ED8 RL_VAL_SW 0 CM_0000 -32768 32767 /end CHARACTERISTIC
/begin CHARACTERISTIC UNK_RD_INJ_08052 "Unidentified constant read directly by INJ 0x127f48 (chapter unknown) [unassigned]" VALUE 0x78052 RL_VAL_UW 0 CM_0000 0 65535 /end CHARACTERISTIC
/begin CHARACTERISTIC UNK_RD_INJ_08054 "Unidentified constant read directly by INJ 0x127f48 (chapter unknown) [unassigned]" VALUE 0x78054 RL_VAL_UW 0 CM_0000 0 65535 /end CHARACTERISTIC
/begin CHARACTERISTIC UNK_RD_INJ_08056 "Unidentified constant read directly by INJ 0x127f48 (chapter unknown) [unassigned]" VALUE 0x78056 RL_VAL_UB 0 CM_0000 0 255 /end CHARACTERISTIC
/begin CHARACTERISTIC UNK_RD_INJ_08057 "Unidentified constant read directly by INJ 0x127f48 (chapter unknown) [unassigned]" VALUE 0x78057 RL_VAL_UB 0 CM_0000 0 255 /end CHARACTERISTIC
/begin CHARACTERISTIC UNK_RD_INJ_08058 "Unidentified constant read directly by INJ 0x127f48 (chapter unknown) [unassigned]" VALUE 0x78058 RL_VAL_UB 0 CM_0000 0 255 /end CHARACTERISTIC
/begin CHARACTERISTIC UNK_RD_INJ_08059 "Unidentified constant read directly by INJ 0x127f48 (chapter unknown) [unassigned]" VALUE 0x78059 RL_VAL_UB 0 CM_0000 0 255 /end CHARACTERISTIC
/begin CHARACTERISTIC UNK_RD_INJ_0805A "Unidentified constant read directly by INJ 0x127f48 (chapter unknown) [unassigned]" VALUE 0x7805A RL_VAL_UB 0 CM_0000 0 255 /end CHARACTERISTIC
/begin CHARACTERISTIC UNK_RD_INJ_082DA "Unidentified constant read directly by INJ 0x5547c (chapter unknown) [unassigned]" VALUE 0x782DA RL_VAL_UB 0 CM_0000 0 255 /end CHARACTERISTIC
/begin CHARACTERISTIC UNK_RD_INJ_086E0 "Unidentified constant read directly by INJ 0x57658 (SK-Manager) [unassigned]" VALUE 0x786E0 RL_VAL_UW 0 CM_0000 0 65535 /end CHARACTERISTIC
/begin CHARACTERISTIC UNK_RD_INJ_08900 "Unidentified constant read directly by INJ 0x59cb8 (Tankentl?ftung) [unassigned]" VALUE 0x78900 RL_VAL_SW 0 CM_0000 -32768 32767 /end CHARACTERISTIC
/begin CHARACTERISTIC UNK_RD_INJ_08902 "Unidentified constant read directly by INJ 0x59cb8 (Tankentl?ftung) [unassigned]" VALUE 0x78902 RL_VAL_UW 0 CM_0000 0 65535 /end CHARACTERISTIC
/begin CHARACTERISTIC UNK_RD_INJ_08906 "Unidentified constant read directly by INJ 0x59cb8 (Tankentl?ftung) [unassigned]" VALUE 0x78906 RL_VAL_UW 0 CM_0000 0 65535 /end CHARACTERISTIC
/begin CHARACTERISTIC UNK_RD_INJ_08908 "Unidentified constant read directly by INJ 0x59cb8 (Tankentl?ftung) [unassigned]" VALUE 0x78908 RL_VAL_UW 0 CM_0000 0 65535 /end CHARACTERISTIC
/begin CHARACTERISTIC UNK_RD_INJ_0890A "Unidentified constant read directly by INJ 0x59630 (Ansauglufttemperatur) [unassigned]" VALUE 0x7890A RL_VAL_SW 0 CM_0000 -32768 32767 /end CHARACTERISTIC
/begin CHARACTERISTIC UNK_RD_INJ_0890C "Unidentified constant read directly by INJ 0x12de64 (Ansauglufttemperatur) [unassigned]" VALUE 0x7890C RL_VAL_SW 0 CM_0000 -32768 32767 /end CHARACTERISTIC
/begin CHARACTERISTIC UNK_RD_INJ_0890E "Unidentified constant read directly by INJ 0x12de64 (Ansauglufttemperatur) [unassigned]" VALUE 0x7890E RL_VAL_SW 0 CM_0000 -32768 32767 /end CHARACTERISTIC
/begin CHARACTERISTIC UNK_RD_INJ_08910 "Unidentified constant read directly by INJ 0x12de64 (Ansauglufttemperatur) [unassigned]" VALUE 0x78910 RL_VAL_SW 0 CM_0000 -32768 32767 /end CHARACTERISTIC
/begin CHARACTERISTIC UNK_RD_INJ_08912 "Unidentified constant read directly by INJ 0x12de64 (Ansauglufttemperatur) [unassigned]" VALUE 0x78912 RL_VAL_SW 0 CM_0000 -32768 32767 /end CHARACTERISTIC
/begin CHARACTERISTIC UNK_RD_INJ_08B45 "Unidentified constant read directly by INJ 0x5547c,0xe315c,0x131a8c (Codierung) [unassigned]" VALUE 0x78B45 RL_VAL_UB 0 CM_0000 0 255 /end CHARACTERISTIC
/begin CHARACTERISTIC UNK_RD_INJ_08B4A "Unidentified constant read directly by INJ 0x2dd38 (chapter unknown) [unassigned]" VALUE 0x78B4A RL_VAL_UB 0 CM_0000 0 255 /end CHARACTERISTIC
/begin CHARACTERISTIC UNK_RD_INJ_08B4B "Unidentified constant read directly by INJ 0x2ba44,0xd5720 (chapter unknown) [unassigned]" VALUE 0x78B4B RL_VAL_UB 0 CM_0000 0 255 /end CHARACTERISTIC
/begin CHARACTERISTIC UNK_RD_INJ_08B4D "Unidentified constant read directly by INJ 0x2bafc,0xd5c40 (chapter unknown) [unassigned]" VALUE 0x78B4D RL_VAL_UB 0 CM_0000 0 255 /end CHARACTERISTIC
/begin CHARACTERISTIC UNK_RD_INJ_08B4E "Unidentified constant read directly by INJ 0x130b88,0x130e1c (chapter unknown) [unassigned]" VALUE 0x78B4E RL_VAL_UB 0 CM_0000 0 255 /end CHARACTERISTIC
/begin CHARACTERISTIC UNK_RD_INJ_093CE "Unidentified constant read directly by INJ 0x136854 (Einspritzung) [unassigned]" VALUE 0x793CE RL_VAL_SW 0 CM_0000 -32768 32767 /end CHARACTERISTIC
/begin CHARACTERISTIC UNK_RD_INJ_0B086 "Unidentified constant read directly by INJ 0x13c750 (chapter unknown) [unassigned]" VALUE 0x7B086 RL_VAL_UW 0 CM_0000 0 65535 /end CHARACTERISTIC
/begin CHARACTERISTIC UNK_RD_INJ_0B088 "Unidentified constant read directly by INJ 0x13c750 (chapter unknown) [unassigned]" VALUE 0x7B088 RL_VAL_UW 0 CM_0000 0 65535 /end CHARACTERISTIC
/begin CHARACTERISTIC UNK_RD_INJ_0B08A "Unidentified constant read directly by INJ 0x13c750 (chapter unknown) [unassigned]" VALUE 0x7B08A RL_VAL_SW 0 CM_0000 -32768 32767 /end CHARACTERISTIC
/begin CHARACTERISTIC UNK_RD_INJ_0B08C "Unidentified constant read directly by INJ 0x13c750 (chapter unknown) [unassigned]" VALUE 0x7B08C RL_VAL_SW 0 CM_0000 -32768 32767 /end CHARACTERISTIC
/begin CHARACTERISTIC UNK_RD_INJ_0B63A "Unidentified constant read directly by INJ 0x62c74 (chapter unknown) [unassigned]" VALUE 0x7B63A RL_VAL_SW 0 CM_0000 -32768 32767 /end CHARACTERISTIC
/begin CHARACTERISTIC UNK_RD_INJ_0B67E "Unidentified constant read directly by INJ 0x64ff4 (chapter unknown) [unassigned]" VALUE 0x7B67E RL_VAL_UW 0 CM_0000 0 65535 /end CHARACTERISTIC
/begin CHARACTERISTIC UNK_RD_INJ_0B680 "Unidentified constant read directly by INJ 0x64130 (chapter unknown) [unassigned]" VALUE 0x7B680 RL_VAL_UW 0 CM_0000 0 65535 /end CHARACTERISTIC
/begin CHARACTERISTIC UNK_RD_INJ_0B682 "Unidentified constant read directly by INJ 0x64ee4,0x652b8 (chapter unknown) [unassigned]" VALUE 0x7B682 RL_VAL_UW 0 CM_0000 0 65535 /end CHARACTERISTIC
/begin CHARACTERISTIC UNK_RD_INJ_0B684 "Unidentified constant read directly by INJ 0x63e5c,0x64ee4,0x650ec (chapter unknown) [unassigned]" VALUE 0x7B684 RL_VAL_UW 0 CM_0000 0 65535 /end CHARACTERISTIC
/begin CHARACTERISTIC UNK_RD_INJ_0B68A "Unidentified constant read directly by INJ 0x652b8 (chapter unknown) [unassigned]" VALUE 0x7B68A RL_VAL_UB 0 CM_0000 0 255 /end CHARACTERISTIC
/begin CHARACTERISTIC UNK_RD_INJ_0B68C "Unidentified constant read directly by INJ 0x27a64 (chapter unknown) [unassigned]" VALUE 0x7B68C RL_VAL_UB 0 CM_0000 0 255 /end CHARACTERISTIC
/begin CHARACTERISTIC UNK_RD_INJ_0B68E "Unidentified constant read directly by INJ 0x27a64 (chapter unknown) [unassigned]" VALUE 0x7B68E RL_VAL_SW 0 CM_0000 -32768 32767 /end CHARACTERISTIC
/begin CHARACTERISTIC UNK_RD_INJ_0B690 "Unidentified constant read directly by INJ 0x27a64 (chapter unknown) [unassigned]" VALUE 0x7B690 RL_VAL_SW 0 CM_0000 -32768 32767 /end CHARACTERISTIC
/begin CHARACTERISTIC UNK_RD_INJ_0B692 "Unidentified constant read directly by INJ 0x54030 (Saugrohrdruck) [unassigned]" VALUE 0x7B692 RL_VAL_UW 0 CM_0000 0 65535 /end CHARACTERISTIC
/begin CHARACTERISTIC UNK_RD_INJ_0B694 "Unidentified constant read directly by INJ 0x54030 (Saugrohrdruck) [unassigned]" VALUE 0x7B694 RL_VAL_SW 0 CM_0000 -32768 32767 /end CHARACTERISTIC
/begin CHARACTERISTIC UNK_RD_INJ_0B696 "Unidentified constant read directly by INJ 0x54030 (Saugrohrdruck) [unassigned]" VALUE 0x7B696 RL_VAL_UB 0 CM_0000 0 255 /end CHARACTERISTIC
/begin CHARACTERISTIC UNK_RD_INJ_0B698 "Unidentified constant read directly by INJ 0x54030 (Saugrohrdruck) [unassigned]" VALUE 0x7B698 RL_VAL_UW 0 CM_0000 0 65535 /end CHARACTERISTIC
/begin CHARACTERISTIC UNK_RD_INJ_0B69A "Unidentified constant read directly by INJ 0x54030 (Saugrohrdruck) [unassigned]" VALUE 0x7B69A RL_VAL_SW 0 CM_0000 -32768 32767 /end CHARACTERISTIC
/begin CHARACTERISTIC UNK_RD_INJ_0B69C "Unidentified constant read directly by INJ 0x5424c (chapter unknown) [unassigned]" VALUE 0x7B69C RL_VAL_SW 0 CM_0000 -32768 32767 /end CHARACTERISTIC
/begin CHARACTERISTIC UNK_RD_INJ_0B69E "Unidentified constant read directly by INJ 0x5424c (chapter unknown) [unassigned]" VALUE 0x7B69E RL_VAL_SW 0 CM_0000 -32768 32767 /end CHARACTERISTIC
/begin CHARACTERISTIC UNK_RD_INJ_0B8E2 "Unidentified constant read directly by INJ 0x13f4b8 (chapter unknown) [unassigned]" VALUE 0x7B8E2 RL_VAL_SW 0 CM_0000 -32768 32767 /end CHARACTERISTIC
/begin CHARACTERISTIC UNK_RD_INJ_0B8E4 "Unidentified constant read directly by INJ 0x13f4b8 (chapter unknown) [unassigned]" VALUE 0x7B8E4 RL_VAL_SW 0 CM_0000 -32768 32767 /end CHARACTERISTIC
/begin CHARACTERISTIC UNK_RD_INJ_0B8E6 "Unidentified constant read directly by INJ 0x13f4b8 (chapter unknown) [unassigned]" VALUE 0x7B8E6 RL_VAL_SW 0 CM_0000 -32768 32767 /end CHARACTERISTIC
/begin CHARACTERISTIC UNK_RD_INJ_0B8E8 "Unidentified constant read directly by INJ 0x13f4b8 (chapter unknown) [unassigned]" VALUE 0x7B8E8 RL_VAL_SW 0 CM_0000 -32768 32767 /end CHARACTERISTIC
/begin CHARACTERISTIC UNK_RD_INJ_0FFF8 "Unidentified constant read directly by INJ 0x150e4,0x1583c,0x15bec (chapter unknown) [unassigned]" VALUE 0x7FFF8 RL_VAL_UL 0 CM_0000 0 4294967295 /end CHARACTERISTIC
/begin CHARACTERISTIC UNK_RD_INJ_0FFFC "Unidentified constant read directly by INJ 0x31ef8 (SK-Manager) [unassigned]" VALUE 0x7FFFC RL_VAL_UL 0 CM_0000 0 4294967295 /end CHARACTERISTIC
/begin CHARACTERISTIC UNK_TANKENTL_08BF0 "Unassigned constant read by INJ 5B2B8 [unassigned]" VALUE 0x78BF0 RL_VAL_UW 0 CM_0000 0 65535 /end CHARACTERISTIC
/begin CHARACTERISTIC UNK_TANKENTL_08C21 "Unassigned constant read by INJ 5BB0C [unassigned]" VALUE 0x78C21 RL_VAL_UB 0 CM_0000 0 255 /end CHARACTERISTIC
/begin CHARACTERISTIC UNK_TANKENTL_08C6A "Unassigned constant read by INJ 5B2B8 [unassigned]" VALUE 0x78C6A RL_VAL_UB 0 CM_0000 0 255 /end CHARACTERISTIC
/begin CHARACTERISTIC UNK_TANKENTL_08C6E "Unassigned constant read by INJ 5B2B8 5BB0C [unassigned]" VALUE 0x78C6E RL_VAL_UW 0 CM_0000 0 65535 /end CHARACTERISTIC
/begin CHARACTERISTIC UNK_TANKENTL_08C74 "Unassigned constant read by INJ 1329BC [unassigned]" VALUE 0x78C74 RL_VAL_UW 0 CM_0000 0 65535 /end CHARACTERISTIC
/begin CHARACTERISTIC UNK_IPMNA_028EE "Unassigned constant read by INJ 371D8 37C30 F79E0 F8034 [unassigned]" VALUE 0x728EE RL_VAL_UB 0 CM_0000 0 255 /end CHARACTERISTIC
/begin CHARACTERISTIC UNK_IPMNA_028EF "Unassigned constant read by INJ F79E0 F8034 [unassigned]" VALUE 0x728EF RL_VAL_UB 0 CM_0000 0 255 /end CHARACTERISTIC
/begin CHARACTERISTIC UNK_IPMNA_028F0 "Unassigned constant read by INJ F79E0 [unassigned]" VALUE 0x728F0 RL_VAL_SW 0 CM_0000 -32768 32767 /end CHARACTERISTIC
/begin CHARACTERISTIC UNK_IPMNA_03CA8 "Unassigned constant read by INJ 37C30 [unassigned]" VALUE 0x73CA8 RL_VAL_SW 0 CM_0000 -32768 32767 /end CHARACTERISTIC
/begin CHARACTERISTIC UNK_IPMNA_03CAA "Unassigned constant read by INJ 37C30 [unassigned]" VALUE 0x73CAA RL_VAL_SW 0 CM_0002 -32768 32767 /end CHARACTERISTIC
/begin CHARACTERISTIC UNK_IPMNA_03CAC "Unassigned constant read by INJ 37C30 [unassigned]" VALUE 0x73CAC RL_VAL_UW 0 CM_0000 0 65535 /end CHARACTERISTIC
/begin CHARACTERISTIC UNK_IPMNA_03CAE "Unassigned constant read by INJ 37C30 [unassigned]" VALUE 0x73CAE RL_VAL_UB 0 CM_0000 0 255 /end CHARACTERISTIC
/begin CHARACTERISTIC UNK_IPMNA_03CAF "Unassigned constant read by INJ 37C30 [unassigned]" VALUE 0x73CAF RL_VAL_UB 0 CM_0000 0 255 /end CHARACTERISTIC
/begin CHARACTERISTIC UNK_IPMNA_03CB0 "Unassigned constant read by INJ 37C30 [unassigned]" VALUE 0x73CB0 RL_VAL_UB 0 CM_0000 0 255 /end CHARACTERISTIC
/begin CHARACTERISTIC UNK_IPMNA_03CB2 "Unassigned constant read by INJ 37C30 [unassigned]" VALUE 0x73CB2 RL_VAL_UB 0 CM_0000 0 255 /end CHARACTERISTIC
/begin CHARACTERISTIC UNK_IPMNA_03CB4 "Unassigned constant read by INJ 37C30 [unassigned]" VALUE 0x73CB4 RL_VAL_UB 0 CM_0000 0 255 /end CHARACTERISTIC
/begin CHARACTERISTIC UNK_IPMNA_03CB5 "Unassigned constant read by INJ 37C30 [unassigned]" VALUE 0x73CB5 RL_VAL_UB 0 CM_0000 0 255 /end CHARACTERISTIC
/begin CHARACTERISTIC UNK_IPMNA_03CBB "Unassigned constant read by INJ 37C30 [unassigned]" VALUE 0x73CBB RL_VAL_UB 0 CM_0000 0 255 /end CHARACTERISTIC
/begin CHARACTERISTIC UNK_POWERMAN_0745C "Unassigned constant read by INJ 119718 [unassigned]" VALUE 0x7745C RL_VAL_UB 0 CM_0000 0 255 /end CHARACTERISTIC
/begin CHARACTERISTIC UNK_POWERMAN_07460 "Unassigned constant read by INJ 119718 [unassigned]" VALUE 0x77460 RL_VAL_UB 0 CM_0000 0 255 /end CHARACTERISTIC
/begin CHARACTERISTIC UNK_POWERMAN_07469 "Unassigned constant read by INJ 119718 [unassigned]" VALUE 0x77469 RL_VAL_UB 0 CM_0000 0 255 /end CHARACTERISTIC
/begin CHARACTERISTIC UNK_POWERMAN_0746E "Unassigned constant read by INJ 119718 [unassigned]" VALUE 0x7746E RL_VAL_UB 0 CM_0000 0 255 /end CHARACTERISTIC
/begin CHARACTERISTIC UNK_POWERMAN_07472 "Unassigned constant read by INJ 119718 [unassigned]" VALUE 0x77472 RL_VAL_UB 0 CM_0000 0 255 /end CHARACTERISTIC
/begin CHARACTERISTIC UNK_POWERMAN_07474 "Unassigned constant read by INJ 11BF58 [unassigned]" VALUE 0x77474 RL_VAL_UB 0 CM_0000 0 255 /end CHARACTERISTIC
/begin CHARACTERISTIC UNK_POWERMAN_07475 "Unassigned constant read by INJ 11BF58 [unassigned]" VALUE 0x77475 RL_VAL_UB 0 CM_0000 0 255 /end CHARACTERISTIC
/begin CHARACTERISTIC UNK_POWERMAN_07477 "Unassigned constant read by INJ 119718 [unassigned]" VALUE 0x77477 RL_VAL_UB 0 CM_0000 0 255 /end CHARACTERISTIC
/begin CHARACTERISTIC UNK_POWERMAN_07478 "Unassigned constant read by INJ 119718 [unassigned]" VALUE 0x77478 RL_VAL_UB 0 CM_0000 0 255 /end CHARACTERISTIC
/begin CHARACTERISTIC UNK_POWERMAN_0753A "Unassigned constant read by INJ 119718 [unassigned]" VALUE 0x7753A RL_VAL_UW 0 CM_0000 0 65535 /end CHARACTERISTIC
/begin CHARACTERISTIC UNK_POWERMAN_0753C "Unassigned constant read by INJ 119718 [unassigned]" VALUE 0x7753C RL_VAL_UB 0 CM_0000 0 255 /end CHARACTERISTIC
/begin CHARACTERISTIC UNK_POWERMAN_0753E "Unassigned constant read by INJ 11C1E8 [unassigned]" VALUE 0x7753E RL_VAL_UW 0 CM_0000 0 65535 /end CHARACTERISTIC
/begin CHARACTERISTIC UNK_POWERMAN_07784 "Unassigned constant read by INJ 120FFC 1212C0 [unassigned]" VALUE 0x77784 RL_VAL_UW 0 CM_0000 0 65535 /end CHARACTERISTIC
/begin CHARACTERISTIC UNK_POWERMAN_0778B "Unassigned constant read by INJ 120FFC [unassigned]" VALUE 0x7778B RL_VAL_UB 0 CM_0000 0 255 /end CHARACTERISTIC
/begin CHARACTERISTIC UNK_POWERMAN_0795E "Unassigned constant read by INJ 1212C0 [unassigned]" VALUE 0x7795E RL_VAL_SW 0 CM_0000 -32768 32767 /end CHARACTERISTIC
/begin CHARACTERISTIC UNK_POWERMAN_07960 "Unassigned constant read by INJ 1212C0 [unassigned]" VALUE 0x77960 RL_VAL_SW 0 CM_0000 -32768 32767 /end CHARACTERISTIC
/begin CHARACTERISTIC UNK_POWERMAN_07962 "Unassigned constant read by INJ 1212C0 [unassigned]" VALUE 0x77962 RL_VAL_UB 0 CM_0000 0 255 /end CHARACTERISTIC
/begin CHARACTERISTIC UNK_POWERMAN_07977 "Unassigned constant read by INJ 121D9C [unassigned]" VALUE 0x77977 RL_VAL_UB 0 CM_0000 0 255 /end CHARACTERISTIC
/begin CHARACTERISTIC UNK_POWERMAN_07978 "Unassigned constant read by INJ 121D9C [unassigned]" VALUE 0x77978 RL_VAL_UB 0 CM_0000 0 255 /end CHARACTERISTIC
/begin CHARACTERISTIC UNK_POWERMAN_079CE "Unassigned constant read by INJ 121D9C [unassigned]" VALUE 0x779CE RL_VAL_UB 0 CM_0000 0 255 /end CHARACTERISTIC
/begin CHARACTERISTIC UNK_POWERMAN_079D0 "Unassigned constant read by INJ 51684 [unassigned]" VALUE 0x779D0 RL_VAL_UB 0 CM_0000 0 255 /end CHARACTERISTIC
/begin CHARACTERISTIC UNK_POWERMAN_079D1 "Unassigned constant read by INJ 107D10 [unassigned]" VALUE 0x779D1 RL_VAL_UB 0 CM_0000 0 255 /end CHARACTERISTIC
/begin CHARACTERISTIC UNK_POWERMAN_07ED0 "Unassigned constant read by INJ 127200 [unassigned]" VALUE 0x77ED0 RL_VAL_SW 0 CM_0000 -32768 32767 /end CHARACTERISTIC
/begin CHARACTERISTIC UNK_POWERMAN_07ED2 "Unassigned constant read by INJ 126324 [unassigned]" VALUE 0x77ED2 RL_VAL_SW 0 CM_0000 -32768 32767 /end CHARACTERISTIC
/begin CHARACTERISTIC UNK_POWERMAN_07EDA "Unassigned constant read by INJ 127200 [unassigned]" VALUE 0x77EDA RL_VAL_UW 0 CM_0000 0 65535 /end CHARACTERISTIC
/begin CHARACTERISTIC UNK_POWERMAN_07EDC "Unassigned constant read by INJ 127200 [unassigned]" VALUE 0x77EDC RL_VAL_UW 0 CM_0000 0 65535 /end CHARACTERISTIC
/begin CHARACTERISTIC UNK_POWERMAN_07EDE "Unassigned constant read by INJ 127200 [unassigned]" VALUE 0x77EDE RL_VAL_UW 0 CM_0000 0 65535 /end CHARACTERISTIC
/begin CHARACTERISTIC UNK_POWERMAN_07EE0 "Unassigned constant read by INJ 127200 [unassigned]" VALUE 0x77EE0 RL_VAL_UW 0 CM_0000 0 65535 /end CHARACTERISTIC
/begin CHARACTERISTIC UNK_POWERMAN_07EE2 "Unassigned constant read by INJ 126324 [unassigned]" VALUE 0x77EE2 RL_VAL_UW 0 CM_0000 0 65535 /end CHARACTERISTIC
/begin CHARACTERISTIC UNK_POWERMAN_07EE4 "Unassigned constant read by INJ 126324 [unassigned]" VALUE 0x77EE4 RL_VAL_UW 0 CM_0000 0 65535 /end CHARACTERISTIC
/begin CHARACTERISTIC UNK_POWERMAN_07EE6 "Unassigned constant read by INJ 127200 [unassigned]" VALUE 0x77EE6 RL_VAL_UB 0 CM_0000 0 255 /end CHARACTERISTIC
/begin CHARACTERISTIC UNK_POWERMAN_07EE7 "Unassigned constant read by INJ 126324 127200 [unassigned]" VALUE 0x77EE7 RL_VAL_UB 0 CM_0000 0 255 /end CHARACTERISTIC
/begin CHARACTERISTIC UNK_POWERMAN_07EE8 "Unassigned constant read by INJ 127200 [unassigned]" VALUE 0x77EE8 RL_VAL_SW 0 CM_0000 -32768 32767 /end CHARACTERISTIC
/begin CHARACTERISTIC UNK_POWERMAN_07EEA "Unassigned constant read by INJ 127200 [unassigned]" VALUE 0x77EEA RL_VAL_SW 0 CM_0000 -32768 32767 /end CHARACTERISTIC
/begin CHARACTERISTIC UNK_POWERMAN_07EEC "Unassigned constant read by INJ 127200 [unassigned]" VALUE 0x77EEC RL_VAL_SW 0 CM_0000 -32768 32767 /end CHARACTERISTIC
/begin CHARACTERISTIC UNK_POWERMAN_07EEE "Unassigned constant read by INJ 127200 [unassigned]" VALUE 0x77EEE RL_VAL_SW 0 CM_0000 -32768 32767 /end CHARACTERISTIC
/begin CHARACTERISTIC UNK_POWERMAN_07EF0 "Unassigned constant read by INJ 127200 [unassigned]" VALUE 0x77EF0 RL_VAL_SW 0 CM_0000 -32768 32767 /end CHARACTERISTIC
/begin CHARACTERISTIC UNK_POWERMAN_07EF2 "Unassigned constant read by INJ 127200 [unassigned]" VALUE 0x77EF2 RL_VAL_SW 0 CM_0000 -32768 32767 /end CHARACTERISTIC
/begin CHARACTERISTIC UNK_POWERMAN_07EF4 "Unassigned constant read by INJ 127200 [unassigned]" VALUE 0x77EF4 RL_VAL_SW 0 CM_0000 -32768 32767 /end CHARACTERISTIC
/begin CHARACTERISTIC UNK_POWERMAN_07EF6 "Unassigned constant read by INJ 127200 [unassigned]" VALUE 0x77EF6 RL_VAL_SW 0 CM_0000 -32768 32767 /end CHARACTERISTIC
/begin CHARACTERISTIC UNK_POWERMAN_07EF8 "Unassigned constant read by INJ 127200 [unassigned]" VALUE 0x77EF8 RL_VAL_UW 0 CM_0000 0 65535 /end CHARACTERISTIC
/begin CHARACTERISTIC UNK_POWERMAN_07EFA "Unassigned constant read by INJ 127200 [unassigned]" VALUE 0x77EFA RL_VAL_UW 0 CM_0000 0 65535 /end CHARACTERISTIC
/begin CHARACTERISTIC UNK_POWERMAN_07EFC "Unassigned constant read by INJ 127200 [unassigned]" VALUE 0x77EFC RL_VAL_UW 0 CM_0000 0 65535 /end CHARACTERISTIC
/begin CHARACTERISTIC UNK_POWERMAN_07EFE "Unassigned constant read by INJ 126324 [unassigned]" VALUE 0x77EFE RL_VAL_UW 0 CM_0000 0 65535 /end CHARACTERISTIC
/begin CHARACTERISTIC UNK_POWERMAN_07F00 "Unassigned constant read by INJ 127200 [unassigned]" VALUE 0x77F00 RL_VAL_UB 0 CM_0000 0 255 /end CHARACTERISTIC
/begin CHARACTERISTIC UNK_KATALYSA_062A2 "Unassigned constant read by INJ 10FCAC 110144 4C108 [unassigned]" VALUE 0x762A2 RL_VAL_UW 0 CM_0000 0 65535 /end CHARACTERISTIC
/begin CHARACTERISTIC UNK_KATALYSA_062A6 "Unassigned constant read by INJ 4C108 [unassigned]" VALUE 0x762A6 RL_VAL_UW 0 CM_0000 0 65535 /end CHARACTERISTIC
/begin CHARACTERISTIC UNK_KATALYSA_062A8 "Unassigned constant read by INJ 4CBFC [unassigned]" VALUE 0x762A8 RL_VAL_UW 0 CM_0000 0 65535 /end CHARACTERISTIC
/begin CHARACTERISTIC UNK_NKATHEI_0577A "Unassigned constant read by INJ 10371C 43E9C [unassigned]" VALUE 0x7577A RL_VAL_SW 0 CM_0002 -32768 32767 /end CHARACTERISTIC
/begin CHARACTERISTIC UNK_NKATHEI_057A6 "Unassigned constant read by INJ 43E9C DB340 [unassigned]" VALUE 0x757A6 RL_VAL_UW 0 CM_0000 0 65535 /end CHARACTERISTIC
/begin CHARACTERISTIC UNK_NKATHEI_057A8 "Unassigned constant read by INJ 43E9C [unassigned]" VALUE 0x757A8 RL_VAL_SW 0 CM_0000 -32768 32767 /end CHARACTERISTIC
/begin CHARACTERISTIC UNK_NKATHEI_057B0 "Unassigned constant read by INJ DB340 [unassigned]" VALUE 0x757B0 RL_VAL_UW 0 CM_0000 0 65535 /end CHARACTERISTIC
/begin CHARACTERISTIC UNK_NKATHEI_057B2 "Unassigned constant read by INJ 34C58 DB340 [unassigned]" VALUE 0x757B2 RL_VAL_UW 0 CM_0000 0 65535 /end CHARACTERISTIC
/begin CHARACTERISTIC UNK_NKATHEI_057B4 "Unassigned constant read by INJ DB340 [unassigned]" VALUE 0x757B4 RL_VAL_UW 0 CM_0000 0 65535 /end CHARACTERISTIC
/begin CHARACTERISTIC UNK_NKATHEI_05C38 "Unassigned constant read by INJ DB340 [unassigned]" VALUE 0x75C38 RL_VAL_SW 0 CM_0000 -32768 32767 /end CHARACTERISTIC
/begin CHARACTERISTIC UNK_NKATHEI_05C3A "Unassigned constant read by INJ DB340 [unassigned]" VALUE 0x75C3A RL_VAL_SW 0 CM_0000 -32768 32767 /end CHARACTERISTIC
/begin CHARACTERISTIC UNK_NKATHEI_05C3C "Unassigned constant read by INJ DB340 [unassigned]" VALUE 0x75C3C RL_VAL_SW 0 CM_0000 -32768 32767 /end CHARACTERISTIC
/begin CHARACTERISTIC UNK_NKATHEI_088DE "Unassigned constant read by INJ 12DE64 [unassigned]" VALUE 0x788DE RL_VAL_SW 0 CM_0000 -32768 32767 /end CHARACTERISTIC
/begin CHARACTERISTIC UNK_ANSAUGLU_025B0 "Unassigned constant read by INJ F5628 [unassigned]" VALUE 0x725B0 RL_VAL_SW 0 CM_0000 -32768 32767 /end CHARACTERISTIC
/begin CHARACTERISTIC UNK_ANSAUGLU_025B6 "Unassigned constant read by INJ F5628 [unassigned]" VALUE 0x725B6 RL_VAL_UW 0 CM_0000 0 65535 /end CHARACTERISTIC
/begin CHARACTERISTIC UNK_ANSAUGLU_025D2 "Unassigned constant read by INJ F5628 [unassigned]" VALUE 0x725D2 RL_VAL_UB 0 CM_0000 0 255 /end CHARACTERISTIC
/begin CHARACTERISTIC UNK_ANSAUGLU_02930 "Unassigned constant read by INJ 36524 371D8 [unassigned]" VALUE 0x72930 RL_VAL_SW 0 CM_0000 -32768 32767 /end CHARACTERISTIC
/begin CHARACTERISTIC UNK_ANSAUGLU_03BD0 "Unassigned constant read by INJ 371D8 [unassigned]" VALUE 0x73BD0 RL_VAL_SW 0 CM_0000 -32768 32767 /end CHARACTERISTIC
/begin CHARACTERISTIC UNK_ANSAUGLU_03BD2 "Unassigned constant read by INJ 371D8 [unassigned]" VALUE 0x73BD2 RL_VAL_SW 0 CM_0000 -32768 32767 /end CHARACTERISTIC
/begin CHARACTERISTIC UNK_ANSAUGLU_03BD4 "Unassigned constant read by INJ 371D8 [unassigned]" VALUE 0x73BD4 RL_VAL_SW 0 CM_0000 -32768 32767 /end CHARACTERISTIC
/begin CHARACTERISTIC UNK_ANSAUGLU_03BD6 "Unassigned constant read by INJ 371D8 [unassigned]" VALUE 0x73BD6 RL_VAL_SW 0 CM_0002 -32768 32767 /end CHARACTERISTIC
/begin CHARACTERISTIC UNK_ANSAUGLU_03BD8 "Unassigned constant read by INJ 371D8 [unassigned]" VALUE 0x73BD8 RL_VAL_UW 0 CM_0000 0 65535 /end CHARACTERISTIC
/begin CHARACTERISTIC UNK_ANSAUGLU_03BDA "Unassigned constant read by INJ 371D8 [unassigned]" VALUE 0x73BDA RL_VAL_UW 0 CM_0000 0 65535 /end CHARACTERISTIC
/begin CHARACTERISTIC UNK_ANSAUGLU_03BDC "Unassigned constant read by INJ 371D8 [unassigned]" VALUE 0x73BDC RL_VAL_UW 0 CM_0000 0 65535 /end CHARACTERISTIC
/begin CHARACTERISTIC UNK_ANSAUGLU_03BDE "Unassigned constant read by INJ 371D8 [unassigned]" VALUE 0x73BDE RL_VAL_UB 0 CM_0000 0 255 /end CHARACTERISTIC
/begin CHARACTERISTIC UNK_ANSAUGLU_03BDF "Unassigned constant read by INJ 371D8 [unassigned]" VALUE 0x73BDF RL_VAL_UB 0 CM_0000 0 255 /end CHARACTERISTIC
/begin CHARACTERISTIC UNK_ANSAUGLU_03C42 "Unassigned constant read by INJ 377B0 38054 [unassigned]" VALUE 0x73C42 RL_VAL_UB 0 CM_0000 0 255 /end CHARACTERISTIC
/begin CHARACTERISTIC UNK_ANSAUGLU_03C44 "Unassigned constant read by INJ 37928 [unassigned]" VALUE 0x73C44 RL_VAL_UW 0 CM_0000 0 65535 /end CHARACTERISTIC
/begin CHARACTERISTIC UNK_ANSAUGLU_08844 "Unassigned constant read by INJ 12D53C [unassigned]" VALUE 0x78844 RL_VAL_SW 0 CM_0000 -32768 32767 /end CHARACTERISTIC
/begin CHARACTERISTIC UNK_ANSAUGLU_08846 "Unassigned constant read by INJ 12D53C [unassigned]" VALUE 0x78846 RL_VAL_SW 0 CM_0000 -32768 32767 /end CHARACTERISTIC
/begin CHARACTERISTIC UNK_ANSAUGLU_08918 "Unassigned constant read by INJ 12D53C 12DE64 59630 [unassigned]" VALUE 0x78918 RL_VAL_UW 0 CM_0000 0 65535 /end CHARACTERISTIC
/begin CHARACTERISTIC UNK_ANSAUGLU_0891A "Unassigned constant read by INJ 12DE64 [unassigned]" VALUE 0x7891A RL_VAL_UW 0 CM_0000 0 65535 /end CHARACTERISTIC
/begin CHARACTERISTIC UNK_QUALITT_008D4 "Unassigned constant read by INJ DFC54 E12F4 [unassigned]" VALUE 0x708D4 RL_VAL_UB 0 CM_0000 0 255 /end CHARACTERISTIC
/begin CHARACTERISTIC UNK_QUALITT_00A3E "Unassigned constant read by INJ EAF4C [unassigned]" VALUE 0x70A3E RL_VAL_UW 0 CM_0000 0 65535 /end CHARACTERISTIC
/begin CHARACTERISTIC UNK_QUALITT_00A40 "Unassigned constant read by INJ EA7A0 [unassigned]" VALUE 0x70A40 RL_VAL_UB 0 CM_0000 0 255 /end CHARACTERISTIC
/begin CHARACTERISTIC UNK_QUALITT_00A44 "Unassigned constant read by INJ EA7A0 [unassigned]" VALUE 0x70A44 RL_VAL_UB 0 CM_0000 0 255 /end CHARACTERISTIC
/begin CHARACTERISTIC UNK_QUALITT_00A45 "Unassigned constant read by INJ EA7A0 [unassigned]" VALUE 0x70A45 RL_VAL_UB 0 CM_0000 0 255 /end CHARACTERISTIC
/begin CHARACTERISTIC UNK_QUALITT_00A4B "Unassigned constant read by INJ 34188 [unassigned]" VALUE 0x70A4B RL_VAL_UB 0 CM_0000 0 255 /end CHARACTERISTIC
/begin CHARACTERISTIC UNK_QUALITT_00A4C "Unassigned constant read by INJ 34188 [unassigned]" VALUE 0x70A4C RL_VAL_UB 0 CM_0000 0 255 /end CHARACTERISTIC
/begin CHARACTERISTIC UNK_QUALITT_00A4D "Unassigned constant read by INJ 34188 [unassigned]" VALUE 0x70A4D RL_VAL_UB 0 CM_0000 0 255 /end CHARACTERISTIC
/begin CHARACTERISTIC UNK_QUALITT_067E2 "Unassigned constant read by INJ 1113B4 111830 [unassigned]" VALUE 0x767E2 RL_VAL_UW 0 CM_0000 0 65535 /end CHARACTERISTIC
/begin CHARACTERISTIC UNK_QUALITT_067E4 "Unassigned constant read by INJ 111830 [unassigned]" VALUE 0x767E4 RL_VAL_UW 0 CM_0000 0 65535 /end CHARACTERISTIC
/begin CHARACTERISTIC UNK_QUALITT_06806 "Unassigned constant read by INJ 1128B0 [unassigned]" VALUE 0x76806 RL_VAL_UB 0 CM_0000 0 255 /end CHARACTERISTIC
/begin CHARACTERISTIC UNK_QUALITT_068F2 "Unassigned constant read by INJ 112CA0 [unassigned]" VALUE 0x768F2 RL_VAL_UB 0 CM_0000 0 255 /end CHARACTERISTIC
/begin CHARACTERISTIC UNK_QUALITT_068F3 "Unassigned constant read by INJ 112CA0 [unassigned]" VALUE 0x768F3 RL_VAL_UB 0 CM_0000 0 255 /end CHARACTERISTIC
/begin CHARACTERISTIC UNK_SCHALTER_084AE "Unassigned constant read by INJ 129AEC 565B4 [unassigned]" VALUE 0x784AE RL_VAL_UW 0 CM_0000 0 65535 /end CHARACTERISTIC
/begin CHARACTERISTIC UNK_SCHALTER_08B3E "Unassigned constant read by INJ 13651C 49D58 4A13C 5E670 [unassigned]" VALUE 0x78B3E RL_VAL_UW 0 CM_0000 0 65535 /end CHARACTERISTIC
/begin CHARACTERISTIC UNK_SCHALTER_08B40 "Unassigned constant read by INJ 10C84C 12F544 2CB0C 2FC80 [unassigned]" VALUE 0x78B40 RL_VAL_UB 0 CM_0000 0 255 /end CHARACTERISTIC
/begin CHARACTERISTIC UNK_SCHALTER_08B41 "Unassigned constant read by INJ 1113B4 11144C 129AEC [unassigned]" VALUE 0x78B41 RL_VAL_UB 0 CM_0000 0 255 /end CHARACTERISTIC
/begin CHARACTERISTIC UNK_SCHALTER_08B42 "Unassigned constant read by INJ 35658 470A0 59630 D8AA4 [unassigned]" VALUE 0x78B42 RL_VAL_UB 0 CM_0000 0 255 /end CHARACTERISTIC
/begin CHARACTERISTIC UNK_FAHRZEUG_0B066 "Unassigned constant read by INJ 13C8E0 [unassigned]" VALUE 0x7B066 RL_VAL_UW 0 CM_0000 0 65535 /end CHARACTERISTIC
/begin CHARACTERISTIC UNK_FAHRZEUG_0B068 "Unassigned constant read by INJ 13C8E0 [unassigned]" VALUE 0x7B068 RL_VAL_SW 0 CM_0002 -32768 32767 /end CHARACTERISTIC
/begin CHARACTERISTIC UNK_FAHRZEUG_0B06A "Unassigned constant read by INJ 13C8E0 [unassigned]" VALUE 0x7B06A RL_VAL_SW 0 CM_0000 -32768 32767 /end CHARACTERISTIC
/begin CHARACTERISTIC UNK_FAHRZEUG_0B06C "Unassigned constant read by INJ 13C8E0 [unassigned]" VALUE 0x7B06C RL_VAL_UW 0 CM_0000 0 65535 /end CHARACTERISTIC
/begin CHARACTERISTIC UNK_FAHRZEUG_0B06E "Unassigned constant read by INJ 13C8E0 [unassigned]" VALUE 0x7B06E RL_VAL_SW 0 CM_0000 -32768 32767 /end CHARACTERISTIC
/begin CHARACTERISTIC UNK_FAHRZEUG_0B070 "Unassigned constant read by INJ 13C8E0 [unassigned]" VALUE 0x7B070 RL_VAL_UW 0 CM_0000 0 65535 /end CHARACTERISTIC
/begin CHARACTERISTIC UNK_FAHRZEUG_0B072 "Unassigned constant read by INJ 13C8E0 [unassigned]" VALUE 0x7B072 RL_VAL_SW 0 CM_0000 -32768 32767 /end CHARACTERISTIC
/begin CHARACTERISTIC UNK_FAHRZEUG_0B074 "Unassigned constant read by INJ 13C8E0 [unassigned]" VALUE 0x7B074 RL_VAL_UW 0 CM_0000 0 65535 /end CHARACTERISTIC
/begin CHARACTERISTIC UNK_FAHRZEUG_0B076 "Unassigned constant read by INJ 13C8E0 [unassigned]" VALUE 0x7B076 RL_VAL_SW 0 CM_0002 -32768 32767 /end CHARACTERISTIC
/begin CHARACTERISTIC UNK_FAHRZEUG_0B078 "Unassigned constant read by INJ 13C8E0 [unassigned]" VALUE 0x7B078 RL_VAL_SW 0 CM_0000 -32768 32767 /end CHARACTERISTIC
/begin CHARACTERISTIC UNK_FAHRZEUG_0B07A "Unassigned constant read by INJ 13C8E0 [unassigned]" VALUE 0x7B07A RL_VAL_SW 0 CM_0000 -32768 32767 /end CHARACTERISTIC
/begin CHARACTERISTIC UNK_FAHRZEUG_0B07C "Unassigned constant read by INJ 61BB8 [unassigned]" VALUE 0x7B07C RL_VAL_UB 0 CM_0000 0 255 /end CHARACTERISTIC
/begin CHARACTERISTIC UNK_LADUNGSW_0A2B6 "Unassigned constant read by INJ 136F20 [unassigned]" VALUE 0x7A2B6 RL_VAL_UW 0 CM_0000 0 65535 /end CHARACTERISTIC
/begin CHARACTERISTIC UNK_LADUNGSW_0A2B8 "Unassigned constant read by INJ 136F20 [unassigned]" VALUE 0x7A2B8 RL_VAL_UW 0 CM_0000 0 65535 /end CHARACTERISTIC
/begin CHARACTERISTIC UNK_LTEMPER_08B51 "Unassigned constant read by INJ 131F9C [unassigned]" VALUE 0x78B51 RL_VAL_UB 0 CM_0000 0 255 /end CHARACTERISTIC
/begin CHARACTERISTIC UNK_BEGRENZU_0B686 "Unassigned constant read by INJ 65160 65220 652B8 [unassigned]" VALUE 0x7B686 RL_VAL_UW 0 CM_0000 0 65535 /end CHARACTERISTIC
/begin CHARACTERISTIC UNK_ELEKTROL_0218C "Unassigned constant read by INJ 3480C 34C58 ECBD0 [unassigned]" VALUE 0x7218C RL_VAL_SW 0 CM_0256 -3550 3003.5 /end CHARACTERISTIC
/begin CHARACTERISTIC UNK_ELEKTROL_0218E "Unassigned constant read by INJ 3480C 34C58 ECBD0 [unassigned]" VALUE 0x7218E RL_VAL_SW 0 CM_0256 -3550 3003.5 /end CHARACTERISTIC
/begin CHARACTERISTIC UNK_ELEKTROL_05782 "Unassigned constant read by INJ 10371C 34C58 DB340 [unassigned]" VALUE 0x75782 RL_VAL_UW 0 CM_0000 0 65535 /end CHARACTERISTIC
/begin CHARACTERISTIC UNK_ELEKTROL_05786 "Unassigned constant read by INJ 10371C [unassigned]" VALUE 0x75786 RL_VAL_UW 0 CM_0000 0 65535 /end CHARACTERISTIC
/begin CHARACTERISTIC UNK_ELEKTROL_05788 "Unassigned constant read by INJ 10371C 34C58 DB340 [unassigned]" VALUE 0x75788 RL_VAL_UW 0 CM_0000 0 65535 /end CHARACTERISTIC
/begin CHARACTERISTIC UNK_ELEKTROL_05B44 "Unassigned constant read by INJ 10A064 D3C04 [unassigned]" VALUE 0x75B44 RL_VAL_SW 0 CM_0000 -32768 32767 /end CHARACTERISTIC
/begin CHARACTERISTIC UNK_ELEKTROL_05B46 "Unassigned constant read by INJ 10A064 [unassigned]" VALUE 0x75B46 RL_VAL_SW 0 CM_0000 -32768 32767 /end CHARACTERISTIC
/begin CHARACTERISTIC UNK_ELEKTROL_05B48 "Unassigned constant read by INJ 10A064 [unassigned]" VALUE 0x75B48 RL_VAL_SW 0 CM_0000 -32768 32767 /end CHARACTERISTIC
/begin CHARACTERISTIC UNK_ELEKTROL_05B4A "Unassigned constant read by INJ 10A064 [unassigned]" VALUE 0x75B4A RL_VAL_UB 0 CM_0000 0 255 /end CHARACTERISTIC
/begin CHARACTERISTIC UNK_ELEKTROL_05B4B "Unassigned constant read by INJ 10A064 [unassigned]" VALUE 0x75B4B RL_VAL_UB 0 CM_0000 0 255 /end CHARACTERISTIC
/begin CHARACTERISTIC UNK_ELEKTROL_05B60 "Unassigned constant read by INJ 34C58 [unassigned]" VALUE 0x75B60 RL_VAL_UW 0 CM_0000 0 65535 /end CHARACTERISTIC
/begin CHARACTERISTIC UNK_ELEKTROL_05C42 "Unassigned constant read by INJ 10B19C [unassigned]" VALUE 0x75C42 RL_VAL_UW 0 CM_0000 0 65535 /end CHARACTERISTIC
/begin CHARACTERISTIC UNK_ELEKTROL_05C48 "Unassigned constant read by INJ 10B19C [unassigned]" VALUE 0x75C48 RL_VAL_UW 0 CM_0000 0 65535 /end CHARACTERISTIC
/begin CHARACTERISTIC UNK_ELEKTROL_05C73 "Unassigned constant read by INJ 10B19C [unassigned]" VALUE 0x75C73 RL_VAL_UB 0 CM_0233 0 4.25 /end CHARACTERISTIC
/begin CHARACTERISTIC UNK_ELEKTROL_05CB8 "Unassigned constant read by INJ 10B19C [unassigned]" VALUE 0x75CB8 RL_VAL_SW 0 CM_0000 -32768 32767 /end CHARACTERISTIC
/begin CHARACTERISTIC UNK_ELEKTROL_05CBA "Unassigned constant read by INJ 10B19C [unassigned]" VALUE 0x75CBA RL_VAL_SW 0 CM_0000 -32768 32767 /end CHARACTERISTIC
/begin CHARACTERISTIC UNK_GENERATO_06C1E "Unassigned constant read by INJ 11541C [unassigned]" VALUE 0x76C1E RL_VAL_UW 0 CM_0000 0 65535 /end CHARACTERISTIC
/begin CHARACTERISTIC UNK_GENERATO_06C22 "Unassigned constant read by INJ 11541C [unassigned]" VALUE 0x76C22 RL_VAL_UW 0 CM_0191 0 6173.397 /end CHARACTERISTIC
/begin CHARACTERISTIC UNK_GENERATO_06C26 "Unassigned constant read by INJ 11541C [unassigned]" VALUE 0x76C26 RL_VAL_UW 0 CM_0000 0 65535 /end CHARACTERISTIC
/begin CHARACTERISTIC UNK_MVAC_05F24 "Unassigned constant read by INJ 488F8 [unassigned]" VALUE 0x75F24 RL_VAL_UW 0 CM_0000 0 65535 /end CHARACTERISTIC
/begin CHARACTERISTIC UNK_LAMBDAS_04CC6 "Unassigned constant read by INJ 10FCAC 110144 4C108 [unassigned]" VALUE 0x74CC6 RL_VAL_SW 0 CM_0000 -32768 32767 /end CHARACTERISTIC
/begin CHARACTERISTIC UNK_LAMBDAS_0576C "Unassigned constant read by INJ 41680 [unassigned]" VALUE 0x7576C RL_VAL_UW 0 CM_0000 0 65535 /end CHARACTERISTIC
/begin CHARACTERISTIC UNK_KATALYSA_0627E "Unassigned constant read by INJ 4B5DC [unassigned]" VALUE 0x7627E RL_VAL_UW 0 CM_0000 0 65535 /end CHARACTERISTIC
/begin CHARACTERISTIC UNK_KATALYSA_07288 "Unassigned constant read by INJ 117D70 [unassigned]" VALUE 0x77288 RL_VAL_SW 0 CM_0000 -32768 32767 /end CHARACTERISTIC
/begin CHARACTERISTIC UNK_KATALYSA_0728A "Unassigned constant read by INJ 117D70 [unassigned]" VALUE 0x7728A RL_VAL_SW 0 CM_0000 -32768 32767 /end CHARACTERISTIC
/begin CHARACTERISTIC UNK_KATALYSA_0728C "Unassigned constant read by INJ 117D70 [unassigned]" VALUE 0x7728C RL_VAL_SW 0 CM_0000 -32768 32767 /end CHARACTERISTIC
/begin CHARACTERISTIC UNK_KATALYSA_0728E "Unassigned constant read by INJ 117D70 [unassigned]" VALUE 0x7728E RL_VAL_SW 0 CM_0000 -32768 32767 /end CHARACTERISTIC
/begin CHARACTERISTIC UNK_KATALYSA_07290 "Unassigned constant read by INJ 117D70 [unassigned]" VALUE 0x77290 RL_VAL_SW 0 CM_0000 -32768 32767 /end CHARACTERISTIC
/begin CHARACTERISTIC UNK_KATALYSA_07292 "Unassigned constant read by INJ 117D70 [unassigned]" VALUE 0x77292 RL_VAL_SW 0 CM_0000 -32768 32767 /end CHARACTERISTIC
/begin CHARACTERISTIC UNK_KATALYSA_07294 "Unassigned constant read by INJ 117D70 [unassigned]" VALUE 0x77294 RL_VAL_SW 0 CM_0000 -32768 32767 /end CHARACTERISTIC
/begin CHARACTERISTIC UNK_KATALYSA_07298 "Unassigned constant read by INJ 117D70 [unassigned]" VALUE 0x77298 RL_VAL_UW 0 CM_0000 0 65535 /end CHARACTERISTIC
/begin CHARACTERISTIC UNK_KATALYSA_0729A "Unassigned constant read by INJ 117D70 [unassigned]" VALUE 0x7729A RL_VAL_UW 0 CM_0000 0 65535 /end CHARACTERISTIC
/begin CHARACTERISTIC UNK_KATALYSA_0729C "Unassigned constant read by INJ 117D70 [unassigned]" VALUE 0x7729C RL_VAL_UW 0 CM_0000 0 65535 /end CHARACTERISTIC
/begin CHARACTERISTIC UNK_KATALYSA_0729E "Unassigned constant read by INJ 117D70 [unassigned]" VALUE 0x7729E RL_VAL_UW 0 CM_0000 0 65535 /end CHARACTERISTIC
/begin CHARACTERISTIC UNK_KATALYSA_072A1 "Unassigned constant read by INJ 117D70 [unassigned]" VALUE 0x772A1 RL_VAL_UB 0 CM_0000 0 255 /end CHARACTERISTIC
/begin CHARACTERISTIC UNK_KATALYSA_072A2 "Unassigned constant read by INJ 117D70 [unassigned]" VALUE 0x772A2 RL_VAL_UB 0 CM_0000 0 255 /end CHARACTERISTIC
/begin CHARACTERISTIC UNK_KATALYSA_072A3 "Unassigned constant read by INJ 117D70 [unassigned]" VALUE 0x772A3 RL_VAL_UB 0 CM_0000 0 255 /end CHARACTERISTIC
/begin CHARACTERISTIC UNK_KATALYSA_072A4 "Unassigned constant read by INJ 117D70 [unassigned]" VALUE 0x772A4 RL_VAL_UB 0 CM_0000 0 255 /end CHARACTERISTIC
/begin CHARACTERISTIC UNK_KATALYSA_072A5 "Unassigned constant read by INJ 117D70 [unassigned]" VALUE 0x772A5 RL_VAL_UB 0 CM_0000 0 255 /end CHARACTERISTIC
/begin CHARACTERISTIC UNK_KATALYSA_072A7 "Unassigned constant read by INJ 117D70 [unassigned]" VALUE 0x772A7 RL_VAL_UB 0 CM_0000 0 255 /end CHARACTERISTIC
/begin CHARACTERISTIC UNK_KATALYSA_072A8 "Unassigned constant read by INJ 117D70 [unassigned]" VALUE 0x772A8 RL_VAL_UB 0 CM_0000 0 255 /end CHARACTERISTIC
/begin CHARACTERISTIC UNK_KATALYSA_072A9 "Unassigned constant read by INJ 117D70 [unassigned]" VALUE 0x772A9 RL_VAL_UB 0 CM_0000 0 255 /end CHARACTERISTIC
/begin CHARACTERISTIC UNK_KATALYSA_072AA "Unassigned constant read by INJ 117D70 [unassigned]" VALUE 0x772AA RL_VAL_UB 0 CM_0000 0 255 /end CHARACTERISTIC
/begin CHARACTERISTIC UNK_KATALYSA_072AB "Unassigned constant read by INJ 117D70 [unassigned]" VALUE 0x772AB RL_VAL_UB 0 CM_0000 0 255 /end CHARACTERISTIC
/begin CHARACTERISTIC UNK_KATALYSA_072AC "Unassigned constant read by INJ 117D70 [unassigned]" VALUE 0x772AC RL_VAL_UB 0 CM_0000 0 255 /end CHARACTERISTIC
/begin CHARACTERISTIC UNK_KATALYSA_072AD "Unassigned constant read by INJ 117D70 [unassigned]" VALUE 0x772AD RL_VAL_UB 0 CM_0000 0 255 /end CHARACTERISTIC
/begin CHARACTERISTIC UNK_KATALYSA_072AE "Unassigned constant read by INJ 107D10 117D70 [unassigned]" VALUE 0x772AE RL_VAL_UB 0 CM_0000 0 255 /end CHARACTERISTIC
/begin CHARACTERISTIC UNK_KATALYSA_072AF "Unassigned constant read by INJ 117D70 [unassigned]" VALUE 0x772AF RL_VAL_UB 0 CM_0000 0 255 /end CHARACTERISTIC
/begin CHARACTERISTIC UNK_KATALYSA_072B0 "Unassigned constant read by INJ 107D10 117D70 [unassigned]" VALUE 0x772B0 RL_VAL_UB 0 CM_0000 0 255 /end CHARACTERISTIC
/begin CHARACTERISTIC UNK_KATALYSA_072B1 "Unassigned constant read by INJ 107D10 117D70 [unassigned]" VALUE 0x772B1 RL_VAL_UB 0 CM_0000 0 255 /end CHARACTERISTIC
/begin CHARACTERISTIC UNK_KATALYSA_072B2 "Unassigned constant read by INJ 107D10 117D70 [unassigned]" VALUE 0x772B2 RL_VAL_UB 0 CM_0000 0 255 /end CHARACTERISTIC
/begin CHARACTERISTIC UNK_KATALYSA_072B3 "Unassigned constant read by INJ 117D70 123150 [unassigned]" VALUE 0x772B3 RL_VAL_UB 0 CM_0000 0 255 /end CHARACTERISTIC
/begin CHARACTERISTIC UNK_KATALYSA_072B4 "Unassigned constant read by INJ 117D70 [unassigned]" VALUE 0x772B4 RL_VAL_UB 0 CM_0000 0 255 /end CHARACTERISTIC
/begin CHARACTERISTIC UNK_KATALYSA_072B5 "Unassigned constant read by INJ 117D70 [unassigned]" VALUE 0x772B5 RL_VAL_UB 0 CM_0000 0 255 /end CHARACTERISTIC
/begin CHARACTERISTIC UNK_KATALYSA_072B6 "Unassigned constant read by INJ 117D70 [unassigned]" VALUE 0x772B6 RL_VAL_UB 0 CM_0000 0 255 /end CHARACTERISTIC
/begin CHARACTERISTIC UNK_KATALYSA_072B8 "Unassigned constant read by INJ 117D70 [unassigned]" VALUE 0x772B8 RL_VAL_UB 0 CM_0000 0 255 /end CHARACTERISTIC
/begin CHARACTERISTIC UNK_KATALYSA_072B9 "Unassigned constant read by INJ 117D70 [unassigned]" VALUE 0x772B9 RL_VAL_UB 0 CM_0000 0 255 /end CHARACTERISTIC
/begin CHARACTERISTIC UNK_KATALYSA_072BA "Unassigned constant read by INJ 117D70 [unassigned]" VALUE 0x772BA RL_VAL_UB 0 CM_0000 0 255 /end CHARACTERISTIC
/begin CHARACTERISTIC UNK_KATALYSA_072BB "Unassigned constant read by INJ 117D70 [unassigned]" VALUE 0x772BB RL_VAL_UB 0 CM_0000 0 255 /end CHARACTERISTIC
/begin CHARACTERISTIC UNK_KATALYSA_072BC "Unassigned constant read by INJ 117D70 [unassigned]" VALUE 0x772BC RL_VAL_UB 0 CM_0000 0 255 /end CHARACTERISTIC
/begin CHARACTERISTIC UNK_KATALYSA_072BD "Unassigned constant read by INJ 117D70 [unassigned]" VALUE 0x772BD RL_VAL_UB 0 CM_0000 0 255 /end CHARACTERISTIC
/begin CHARACTERISTIC UNK_KATALYSA_072BE "Unassigned constant read by INJ 117D70 [unassigned]" VALUE 0x772BE RL_VAL_UB 0 CM_0000 0 255 /end CHARACTERISTIC
/begin CHARACTERISTIC UNK_KATALYSA_072BF "Unassigned constant read by INJ 117D70 [unassigned]" VALUE 0x772BF RL_VAL_UB 0 CM_0000 0 255 /end CHARACTERISTIC
/begin CHARACTERISTIC UNK_KATALYSA_072C0 "Unassigned constant read by INJ 117D70 [unassigned]" VALUE 0x772C0 RL_VAL_UB 0 CM_0000 0 255 /end CHARACTERISTIC
/begin CHARACTERISTIC UNK_KATALYSA_072C1 "Unassigned constant read by INJ 117D70 [unassigned]" VALUE 0x772C1 RL_VAL_UB 0 CM_0000 0 255 /end CHARACTERISTIC
/begin CHARACTERISTIC UNK_KATALYSA_072C2 "Unassigned constant read by INJ 117D70 [unassigned]" VALUE 0x772C2 RL_VAL_UB 0 CM_0000 0 255 /end CHARACTERISTIC
/begin CHARACTERISTIC UNK_KATALYSA_072C3 "Unassigned constant read by INJ 117D70 [unassigned]" VALUE 0x772C3 RL_VAL_UB 0 CM_0000 0 255 /end CHARACTERISTIC
/begin CHARACTERISTIC UNK_KATALYSA_072C4 "Unassigned constant read by INJ 117D70 [unassigned]" VALUE 0x772C4 RL_VAL_UB 0 CM_0000 0 255 /end CHARACTERISTIC
/begin CHARACTERISTIC UNK_KATALYSA_072C5 "Unassigned constant read by INJ 117D70 [unassigned]" VALUE 0x772C5 RL_VAL_UB 0 CM_0000 0 255 /end CHARACTERISTIC
/begin CHARACTERISTIC UNK_KATALYSA_072C6 "Unassigned constant read by INJ 117D70 [unassigned]" VALUE 0x772C6 RL_VAL_UB 0 CM_0000 0 255 /end CHARACTERISTIC
/begin CHARACTERISTIC UNK_KATALYSA_072C7 "Unassigned constant read by INJ 117D70 [unassigned]" VALUE 0x772C7 RL_VAL_UB 0 CM_0000 0 255 /end CHARACTERISTIC
/begin CHARACTERISTIC UNK_KATALYSA_073C8 "Unassigned constant read by INJ 117D70 [unassigned]" VALUE 0x773C8 RL_VAL_SW 0 CM_0000 -32768 32767 /end CHARACTERISTIC
/begin CHARACTERISTIC UNK_KATALYSA_073CA "Unassigned constant read by INJ 117D70 [unassigned]" VALUE 0x773CA RL_VAL_SW 0 CM_0000 -32768 32767 /end CHARACTERISTIC
/begin CHARACTERISTIC UNK_KATALYSA_073CC "Unassigned constant read by INJ 117D70 [unassigned]" VALUE 0x773CC RL_VAL_UB 0 CM_0000 0 255 /end CHARACTERISTIC
/begin CHARACTERISTIC UNK_KATALYSA_073CD "Unassigned constant read by INJ 117D70 [unassigned]" VALUE 0x773CD RL_VAL_UB 0 CM_0000 0 255 /end CHARACTERISTIC
/begin CHARACTERISTIC UNK_KATALYSA_073CE "Unassigned constant read by INJ 117D70 [unassigned]" VALUE 0x773CE RL_VAL_UB 0 CM_0000 0 255 /end CHARACTERISTIC
/begin CHARACTERISTIC UNK_KATALYSA_073CF "Unassigned constant read by INJ 117D70 [unassigned]" VALUE 0x773CF RL_VAL_UB 0 CM_0000 0 255 /end CHARACTERISTIC
/begin CHARACTERISTIC UNK_KATALYSA_073D0 "Unassigned constant read by INJ 117D70 [unassigned]" VALUE 0x773D0 RL_VAL_UB 0 CM_0000 0 255 /end CHARACTERISTIC
/begin CHARACTERISTIC UNK_KATALYSA_073D1 "Unassigned constant read by INJ 117D70 [unassigned]" VALUE 0x773D1 RL_VAL_UB 0 CM_0000 0 255 /end CHARACTERISTIC
/begin CHARACTERISTIC UNK_KATALYSA_073D2 "Unassigned constant read by INJ 117D70 [unassigned]" VALUE 0x773D2 RL_VAL_UB 0 CM_0000 0 255 /end CHARACTERISTIC
/begin CHARACTERISTIC UNK_KATALYSA_073D3 "Unassigned constant read by INJ 117D70 [unassigned]" VALUE 0x773D3 RL_VAL_UB 0 CM_0000 0 255 /end CHARACTERISTIC
/begin CHARACTERISTIC UNK_KATALYSA_073D4 "Unassigned constant read by INJ 117D70 [unassigned]" VALUE 0x773D4 RL_VAL_UB 0 CM_0000 0 255 /end CHARACTERISTIC
/begin CHARACTERISTIC UNK_LA_TRIM_0423A "Unassigned constant (role from code) [unassigned]" VALUE 0x7423A RL_VAL_UW 0 CM_0000 0 65535 /end CHARACTERISTIC
/begin CHARACTERISTIC UNK_PKSR_PL_06E4A "Unassigned constant (role from code) [unassigned]" VALUE 0x76E4A RL_VAL_UW 0 CM_0000 0 65535 /end CHARACTERISTIC
/begin CHARACTERISTIC UNK_PKSR_PL_06E4C "Unassigned constant (role from code) [unassigned]" VALUE 0x76E4C RL_VAL_UW 0 CM_0000 0 65535 /end CHARACTERISTIC
/begin CHARACTERISTIC UNK_PKSR_PL_06E4E "Unassigned constant (role from code) [unassigned]" VALUE 0x76E4E RL_VAL_UW 0 CM_0000 0 65535 /end CHARACTERISTIC
/begin CHARACTERISTIC UNK_PKSR_PL_06E50 "Unassigned constant (role from code) [unassigned]" VALUE 0x76E50 RL_VAL_UW 0 CM_0000 0 65535 /end CHARACTERISTIC
/begin COMPU_METHOD CM_0000 "X" RAT_FUNC "%.4g" "-" COEFFS 0 1 0 0 0 1 /end COMPU_METHOD
/begin COMPU_METHOD CM_0002 "X" RAT_FUNC "%.4g" "Upm" COEFFS 0 1 0 0 0 1 /end COMPU_METHOD
/begin COMPU_METHOD CM_0191 "X*0.0942" RAT_FUNC "%.4g" "V" COEFFS 0 1 0 0 0 0.0942 /end COMPU_METHOD
/begin COMPU_METHOD CM_0233 "X/60" RAT_FUNC "%.4g" "min" COEFFS 0 60 0 0 0 1 /end COMPU_METHOD
/begin COMPU_METHOD CM_0256 "(X-2732)/10" RAT_FUNC "%.4g" "?C" COEFFS 0 10 2732 0 0 1 /end COMPU_METHOD
/begin COMPU_METHOD CM_0257 "X/2" RAT_FUNC "%.4g" "l" COEFFS 0 2 0 0 0 1 /end COMPU_METHOD
/begin RECORD_LAYOUT RL_VAL_SW FNC_VALUES 1 SWORD COLUMN_DIR DIRECT /end RECORD_LAYOUT
/begin RECORD_LAYOUT RL_VAL_UB FNC_VALUES 1 UBYTE COLUMN_DIR DIRECT /end RECORD_LAYOUT
/begin RECORD_LAYOUT RL_VAL_UL FNC_VALUES 1 ULONG COLUMN_DIR DIRECT /end RECORD_LAYOUT
/begin RECORD_LAYOUT RL_VAL_UW FNC_VALUES 1 UWORD COLUMN_DIR DIRECT /end RECORD_LAYOUT
/begin GROUP G_z_Unidentified___values "z Unidentified - values" ROOT
 /begin REF_CHARACTERISTIC UNK_PKS_06D58 UNK_PKS_06D5A UNK_PKS_06D5C UNK_PKS_06D5E UNK_PKS_06DD2 UNK_PKS_06DD4 UNK_PKS_06E0D UNK_PKS_06E1A UNK_PKS_06E1B UNK_PKS_06E1C UNK_PKS_06E1E UNK_PKS_06E20 UNK_PKS_06E22 UNK_PKS_06E24 UNK_PKS_06E25 UNK_PKS_06E26 UNK_PKS_06E28 UNK_PKS_06E2A UNK_PKS_06E2C UNK_PKS_06E2E UNK_PKS_06E30 UNK_PKS_06E32 UNK_PKS_06E36 UNK_PKS_06E3A UNK_PKS_06E3C UNK_PKS_06E3E UNK_PKS_06E40 UNK_PKS_06E42 UNK_PKS_06E44 UNK_PKS_06E46 UNK_PKS_06E48 UNK_PKS_06E54 UNK_PKS_06E56 UNK_PKS_06E58 UNK_PKS_06E5A UNK_PKS_06E5C UNK_PKS_06E5E UNK_PKS_06E60 UNK_PKS_06E62 UNK_PKS_06E64 UNK_PKS_06E6A UNK_PKS_06E6C UNK_PKS_06E6E UNK_PKS_06E78 UNK_PKS_06E7A UNK_PKS_06E7C UNK_PKS_06E7D UNK_PKS_06E7E UNK_PKS_06E80 UNK_PKS_06E82 UNK_PKS_06E84 UNK_PKS_06E86 UNK_PKS_06E88 UNK_PKS_06E8A UNK_PKS_06E8C UNK_LA_TRIM_04258 UNK_LAVK_04928 UNK_NBEGR_06000 UNK_NBEGR_0603C UNK_NBEGR_0B672 UNK_NBEGR_0B674 UNK_NBEGR_0B676 UNK_NBEGR_0B678 UNK_NBEGR_0B679 UNK_NBEGR_0B67A UNK_SL_086E2 UNK_SL_086F4 UNK_SL_086F6 UNK_SL_086F8 UNK_SL_086FA UNK_RD_INJ_00000 UNK_RD_INJ_00004 UNK_RD_INJ_00008 UNK_RD_INJ_0000C UNK_RD_INJ_00010 UNK_RD_INJ_00014 UNK_RD_INJ_00018 UNK_RD_INJ_0001C UNK_RD_INJ_00030 UNK_RD_INJ_00080 UNK_RD_INJ_001C0 UNK_RD_INJ_001C4 UNK_RD_INJ_001C8 UNK_RD_INJ_00204 UNK_RD_INJ_00208 UNK_RD_INJ_0020C UNK_RD_INJ_00290 UNK_RD_INJ_002A3 UNK_RD_INJ_002A4 UNK_RD_INJ_002A6 UNK_RD_INJ_002A8 UNK_RD_INJ_002AA UNK_RD_INJ_002AC UNK_RD_INJ_002AD UNK_RD_INJ_002B0 UNK_RD_INJ_002B4 UNK_RD_INJ_002B6 UNK_RD_INJ_002B8 UNK_RD_INJ_002CA UNK_RD_INJ_002CB UNK_RD_INJ_002CC UNK_RD_INJ_002CE UNK_RD_INJ_002D0 UNK_RD_INJ_002D2 UNK_RD_INJ_00316 UNK_RD_INJ_00317 UNK_RD_INJ_0051E UNK_RD_INJ_0051F UNK_RD_INJ_00521 UNK_RD_INJ_00522 UNK_RD_INJ_00523 UNK_RD_INJ_00524 UNK_RD_INJ_00525 UNK_RD_INJ_0054C UNK_RD_INJ_00551 UNK_RD_INJ_00554 UNK_RD_INJ_00566 UNK_RD_INJ_00568 UNK_RD_INJ_0056A UNK_RD_INJ_0056C UNK_RD_INJ_0056E UNK_RD_INJ_00570 UNK_RD_INJ_00572 UNK_RD_INJ_00574 UNK_RD_INJ_00575 UNK_RD_INJ_00578 UNK_RD_INJ_0057A UNK_RD_INJ_005B4 UNK_RD_INJ_008D8 UNK_RD_INJ_008DC UNK_RD_INJ_008DE UNK_RD_INJ_008E0 UNK_RD_INJ_008E2 UNK_RD_INJ_008E4 UNK_RD_INJ_008E6 UNK_RD_INJ_008E8 UNK_RD_INJ_008EA UNK_RD_INJ_008EC UNK_RD_INJ_008EE UNK_RD_INJ_008F0 UNK_RD_INJ_008F1 UNK_RD_INJ_008F2 UNK_RD_INJ_008F3 UNK_RD_INJ_008F4 UNK_RD_INJ_008F5 UNK_RD_INJ_008F6 UNK_RD_INJ_008F7 UNK_RD_INJ_008F8 UNK_RD_INJ_008F9 UNK_RD_INJ_008FA UNK_RD_INJ_0090A UNK_RD_INJ_0090C UNK_RD_INJ_0090E UNK_RD_INJ_00910 UNK_RD_INJ_00912 UNK_RD_INJ_00918 UNK_RD_INJ_0091A UNK_RD_INJ_0091C UNK_RD_INJ_00921 UNK_RD_INJ_00925 UNK_RD_INJ_00928 UNK_RD_INJ_0092E UNK_RD_INJ_0092F UNK_RD_INJ_00A4A UNK_RD_INJ_00A4E UNK_RD_INJ_00A4F UNK_RD_INJ_00A52 UNK_RD_INJ_00A54 UNK_RD_INJ_02188 UNK_RD_INJ_0218A UNK_RD_INJ_021A6 UNK_RD_INJ_021AA UNK_RD_INJ_021E2 UNK_RD_INJ_021E4 UNK_RD_INJ_021E6 UNK_RD_INJ_021E8 UNK_RD_INJ_021EA UNK_RD_INJ_021EC UNK_RD_INJ_021EE UNK_RD_INJ_021F0 UNK_RD_INJ_021F2 UNK_RD_INJ_021F4 UNK_RD_INJ_021F6 UNK_RD_INJ_021F8 UNK_RD_INJ_021FA UNK_RD_INJ_021FC UNK_RD_INJ_021FE UNK_RD_INJ_02200 UNK_RD_INJ_02202 UNK_RD_INJ_02204 UNK_RD_INJ_02206 UNK_RD_INJ_02207 UNK_RD_INJ_028E4 UNK_RD_INJ_028E6 UNK_RD_INJ_028E8 UNK_RD_INJ_028EA UNK_RD_INJ_028EB UNK_RD_INJ_028EC UNK_RD_INJ_028ED UNK_RD_INJ_028F2 UNK_RD_INJ_028F4 UNK_RD_INJ_028F6 UNK_RD_INJ_028F8 UNK_RD_INJ_028FA UNK_RD_INJ_028FC UNK_RD_INJ_028FD UNK_RD_INJ_028FE UNK_RD_INJ_028FF UNK_RD_INJ_02900 UNK_RD_INJ_02901 UNK_RD_INJ_02902 UNK_RD_INJ_02903 UNK_RD_INJ_02904 UNK_RD_INJ_02905 UNK_RD_INJ_02906 UNK_RD_INJ_02907 UNK_RD_INJ_02908 UNK_RD_INJ_02916 UNK_RD_INJ_02918 UNK_RD_INJ_0291A UNK_RD_INJ_0291C UNK_RD_INJ_0291E UNK_RD_INJ_0291F UNK_RD_INJ_02923 UNK_RD_INJ_02924 UNK_RD_INJ_02925 UNK_RD_INJ_02926 UNK_RD_INJ_02928 UNK_RD_INJ_0292A UNK_RD_INJ_0292C UNK_RD_INJ_0292D UNK_RD_INJ_0292E UNK_RD_INJ_03A36 UNK_RD_INJ_03A38 UNK_RD_INJ_03A3A UNK_RD_INJ_03A3C UNK_RD_INJ_03A3E UNK_RD_INJ_03A40 UNK_RD_INJ_03A42 UNK_RD_INJ_03A44 UNK_RD_INJ_03A46 UNK_RD_INJ_03A47 UNK_RD_INJ_03A48 UNK_RD_INJ_03A49 UNK_RD_INJ_03A4A UNK_RD_INJ_03C46 UNK_RD_INJ_03C47 UNK_RD_INJ_03C48 UNK_RD_INJ_03C4A UNK_RD_INJ_03C4C UNK_RD_INJ_03C4E UNK_RD_INJ_03C50 UNK_RD_INJ_03C52 UNK_RD_INJ_03C54 UNK_RD_INJ_03C56 UNK_RD_INJ_03C58 UNK_RD_INJ_03C5A UNK_RD_INJ_03C5C UNK_RD_INJ_03C5E UNK_RD_INJ_03C60 UNK_RD_INJ_03C61 UNK_RD_INJ_03C62 UNK_RD_INJ_03C63 UNK_RD_INJ_03E06 UNK_RD_INJ_03E07 UNK_RD_INJ_03E08 UNK_RD_INJ_03E09 UNK_RD_INJ_03E0A UNK_RD_INJ_03E0B UNK_RD_INJ_03E0C UNK_RD_INJ_03E0D UNK_RD_INJ_03E0E UNK_RD_INJ_03E0F UNK_RD_INJ_03E10 UNK_RD_INJ_03E11 UNK_RD_INJ_03E12 UNK_RD_INJ_03E14 UNK_RD_INJ_03E16 UNK_RD_INJ_03E18 UNK_RD_INJ_03E1A UNK_RD_INJ_03E1C UNK_RD_INJ_04000 UNK_RD_INJ_04001 UNK_RD_INJ_04002 UNK_RD_INJ_04003 UNK_RD_INJ_04004 UNK_RD_INJ_04005 UNK_RD_INJ_04006 UNK_RD_INJ_04007 UNK_RD_INJ_04008 UNK_RD_INJ_04009 UNK_RD_INJ_0400A UNK_RD_INJ_0400B UNK_RD_INJ_0400C UNK_RD_INJ_0400D UNK_RD_INJ_0400E UNK_RD_INJ_04010 UNK_RD_INJ_04012 UNK_RD_INJ_04014 UNK_RD_INJ_04016 UNK_RD_INJ_04018 UNK_RD_INJ_0401A UNK_RD_INJ_0401C UNK_RD_INJ_0401E UNK_RD_INJ_04020 UNK_RD_INJ_04022 UNK_RD_INJ_04024 UNK_RD_INJ_04026 UNK_RD_INJ_04028 UNK_RD_INJ_0402A UNK_RD_INJ_0402C UNK_RD_INJ_0402E UNK_RD_INJ_04030 UNK_RD_INJ_04031 UNK_RD_INJ_04032 UNK_RD_INJ_04033 UNK_RD_INJ_04034 UNK_RD_INJ_04035 UNK_RD_INJ_04036 UNK_RD_INJ_04037 UNK_RD_INJ_04038 UNK_RD_INJ_04039 UNK_RD_INJ_0403A UNK_RD_INJ_0403C UNK_RD_INJ_0403E UNK_RD_INJ_04040 UNK_RD_INJ_04042 UNK_RD_INJ_04044 UNK_RD_INJ_04046 UNK_RD_INJ_04048 UNK_RD_INJ_0404A UNK_RD_INJ_0404C UNK_RD_INJ_040C2 UNK_RD_INJ_040C3 UNK_RD_INJ_040C4 UNK_RD_INJ_040C6 UNK_RD_INJ_040C8 UNK_RD_INJ_040CA UNK_RD_INJ_040CC UNK_RD_INJ_040CE UNK_RD_INJ_040D0 UNK_RD_INJ_040D2 UNK_RD_INJ_040D4 UNK_RD_INJ_040D6 UNK_RD_INJ_040D8 UNK_RD_INJ_040DA UNK_RD_INJ_040DC UNK_RD_INJ_040DE UNK_RD_INJ_040E0 UNK_RD_INJ_040E2 UNK_RD_INJ_040E4 UNK_RD_INJ_040E6 UNK_RD_INJ_040E8 UNK_RD_INJ_040EA UNK_RD_INJ_040EC UNK_RD_INJ_040EE UNK_RD_INJ_040F0 UNK_RD_INJ_040F2 UNK_RD_INJ_040F4 UNK_RD_INJ_040F6 UNK_RD_INJ_040F8 UNK_RD_INJ_040F9 UNK_RD_INJ_040FA UNK_RD_INJ_040FC UNK_RD_INJ_041D8 UNK_RD_INJ_041DB UNK_RD_INJ_041DF UNK_RD_INJ_041E0 UNK_RD_INJ_041E1 UNK_RD_INJ_041E2 UNK_RD_INJ_041EA UNK_RD_INJ_05764 UNK_RD_INJ_0577C UNK_RD_INJ_0577E UNK_RD_INJ_05780 UNK_RD_INJ_0578E UNK_RD_INJ_05790 UNK_RD_INJ_05792 UNK_RD_INJ_05794 UNK_RD_INJ_05796 UNK_RD_INJ_05798 UNK_RD_INJ_057A2 UNK_RD_INJ_057AA UNK_RD_INJ_057AB UNK_RD_INJ_057AC UNK_RD_INJ_057AE UNK_RD_INJ_057BA UNK_RD_INJ_057BC UNK_RD_INJ_057BE UNK_RD_INJ_057C0 UNK_RD_INJ_057C2 UNK_RD_INJ_057C4 UNK_RD_INJ_057C6 UNK_RD_INJ_05916 UNK_RD_INJ_0596E UNK_RD_INJ_0596F UNK_RD_INJ_05970 UNK_RD_INJ_05B2E UNK_RD_INJ_05B2F UNK_RD_INJ_05B30 UNK_RD_INJ_05B31 UNK_RD_INJ_05B32 UNK_RD_INJ_05B33 UNK_RD_INJ_05B34 UNK_RD_INJ_05B35 UNK_RD_INJ_05B36 UNK_RD_INJ_05B37 UNK_RD_INJ_05B3E UNK_RD_INJ_05B43 UNK_MDRV_ALT_OVERRIDE UNK_RD_INJ_05EAE UNK_MDRV_ALT_DSC UNK_MDRV_ALT_MOD_SMG UNK_MDRV_ALT_STG_SMG UNK_MDRV_ALT_ENG UNK_MDRV_ALT_EDCK UNK_MDRV_ALT_EPAS UNK_MDRV_ALT_SHLI UNK_RD_INJ_05EC6 UNK_RD_INJ_05EC8 UNK_RD_INJ_067C8 UNK_RD_INJ_067CA UNK_RD_INJ_067CC UNK_RD_INJ_067CE UNK_RD_INJ_067D0 UNK_RD_INJ_067D2 UNK_RD_INJ_067D4 UNK_RD_INJ_067D6 UNK_RD_INJ_067D8 UNK_RD_INJ_067DA UNK_RD_INJ_067DC UNK_RD_INJ_067DE UNK_RD_INJ_067E0 UNK_RD_INJ_06BD0 UNK_RD_INJ_06BD4 UNK_RD_INJ_06BD6 UNK_RD_INJ_06BD8 UNK_RD_INJ_06BDA UNK_RD_INJ_06BF0 UNK_RD_INJ_06BF2 UNK_RD_INJ_06BF6 UNK_RD_INJ_06BF7 UNK_RD_INJ_06BF8 UNK_RD_INJ_06BFB UNK_RD_INJ_06C00 UNK_RD_INJ_06C01 UNK_RD_INJ_06C02 UNK_RD_INJ_06DFC UNK_RD_INJ_06DFE UNK_RD_INJ_06E00 UNK_RD_INJ_06E02 UNK_RD_INJ_06E04 UNK_RD_INJ_06E06 UNK_RD_INJ_06E08 UNK_RD_INJ_06E0A UNK_RD_INJ_06E0C UNK_RD_INJ_07296 UNK_RD_INJ_072A6 UNK_RD_INJ_072B7 UNK_RD_INJ_073F2 UNK_RD_INJ_073F4 UNK_RD_INJ_073F6 UNK_RD_INJ_073F8 UNK_RD_INJ_073FA UNK_RD_INJ_0740A UNK_RD_INJ_0740B UNK_RD_INJ_0740C UNK_RD_INJ_0740D UNK_RD_INJ_0740E UNK_RD_INJ_0740F UNK_RD_INJ_07540 UNK_RD_INJ_07541 UNK_RD_INJ_07542 UNK_RD_INJ_07543 UNK_RD_INJ_07544 UNK_RD_INJ_07545 UNK_RD_INJ_07546 UNK_RD_INJ_07547 UNK_RD_INJ_07548 UNK_RD_INJ_0754A UNK_RD_INJ_0754C UNK_RD_INJ_0754E UNK_RD_INJ_07550 UNK_RD_INJ_07552 UNK_RD_INJ_07554 UNK_RD_INJ_07556 UNK_RD_INJ_07558 UNK_RD_INJ_0755A UNK_RD_INJ_0755C UNK_RD_INJ_0755E UNK_RD_INJ_0755F UNK_RD_INJ_07560 UNK_RD_INJ_07561 UNK_RD_INJ_07564 UNK_RD_INJ_07566 UNK_RD_INJ_07567 UNK_RD_INJ_07568 UNK_RD_INJ_07569 UNK_RD_INJ_0756A UNK_RD_INJ_0756C UNK_RD_INJ_0756E UNK_RD_INJ_07570 UNK_RD_INJ_07572 UNK_RD_INJ_07574 UNK_RD_INJ_07578 UNK_RD_INJ_07579 UNK_RD_INJ_0757A UNK_RD_INJ_07590 UNK_RD_INJ_07592 UNK_RD_INJ_07596 UNK_RD_INJ_0759A UNK_RD_INJ_075A4 UNK_RD_INJ_075A6 UNK_RD_INJ_075AE UNK_RD_INJ_075AF UNK_RD_INJ_075C2 UNK_RD_INJ_075C3 UNK_RD_INJ_075C8 UNK_RD_INJ_075CB UNK_RD_INJ_075CC UNK_RD_INJ_075CD UNK_RD_INJ_075CE UNK_RD_INJ_075D0 UNK_RD_INJ_075D5 UNK_RD_INJ_0778A UNK_RD_INJ_07964 UNK_RD_INJ_07966 UNK_PMV_REQ03_U_OFFS UNK_PMV_REQ04_U_OFFS UNK_PMV_REQ05_U_OFFS UNK_PMV_CH6_COND2 UNK_PMV_START_COND UNK_PMV_REQ03_T_HOLD UNK_PMV_REQ04_T_HOLD UNK_PMV_REQ05_T_HOLD UNK_PMV_REQ06_T_HOLD UNK_PMV_REQ12_T_HOLD UNK_PMV_REQ09_T_HOLD UNK_PMV_REQ11_T_HOLD UNK_PMV_REQ10_T_HOLD UNK_PMV_REQ13_T_HOLD UNK_PMV_REQ15_T_HOLD UNK_PMV_REQ17_T_HOLD UNK_PMV_REQ19_T_HOLD UNK_PMV_REQ21_T_HOLD UNK_PMV_REQ08_T_HOLD UNK_PMV_CH6_T UNK_PMV_CH6_COND UNK_PMV_START_T UNK_PMV_START_CNT_STEP UNK_PMV_START_CNT_MAX UNK_PMV_START_U_MAX UNK_PMV_REQ03_PRIO UNK_PMV_START_PRIO_A UNK_PMV_FLAG_PRIO_A UNK_PMV_REQ02_PRIO UNK_PMV_REQ01_PRIO UNK_PMV_REQ04_PRIO UNK_PMV_REQ06_PRIO UNK_PMV_REQ05_PRIO UNK_PMV_REQ12_PRIO UNK_PMV_REQ09_PRIO UNK_PMV_REQ11_PRIO UNK_PMV_REQ10_PRIO UNK_PMV_REQ13_PRIO UNK_PMV_REQ14_PRIO UNK_PMV_REQ15_PRIO UNK_PMV_REQ16_PRIO UNK_PMV_REQ17_PRIO UNK_PMV_REQ18_PRIO UNK_PMV_REQ19_PRIO UNK_PMV_REQ20_PRIO UNK_PMV_REQ21_PRIO UNK_PMV_REQ22_PRIO UNK_PMV_REQ08_PRIO UNK_PMV_REQ07_PRIO UNK_PMV_REQ06_U_OFFS UNK_PMV_REQ01_U_OFFS UNK_PMV_REQ11_U_OFFS UNK_PMV_REQ09_U_OFFS UNK_PMV_REQ13_U_OFFS UNK_PMV_REQ14_U_OFFS UNK_PMV_REQ15_U_OFFS UNK_PMV_REQ16_U_OFFS UNK_PMV_REQ17_U_OFFS UNK_PMV_REQ18_U_OFFS UNK_PMV_REQ19_U_OFFS UNK_PMV_REQ07_U_OFFS UNK_PMV_REQ20_U_OFFS UNK_PMV_REQ21_U_OFFS UNK_PMV_REQ22_U_OFFS UNK_PMV_REQ02_U_OFFS UNK_PMV_REQ08_U_OFFS UNK_PMV_REQ10_U_OFFS UNK_PMV_REQ12_U_OFFS UNK_PMV_UBATT_OFFS UNK_PMV_U_MARGIN UNK_PMV_START_PRIO_B UNK_PMV_FLAG_PRIO_B UNK_PMV_CH6_U_OFFS2 UNK_PMV_CH6_ENABLE UNK_PMV_CH6_SW UNK_PMV_CH6_SW2 UNK_RD_INJ_07A32 UNK_RD_INJ_07A34 UNK_RD_INJ_07A36 UNK_RD_INJ_07A38 UNK_RD_INJ_07A3A UNK_RD_INJ_07A3C UNK_RD_INJ_07A3D UNK_RD_INJ_07A3E UNK_RD_INJ_07A3F UNK_RD_INJ_07A40 UNK_RD_INJ_07A42 UNK_RD_INJ_07A44 UNK_RD_INJ_07A46 UNK_RD_INJ_07A48 UNK_RD_INJ_07A4A UNK_RD_INJ_07A4C UNK_RD_INJ_07A4E UNK_RD_INJ_07A50 UNK_RD_INJ_07A51 UNK_RD_INJ_07A52 UNK_RD_INJ_07A53 UNK_RD_INJ_07A54 UNK_RD_INJ_07A55 UNK_RD_INJ_07A56 UNK_RD_INJ_07A57 UNK_RD_INJ_07A58 UNK_RD_INJ_07A59 UNK_RD_INJ_07A5B UNK_RD_INJ_07A5D UNK_RD_INJ_07A5E UNK_RD_INJ_07A5F UNK_RD_INJ_07A70 UNK_RD_INJ_07A72 UNK_RD_INJ_07A74 UNK_RD_INJ_07A76 UNK_RD_INJ_07A77 UNK_RD_INJ_07A78 UNK_RD_INJ_07A7E UNK_RD_INJ_07A7F UNK_RD_INJ_07AB6 UNK_RD_INJ_07AB8 UNK_RD_INJ_07ABA UNK_RD_INJ_07ABC UNK_RD_INJ_07ABD UNK_RD_INJ_07ABE UNK_RD_INJ_07ABF UNK_RD_INJ_07AC1 UNK_RD_INJ_07AC2 UNK_RD_INJ_07AC3 UNK_RD_INJ_07AC4 UNK_RD_INJ_07AC5 UNK_RD_INJ_07AC6 UNK_RD_INJ_07AC7 UNK_RD_INJ_07AC8 UNK_RD_INJ_07AC9 UNK_RD_INJ_07ACA UNK_RD_INJ_07ACB UNK_RD_INJ_07ACC UNK_RD_INJ_07ACD UNK_RD_INJ_07ACE UNK_RD_INJ_07AD0 UNK_RD_INJ_07AD1 UNK_RD_INJ_07AD2 UNK_RD_INJ_07AD3 UNK_RD_INJ_07AD4 UNK_RD_INJ_07AD5 UNK_RD_INJ_07AD6 UNK_RD_INJ_07AD7 UNK_RD_INJ_07AD8 UNK_RD_INJ_07AD9 UNK_RD_INJ_07ADA UNK_RD_INJ_07ADB UNK_RD_INJ_07ADC UNK_RD_INJ_07ADD UNK_RD_INJ_07ADE UNK_RD_INJ_07ADF UNK_RD_INJ_07AE0 UNK_RD_INJ_07AE1 UNK_RD_INJ_07AE2 UNK_RD_INJ_07AE3 UNK_RD_INJ_07AE4 UNK_RD_INJ_07AE5 UNK_RD_INJ_07AE6 UNK_RD_INJ_07AE7 UNK_RD_INJ_07AE8 UNK_RD_INJ_07AE9 UNK_RD_INJ_07AEA UNK_RD_INJ_07AEB UNK_RD_INJ_07AEC UNK_RD_INJ_07AED UNK_RD_INJ_07AEE UNK_RD_INJ_07AF1 UNK_RD_INJ_07AF2 UNK_RD_INJ_07AF3 UNK_RD_INJ_07AF4 UNK_RD_INJ_07AF5 UNK_RD_INJ_07AF6 UNK_RD_INJ_07AF7 UNK_RD_INJ_07AF8 UNK_RD_INJ_07AF9 UNK_RD_INJ_07AFA UNK_RD_INJ_07AFB UNK_RD_INJ_07AFC UNK_RD_INJ_07AFD UNK_RD_INJ_07AFE UNK_RD_INJ_07AFF UNK_RD_INJ_07B00 UNK_RD_INJ_07B01 UNK_RD_INJ_07B02 UNK_RD_INJ_07B03 UNK_RD_INJ_07B04 UNK_RD_INJ_07B05 UNK_RD_INJ_07B06 UNK_RD_INJ_07EC0 UNK_RD_INJ_07EC4 UNK_RD_INJ_07EC8 UNK_RD_INJ_07ECC UNK_RD_INJ_07ED4 UNK_RD_INJ_07ED6 UNK_RD_INJ_07ED8 UNK_RD_INJ_08052 UNK_RD_INJ_08054 UNK_RD_INJ_08056 UNK_RD_INJ_08057 UNK_RD_INJ_08058 UNK_RD_INJ_08059 UNK_RD_INJ_0805A UNK_RD_INJ_082DA UNK_RD_INJ_086E0 UNK_RD_INJ_08900 UNK_RD_INJ_08902 UNK_RD_INJ_08906 UNK_RD_INJ_08908 UNK_RD_INJ_0890A UNK_RD_INJ_0890C UNK_RD_INJ_0890E UNK_RD_INJ_08910 UNK_RD_INJ_08912 UNK_RD_INJ_08B45 UNK_RD_INJ_08B4A UNK_RD_INJ_08B4B UNK_RD_INJ_08B4D UNK_RD_INJ_08B4E UNK_RD_INJ_093CE UNK_RD_INJ_0B086 UNK_RD_INJ_0B088 UNK_RD_INJ_0B08A UNK_RD_INJ_0B08C UNK_RD_INJ_0B63A UNK_RD_INJ_0B67E UNK_RD_INJ_0B680 UNK_RD_INJ_0B682 UNK_RD_INJ_0B684 UNK_RD_INJ_0B68A UNK_RD_INJ_0B68C UNK_RD_INJ_0B68E UNK_RD_INJ_0B690 UNK_RD_INJ_0B692 UNK_RD_INJ_0B694 UNK_RD_INJ_0B696 UNK_RD_INJ_0B698 UNK_RD_INJ_0B69A UNK_RD_INJ_0B69C UNK_RD_INJ_0B69E UNK_RD_INJ_0B8E2 UNK_RD_INJ_0B8E4 UNK_RD_INJ_0B8E6 UNK_RD_INJ_0B8E8 UNK_RD_INJ_0FFF8 UNK_RD_INJ_0FFFC UNK_TANKENTL_08BF0 UNK_TANKENTL_08C21 UNK_TANKENTL_08C6A UNK_TANKENTL_08C6E UNK_TANKENTL_08C74 UNK_IPMNA_028EE UNK_IPMNA_028EF UNK_IPMNA_028F0 UNK_IPMNA_03CA8 UNK_IPMNA_03CAA UNK_IPMNA_03CAC UNK_IPMNA_03CAE UNK_IPMNA_03CAF UNK_IPMNA_03CB0 UNK_IPMNA_03CB2 UNK_IPMNA_03CB4 UNK_IPMNA_03CB5 UNK_IPMNA_03CBB UNK_POWERMAN_0745C UNK_POWERMAN_07460 UNK_POWERMAN_07469 UNK_POWERMAN_0746E UNK_POWERMAN_07472 UNK_POWERMAN_07474 UNK_POWERMAN_07475 UNK_POWERMAN_07477 UNK_POWERMAN_07478 UNK_POWERMAN_0753A UNK_POWERMAN_0753C UNK_POWERMAN_0753E UNK_POWERMAN_07784 UNK_POWERMAN_0778B UNK_POWERMAN_0795E UNK_POWERMAN_07960 UNK_POWERMAN_07962 UNK_POWERMAN_07977 UNK_POWERMAN_07978 UNK_POWERMAN_079CE UNK_POWERMAN_079D0 UNK_POWERMAN_079D1 UNK_POWERMAN_07ED0 UNK_POWERMAN_07ED2 UNK_POWERMAN_07EDA UNK_POWERMAN_07EDC UNK_POWERMAN_07EDE UNK_POWERMAN_07EE0 UNK_POWERMAN_07EE2 UNK_POWERMAN_07EE4 UNK_POWERMAN_07EE6 UNK_POWERMAN_07EE7 UNK_POWERMAN_07EE8 UNK_POWERMAN_07EEA UNK_POWERMAN_07EEC UNK_POWERMAN_07EEE UNK_POWERMAN_07EF0 UNK_POWERMAN_07EF2 UNK_POWERMAN_07EF4 UNK_POWERMAN_07EF6 UNK_POWERMAN_07EF8 UNK_POWERMAN_07EFA UNK_POWERMAN_07EFC UNK_POWERMAN_07EFE UNK_POWERMAN_07F00 UNK_KATALYSA_062A2 UNK_KATALYSA_062A6 UNK_KATALYSA_062A8 UNK_NKATHEI_0577A UNK_NKATHEI_057A6 UNK_NKATHEI_057A8 UNK_NKATHEI_057B0 UNK_NKATHEI_057B2 UNK_NKATHEI_057B4 UNK_NKATHEI_05C38 UNK_NKATHEI_05C3A UNK_NKATHEI_05C3C UNK_NKATHEI_088DE UNK_ANSAUGLU_025B0 UNK_ANSAUGLU_025B6 UNK_ANSAUGLU_025D2 UNK_ANSAUGLU_02930 UNK_ANSAUGLU_03BD0 UNK_ANSAUGLU_03BD2 UNK_ANSAUGLU_03BD4 UNK_ANSAUGLU_03BD6 UNK_ANSAUGLU_03BD8 UNK_ANSAUGLU_03BDA UNK_ANSAUGLU_03BDC UNK_ANSAUGLU_03BDE UNK_ANSAUGLU_03BDF UNK_ANSAUGLU_03C42 UNK_ANSAUGLU_03C44 UNK_ANSAUGLU_08844 UNK_ANSAUGLU_08846 UNK_ANSAUGLU_08918 UNK_ANSAUGLU_0891A UNK_QUALITT_008D4 UNK_QUALITT_00A3E UNK_QUALITT_00A40 UNK_QUALITT_00A44 UNK_QUALITT_00A45 UNK_QUALITT_00A4B UNK_QUALITT_00A4C UNK_QUALITT_00A4D UNK_QUALITT_067E2 UNK_QUALITT_067E4 UNK_QUALITT_06806 UNK_QUALITT_068F2 UNK_QUALITT_068F3 UNK_SCHALTER_084AE UNK_SCHALTER_08B3E UNK_SCHALTER_08B40 UNK_SCHALTER_08B41 UNK_SCHALTER_08B42 UNK_FAHRZEUG_0B066 UNK_FAHRZEUG_0B068 UNK_FAHRZEUG_0B06A UNK_FAHRZEUG_0B06C UNK_FAHRZEUG_0B06E UNK_FAHRZEUG_0B070 UNK_FAHRZEUG_0B072 UNK_FAHRZEUG_0B074 UNK_FAHRZEUG_0B076 UNK_FAHRZEUG_0B078 UNK_FAHRZEUG_0B07A UNK_FAHRZEUG_0B07C UNK_LADUNGSW_0A2B6 UNK_LADUNGSW_0A2B8 UNK_LTEMPER_08B51 UNK_BEGRENZU_0B686 UNK_ELEKTROL_0218C UNK_ELEKTROL_0218E UNK_ELEKTROL_05782 UNK_ELEKTROL_05786 UNK_ELEKTROL_05788 UNK_ELEKTROL_05B44 UNK_ELEKTROL_05B46 UNK_ELEKTROL_05B48 UNK_ELEKTROL_05B4A UNK_ELEKTROL_05B4B UNK_ELEKTROL_05B60 UNK_ELEKTROL_05C42 UNK_ELEKTROL_05C48 UNK_ELEKTROL_05C73 UNK_ELEKTROL_05CB8 UNK_ELEKTROL_05CBA UNK_GENERATO_06C1E UNK_GENERATO_06C22 UNK_GENERATO_06C26 UNK_MVAC_05F24 UNK_LAMBDAS_04CC6 UNK_LAMBDAS_0576C UNK_KATALYSA_0627E UNK_KATALYSA_07288 UNK_KATALYSA_0728A UNK_KATALYSA_0728C UNK_KATALYSA_0728E UNK_KATALYSA_07290 UNK_KATALYSA_07292 UNK_KATALYSA_07294 UNK_KATALYSA_07298 UNK_KATALYSA_0729A UNK_KATALYSA_0729C UNK_KATALYSA_0729E UNK_KATALYSA_072A1 UNK_KATALYSA_072A2 UNK_KATALYSA_072A3 UNK_KATALYSA_072A4 UNK_KATALYSA_072A5 UNK_KATALYSA_072A7 UNK_KATALYSA_072A8 UNK_KATALYSA_072A9 UNK_KATALYSA_072AA UNK_KATALYSA_072AB UNK_KATALYSA_072AC UNK_KATALYSA_072AD UNK_KATALYSA_072AE UNK_KATALYSA_072AF UNK_KATALYSA_072B0 UNK_KATALYSA_072B1 UNK_KATALYSA_072B2 UNK_KATALYSA_072B3 UNK_KATALYSA_072B4 UNK_KATALYSA_072B5 UNK_KATALYSA_072B6 UNK_KATALYSA_072B8 UNK_KATALYSA_072B9 UNK_KATALYSA_072BA UNK_KATALYSA_072BB UNK_KATALYSA_072BC UNK_KATALYSA_072BD UNK_KATALYSA_072BE UNK_KATALYSA_072BF UNK_KATALYSA_072C0 UNK_KATALYSA_072C1 UNK_KATALYSA_072C2 UNK_KATALYSA_072C3 UNK_KATALYSA_072C4 UNK_KATALYSA_072C5 UNK_KATALYSA_072C6 UNK_KATALYSA_072C7 UNK_KATALYSA_073C8 UNK_KATALYSA_073CA UNK_KATALYSA_073CC UNK_KATALYSA_073CD UNK_KATALYSA_073CE UNK_KATALYSA_073CF UNK_KATALYSA_073D0 UNK_KATALYSA_073D1 UNK_KATALYSA_073D2 UNK_KATALYSA_073D3 UNK_KATALYSA_073D4 UNK_LA_TRIM_0423A UNK_PKSR_PL_06E4A UNK_PKSR_PL_06E4C UNK_PKSR_PL_06E4E UNK_PKSR_PL_06E50 /end REF_CHARACTERISTIC
/end GROUP
/end MODULE
/end PROJECT
