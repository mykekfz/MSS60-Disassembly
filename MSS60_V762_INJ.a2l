ASAP2_VERSION 1 60
/begin PROJECT MSS60_V762_INJ "MSS60 (S65) V762 INJ CPU - generated 04.11.2026 from the reverse-engineered XDF"
/begin HEADER "Calibration description (characteristics from the XDF; measurements = V530 RAM names transferred to V762 addresses, confidence in each long identifier). Status tag in every long identifier: verified (checked against the code) / A2L-ref (placed from the V530 A2L) / EST (estimated) / unassigned (UNK placeholder)." VERSION "V762-RE-04112026" /end HEADER
/begin MODULE INJ "MSS60 V762 INJ"
/begin MOD_COMMON "" BYTE_ORDER MSB_FIRST ALIGNMENT_BYTE 1 ALIGNMENT_WORD 2 ALIGNMENT_LONG 4 /end MOD_COMMON
/begin CHARACTERISTIC K_ED_EV4.INC_VOR_EINTRAG "Fault code EV4 - debounce filter increment before fault-memory entry [verified]" VALUE 0x713F2 RL_VAL_UB 0 CM_0000 0 255 /end CHARACTERISTIC
/begin CHARACTERISTIC K_ED_EV4.KLASSENINDEX "Fault code EV4 - fault class selection (lamp / warning behaviour) [verified]" VALUE 0x713F6 RL_VAL_UB 0 CM_0000 0 255 /end CHARACTERISTIC
/begin CHARACTERISTIC K_ED_EV4.OK_SCHWELLE "Fault code EV4 - debounce filter threshold for clearing (healing) the fault [verified]" VALUE 0x713F1 RL_VAL_UB 0 CM_0000 0 255 /end CHARACTERISTIC
/begin CHARACTERISTIC K_ED_EV4.P_CODE_OPENLOAD "Fault code EV4 - OBD P-code reported for open circuit [verified]" VALUE 0x713EC RL_VAL_UW 0 CM_0000 0 65535 /end CHARACTERISTIC
/begin CHARACTERISTIC K_ED_EV4.P_CODE_SH_TO_GND "Fault code EV4 - OBD P-code reported for short to ground [verified]" VALUE 0x713EA RL_VAL_UW 0 CM_0000 0 65535 /end CHARACTERISTIC
/begin CHARACTERISTIC K_ED_EV4.P_CODE_SH_TO_UB "Fault code EV4 - OBD P-code reported for short to battery voltage [verified]" VALUE 0x713E8 RL_VAL_UW 0 CM_0000 0 65535 /end CHARACTERISTIC
/begin CHARACTERISTIC K_ED_EV4.P_CODE_UNPLAUSIBEL "Fault code EV4 - OBD P-code reported for implausible signal [verified]" VALUE 0x713EE RL_VAL_UW 0 CM_0000 0 65535 /end CHARACTERISTIC
/begin CHARACTERISTIC K_ED_EV5.DEC_NACH_EINTRAG "Fault code EV5 - debounce filter decrement after fault-memory entry [verified]" VALUE 0x7140F RL_VAL_UB 0 CM_0000 0 255 /end CHARACTERISTIC
/begin CHARACTERISTIC K_ED_EV5.DEC_VOR_EINTRAG "Fault code EV5 - debounce filter decrement before fault-memory entry [verified]" VALUE 0x7140D RL_VAL_UB 0 CM_0000 0 255 /end CHARACTERISTIC
/begin CHARACTERISTIC K_ED_EV5.FEHLERSCHWELLE "Fault code EV5 - debounce filter threshold for setting the fault [verified]" VALUE 0x7140A RL_VAL_UB 0 CM_0000 0 255 /end CHARACTERISTIC
/begin CHARACTERISTIC K_ED_EV5.INC_NACH_EINTRAG "Fault code EV5 - debounce filter increment after fault-memory entry [verified]" VALUE 0x7140E RL_VAL_UB 0 CM_0000 0 255 /end CHARACTERISTIC
/begin CHARACTERISTIC K_ED_EV5.INC_VOR_EINTRAG "Fault code EV5 - debounce filter increment before fault-memory entry [verified]" VALUE 0x7140C RL_VAL_UB 0 CM_0000 0 255 /end CHARACTERISTIC
/begin CHARACTERISTIC K_ED_EV5.KLASSENINDEX "Fault code EV5 - fault class selection (lamp / warning behaviour) [verified]" VALUE 0x71410 RL_VAL_UB 0 CM_0000 0 255 /end CHARACTERISTIC
/begin CHARACTERISTIC K_ED_EV5.OK_SCHWELLE "Fault code EV5 - debounce filter threshold for clearing (healing) the fault [verified]" VALUE 0x7140B RL_VAL_UB 0 CM_0000 0 255 /end CHARACTERISTIC
/begin CHARACTERISTIC K_ED_EV5.P_CODE_OPENLOAD "Fault code EV5 - OBD P-code reported for open circuit [verified]" VALUE 0x71406 RL_VAL_UW 0 CM_0000 0 65535 /end CHARACTERISTIC
/begin CHARACTERISTIC K_ED_EV5.P_CODE_SH_TO_GND "Fault code EV5 - OBD P-code reported for short to ground [verified]" VALUE 0x71404 RL_VAL_UW 0 CM_0000 0 65535 /end CHARACTERISTIC
/begin CHARACTERISTIC K_ED_EV5.P_CODE_SH_TO_UB "Fault code EV5 - OBD P-code reported for short to battery voltage [verified]" VALUE 0x71402 RL_VAL_UW 0 CM_0000 0 65535 /end CHARACTERISTIC
/begin CHARACTERISTIC K_ED_EV5.P_CODE_UNPLAUSIBEL "Fault code EV5 - OBD P-code reported for implausible signal [verified]" VALUE 0x71408 RL_VAL_UW 0 CM_0000 0 65535 /end CHARACTERISTIC
/begin CHARACTERISTIC K_ED_EV6.DEC_NACH_EINTRAG "Fault code EV6 - debounce filter decrement after fault-memory entry [verified]" VALUE 0x71429 RL_VAL_UB 0 CM_0000 0 255 /end CHARACTERISTIC
/begin CHARACTERISTIC K_ED_EV6.DEC_VOR_EINTRAG "Fault code EV6 - debounce filter decrement before fault-memory entry [verified]" VALUE 0x71427 RL_VAL_UB 0 CM_0000 0 255 /end CHARACTERISTIC
/begin CHARACTERISTIC K_ED_EV6.FEHLERSCHWELLE "Fault code EV6 - debounce filter threshold for setting the fault [verified]" VALUE 0x71424 RL_VAL_UB 0 CM_0000 0 255 /end CHARACTERISTIC
/begin CHARACTERISTIC K_ED_EV6.INC_NACH_EINTRAG "Fault code EV6 - debounce filter increment after fault-memory entry [verified]" VALUE 0x71428 RL_VAL_UB 0 CM_0000 0 255 /end CHARACTERISTIC
/begin CHARACTERISTIC K_ED_EV6.INC_VOR_EINTRAG "Fault code EV6 - debounce filter increment before fault-memory entry [verified]" VALUE 0x71426 RL_VAL_UB 0 CM_0000 0 255 /end CHARACTERISTIC
/begin CHARACTERISTIC K_ED_EV6.KLASSENINDEX "Fault code EV6 - fault class selection (lamp / warning behaviour) [verified]" VALUE 0x7142A RL_VAL_UB 0 CM_0000 0 255 /end CHARACTERISTIC
/begin CHARACTERISTIC K_ED_EV6.OK_SCHWELLE "Fault code EV6 - debounce filter threshold for clearing (healing) the fault [verified]" VALUE 0x71425 RL_VAL_UB 0 CM_0000 0 255 /end CHARACTERISTIC
/begin CHARACTERISTIC K_ED_EV6.P_CODE_OPENLOAD "Fault code EV6 - OBD P-code reported for open circuit [verified]" VALUE 0x71420 RL_VAL_UW 0 CM_0000 0 65535 /end CHARACTERISTIC
/begin CHARACTERISTIC K_ED_EV6.P_CODE_SH_TO_GND "Fault code EV6 - OBD P-code reported for short to ground [verified]" VALUE 0x7141E RL_VAL_UW 0 CM_0000 0 65535 /end CHARACTERISTIC
/begin CHARACTERISTIC K_ED_EV6.P_CODE_SH_TO_UB "Fault code EV6 - OBD P-code reported for short to battery voltage [verified]" VALUE 0x7141C RL_VAL_UW 0 CM_0000 0 65535 /end CHARACTERISTIC
/begin CHARACTERISTIC K_ED_EV6.P_CODE_UNPLAUSIBEL "Fault code EV6 - OBD P-code reported for implausible signal [verified]" VALUE 0x71422 RL_VAL_UW 0 CM_0000 0 65535 /end CHARACTERISTIC
/begin CHARACTERISTIC K_ED_EV7.DEC_NACH_EINTRAG "Fault code EV7 - debounce filter decrement after fault-memory entry [verified]" VALUE 0x71443 RL_VAL_UB 0 CM_0000 0 255 /end CHARACTERISTIC
/begin CHARACTERISTIC K_ED_EV7.DEC_VOR_EINTRAG "Fault code EV7 - debounce filter decrement before fault-memory entry [verified]" VALUE 0x71441 RL_VAL_UB 0 CM_0000 0 255 /end CHARACTERISTIC
/begin CHARACTERISTIC K_ED_EV7.FEHLERSCHWELLE "Fault code EV7 - debounce filter threshold for setting the fault [verified]" VALUE 0x7143E RL_VAL_UB 0 CM_0000 0 255 /end CHARACTERISTIC
/begin CHARACTERISTIC K_ED_EV7.INC_NACH_EINTRAG "Fault code EV7 - debounce filter increment after fault-memory entry [verified]" VALUE 0x71442 RL_VAL_UB 0 CM_0000 0 255 /end CHARACTERISTIC
/begin CHARACTERISTIC K_ED_EV7.INC_VOR_EINTRAG "Fault code EV7 - debounce filter increment before fault-memory entry [verified]" VALUE 0x71440 RL_VAL_UB 0 CM_0000 0 255 /end CHARACTERISTIC
/begin CHARACTERISTIC K_ED_EV7.KLASSENINDEX "Fault code EV7 - fault class selection (lamp / warning behaviour) [verified]" VALUE 0x71444 RL_VAL_UB 0 CM_0000 0 255 /end CHARACTERISTIC
/begin CHARACTERISTIC K_ED_EV7.OK_SCHWELLE "Fault code EV7 - debounce filter threshold for clearing (healing) the fault [verified]" VALUE 0x7143F RL_VAL_UB 0 CM_0000 0 255 /end CHARACTERISTIC
/begin CHARACTERISTIC K_ED_EV7.P_CODE_OPENLOAD "Fault code EV7 - OBD P-code reported for open circuit [verified]" VALUE 0x7143A RL_VAL_UW 0 CM_0000 0 65535 /end CHARACTERISTIC
/begin CHARACTERISTIC K_ED_EV7.P_CODE_SH_TO_GND "Fault code EV7 - OBD P-code reported for short to ground [verified]" VALUE 0x71438 RL_VAL_UW 0 CM_0000 0 65535 /end CHARACTERISTIC
/begin CHARACTERISTIC K_ED_EV7.P_CODE_SH_TO_UB "Fault code EV7 - OBD P-code reported for short to battery voltage [verified]" VALUE 0x71436 RL_VAL_UW 0 CM_0000 0 65535 /end CHARACTERISTIC
/begin CHARACTERISTIC K_ED_EV7.P_CODE_UNPLAUSIBEL "Fault code EV7 - OBD P-code reported for implausible signal [verified]" VALUE 0x7143C RL_VAL_UW 0 CM_0000 0 65535 /end CHARACTERISTIC
/begin CHARACTERISTIC K_ED_EV8.DEC_NACH_EINTRAG "Fault code EV8 - debounce filter decrement after fault-memory entry [verified]" VALUE 0x7145D RL_VAL_UB 0 CM_0000 0 255 /end CHARACTERISTIC
/begin CHARACTERISTIC K_ED_EV8.DEC_VOR_EINTRAG "Fault code EV8 - debounce filter decrement before fault-memory entry [verified]" VALUE 0x7145B RL_VAL_UB 0 CM_0000 0 255 /end CHARACTERISTIC
/begin CHARACTERISTIC K_ED_EV8.FEHLERSCHWELLE "Fault code EV8 - debounce filter threshold for setting the fault [verified]" VALUE 0x71458 RL_VAL_UB 0 CM_0000 0 255 /end CHARACTERISTIC
/begin CHARACTERISTIC K_ED_EV8.INC_NACH_EINTRAG "Fault code EV8 - debounce filter increment after fault-memory entry [verified]" VALUE 0x7145C RL_VAL_UB 0 CM_0000 0 255 /end CHARACTERISTIC
/begin CHARACTERISTIC K_ED_EV8.INC_VOR_EINTRAG "Fault code EV8 - debounce filter increment before fault-memory entry [verified]" VALUE 0x7145A RL_VAL_UB 0 CM_0000 0 255 /end CHARACTERISTIC
/begin CHARACTERISTIC K_ED_EV8.KLASSENINDEX "Fault code EV8 - fault class selection (lamp / warning behaviour) [verified]" VALUE 0x7145E RL_VAL_UB 0 CM_0000 0 255 /end CHARACTERISTIC
/begin CHARACTERISTIC K_ED_EV8.OK_SCHWELLE "Fault code EV8 - debounce filter threshold for clearing (healing) the fault [verified]" VALUE 0x71459 RL_VAL_UB 0 CM_0000 0 255 /end CHARACTERISTIC
/begin CHARACTERISTIC K_ED_EV8.P_CODE_OPENLOAD "Fault code EV8 - OBD P-code reported for open circuit [verified]" VALUE 0x71454 RL_VAL_UW 0 CM_0000 0 65535 /end CHARACTERISTIC
/begin CHARACTERISTIC K_ED_EV8.P_CODE_SH_TO_GND "Fault code EV8 - OBD P-code reported for short to ground [verified]" VALUE 0x71452 RL_VAL_UW 0 CM_0000 0 65535 /end CHARACTERISTIC
/begin CHARACTERISTIC K_ED_EV8.P_CODE_SH_TO_UB "Fault code EV8 - OBD P-code reported for short to battery voltage [verified]" VALUE 0x71450 RL_VAL_UW 0 CM_0000 0 65535 /end CHARACTERISTIC
/begin CHARACTERISTIC K_ED_EV8.P_CODE_UNPLAUSIBEL "Fault code EV8 - OBD P-code reported for implausible signal [verified]" VALUE 0x71456 RL_VAL_UW 0 CM_0000 0 65535 /end CHARACTERISTIC
/begin CHARACTERISTIC K_ED_EV9.DEC_NACH_EINTRAG "Fault code EV9 - debounce filter decrement after fault-memory entry [verified]" VALUE 0x71477 RL_VAL_UB 0 CM_0000 0 255 /end CHARACTERISTIC
/begin CHARACTERISTIC K_ED_EV9.DEC_VOR_EINTRAG "Fault code EV9 - debounce filter decrement before fault-memory entry [verified]" VALUE 0x71475 RL_VAL_UB 0 CM_0000 0 255 /end CHARACTERISTIC
/begin CHARACTERISTIC K_ED_EV9.FEHLERSCHWELLE "Fault code EV9 - debounce filter threshold for setting the fault [verified]" VALUE 0x71472 RL_VAL_UB 0 CM_0000 0 255 /end CHARACTERISTIC
/begin CHARACTERISTIC K_ED_EV9.INC_NACH_EINTRAG "Fault code EV9 - debounce filter increment after fault-memory entry [verified]" VALUE 0x71476 RL_VAL_UB 0 CM_0000 0 255 /end CHARACTERISTIC
/begin CHARACTERISTIC K_ED_EV9.INC_VOR_EINTRAG "Fault code EV9 - debounce filter increment before fault-memory entry [verified]" VALUE 0x71474 RL_VAL_UB 0 CM_0000 0 255 /end CHARACTERISTIC
/begin CHARACTERISTIC K_ED_EV9.KLASSENINDEX "Fault code EV9 - fault class selection (lamp / warning behaviour) [verified]" VALUE 0x71478 RL_VAL_UB 0 CM_0000 0 255 /end CHARACTERISTIC
/begin CHARACTERISTIC K_ED_EV9.OK_SCHWELLE "Fault code EV9 - debounce filter threshold for clearing (healing) the fault [verified]" VALUE 0x71473 RL_VAL_UB 0 CM_0000 0 255 /end CHARACTERISTIC
/begin CHARACTERISTIC K_ED_EV9.P_CODE_OPENLOAD "Fault code EV9 - OBD P-code reported for open circuit [verified]" VALUE 0x7146E RL_VAL_UW 0 CM_0000 0 65535 /end CHARACTERISTIC
/begin CHARACTERISTIC K_ED_EV9.P_CODE_SH_TO_GND "Fault code EV9 - OBD P-code reported for short to ground [verified]" VALUE 0x7146C RL_VAL_UW 0 CM_0000 0 65535 /end CHARACTERISTIC
/begin CHARACTERISTIC K_ED_EV9.P_CODE_SH_TO_UB "Fault code EV9 - OBD P-code reported for short to battery voltage [verified]" VALUE 0x7146A RL_VAL_UW 0 CM_0000 0 65535 /end CHARACTERISTIC
/begin CHARACTERISTIC K_ED_EV9.P_CODE_UNPLAUSIBEL "Fault code EV9 - OBD P-code reported for implausible signal [verified]" VALUE 0x71470 RL_VAL_UW 0 CM_0000 0 65535 /end CHARACTERISTIC
/begin CHARACTERISTIC K_ED_EWS_MAN.DEC_NACH_EINTRAG "Fault code EWS_MAN - debounce filter decrement after fault-memory entry [verified]" VALUE 0x718BB RL_VAL_UB 0 CM_0000 0 255 /end CHARACTERISTIC
/begin CHARACTERISTIC K_ED_EWS_MAN.DEC_VOR_EINTRAG "Fault code EWS_MAN - debounce filter decrement before fault-memory entry [verified]" VALUE 0x718B9 RL_VAL_UB 0 CM_0000 0 255 /end CHARACTERISTIC
/begin CHARACTERISTIC K_ED_EWS_MAN.FEHLERSCHWELLE "Fault code EWS_MAN - debounce filter threshold for setting the fault [verified]" VALUE 0x718B6 RL_VAL_UB 0 CM_0000 0 255 /end CHARACTERISTIC
/begin CHARACTERISTIC K_ED_EWS_MAN.INC_NACH_EINTRAG "Fault code EWS_MAN - debounce filter increment after fault-memory entry [verified]" VALUE 0x718BA RL_VAL_UB 0 CM_0000 0 255 /end CHARACTERISTIC
/begin CHARACTERISTIC K_ED_EWS_MAN.INC_VOR_EINTRAG "Fault code EWS_MAN - debounce filter increment before fault-memory entry [verified]" VALUE 0x718B8 RL_VAL_UB 0 CM_0000 0 255 /end CHARACTERISTIC
/begin CHARACTERISTIC K_ED_EWS_MAN.KLASSENINDEX "Fault code EWS_MAN - fault class selection (lamp / warning behaviour) [verified]" VALUE 0x718BC RL_VAL_UB 0 CM_0000 0 255 /end CHARACTERISTIC
/begin CHARACTERISTIC K_ED_EWS_MAN.OK_SCHWELLE "Fault code EWS_MAN - debounce filter threshold for clearing (healing) the fault [verified]" VALUE 0x718B7 RL_VAL_UB 0 CM_0000 0 255 /end CHARACTERISTIC
/begin CHARACTERISTIC K_ED_EWS_MAN.P_CODE_OPENLOAD "Fault code EWS_MAN - OBD P-code reported for open circuit [verified]" VALUE 0x718B2 RL_VAL_UW 0 CM_0000 0 65535 /end CHARACTERISTIC
/begin CHARACTERISTIC K_ED_EWS_MAN.P_CODE_SH_TO_GND "Fault code EWS_MAN - OBD P-code reported for short to ground [verified]" VALUE 0x718B0 RL_VAL_UW 0 CM_0000 0 65535 /end CHARACTERISTIC
/begin CHARACTERISTIC K_ED_EWS_MAN.P_CODE_SH_TO_UB "Fault code EWS_MAN - OBD P-code reported for short to battery voltage [verified]" VALUE 0x718AE RL_VAL_UW 0 CM_0000 0 65535 /end CHARACTERISTIC
/begin CHARACTERISTIC K_ED_EWS_MAN.P_CODE_UNPLAUSIBEL "Fault code EWS_MAN - OBD P-code reported for implausible signal [verified]" VALUE 0x718B4 RL_VAL_UW 0 CM_0000 0 65535 /end CHARACTERISTIC
/begin CHARACTERISTIC K_ED_EWS_SCI.DEC_NACH_EINTRAG "Fault code EWS_SCI - debounce filter decrement after fault-memory entry [verified]" VALUE 0x718A1 RL_VAL_UB 0 CM_0000 0 255 /end CHARACTERISTIC
/begin CHARACTERISTIC K_ED_EWS_SCI.DEC_VOR_EINTRAG "Fault code EWS_SCI - debounce filter decrement before fault-memory entry [verified]" VALUE 0x7189F RL_VAL_UB 0 CM_0000 0 255 /end CHARACTERISTIC
/begin CHARACTERISTIC K_ED_EWS_SCI.FEHLERSCHWELLE "Fault code EWS_SCI - debounce filter threshold for setting the fault [verified]" VALUE 0x7189C RL_VAL_UB 0 CM_0000 0 255 /end CHARACTERISTIC
/begin CHARACTERISTIC K_ED_EWS_SCI.INC_NACH_EINTRAG "Fault code EWS_SCI - debounce filter increment after fault-memory entry [verified]" VALUE 0x718A0 RL_VAL_UB 0 CM_0000 0 255 /end CHARACTERISTIC
/begin CHARACTERISTIC K_ED_EWS_SCI.INC_VOR_EINTRAG "Fault code EWS_SCI - debounce filter increment before fault-memory entry [verified]" VALUE 0x7189E RL_VAL_UB 0 CM_0000 0 255 /end CHARACTERISTIC
/begin CHARACTERISTIC K_ED_EWS_SCI.KLASSENINDEX "Fault code EWS_SCI - fault class selection (lamp / warning behaviour) [verified]" VALUE 0x718A2 RL_VAL_UB 0 CM_0000 0 255 /end CHARACTERISTIC
/begin CHARACTERISTIC K_ED_EWS_SCI.OK_SCHWELLE "Fault code EWS_SCI - debounce filter threshold for clearing (healing) the fault [verified]" VALUE 0x7189D RL_VAL_UB 0 CM_0000 0 255 /end CHARACTERISTIC
/begin CHARACTERISTIC K_ED_EWS_SCI.P_CODE_OPENLOAD "Fault code EWS_SCI - OBD P-code reported for open circuit [verified]" VALUE 0x71898 RL_VAL_UW 0 CM_0000 0 65535 /end CHARACTERISTIC
/begin CHARACTERISTIC K_ED_EWS_SCI.P_CODE_SH_TO_GND "Fault code EWS_SCI - OBD P-code reported for short to ground [verified]" VALUE 0x71896 RL_VAL_UW 0 CM_0000 0 65535 /end CHARACTERISTIC
/begin CHARACTERISTIC K_ED_EWS_SCI.P_CODE_SH_TO_UB "Fault code EWS_SCI - OBD P-code reported for short to battery voltage [verified]" VALUE 0x71894 RL_VAL_UW 0 CM_0000 0 65535 /end CHARACTERISTIC
/begin CHARACTERISTIC K_ED_EWS_SCI.P_CODE_UNPLAUSIBEL "Fault code EWS_SCI - OBD P-code reported for implausible signal [verified]" VALUE 0x7189A RL_VAL_UW 0 CM_0000 0 65535 /end CHARACTERISTIC
/begin CHARACTERISTIC K_ED_FETRAWE.DEC_NACH_EINTRAG "Fault code FETRAWE - debounce filter decrement after fault-memory entry [verified]" VALUE 0x71B5F RL_VAL_UB 0 CM_0000 0 255 /end CHARACTERISTIC
/begin CHARACTERISTIC K_ED_FETRAWE.DEC_VOR_EINTRAG "Fault code FETRAWE - debounce filter decrement before fault-memory entry [verified]" VALUE 0x71B5D RL_VAL_UB 0 CM_0000 0 255 /end CHARACTERISTIC
/begin CHARACTERISTIC K_ED_FETRAWE.FEHLERSCHWELLE "Fault code FETRAWE - debounce filter threshold for setting the fault [verified]" VALUE 0x71B5A RL_VAL_UB 0 CM_0000 0 255 /end CHARACTERISTIC
/begin CHARACTERISTIC K_ED_FETRAWE.INC_NACH_EINTRAG "Fault code FETRAWE - debounce filter increment after fault-memory entry [verified]" VALUE 0x71B5E RL_VAL_UB 0 CM_0000 0 255 /end CHARACTERISTIC
/begin CHARACTERISTIC K_ED_FETRAWE.INC_VOR_EINTRAG "Fault code FETRAWE - debounce filter increment before fault-memory entry [verified]" VALUE 0x71B5C RL_VAL_UB 0 CM_0000 0 255 /end CHARACTERISTIC
/begin CHARACTERISTIC K_ED_FETRAWE.KLASSENINDEX "Fault code FETRAWE - fault class selection (lamp / warning behaviour) [verified]" VALUE 0x71B60 RL_VAL_UB 0 CM_0000 0 255 /end CHARACTERISTIC
/begin CHARACTERISTIC K_ED_FETRAWE.OK_SCHWELLE "Fault code FETRAWE - debounce filter threshold for clearing (healing) the fault [verified]" VALUE 0x71B5B RL_VAL_UB 0 CM_0000 0 255 /end CHARACTERISTIC
/begin CHARACTERISTIC K_ED_FETRAWE.P_CODE_OPENLOAD "Fault code FETRAWE - OBD P-code reported for open circuit [verified]" VALUE 0x71B56 RL_VAL_UW 0 CM_0000 0 65535 /end CHARACTERISTIC
/begin CHARACTERISTIC K_ED_FETRAWE.P_CODE_SH_TO_GND "Fault code FETRAWE - OBD P-code reported for short to ground [verified]" VALUE 0x71B54 RL_VAL_UW 0 CM_0000 0 65535 /end CHARACTERISTIC
/begin CHARACTERISTIC K_ED_FETRAWE.P_CODE_SH_TO_UB "Fault code FETRAWE - OBD P-code reported for short to battery voltage [verified]" VALUE 0x71B52 RL_VAL_UW 0 CM_0000 0 65535 /end CHARACTERISTIC
/begin CHARACTERISTIC K_ED_FETRAWE.P_CODE_UNPLAUSIBEL "Fault code FETRAWE - OBD P-code reported for implausible signal [verified]" VALUE 0x71B58 RL_VAL_UW 0 CM_0000 0 65535 /end CHARACTERISTIC
/begin CHARACTERISTIC K_ED_FI_BSD.DEC_NACH_EINTRAG "Fault code FI_BSD - debounce filter decrement after fault-memory entry [verified]" VALUE 0x71783 RL_VAL_UB 0 CM_0000 0 255 /end CHARACTERISTIC
/begin CHARACTERISTIC K_ED_FI_BSD.DEC_VOR_EINTRAG "Fault code FI_BSD - debounce filter decrement before fault-memory entry [verified]" VALUE 0x71781 RL_VAL_UB 0 CM_0000 0 255 /end CHARACTERISTIC
/begin CHARACTERISTIC K_ED_FI_BSD.FEHLERSCHWELLE "Fault code FI_BSD - debounce filter threshold for setting the fault [verified]" VALUE 0x7177E RL_VAL_UB 0 CM_0000 0 255 /end CHARACTERISTIC
/begin CHARACTERISTIC K_ED_FI_BSD.INC_NACH_EINTRAG "Fault code FI_BSD - debounce filter increment after fault-memory entry [verified]" VALUE 0x71782 RL_VAL_UB 0 CM_0000 0 255 /end CHARACTERISTIC
/begin CHARACTERISTIC K_ED_FI_BSD.INC_VOR_EINTRAG "Fault code FI_BSD - debounce filter increment before fault-memory entry [verified]" VALUE 0x71780 RL_VAL_UB 0 CM_0000 0 255 /end CHARACTERISTIC
/begin CHARACTERISTIC K_ED_FI_BSD.KLASSENINDEX "Fault code FI_BSD - fault class selection (lamp / warning behaviour) [verified]" VALUE 0x71784 RL_VAL_UB 0 CM_0000 0 255 /end CHARACTERISTIC
/begin CHARACTERISTIC K_ED_FI_BSD.OK_SCHWELLE "Fault code FI_BSD - debounce filter threshold for clearing (healing) the fault [verified]" VALUE 0x7177F RL_VAL_UB 0 CM_0000 0 255 /end CHARACTERISTIC
/begin CHARACTERISTIC K_ED_FI_BSD.P_CODE_OPENLOAD "Fault code FI_BSD - OBD P-code reported for open circuit [verified]" VALUE 0x7177A RL_VAL_UW 0 CM_0000 0 65535 /end CHARACTERISTIC
/begin CHARACTERISTIC K_ED_FI_BSD.P_CODE_SH_TO_GND "Fault code FI_BSD - OBD P-code reported for short to ground [verified]" VALUE 0x71778 RL_VAL_UW 0 CM_0000 0 65535 /end CHARACTERISTIC
/begin CHARACTERISTIC K_ED_FI_BSD.P_CODE_SH_TO_UB "Fault code FI_BSD - OBD P-code reported for short to battery voltage [verified]" VALUE 0x71776 RL_VAL_UW 0 CM_0000 0 65535 /end CHARACTERISTIC
/begin CHARACTERISTIC K_ED_FI_BSD.P_CODE_UNPLAUSIBEL "Fault code FI_BSD - OBD P-code reported for implausible signal [verified]" VALUE 0x7177C RL_VAL_UW 0 CM_0000 0 65535 /end CHARACTERISTIC
/begin CHARACTERISTIC K_ED_FI_BSDGLOB.DEC_NACH_EINTRAG "Fault code FI_BSDGLOB - debounce filter decrement after fault-memory entry [verified]" VALUE 0x71909 RL_VAL_UB 0 CM_0000 0 255 /end CHARACTERISTIC
/begin CHARACTERISTIC K_ED_FI_BSDGLOB.DEC_VOR_EINTRAG "Fault code FI_BSDGLOB - debounce filter decrement before fault-memory entry [verified]" VALUE 0x71907 RL_VAL_UB 0 CM_0000 0 255 /end CHARACTERISTIC
/begin CHARACTERISTIC K_ED_FI_BSDGLOB.FEHLERSCHWELLE "Fault code FI_BSDGLOB - debounce filter threshold for setting the fault [verified]" VALUE 0x71904 RL_VAL_UB 0 CM_0000 0 255 /end CHARACTERISTIC
/begin CHARACTERISTIC K_ED_FI_BSDGLOB.INC_NACH_EINTRAG "Fault code FI_BSDGLOB - debounce filter increment after fault-memory entry [verified]" VALUE 0x71908 RL_VAL_UB 0 CM_0000 0 255 /end CHARACTERISTIC
/begin CHARACTERISTIC K_ED_FI_BSDGLOB.INC_VOR_EINTRAG "Fault code FI_BSDGLOB - debounce filter increment before fault-memory entry [verified]" VALUE 0x71906 RL_VAL_UB 0 CM_0000 0 255 /end CHARACTERISTIC
/begin CHARACTERISTIC K_ED_FI_BSDGLOB.KLASSENINDEX "Fault code FI_BSDGLOB - fault class selection (lamp / warning behaviour) [verified]" VALUE 0x7190A RL_VAL_UB 0 CM_0000 0 255 /end CHARACTERISTIC
/begin CHARACTERISTIC K_ED_FI_BSDGLOB.OK_SCHWELLE "Fault code FI_BSDGLOB - debounce filter threshold for clearing (healing) the fault [verified]" VALUE 0x71905 RL_VAL_UB 0 CM_0000 0 255 /end CHARACTERISTIC
/begin CHARACTERISTIC K_ED_FI_BSDGLOB.P_CODE_OPENLOAD "Fault code FI_BSDGLOB - OBD P-code reported for open circuit [verified]" VALUE 0x71900 RL_VAL_UW 0 CM_0000 0 65535 /end CHARACTERISTIC
/begin CHARACTERISTIC K_ED_FI_BSDGLOB.P_CODE_SH_TO_GND "Fault code FI_BSDGLOB - OBD P-code reported for short to ground [verified]" VALUE 0x718FE RL_VAL_UW 0 CM_0000 0 65535 /end CHARACTERISTIC
/begin CHARACTERISTIC K_ED_FI_BSDGLOB.P_CODE_SH_TO_UB "Fault code FI_BSDGLOB - OBD P-code reported for short to battery voltage [verified]" VALUE 0x718FC RL_VAL_UW 0 CM_0000 0 65535 /end CHARACTERISTIC
/begin CHARACTERISTIC K_ED_FI_BSDGLOB.P_CODE_UNPLAUSIBEL "Fault code FI_BSDGLOB - OBD P-code reported for implausible signal [verified]" VALUE 0x71902 RL_VAL_UW 0 CM_0000 0 65535 /end CHARACTERISTIC
/begin CHARACTERISTIC K_ED_FI_BSD_0.DEC_NACH_EINTRAG "Fault code FI_BSD_0 - debounce filter decrement after fault-memory entry [verified]" VALUE 0x718D5 RL_VAL_UB 0 CM_0000 0 255 /end CHARACTERISTIC
/begin CHARACTERISTIC K_ED_FI_BSD_0.DEC_VOR_EINTRAG "Fault code FI_BSD_0 - debounce filter decrement before fault-memory entry [verified]" VALUE 0x718D3 RL_VAL_UB 0 CM_0000 0 255 /end CHARACTERISTIC
/begin CHARACTERISTIC K_ED_FI_BSD_0.FEHLERSCHWELLE "Fault code FI_BSD_0 - debounce filter threshold for setting the fault [verified]" VALUE 0x718D0 RL_VAL_UB 0 CM_0000 0 255 /end CHARACTERISTIC
/begin CHARACTERISTIC K_ED_FI_BSD_0.INC_NACH_EINTRAG "Fault code FI_BSD_0 - debounce filter increment after fault-memory entry [verified]" VALUE 0x718D4 RL_VAL_UB 0 CM_0000 0 255 /end CHARACTERISTIC
/begin CHARACTERISTIC K_ED_FI_BSD_0.INC_VOR_EINTRAG "Fault code FI_BSD_0 - debounce filter increment before fault-memory entry [verified]" VALUE 0x718D2 RL_VAL_UB 0 CM_0000 0 255 /end CHARACTERISTIC
/begin CHARACTERISTIC K_ED_FI_BSD_0.KLASSENINDEX "Fault code FI_BSD_0 - fault class selection (lamp / warning behaviour) [verified]" VALUE 0x718D6 RL_VAL_UB 0 CM_0000 0 255 /end CHARACTERISTIC
/begin CHARACTERISTIC K_ED_FI_BSD_0.OK_SCHWELLE "Fault code FI_BSD_0 - debounce filter threshold for clearing (healing) the fault [verified]" VALUE 0x718D1 RL_VAL_UB 0 CM_0000 0 255 /end CHARACTERISTIC
/begin CHARACTERISTIC K_ED_FI_BSD_0.P_CODE_OPENLOAD "Fault code FI_BSD_0 - OBD P-code reported for open circuit [verified]" VALUE 0x718CC RL_VAL_UW 0 CM_0000 0 65535 /end CHARACTERISTIC
/begin CHARACTERISTIC K_ED_FI_BSD_0.P_CODE_SH_TO_GND "Fault code FI_BSD_0 - OBD P-code reported for short to ground [verified]" VALUE 0x718CA RL_VAL_UW 0 CM_0000 0 65535 /end CHARACTERISTIC
/begin CHARACTERISTIC K_ED_FI_BSD_0.P_CODE_SH_TO_UB "Fault code FI_BSD_0 - OBD P-code reported for short to battery voltage [verified]" VALUE 0x718C8 RL_VAL_UW 0 CM_0000 0 65535 /end CHARACTERISTIC
/begin CHARACTERISTIC K_ED_FI_BSD_0.P_CODE_UNPLAUSIBEL "Fault code FI_BSD_0 - OBD P-code reported for implausible signal [verified]" VALUE 0x718CE RL_VAL_UW 0 CM_0000 0 65535 /end CHARACTERISTIC
/begin CHARACTERISTIC K_ED_FI_BSD_6.DEC_NACH_EINTRAG "Fault code FI_BSD_6 - debounce filter decrement after fault-memory entry [verified]" VALUE 0x718EF RL_VAL_UB 0 CM_0000 0 255 /end CHARACTERISTIC
/begin CHARACTERISTIC K_ED_FI_BSD_6.DEC_VOR_EINTRAG "Fault code FI_BSD_6 - debounce filter decrement before fault-memory entry [verified]" VALUE 0x718ED RL_VAL_UB 0 CM_0000 0 255 /end CHARACTERISTIC
/begin CHARACTERISTIC K_ED_FI_BSD_6.FEHLERSCHWELLE "Fault code FI_BSD_6 - debounce filter threshold for setting the fault [verified]" VALUE 0x718EA RL_VAL_UB 0 CM_0000 0 255 /end CHARACTERISTIC
/begin CHARACTERISTIC K_ED_FI_BSD_6.INC_NACH_EINTRAG "Fault code FI_BSD_6 - debounce filter increment after fault-memory entry [verified]" VALUE 0x718EE RL_VAL_UB 0 CM_0000 0 255 /end CHARACTERISTIC
/begin CHARACTERISTIC K_ED_FI_BSD_6.INC_VOR_EINTRAG "Fault code FI_BSD_6 - debounce filter increment before fault-memory entry [verified]" VALUE 0x718EC RL_VAL_UB 0 CM_0000 0 255 /end CHARACTERISTIC
/begin CHARACTERISTIC K_ED_FI_BSD_6.KLASSENINDEX "Fault code FI_BSD_6 - fault class selection (lamp / warning behaviour) [verified]" VALUE 0x718F0 RL_VAL_UB 0 CM_0000 0 255 /end CHARACTERISTIC
/begin CHARACTERISTIC K_ED_FI_BSD_6.OK_SCHWELLE "Fault code FI_BSD_6 - debounce filter threshold for clearing (healing) the fault [verified]" VALUE 0x718EB RL_VAL_UB 0 CM_0000 0 255 /end CHARACTERISTIC
/begin CHARACTERISTIC K_ED_FI_BSD_6.P_CODE_OPENLOAD "Fault code FI_BSD_6 - OBD P-code reported for open circuit [verified]" VALUE 0x718E6 RL_VAL_UW 0 CM_0000 0 65535 /end CHARACTERISTIC
/begin CHARACTERISTIC K_ED_FI_BSD_6.P_CODE_SH_TO_GND "Fault code FI_BSD_6 - OBD P-code reported for short to ground [verified]" VALUE 0x718E4 RL_VAL_UW 0 CM_0000 0 65535 /end CHARACTERISTIC
/begin CHARACTERISTIC K_ED_FI_BSD_6.P_CODE_SH_TO_UB "Fault code FI_BSD_6 - OBD P-code reported for short to battery voltage [verified]" VALUE 0x718E2 RL_VAL_UW 0 CM_0000 0 65535 /end CHARACTERISTIC
/begin CHARACTERISTIC K_ED_FI_BSD_6.P_CODE_UNPLAUSIBEL "Fault code FI_BSD_6 - OBD P-code reported for implausible signal [verified]" VALUE 0x718E8 RL_VAL_UW 0 CM_0000 0 65535 /end CHARACTERISTIC
/begin CHARACTERISTIC K_ED_FI_GEN.DEC_NACH_EINTRAG "Fault code FI_GEN - debounce filter decrement after fault-memory entry [verified]" VALUE 0x71769 RL_VAL_UB 0 CM_0000 0 255 /end CHARACTERISTIC
/begin CHARACTERISTIC K_ED_FI_GEN.DEC_VOR_EINTRAG "Fault code FI_GEN - debounce filter decrement before fault-memory entry [verified]" VALUE 0x71767 RL_VAL_UB 0 CM_0000 0 255 /end CHARACTERISTIC
/begin CHARACTERISTIC K_ED_FI_GEN.FEHLERSCHWELLE "Fault code FI_GEN - debounce filter threshold for setting the fault [verified]" VALUE 0x71764 RL_VAL_UB 0 CM_0000 0 255 /end CHARACTERISTIC
/begin CHARACTERISTIC K_ED_FI_GEN.INC_NACH_EINTRAG "Fault code FI_GEN - debounce filter increment after fault-memory entry [verified]" VALUE 0x71768 RL_VAL_UB 0 CM_0000 0 255 /end CHARACTERISTIC
/begin CHARACTERISTIC K_ED_FI_GEN.INC_VOR_EINTRAG "Fault code FI_GEN - debounce filter increment before fault-memory entry [verified]" VALUE 0x71766 RL_VAL_UB 0 CM_0000 0 255 /end CHARACTERISTIC
/begin CHARACTERISTIC K_ED_FI_GEN.KLASSENINDEX "Fault code FI_GEN - fault class selection (lamp / warning behaviour) [verified]" VALUE 0x7176A RL_VAL_UB 0 CM_0000 0 255 /end CHARACTERISTIC
/begin CHARACTERISTIC K_ED_FI_GEN.OK_SCHWELLE "Fault code FI_GEN - debounce filter threshold for clearing (healing) the fault [verified]" VALUE 0x71765 RL_VAL_UB 0 CM_0000 0 255 /end CHARACTERISTIC
/begin CHARACTERISTIC K_ED_FI_GEN.P_CODE_OPENLOAD "Fault code FI_GEN - OBD P-code reported for open circuit [verified]" VALUE 0x71760 RL_VAL_UW 0 CM_0000 0 65535 /end CHARACTERISTIC
/begin CHARACTERISTIC K_ED_FI_GEN.P_CODE_SH_TO_GND "Fault code FI_GEN - OBD P-code reported for short to ground [verified]" VALUE 0x7175E RL_VAL_UW 0 CM_0000 0 65535 /end CHARACTERISTIC
/begin CHARACTERISTIC K_ED_FI_GEN.P_CODE_SH_TO_UB "Fault code FI_GEN - OBD P-code reported for short to battery voltage [verified]" VALUE 0x7175C RL_VAL_UW 0 CM_0000 0 65535 /end CHARACTERISTIC
/begin CHARACTERISTIC K_ED_FI_GEN.P_CODE_UNPLAUSIBEL "Fault code FI_GEN - OBD P-code reported for implausible signal [verified]" VALUE 0x71762 RL_VAL_UW 0 CM_0000 0 65535 /end CHARACTERISTIC
/begin CHARACTERISTIC K_ED_FI_IBS1.DEC_NACH_EINTRAG "Fault code FI_IBS1 - debounce filter decrement after fault-memory entry [verified]" VALUE 0x717B7 RL_VAL_UB 0 CM_0000 0 255 /end CHARACTERISTIC
/begin CHARACTERISTIC K_ED_FI_IBS1.DEC_VOR_EINTRAG "Fault code FI_IBS1 - debounce filter decrement before fault-memory entry [verified]" VALUE 0x717B5 RL_VAL_UB 0 CM_0000 0 255 /end CHARACTERISTIC
/begin CHARACTERISTIC K_ED_FI_IBS1.FEHLERSCHWELLE "Fault code FI_IBS1 - debounce filter threshold for setting the fault [verified]" VALUE 0x717B2 RL_VAL_UB 0 CM_0000 0 255 /end CHARACTERISTIC
/begin CHARACTERISTIC K_ED_FI_IBS1.INC_NACH_EINTRAG "Fault code FI_IBS1 - debounce filter increment after fault-memory entry [verified]" VALUE 0x717B6 RL_VAL_UB 0 CM_0000 0 255 /end CHARACTERISTIC
/begin CHARACTERISTIC K_ED_FI_IBS1.INC_VOR_EINTRAG "Fault code FI_IBS1 - debounce filter increment before fault-memory entry [verified]" VALUE 0x717B4 RL_VAL_UB 0 CM_0000 0 255 /end CHARACTERISTIC
/begin CHARACTERISTIC K_ED_FI_IBS1.KLASSENINDEX "Fault code FI_IBS1 - fault class selection (lamp / warning behaviour) [verified]" VALUE 0x717B8 RL_VAL_UB 0 CM_0000 0 255 /end CHARACTERISTIC
/begin CHARACTERISTIC K_ED_FI_IBS1.OK_SCHWELLE "Fault code FI_IBS1 - debounce filter threshold for clearing (healing) the fault [verified]" VALUE 0x717B3 RL_VAL_UB 0 CM_0000 0 255 /end CHARACTERISTIC
/begin CHARACTERISTIC K_ED_FI_IBS1.P_CODE_OPENLOAD "Fault code FI_IBS1 - OBD P-code reported for open circuit [verified]" VALUE 0x717AE RL_VAL_UW 0 CM_0000 0 65535 /end CHARACTERISTIC
/begin CHARACTERISTIC K_ED_FI_IBS1.P_CODE_SH_TO_GND "Fault code FI_IBS1 - OBD P-code reported for short to ground [verified]" VALUE 0x717AC RL_VAL_UW 0 CM_0000 0 65535 /end CHARACTERISTIC
/begin CHARACTERISTIC K_ED_FI_IBS1.P_CODE_SH_TO_UB "Fault code FI_IBS1 - OBD P-code reported for short to battery voltage [verified]" VALUE 0x717AA RL_VAL_UW 0 CM_0000 0 65535 /end CHARACTERISTIC
/begin CHARACTERISTIC K_ED_FI_IBS1.P_CODE_UNPLAUSIBEL "Fault code FI_IBS1 - OBD P-code reported for implausible signal [verified]" VALUE 0x717B0 RL_VAL_UW 0 CM_0000 0 65535 /end CHARACTERISTIC
/begin CHARACTERISTIC K_ED_FI_IBS2.DEC_NACH_EINTRAG "Fault code FI_IBS2 - debounce filter decrement after fault-memory entry [verified]" VALUE 0x717D1 RL_VAL_UB 0 CM_0000 0 255 /end CHARACTERISTIC
/begin CHARACTERISTIC K_ED_FI_IBS2.DEC_VOR_EINTRAG "Fault code FI_IBS2 - debounce filter decrement before fault-memory entry [verified]" VALUE 0x717CF RL_VAL_UB 0 CM_0000 0 255 /end CHARACTERISTIC
/begin CHARACTERISTIC K_ED_FI_IBS2.FEHLERSCHWELLE "Fault code FI_IBS2 - debounce filter threshold for setting the fault [verified]" VALUE 0x717CC RL_VAL_UB 0 CM_0000 0 255 /end CHARACTERISTIC
/begin CHARACTERISTIC K_ED_FI_IBS2.INC_NACH_EINTRAG "Fault code FI_IBS2 - debounce filter increment after fault-memory entry [verified]" VALUE 0x717D0 RL_VAL_UB 0 CM_0000 0 255 /end CHARACTERISTIC
/begin CHARACTERISTIC K_ED_FI_IBS2.INC_VOR_EINTRAG "Fault code FI_IBS2 - debounce filter increment before fault-memory entry [verified]" VALUE 0x717CE RL_VAL_UB 0 CM_0000 0 255 /end CHARACTERISTIC
/begin CHARACTERISTIC K_ED_FI_IBS2.KLASSENINDEX "Fault code FI_IBS2 - fault class selection (lamp / warning behaviour) [verified]" VALUE 0x717D2 RL_VAL_UB 0 CM_0000 0 255 /end CHARACTERISTIC
/begin CHARACTERISTIC K_ED_FI_IBS2.OK_SCHWELLE "Fault code FI_IBS2 - debounce filter threshold for clearing (healing) the fault [verified]" VALUE 0x717CD RL_VAL_UB 0 CM_0000 0 255 /end CHARACTERISTIC
/begin CHARACTERISTIC K_ED_FI_IBS2.P_CODE_OPENLOAD "Fault code FI_IBS2 - OBD P-code reported for open circuit [verified]" VALUE 0x717C8 RL_VAL_UW 0 CM_0000 0 65535 /end CHARACTERISTIC
/begin CHARACTERISTIC K_ED_FI_IBS2.P_CODE_SH_TO_GND "Fault code FI_IBS2 - OBD P-code reported for short to ground [verified]" VALUE 0x717C6 RL_VAL_UW 0 CM_0000 0 65535 /end CHARACTERISTIC
/begin CHARACTERISTIC K_ED_FI_IBS2.P_CODE_SH_TO_UB "Fault code FI_IBS2 - OBD P-code reported for short to battery voltage [verified]" VALUE 0x717C4 RL_VAL_UW 0 CM_0000 0 65535 /end CHARACTERISTIC
/begin CHARACTERISTIC K_ED_FI_IBS2.P_CODE_UNPLAUSIBEL "Fault code FI_IBS2 - OBD P-code reported for implausible signal [verified]" VALUE 0x717CA RL_VAL_UW 0 CM_0000 0 65535 /end CHARACTERISTIC
/begin CHARACTERISTIC K_ED_FI_IBS3.DEC_NACH_EINTRAG "Fault code FI_IBS3 - debounce filter decrement after fault-memory entry [verified]" VALUE 0x717EB RL_VAL_UB 0 CM_0000 0 255 /end CHARACTERISTIC
/begin CHARACTERISTIC K_ED_FI_IBS3.DEC_VOR_EINTRAG "Fault code FI_IBS3 - debounce filter decrement before fault-memory entry [verified]" VALUE 0x717E9 RL_VAL_UB 0 CM_0000 0 255 /end CHARACTERISTIC
/begin CHARACTERISTIC K_ED_FI_IBS3.FEHLERSCHWELLE "Fault code FI_IBS3 - debounce filter threshold for setting the fault [verified]" VALUE 0x717E6 RL_VAL_UB 0 CM_0000 0 255 /end CHARACTERISTIC
/begin CHARACTERISTIC K_ED_FI_IBS3.INC_NACH_EINTRAG "Fault code FI_IBS3 - debounce filter increment after fault-memory entry [verified]" VALUE 0x717EA RL_VAL_UB 0 CM_0000 0 255 /end CHARACTERISTIC
/begin CHARACTERISTIC K_ED_FI_IBS3.INC_VOR_EINTRAG "Fault code FI_IBS3 - debounce filter increment before fault-memory entry [verified]" VALUE 0x717E8 RL_VAL_UB 0 CM_0000 0 255 /end CHARACTERISTIC
/begin CHARACTERISTIC K_ED_FI_IBS3.KLASSENINDEX "Fault code FI_IBS3 - fault class selection (lamp / warning behaviour) [verified]" VALUE 0x717EC RL_VAL_UB 0 CM_0000 0 255 /end CHARACTERISTIC
/begin CHARACTERISTIC K_ED_FI_IBS3.OK_SCHWELLE "Fault code FI_IBS3 - debounce filter threshold for clearing (healing) the fault [verified]" VALUE 0x717E7 RL_VAL_UB 0 CM_0000 0 255 /end CHARACTERISTIC
/begin CHARACTERISTIC K_ED_FI_IBS3.P_CODE_OPENLOAD "Fault code FI_IBS3 - OBD P-code reported for open circuit [verified]" VALUE 0x717E2 RL_VAL_UW 0 CM_0000 0 65535 /end CHARACTERISTIC
/begin CHARACTERISTIC K_ED_FI_IBS3.P_CODE_SH_TO_GND "Fault code FI_IBS3 - OBD P-code reported for short to ground [verified]" VALUE 0x717E0 RL_VAL_UW 0 CM_0000 0 65535 /end CHARACTERISTIC
/begin CHARACTERISTIC K_ED_FI_IBS3.P_CODE_SH_TO_UB "Fault code FI_IBS3 - OBD P-code reported for short to battery voltage [verified]" VALUE 0x717DE RL_VAL_UW 0 CM_0000 0 65535 /end CHARACTERISTIC
/begin CHARACTERISTIC K_ED_FI_IBS3.P_CODE_UNPLAUSIBEL "Fault code FI_IBS3 - OBD P-code reported for implausible signal [verified]" VALUE 0x717E4 RL_VAL_UW 0 CM_0000 0 65535 /end CHARACTERISTIC
/begin CHARACTERISTIC K_ED_FI_PMBATT.DEC_NACH_EINTRAG "Fault code FI_PMBATT - debounce filter decrement after fault-memory entry [verified]" VALUE 0x7181F RL_VAL_UB 0 CM_0000 0 255 /end CHARACTERISTIC
/begin CHARACTERISTIC K_ED_FI_PMBATT.DEC_VOR_EINTRAG "Fault code FI_PMBATT - debounce filter decrement before fault-memory entry [verified]" VALUE 0x7181D RL_VAL_UB 0 CM_0000 0 255 /end CHARACTERISTIC
/begin CHARACTERISTIC K_ED_FI_PMBATT.FEHLERSCHWELLE "Fault code FI_PMBATT - debounce filter threshold for setting the fault [verified]" VALUE 0x7181A RL_VAL_UB 0 CM_0000 0 255 /end CHARACTERISTIC
/begin CHARACTERISTIC K_ED_FI_PMBATT.INC_NACH_EINTRAG "Fault code FI_PMBATT - debounce filter increment after fault-memory entry [verified]" VALUE 0x7181E RL_VAL_UB 0 CM_0000 0 255 /end CHARACTERISTIC
/begin CHARACTERISTIC K_ED_FI_PMBATT.INC_VOR_EINTRAG "Fault code FI_PMBATT - debounce filter increment before fault-memory entry [verified]" VALUE 0x7181C RL_VAL_UB 0 CM_0000 0 255 /end CHARACTERISTIC
/begin CHARACTERISTIC K_ED_FI_PMBATT.KLASSENINDEX "Fault code FI_PMBATT - fault class selection (lamp / warning behaviour) [verified]" VALUE 0x71820 RL_VAL_UB 0 CM_0000 0 255 /end CHARACTERISTIC
/begin CHARACTERISTIC K_ED_FI_PMBATT.OK_SCHWELLE "Fault code FI_PMBATT - debounce filter threshold for clearing (healing) the fault [verified]" VALUE 0x7181B RL_VAL_UB 0 CM_0000 0 255 /end CHARACTERISTIC
/begin CHARACTERISTIC K_ED_FI_PMBATT.P_CODE_OPENLOAD "Fault code FI_PMBATT - OBD P-code reported for open circuit [verified]" VALUE 0x71816 RL_VAL_UW 0 CM_0000 0 65535 /end CHARACTERISTIC
/begin CHARACTERISTIC K_ED_FI_PMBATT.P_CODE_SH_TO_GND "Fault code FI_PMBATT - OBD P-code reported for short to ground [verified]" VALUE 0x71814 RL_VAL_UW 0 CM_0000 0 65535 /end CHARACTERISTIC
/begin CHARACTERISTIC K_ED_FI_PMBATT.P_CODE_SH_TO_UB "Fault code FI_PMBATT - OBD P-code reported for short to battery voltage [verified]" VALUE 0x71812 RL_VAL_UW 0 CM_0000 0 65535 /end CHARACTERISTIC
/begin CHARACTERISTIC K_ED_FI_PMBATT.P_CODE_UNPLAUSIBEL "Fault code FI_PMBATT - OBD P-code reported for implausible signal [verified]" VALUE 0x71818 RL_VAL_UW 0 CM_0000 0 65535 /end CHARACTERISTIC
/begin CHARACTERISTIC K_ED_FI_PMBN.DEC_NACH_EINTRAG "Fault code FI_PMBN - debounce filter decrement after fault-memory entry [verified]" VALUE 0x71805 RL_VAL_UB 0 CM_0000 0 255 /end CHARACTERISTIC
/begin CHARACTERISTIC K_ED_FI_PMBN.DEC_VOR_EINTRAG "Fault code FI_PMBN - debounce filter decrement before fault-memory entry [verified]" VALUE 0x71803 RL_VAL_UB 0 CM_0000 0 255 /end CHARACTERISTIC
/begin CHARACTERISTIC K_ED_FI_PMBN.FEHLERSCHWELLE "Fault code FI_PMBN - debounce filter threshold for setting the fault [verified]" VALUE 0x71800 RL_VAL_UB 0 CM_0000 0 255 /end CHARACTERISTIC
/begin CHARACTERISTIC K_ED_FI_PMBN.INC_NACH_EINTRAG "Fault code FI_PMBN - debounce filter increment after fault-memory entry [verified]" VALUE 0x71804 RL_VAL_UB 0 CM_0000 0 255 /end CHARACTERISTIC
/begin CHARACTERISTIC K_ED_FI_PMBN.INC_VOR_EINTRAG "Fault code FI_PMBN - debounce filter increment before fault-memory entry [verified]" VALUE 0x71802 RL_VAL_UB 0 CM_0000 0 255 /end CHARACTERISTIC
/begin CHARACTERISTIC K_ED_FI_PMBN.KLASSENINDEX "Fault code FI_PMBN - fault class selection (lamp / warning behaviour) [verified]" VALUE 0x71806 RL_VAL_UB 0 CM_0000 0 255 /end CHARACTERISTIC
/begin CHARACTERISTIC K_ED_FI_PMBN.OK_SCHWELLE "Fault code FI_PMBN - debounce filter threshold for clearing (healing) the fault [verified]" VALUE 0x71801 RL_VAL_UB 0 CM_0000 0 255 /end CHARACTERISTIC
/begin CHARACTERISTIC K_ED_FI_PMBN.P_CODE_OPENLOAD "Fault code FI_PMBN - OBD P-code reported for open circuit [verified]" VALUE 0x717FC RL_VAL_UW 0 CM_0000 0 65535 /end CHARACTERISTIC
/begin CHARACTERISTIC K_ED_FI_PMBN.P_CODE_SH_TO_GND "Fault code FI_PMBN - OBD P-code reported for short to ground [verified]" VALUE 0x717FA RL_VAL_UW 0 CM_0000 0 65535 /end CHARACTERISTIC
/begin CHARACTERISTIC K_ED_FI_PMBN.P_CODE_SH_TO_UB "Fault code FI_PMBN - OBD P-code reported for short to battery voltage [verified]" VALUE 0x717F8 RL_VAL_UW 0 CM_0000 0 65535 /end CHARACTERISTIC
/begin CHARACTERISTIC K_ED_FI_PMBN.P_CODE_UNPLAUSIBEL "Fault code FI_PMBN - OBD P-code reported for implausible signal [verified]" VALUE 0x717FE RL_VAL_UW 0 CM_0000 0 65535 /end CHARACTERISTIC
/begin CHARACTERISTIC K_ED_FI_PMRUHVERL.DEC_NACH_EINTRAG "Fault code FI_PMRUHVERL - debounce filter decrement after fault-memory entry [verified]" VALUE 0x71923 RL_VAL_UB 0 CM_0000 0 255 /end CHARACTERISTIC
/begin CHARACTERISTIC K_ED_FI_PMRUHVERL.DEC_VOR_EINTRAG "Fault code FI_PMRUHVERL - debounce filter decrement before fault-memory entry [verified]" VALUE 0x71921 RL_VAL_UB 0 CM_0000 0 255 /end CHARACTERISTIC
/begin CHARACTERISTIC K_ED_FI_PMRUHVERL.FEHLERSCHWELLE "Fault code FI_PMRUHVERL - debounce filter threshold for setting the fault [verified]" VALUE 0x7191E RL_VAL_UB 0 CM_0000 0 255 /end CHARACTERISTIC
/begin CHARACTERISTIC K_ED_FI_PMRUHVERL.INC_NACH_EINTRAG "Fault code FI_PMRUHVERL - debounce filter increment after fault-memory entry [verified]" VALUE 0x71922 RL_VAL_UB 0 CM_0000 0 255 /end CHARACTERISTIC
/begin CHARACTERISTIC K_ED_FI_PMRUHVERL.INC_VOR_EINTRAG "Fault code FI_PMRUHVERL - debounce filter increment before fault-memory entry [verified]" VALUE 0x71920 RL_VAL_UB 0 CM_0000 0 255 /end CHARACTERISTIC
/begin CHARACTERISTIC K_ED_FI_PMRUHVERL.KLASSENINDEX "Fault code FI_PMRUHVERL - fault class selection (lamp / warning behaviour) [verified]" VALUE 0x71924 RL_VAL_UB 0 CM_0000 0 255 /end CHARACTERISTIC
/begin CHARACTERISTIC K_ED_FI_PMRUHVERL.OK_SCHWELLE "Fault code FI_PMRUHVERL - debounce filter threshold for clearing (healing) the fault [verified]" VALUE 0x7191F RL_VAL_UB 0 CM_0000 0 255 /end CHARACTERISTIC
/begin CHARACTERISTIC K_ED_FI_PMRUHVERL.P_CODE_OPENLOAD "Fault code FI_PMRUHVERL - OBD P-code reported for open circuit [verified]" VALUE 0x7191A RL_VAL_UW 0 CM_0000 0 65535 /end CHARACTERISTIC
/begin CHARACTERISTIC K_ED_FI_PMRUHVERL.P_CODE_SH_TO_GND "Fault code FI_PMRUHVERL - OBD P-code reported for short to ground [verified]" VALUE 0x71918 RL_VAL_UW 0 CM_0000 0 65535 /end CHARACTERISTIC
/begin CHARACTERISTIC K_ED_FI_PMRUHVERL.P_CODE_SH_TO_UB "Fault code FI_PMRUHVERL - OBD P-code reported for short to battery voltage [verified]" VALUE 0x71916 RL_VAL_UW 0 CM_0000 0 65535 /end CHARACTERISTIC
/begin CHARACTERISTIC K_ED_FI_PMRUHVERL.P_CODE_UNPLAUSIBEL "Fault code FI_PMRUHVERL - OBD P-code reported for implausible signal [verified]" VALUE 0x7191C RL_VAL_UW 0 CM_0000 0 65535 /end CHARACTERISTIC
/begin CHARACTERISTIC K_ED_FI_QLT.DEC_NACH_EINTRAG "Fault code FI_QLT - debounce filter decrement after fault-memory entry [verified]" VALUE 0x7179D RL_VAL_UB 0 CM_0000 0 255 /end CHARACTERISTIC
/begin CHARACTERISTIC K_ED_FI_QLT.DEC_VOR_EINTRAG "Fault code FI_QLT - debounce filter decrement before fault-memory entry [verified]" VALUE 0x7179B RL_VAL_UB 0 CM_0000 0 255 /end CHARACTERISTIC
/begin CHARACTERISTIC K_ED_FI_QLT.FEHLERSCHWELLE "Fault code FI_QLT - debounce filter threshold for setting the fault [verified]" VALUE 0x71798 RL_VAL_UB 0 CM_0000 0 255 /end CHARACTERISTIC
/begin CHARACTERISTIC K_ED_FI_QLT.INC_NACH_EINTRAG "Fault code FI_QLT - debounce filter increment after fault-memory entry [verified]" VALUE 0x7179C RL_VAL_UB 0 CM_0000 0 255 /end CHARACTERISTIC
/begin CHARACTERISTIC K_ED_FI_QLT.INC_VOR_EINTRAG "Fault code FI_QLT - debounce filter increment before fault-memory entry [verified]" VALUE 0x7179A RL_VAL_UB 0 CM_0000 0 255 /end CHARACTERISTIC
/begin CHARACTERISTIC K_ED_FI_QLT.KLASSENINDEX "Fault code FI_QLT - fault class selection (lamp / warning behaviour) [verified]" VALUE 0x7179E RL_VAL_UB 0 CM_0000 0 255 /end CHARACTERISTIC
/begin CHARACTERISTIC K_ED_FI_QLT.OK_SCHWELLE "Fault code FI_QLT - debounce filter threshold for clearing (healing) the fault [verified]" VALUE 0x71799 RL_VAL_UB 0 CM_0000 0 255 /end CHARACTERISTIC
/begin CHARACTERISTIC K_ED_FI_QLT.P_CODE_OPENLOAD "Fault code FI_QLT - OBD P-code reported for open circuit [verified]" VALUE 0x71794 RL_VAL_UW 0 CM_0000 0 65535 /end CHARACTERISTIC
/begin CHARACTERISTIC K_ED_FI_QLT.P_CODE_SH_TO_GND "Fault code FI_QLT - OBD P-code reported for short to ground [verified]" VALUE 0x71792 RL_VAL_UW 0 CM_0000 0 65535 /end CHARACTERISTIC
/begin CHARACTERISTIC K_ED_FI_QLT.P_CODE_SH_TO_UB "Fault code FI_QLT - OBD P-code reported for short to battery voltage [verified]" VALUE 0x71790 RL_VAL_UW 0 CM_0000 0 65535 /end CHARACTERISTIC
/begin CHARACTERISTIC K_ED_FI_QLT.P_CODE_UNPLAUSIBEL "Fault code FI_QLT - OBD P-code reported for implausible signal [verified]" VALUE 0x71796 RL_VAL_UW 0 CM_0000 0 65535 /end CHARACTERISTIC
/begin CHARACTERISTIC K_ED_FI_TOENS.DEC_NACH_EINTRAG "Fault code FI_TOENS - debounce filter decrement after fault-memory entry [verified]" VALUE 0x7193D RL_VAL_UB 0 CM_0000 0 255 /end CHARACTERISTIC
/begin CHARACTERISTIC K_ED_FI_TOENS.DEC_VOR_EINTRAG "Fault code FI_TOENS - debounce filter decrement before fault-memory entry [verified]" VALUE 0x7193B RL_VAL_UB 0 CM_0000 0 255 /end CHARACTERISTIC
/begin CHARACTERISTIC K_ED_FI_TOENS.FEHLERSCHWELLE "Fault code FI_TOENS - debounce filter threshold for setting the fault [verified]" VALUE 0x71938 RL_VAL_UB 0 CM_0000 0 255 /end CHARACTERISTIC
/begin CHARACTERISTIC K_ED_FI_TOENS.INC_NACH_EINTRAG "Fault code FI_TOENS - debounce filter increment after fault-memory entry [verified]" VALUE 0x7193C RL_VAL_UB 0 CM_0000 0 255 /end CHARACTERISTIC
/begin CHARACTERISTIC K_ED_FI_TOENS.INC_VOR_EINTRAG "Fault code FI_TOENS - debounce filter increment before fault-memory entry [verified]" VALUE 0x7193A RL_VAL_UB 0 CM_0000 0 255 /end CHARACTERISTIC
/begin CHARACTERISTIC K_ED_FI_TOENS.KLASSENINDEX "Fault code FI_TOENS - fault class selection (lamp / warning behaviour) [verified]" VALUE 0x7193E RL_VAL_UB 0 CM_0000 0 255 /end CHARACTERISTIC
/begin CHARACTERISTIC K_ED_FI_TOENS.OK_SCHWELLE "Fault code FI_TOENS - debounce filter threshold for clearing (healing) the fault [verified]" VALUE 0x71939 RL_VAL_UB 0 CM_0000 0 255 /end CHARACTERISTIC
/begin CHARACTERISTIC K_ED_FI_TOENS.P_CODE_OPENLOAD "Fault code FI_TOENS - OBD P-code reported for open circuit [verified]" VALUE 0x71934 RL_VAL_UW 0 CM_0000 0 65535 /end CHARACTERISTIC
/begin CHARACTERISTIC K_ED_FI_TOENS.P_CODE_SH_TO_GND "Fault code FI_TOENS - OBD P-code reported for short to ground [verified]" VALUE 0x71932 RL_VAL_UW 0 CM_0000 0 65535 /end CHARACTERISTIC
/begin CHARACTERISTIC K_ED_FI_TOENS.P_CODE_SH_TO_UB "Fault code FI_TOENS - OBD P-code reported for short to battery voltage [verified]" VALUE 0x71930 RL_VAL_UW 0 CM_0000 0 65535 /end CHARACTERISTIC
/begin CHARACTERISTIC K_ED_FI_TOENS.P_CODE_UNPLAUSIBEL "Fault code FI_TOENS - OBD P-code reported for implausible signal [verified]" VALUE 0x71936 RL_VAL_UW 0 CM_0000 0 65535 /end CHARACTERISTIC
/begin CHARACTERISTIC K_ED_FPLAU1.DEC_NACH_EINTRAG "Fault code FPLAU1 - debounce filter decrement after fault-memory entry [verified]" VALUE 0x70EC7 RL_VAL_UB 0 CM_0000 0 255 /end CHARACTERISTIC
/begin CHARACTERISTIC K_ED_FPLAU1.DEC_VOR_EINTRAG "Fault code FPLAU1 - debounce filter decrement before fault-memory entry [verified]" VALUE 0x70EC5 RL_VAL_UB 0 CM_0000 0 255 /end CHARACTERISTIC
/begin CHARACTERISTIC K_ED_FPLAU1.FEHLERSCHWELLE "Fault code FPLAU1 - debounce filter threshold for setting the fault [verified]" VALUE 0x70EC2 RL_VAL_UB 0 CM_0000 0 255 /end CHARACTERISTIC
/begin CHARACTERISTIC K_ED_FPLAU1.INC_NACH_EINTRAG "Fault code FPLAU1 - debounce filter increment after fault-memory entry [verified]" VALUE 0x70EC6 RL_VAL_UB 0 CM_0000 0 255 /end CHARACTERISTIC
/begin CHARACTERISTIC K_ED_FPLAU1.INC_VOR_EINTRAG "Fault code FPLAU1 - debounce filter increment before fault-memory entry [verified]" VALUE 0x70EC4 RL_VAL_UB 0 CM_0000 0 255 /end CHARACTERISTIC
/begin CHARACTERISTIC K_ED_FPLAU1.KLASSENINDEX "Fault code FPLAU1 - fault class selection (lamp / warning behaviour) [verified]" VALUE 0x70EC8 RL_VAL_UB 0 CM_0000 0 255 /end CHARACTERISTIC
/begin CHARACTERISTIC K_ED_FPLAU1.OK_SCHWELLE "Fault code FPLAU1 - debounce filter threshold for clearing (healing) the fault [verified]" VALUE 0x70EC3 RL_VAL_UB 0 CM_0000 0 255 /end CHARACTERISTIC
/begin CHARACTERISTIC K_ED_FPLAU1.P_CODE_OPENLOAD "Fault code FPLAU1 - OBD P-code reported for open circuit [verified]" VALUE 0x70EBE RL_VAL_UW 0 CM_0000 0 65535 /end CHARACTERISTIC
/begin CHARACTERISTIC K_ED_FPLAU1.P_CODE_SH_TO_GND "Fault code FPLAU1 - OBD P-code reported for short to ground [verified]" VALUE 0x70EBC RL_VAL_UW 0 CM_0000 0 65535 /end CHARACTERISTIC
/begin CHARACTERISTIC K_ED_FPLAU1.P_CODE_SH_TO_UB "Fault code FPLAU1 - OBD P-code reported for short to battery voltage [verified]" VALUE 0x70EBA RL_VAL_UW 0 CM_0000 0 65535 /end CHARACTERISTIC
/begin CHARACTERISTIC K_ED_FPLAU1.P_CODE_UNPLAUSIBEL "Fault code FPLAU1 - OBD P-code reported for implausible signal [verified]" VALUE 0x70EC0 RL_VAL_UW 0 CM_0000 0 65535 /end CHARACTERISTIC
/begin CHARACTERISTIC K_ED_FPLAU2.DEC_NACH_EINTRAG "Fault code FPLAU2 - debounce filter decrement after fault-memory entry [verified]" VALUE 0x70EE1 RL_VAL_UB 0 CM_0000 0 255 /end CHARACTERISTIC
/begin CHARACTERISTIC K_ED_FPLAU2.DEC_VOR_EINTRAG "Fault code FPLAU2 - debounce filter decrement before fault-memory entry [verified]" VALUE 0x70EDF RL_VAL_UB 0 CM_0000 0 255 /end CHARACTERISTIC
/begin CHARACTERISTIC K_ED_FPLAU2.FEHLERSCHWELLE "Fault code FPLAU2 - debounce filter threshold for setting the fault [verified]" VALUE 0x70EDC RL_VAL_UB 0 CM_0000 0 255 /end CHARACTERISTIC
/begin CHARACTERISTIC K_ED_FPLAU2.INC_NACH_EINTRAG "Fault code FPLAU2 - debounce filter increment after fault-memory entry [verified]" VALUE 0x70EE0 RL_VAL_UB 0 CM_0000 0 255 /end CHARACTERISTIC
/begin CHARACTERISTIC K_ED_FPLAU2.INC_VOR_EINTRAG "Fault code FPLAU2 - debounce filter increment before fault-memory entry [verified]" VALUE 0x70EDE RL_VAL_UB 0 CM_0000 0 255 /end CHARACTERISTIC
/begin CHARACTERISTIC K_ED_FPLAU2.KLASSENINDEX "Fault code FPLAU2 - fault class selection (lamp / warning behaviour) [verified]" VALUE 0x70EE2 RL_VAL_UB 0 CM_0000 0 255 /end CHARACTERISTIC
/begin CHARACTERISTIC K_ED_FPLAU2.OK_SCHWELLE "Fault code FPLAU2 - debounce filter threshold for clearing (healing) the fault [verified]" VALUE 0x70EDD RL_VAL_UB 0 CM_0000 0 255 /end CHARACTERISTIC
/begin CHARACTERISTIC K_ED_FPLAU2.P_CODE_OPENLOAD "Fault code FPLAU2 - OBD P-code reported for open circuit [verified]" VALUE 0x70ED8 RL_VAL_UW 0 CM_0000 0 65535 /end CHARACTERISTIC
/begin CHARACTERISTIC K_ED_FPLAU2.P_CODE_SH_TO_GND "Fault code FPLAU2 - OBD P-code reported for short to ground [verified]" VALUE 0x70ED6 RL_VAL_UW 0 CM_0000 0 65535 /end CHARACTERISTIC
/begin CHARACTERISTIC K_ED_FPLAU2.P_CODE_SH_TO_UB "Fault code FPLAU2 - OBD P-code reported for short to battery voltage [verified]" VALUE 0x70ED4 RL_VAL_UW 0 CM_0000 0 65535 /end CHARACTERISTIC
/begin CHARACTERISTIC K_ED_FPLAU2.P_CODE_UNPLAUSIBEL "Fault code FPLAU2 - OBD P-code reported for implausible signal [verified]" VALUE 0x70EDA RL_VAL_UW 0 CM_0000 0 65535 /end CHARACTERISTIC
/begin CHARACTERISTIC K_ED_FST.DEC_NACH_EINTRAG "Fault code FST - debounce filter decrement after fault-memory entry [verified]" VALUE 0x71ADD RL_VAL_UB 0 CM_0000 0 255 /end CHARACTERISTIC
/begin CHARACTERISTIC K_ED_FST.DEC_VOR_EINTRAG "Fault code FST - debounce filter decrement before fault-memory entry [verified]" VALUE 0x71ADB RL_VAL_UB 0 CM_0000 0 255 /end CHARACTERISTIC
/begin CHARACTERISTIC K_ED_FST.FEHLERSCHWELLE "Fault code FST - debounce filter threshold for setting the fault [verified]" VALUE 0x71AD8 RL_VAL_UB 0 CM_0000 0 255 /end CHARACTERISTIC
/begin CHARACTERISTIC K_ED_FST.INC_NACH_EINTRAG "Fault code FST - debounce filter increment after fault-memory entry [verified]" VALUE 0x71ADC RL_VAL_UB 0 CM_0000 0 255 /end CHARACTERISTIC
/begin CHARACTERISTIC K_ED_FST.INC_VOR_EINTRAG "Fault code FST - debounce filter increment before fault-memory entry [verified]" VALUE 0x71ADA RL_VAL_UB 0 CM_0000 0 255 /end CHARACTERISTIC
/begin CHARACTERISTIC K_ED_FST.KLASSENINDEX "Fault code FST - fault class selection (lamp / warning behaviour) [verified]" VALUE 0x71ADE RL_VAL_UB 0 CM_0000 0 255 /end CHARACTERISTIC
/begin CHARACTERISTIC K_ED_FST.OK_SCHWELLE "Fault code FST - debounce filter threshold for clearing (healing) the fault [verified]" VALUE 0x71AD9 RL_VAL_UB 0 CM_0000 0 255 /end CHARACTERISTIC
/begin CHARACTERISTIC K_ED_FST.P_CODE_OPENLOAD "Fault code FST - OBD P-code reported for open circuit [verified]" VALUE 0x71AD4 RL_VAL_UW 0 CM_0000 0 65535 /end CHARACTERISTIC
/begin CHARACTERISTIC K_ED_FST.P_CODE_SH_TO_GND "Fault code FST - OBD P-code reported for short to ground [verified]" VALUE 0x71AD2 RL_VAL_UW 0 CM_0000 0 65535 /end CHARACTERISTIC
/begin CHARACTERISTIC K_ED_FST.P_CODE_SH_TO_UB "Fault code FST - OBD P-code reported for short to battery voltage [verified]" VALUE 0x71AD0 RL_VAL_UW 0 CM_0000 0 65535 /end CHARACTERISTIC
/begin CHARACTERISTIC K_ED_FST.P_CODE_UNPLAUSIBEL "Fault code FST - OBD P-code reported for implausible signal [verified]" VALUE 0x71AD6 RL_VAL_UW 0 CM_0000 0 65535 /end CHARACTERISTIC
/begin CHARACTERISTIC K_ED_FST_GEBER.DEC_NACH_EINTRAG "Fault code FST_GEBER - debounce filter decrement after fault-memory entry [verified]" VALUE 0x71CB1 RL_VAL_UB 0 CM_0000 0 255 /end CHARACTERISTIC
/begin CHARACTERISTIC K_ED_FST_GEBER.DEC_VOR_EINTRAG "Fault code FST_GEBER - debounce filter decrement before fault-memory entry [verified]" VALUE 0x71CAF RL_VAL_UB 0 CM_0000 0 255 /end CHARACTERISTIC
/begin CHARACTERISTIC K_ED_FST_GEBER.FEHLERSCHWELLE "Fault code FST_GEBER - debounce filter threshold for setting the fault [verified]" VALUE 0x71CAC RL_VAL_UB 0 CM_0000 0 255 /end CHARACTERISTIC
/begin CHARACTERISTIC K_ED_FST_GEBER.INC_NACH_EINTRAG "Fault code FST_GEBER - debounce filter increment after fault-memory entry [verified]" VALUE 0x71CB0 RL_VAL_UB 0 CM_0000 0 255 /end CHARACTERISTIC
/begin CHARACTERISTIC K_ED_FST_GEBER.INC_VOR_EINTRAG "Fault code FST_GEBER - debounce filter increment before fault-memory entry [verified]" VALUE 0x71CAE RL_VAL_UB 0 CM_0000 0 255 /end CHARACTERISTIC
/begin CHARACTERISTIC K_ED_FST_GEBER.KLASSENINDEX "Fault code FST_GEBER - fault class selection (lamp / warning behaviour) [verified]" VALUE 0x71CB2 RL_VAL_UB 0 CM_0000 0 255 /end CHARACTERISTIC
/begin CHARACTERISTIC K_ED_FST_GEBER.OK_SCHWELLE "Fault code FST_GEBER - debounce filter threshold for clearing (healing) the fault [verified]" VALUE 0x71CAD RL_VAL_UB 0 CM_0000 0 255 /end CHARACTERISTIC
/begin CHARACTERISTIC K_ED_FST_GEBER.P_CODE_OPENLOAD "Fault code FST_GEBER - OBD P-code reported for open circuit [verified]" VALUE 0x71CA8 RL_VAL_UW 0 CM_0000 0 65535 /end CHARACTERISTIC
/begin CHARACTERISTIC K_ED_FST_GEBER.P_CODE_SH_TO_GND "Fault code FST_GEBER - OBD P-code reported for short to ground [verified]" VALUE 0x71CA6 RL_VAL_UW 0 CM_0000 0 65535 /end CHARACTERISTIC
/begin CHARACTERISTIC K_ED_FST_GEBER.P_CODE_SH_TO_UB "Fault code FST_GEBER - OBD P-code reported for short to battery voltage [verified]" VALUE 0x71CA4 RL_VAL_UW 0 CM_0000 0 65535 /end CHARACTERISTIC
/begin CHARACTERISTIC K_ED_FST_GEBER.P_CODE_UNPLAUSIBEL "Fault code FST_GEBER - OBD P-code reported for implausible signal [verified]" VALUE 0x71CAA RL_VAL_UW 0 CM_0000 0 65535 /end CHARACTERISTIC
/begin CHARACTERISTIC K_ED_HFM1.DEC_NACH_EINTRAG "Fault code HFM1 - debounce filter decrement after fault-memory entry [verified]" VALUE 0x70B05 RL_VAL_UB 0 CM_0000 0 255 /end CHARACTERISTIC
/begin CHARACTERISTIC K_ED_HFM1.DEC_VOR_EINTRAG "Fault code HFM1 - debounce filter decrement before fault-memory entry [verified]" VALUE 0x70B03 RL_VAL_UB 0 CM_0000 0 255 /end CHARACTERISTIC
/begin CHARACTERISTIC K_ED_HFM1.FEHLERSCHWELLE "Fault code HFM1 - debounce filter threshold for setting the fault [verified]" VALUE 0x70B00 RL_VAL_UB 0 CM_0000 0 255 /end CHARACTERISTIC
/begin CHARACTERISTIC K_ED_HFM1.INC_NACH_EINTRAG "Fault code HFM1 - debounce filter increment after fault-memory entry [verified]" VALUE 0x70B04 RL_VAL_UB 0 CM_0000 0 255 /end CHARACTERISTIC
/begin CHARACTERISTIC K_ED_HFM1.INC_VOR_EINTRAG "Fault code HFM1 - debounce filter increment before fault-memory entry [verified]" VALUE 0x70B02 RL_VAL_UB 0 CM_0000 0 255 /end CHARACTERISTIC
/begin CHARACTERISTIC K_ED_HFM1.KLASSENINDEX "Fault code HFM1 - fault class selection (lamp / warning behaviour) [verified]" VALUE 0x70B06 RL_VAL_UB 0 CM_0000 0 255 /end CHARACTERISTIC
/begin CHARACTERISTIC K_ED_HFM1.OK_SCHWELLE "Fault code HFM1 - debounce filter threshold for clearing (healing) the fault [verified]" VALUE 0x70B01 RL_VAL_UB 0 CM_0000 0 255 /end CHARACTERISTIC
/begin CHARACTERISTIC K_ED_HFM1.P_CODE_OPENLOAD "Fault code HFM1 - OBD P-code reported for open circuit [verified]" VALUE 0x70AFC RL_VAL_UW 0 CM_0000 0 65535 /end CHARACTERISTIC
/begin CHARACTERISTIC K_ED_HFM1.P_CODE_SH_TO_GND "Fault code HFM1 - OBD P-code reported for short to ground [verified]" VALUE 0x70AFA RL_VAL_UW 0 CM_0000 0 65535 /end CHARACTERISTIC
/begin CHARACTERISTIC K_ED_HFM1.P_CODE_SH_TO_UB "Fault code HFM1 - OBD P-code reported for short to battery voltage [verified]" VALUE 0x70AF8 RL_VAL_UW 0 CM_0000 0 65535 /end CHARACTERISTIC
/begin CHARACTERISTIC K_ED_HFM1.P_CODE_UNPLAUSIBEL "Fault code HFM1 - OBD P-code reported for implausible signal [verified]" VALUE 0x70AFE RL_VAL_UW 0 CM_0000 0 65535 /end CHARACTERISTIC
/begin CHARACTERISTIC K_ED_HFM2.DEC_NACH_EINTRAG "Fault code HFM2 - debounce filter decrement after fault-memory entry [verified]" VALUE 0x70B1F RL_VAL_UB 0 CM_0000 0 255 /end CHARACTERISTIC
/begin CHARACTERISTIC K_ED_HFM2.DEC_VOR_EINTRAG "Fault code HFM2 - debounce filter decrement before fault-memory entry [verified]" VALUE 0x70B1D RL_VAL_UB 0 CM_0000 0 255 /end CHARACTERISTIC
/begin CHARACTERISTIC K_ED_HFM2.FEHLERSCHWELLE "Fault code HFM2 - debounce filter threshold for setting the fault [verified]" VALUE 0x70B1A RL_VAL_UB 0 CM_0000 0 255 /end CHARACTERISTIC
/begin CHARACTERISTIC K_ED_HFM2.INC_NACH_EINTRAG "Fault code HFM2 - debounce filter increment after fault-memory entry [verified]" VALUE 0x70B1E RL_VAL_UB 0 CM_0000 0 255 /end CHARACTERISTIC
/begin CHARACTERISTIC K_ED_HFM2.INC_VOR_EINTRAG "Fault code HFM2 - debounce filter increment before fault-memory entry [verified]" VALUE 0x70B1C RL_VAL_UB 0 CM_0000 0 255 /end CHARACTERISTIC
/begin CHARACTERISTIC K_ED_HFM2.KLASSENINDEX "Fault code HFM2 - fault class selection (lamp / warning behaviour) [verified]" VALUE 0x70B20 RL_VAL_UB 0 CM_0000 0 255 /end CHARACTERISTIC
/begin CHARACTERISTIC K_ED_HFM2.OK_SCHWELLE "Fault code HFM2 - debounce filter threshold for clearing (healing) the fault [verified]" VALUE 0x70B1B RL_VAL_UB 0 CM_0000 0 255 /end CHARACTERISTIC
/begin CHARACTERISTIC K_ED_HFM2.P_CODE_OPENLOAD "Fault code HFM2 - OBD P-code reported for open circuit [verified]" VALUE 0x70B16 RL_VAL_UW 0 CM_0000 0 65535 /end CHARACTERISTIC
/begin CHARACTERISTIC K_ED_HFM2.P_CODE_SH_TO_GND "Fault code HFM2 - OBD P-code reported for short to ground [verified]" VALUE 0x70B14 RL_VAL_UW 0 CM_0000 0 65535 /end CHARACTERISTIC
/begin CHARACTERISTIC K_ED_HFM2.P_CODE_SH_TO_UB "Fault code HFM2 - OBD P-code reported for short to battery voltage [verified]" VALUE 0x70B12 RL_VAL_UW 0 CM_0000 0 65535 /end CHARACTERISTIC
/begin CHARACTERISTIC K_ED_HFM2.P_CODE_UNPLAUSIBEL "Fault code HFM2 - OBD P-code reported for implausible signal [verified]" VALUE 0x70B18 RL_VAL_UW 0 CM_0000 0 65535 /end CHARACTERISTIC
/begin CHARACTERISTIC K_ED_INDEX_135_INJ.DEC_NACH_EINTRAG "Fault code INDEX_135_INJ - debounce filter decrement after fault-memory entry [verified]" VALUE 0x71887 RL_VAL_UB 0 CM_0000 0 255 /end CHARACTERISTIC
/begin CHARACTERISTIC K_ED_INDEX_135_INJ.DEC_VOR_EINTRAG "Fault code INDEX_135_INJ - debounce filter decrement before fault-memory entry [verified]" VALUE 0x71885 RL_VAL_UB 0 CM_0000 0 255 /end CHARACTERISTIC
/begin CHARACTERISTIC K_ED_INDEX_135_INJ.FEHLERSCHWELLE "Fault code INDEX_135_INJ - debounce filter threshold for setting the fault [verified]" VALUE 0x71882 RL_VAL_UB 0 CM_0000 0 255 /end CHARACTERISTIC
/begin CHARACTERISTIC K_ED_INDEX_135_INJ.INC_NACH_EINTRAG "Fault code INDEX_135_INJ - debounce filter increment after fault-memory entry [verified]" VALUE 0x71886 RL_VAL_UB 0 CM_0000 0 255 /end CHARACTERISTIC
/begin CHARACTERISTIC K_ED_INDEX_135_INJ.INC_VOR_EINTRAG "Fault code INDEX_135_INJ - debounce filter increment before fault-memory entry [verified]" VALUE 0x71884 RL_VAL_UB 0 CM_0000 0 255 /end CHARACTERISTIC
/begin CHARACTERISTIC K_ED_INDEX_135_INJ.KLASSENINDEX "Fault code INDEX_135_INJ - fault class selection (lamp / warning behaviour) [verified]" VALUE 0x71888 RL_VAL_UB 0 CM_0000 0 255 /end CHARACTERISTIC
/begin CHARACTERISTIC K_ED_INDEX_135_INJ.OK_SCHWELLE "Fault code INDEX_135_INJ - debounce filter threshold for clearing (healing) the fault [verified]" VALUE 0x71883 RL_VAL_UB 0 CM_0000 0 255 /end CHARACTERISTIC
/begin CHARACTERISTIC K_ED_INDEX_135_INJ.P_CODE_OPENLOAD "Fault code INDEX_135_INJ - OBD P-code reported for open circuit [verified]" VALUE 0x7187E RL_VAL_UW 0 CM_0000 0 65535 /end CHARACTERISTIC
/begin CHARACTERISTIC K_ED_INDEX_135_INJ.P_CODE_SH_TO_GND "Fault code INDEX_135_INJ - OBD P-code reported for short to ground [verified]" VALUE 0x7187C RL_VAL_UW 0 CM_0000 0 65535 /end CHARACTERISTIC
/begin CHARACTERISTIC K_ED_INDEX_135_INJ.P_CODE_SH_TO_UB "Fault code INDEX_135_INJ - OBD P-code reported for short to battery voltage [verified]" VALUE 0x7187A RL_VAL_UW 0 CM_0000 0 65535 /end CHARACTERISTIC
/begin CHARACTERISTIC K_ED_INDEX_135_INJ.P_CODE_UNPLAUSIBEL "Fault code INDEX_135_INJ - OBD P-code reported for implausible signal [verified]" VALUE 0x71880 RL_VAL_UW 0 CM_0000 0 65535 /end CHARACTERISTIC
/begin CHARACTERISTIC K_ED_INDEX_15_INJ.DEC_NACH_EINTRAG "Fault code INDEX_15_INJ - debounce filter decrement after fault-memory entry [verified]" VALUE 0x70C57 RL_VAL_UB 0 CM_0000 0 255 /end CHARACTERISTIC
/begin CHARACTERISTIC K_ED_INDEX_15_INJ.DEC_VOR_EINTRAG "Fault code INDEX_15_INJ - debounce filter decrement before fault-memory entry [verified]" VALUE 0x70C55 RL_VAL_UB 0 CM_0000 0 255 /end CHARACTERISTIC
/begin CHARACTERISTIC K_ED_INDEX_15_INJ.FEHLERSCHWELLE "Fault code INDEX_15_INJ - debounce filter threshold for setting the fault [verified]" VALUE 0x70C52 RL_VAL_UB 0 CM_0000 0 255 /end CHARACTERISTIC
/begin CHARACTERISTIC K_ED_INDEX_15_INJ.INC_NACH_EINTRAG "Fault code INDEX_15_INJ - debounce filter increment after fault-memory entry [verified]" VALUE 0x70C56 RL_VAL_UB 0 CM_0000 0 255 /end CHARACTERISTIC
/begin CHARACTERISTIC K_ED_INDEX_15_INJ.INC_VOR_EINTRAG "Fault code INDEX_15_INJ - debounce filter increment before fault-memory entry [verified]" VALUE 0x70C54 RL_VAL_UB 0 CM_0000 0 255 /end CHARACTERISTIC
/begin CHARACTERISTIC K_ED_INDEX_15_INJ.KLASSENINDEX "Fault code INDEX_15_INJ - fault class selection (lamp / warning behaviour) [verified]" VALUE 0x70C58 RL_VAL_UB 0 CM_0000 0 255 /end CHARACTERISTIC
/begin CHARACTERISTIC K_ED_INDEX_15_INJ.OK_SCHWELLE "Fault code INDEX_15_INJ - debounce filter threshold for clearing (healing) the fault [verified]" VALUE 0x70C53 RL_VAL_UB 0 CM_0000 0 255 /end CHARACTERISTIC
/begin CHARACTERISTIC K_ED_INDEX_15_INJ.P_CODE_OPENLOAD "Fault code INDEX_15_INJ - OBD P-code reported for open circuit [verified]" VALUE 0x70C4E RL_VAL_UW 0 CM_0000 0 65535 /end CHARACTERISTIC
/begin CHARACTERISTIC K_ED_INDEX_15_INJ.P_CODE_SH_TO_GND "Fault code INDEX_15_INJ - OBD P-code reported for short to ground [verified]" VALUE 0x70C4C RL_VAL_UW 0 CM_0000 0 65535 /end CHARACTERISTIC
/begin CHARACTERISTIC K_ED_INDEX_15_INJ.P_CODE_SH_TO_UB "Fault code INDEX_15_INJ - OBD P-code reported for short to battery voltage [verified]" VALUE 0x70C4A RL_VAL_UW 0 CM_0000 0 65535 /end CHARACTERISTIC
/begin CHARACTERISTIC K_ED_INDEX_15_INJ.P_CODE_UNPLAUSIBEL "Fault code INDEX_15_INJ - OBD P-code reported for implausible signal [verified]" VALUE 0x70C50 RL_VAL_UW 0 CM_0000 0 65535 /end CHARACTERISTIC
/begin CHARACTERISTIC K_ED_INDEX_196_INJ.DEC_NACH_EINTRAG "Fault code INDEX_196_INJ - debounce filter decrement after fault-memory entry [verified]" VALUE 0x71EB9 RL_VAL_UB 0 CM_0000 0 255 /end CHARACTERISTIC
/begin CHARACTERISTIC K_ED_INDEX_196_INJ.DEC_VOR_EINTRAG "Fault code INDEX_196_INJ - debounce filter decrement before fault-memory entry [verified]" VALUE 0x71EB7 RL_VAL_UB 0 CM_0000 0 255 /end CHARACTERISTIC
/begin CHARACTERISTIC K_ED_INDEX_196_INJ.FEHLERSCHWELLE "Fault code INDEX_196_INJ - debounce filter threshold for setting the fault [verified]" VALUE 0x71EB4 RL_VAL_UB 0 CM_0000 0 255 /end CHARACTERISTIC
/begin CHARACTERISTIC K_ED_INDEX_196_INJ.INC_NACH_EINTRAG "Fault code INDEX_196_INJ - debounce filter increment after fault-memory entry [verified]" VALUE 0x71EB8 RL_VAL_UB 0 CM_0000 0 255 /end CHARACTERISTIC
/begin CHARACTERISTIC K_ED_INDEX_196_INJ.INC_VOR_EINTRAG "Fault code INDEX_196_INJ - debounce filter increment before fault-memory entry [verified]" VALUE 0x71EB6 RL_VAL_UB 0 CM_0000 0 255 /end CHARACTERISTIC
/begin CHARACTERISTIC K_ED_INDEX_196_INJ.KLASSENINDEX "Fault code INDEX_196_INJ - fault class selection (lamp / warning behaviour) [verified]" VALUE 0x71EBA RL_VAL_UB 0 CM_0000 0 255 /end CHARACTERISTIC
/begin CHARACTERISTIC K_ED_INDEX_196_INJ.OK_SCHWELLE "Fault code INDEX_196_INJ - debounce filter threshold for clearing (healing) the fault [verified]" VALUE 0x71EB5 RL_VAL_UB 0 CM_0000 0 255 /end CHARACTERISTIC
/begin CHARACTERISTIC K_ED_INDEX_196_INJ.P_CODE_OPENLOAD "Fault code INDEX_196_INJ - OBD P-code reported for open circuit [verified]" VALUE 0x71EB0 RL_VAL_UW 0 CM_0000 0 65535 /end CHARACTERISTIC
/begin CHARACTERISTIC K_ED_INDEX_196_INJ.P_CODE_SH_TO_GND "Fault code INDEX_196_INJ - OBD P-code reported for short to ground [verified]" VALUE 0x71EAE RL_VAL_UW 0 CM_0000 0 65535 /end CHARACTERISTIC
/begin CHARACTERISTIC K_ED_INDEX_196_INJ.P_CODE_SH_TO_UB "Fault code INDEX_196_INJ - OBD P-code reported for short to battery voltage [verified]" VALUE 0x71EAC RL_VAL_UW 0 CM_0000 0 65535 /end CHARACTERISTIC
/begin CHARACTERISTIC K_ED_INDEX_196_INJ.P_CODE_UNPLAUSIBEL "Fault code INDEX_196_INJ - OBD P-code reported for implausible signal [verified]" VALUE 0x71EB2 RL_VAL_UW 0 CM_0000 0 65535 /end CHARACTERISTIC
/begin CHARACTERISTIC K_ED_INDEX_197_INJ.DEC_NACH_EINTRAG "Fault code INDEX_197_INJ - debounce filter decrement after fault-memory entry [verified]" VALUE 0x71ED3 RL_VAL_UB 0 CM_0000 0 255 /end CHARACTERISTIC
/begin CHARACTERISTIC K_ED_INDEX_197_INJ.DEC_VOR_EINTRAG "Fault code INDEX_197_INJ - debounce filter decrement before fault-memory entry [verified]" VALUE 0x71ED1 RL_VAL_UB 0 CM_0000 0 255 /end CHARACTERISTIC
/begin CHARACTERISTIC K_ED_INDEX_197_INJ.FEHLERSCHWELLE "Fault code INDEX_197_INJ - debounce filter threshold for setting the fault [verified]" VALUE 0x71ECE RL_VAL_UB 0 CM_0000 0 255 /end CHARACTERISTIC
/begin CHARACTERISTIC K_ED_INDEX_197_INJ.INC_NACH_EINTRAG "Fault code INDEX_197_INJ - debounce filter increment after fault-memory entry [verified]" VALUE 0x71ED2 RL_VAL_UB 0 CM_0000 0 255 /end CHARACTERISTIC
/begin CHARACTERISTIC K_ED_INDEX_197_INJ.INC_VOR_EINTRAG "Fault code INDEX_197_INJ - debounce filter increment before fault-memory entry [verified]" VALUE 0x71ED0 RL_VAL_UB 0 CM_0000 0 255 /end CHARACTERISTIC
/begin CHARACTERISTIC K_ED_INDEX_197_INJ.KLASSENINDEX "Fault code INDEX_197_INJ - fault class selection (lamp / warning behaviour) [verified]" VALUE 0x71ED4 RL_VAL_UB 0 CM_0000 0 255 /end CHARACTERISTIC
/begin CHARACTERISTIC K_ED_INDEX_197_INJ.OK_SCHWELLE "Fault code INDEX_197_INJ - debounce filter threshold for clearing (healing) the fault [verified]" VALUE 0x71ECF RL_VAL_UB 0 CM_0000 0 255 /end CHARACTERISTIC
/begin CHARACTERISTIC K_ED_INDEX_197_INJ.P_CODE_OPENLOAD "Fault code INDEX_197_INJ - OBD P-code reported for open circuit [verified]" VALUE 0x71ECA RL_VAL_UW 0 CM_0000 0 65535 /end CHARACTERISTIC
/begin CHARACTERISTIC K_ED_INDEX_197_INJ.P_CODE_SH_TO_GND "Fault code INDEX_197_INJ - OBD P-code reported for short to ground [verified]" VALUE 0x71EC8 RL_VAL_UW 0 CM_0000 0 65535 /end CHARACTERISTIC
/begin CHARACTERISTIC K_ED_INDEX_197_INJ.P_CODE_SH_TO_UB "Fault code INDEX_197_INJ - OBD P-code reported for short to battery voltage [verified]" VALUE 0x71EC6 RL_VAL_UW 0 CM_0000 0 65535 /end CHARACTERISTIC
/begin CHARACTERISTIC K_ED_INDEX_197_INJ.P_CODE_UNPLAUSIBEL "Fault code INDEX_197_INJ - OBD P-code reported for implausible signal [verified]" VALUE 0x71ECC RL_VAL_UW 0 CM_0000 0 65535 /end CHARACTERISTIC
/begin CHARACTERISTIC K_ED_INDEX_198_INJ.DEC_NACH_EINTRAG "Fault code INDEX_198_INJ - debounce filter decrement after fault-memory entry [verified]" VALUE 0x71EED RL_VAL_UB 0 CM_0000 0 255 /end CHARACTERISTIC
/begin CHARACTERISTIC K_ED_INDEX_198_INJ.DEC_VOR_EINTRAG "Fault code INDEX_198_INJ - debounce filter decrement before fault-memory entry [verified]" VALUE 0x71EEB RL_VAL_UB 0 CM_0000 0 255 /end CHARACTERISTIC
/begin CHARACTERISTIC K_ED_INDEX_198_INJ.FEHLERSCHWELLE "Fault code INDEX_198_INJ - debounce filter threshold for setting the fault [verified]" VALUE 0x71EE8 RL_VAL_UB 0 CM_0000 0 255 /end CHARACTERISTIC
/begin CHARACTERISTIC K_ED_INDEX_198_INJ.INC_NACH_EINTRAG "Fault code INDEX_198_INJ - debounce filter increment after fault-memory entry [verified]" VALUE 0x71EEC RL_VAL_UB 0 CM_0000 0 255 /end CHARACTERISTIC
/begin CHARACTERISTIC K_ED_INDEX_198_INJ.INC_VOR_EINTRAG "Fault code INDEX_198_INJ - debounce filter increment before fault-memory entry [verified]" VALUE 0x71EEA RL_VAL_UB 0 CM_0000 0 255 /end CHARACTERISTIC
/begin CHARACTERISTIC K_ED_INDEX_198_INJ.KLASSENINDEX "Fault code INDEX_198_INJ - fault class selection (lamp / warning behaviour) [verified]" VALUE 0x71EEE RL_VAL_UB 0 CM_0000 0 255 /end CHARACTERISTIC
/begin CHARACTERISTIC K_ED_INDEX_198_INJ.OK_SCHWELLE "Fault code INDEX_198_INJ - debounce filter threshold for clearing (healing) the fault [verified]" VALUE 0x71EE9 RL_VAL_UB 0 CM_0000 0 255 /end CHARACTERISTIC
/begin CHARACTERISTIC K_ED_INDEX_198_INJ.P_CODE_OPENLOAD "Fault code INDEX_198_INJ - OBD P-code reported for open circuit [verified]" VALUE 0x71EE4 RL_VAL_UW 0 CM_0000 0 65535 /end CHARACTERISTIC
/begin CHARACTERISTIC K_ED_INDEX_198_INJ.P_CODE_SH_TO_GND "Fault code INDEX_198_INJ - OBD P-code reported for short to ground [verified]" VALUE 0x71EE2 RL_VAL_UW 0 CM_0000 0 65535 /end CHARACTERISTIC
/begin CHARACTERISTIC K_ED_INDEX_198_INJ.P_CODE_SH_TO_UB "Fault code INDEX_198_INJ - OBD P-code reported for short to battery voltage [verified]" VALUE 0x71EE0 RL_VAL_UW 0 CM_0000 0 65535 /end CHARACTERISTIC
/begin CHARACTERISTIC K_ED_INDEX_198_INJ.P_CODE_UNPLAUSIBEL "Fault code INDEX_198_INJ - OBD P-code reported for implausible signal [verified]" VALUE 0x71EE6 RL_VAL_UW 0 CM_0000 0 65535 /end CHARACTERISTIC
/begin CHARACTERISTIC K_ED_INDEX_199_INJ.DEC_NACH_EINTRAG "Fault code INDEX_199_INJ - debounce filter decrement after fault-memory entry [verified]" VALUE 0x71F07 RL_VAL_UB 0 CM_0000 0 255 /end CHARACTERISTIC
/begin CHARACTERISTIC K_ED_INDEX_199_INJ.DEC_VOR_EINTRAG "Fault code INDEX_199_INJ - debounce filter decrement before fault-memory entry [verified]" VALUE 0x71F05 RL_VAL_UB 0 CM_0000 0 255 /end CHARACTERISTIC
/begin CHARACTERISTIC K_ED_INDEX_199_INJ.FEHLERSCHWELLE "Fault code INDEX_199_INJ - debounce filter threshold for setting the fault [verified]" VALUE 0x71F02 RL_VAL_UB 0 CM_0000 0 255 /end CHARACTERISTIC
/begin CHARACTERISTIC K_ED_INDEX_199_INJ.INC_NACH_EINTRAG "Fault code INDEX_199_INJ - debounce filter increment after fault-memory entry [verified]" VALUE 0x71F06 RL_VAL_UB 0 CM_0000 0 255 /end CHARACTERISTIC
/begin CHARACTERISTIC K_ED_INDEX_199_INJ.INC_VOR_EINTRAG "Fault code INDEX_199_INJ - debounce filter increment before fault-memory entry [verified]" VALUE 0x71F04 RL_VAL_UB 0 CM_0000 0 255 /end CHARACTERISTIC
/begin CHARACTERISTIC K_ED_INDEX_199_INJ.KLASSENINDEX "Fault code INDEX_199_INJ - fault class selection (lamp / warning behaviour) [verified]" VALUE 0x71F08 RL_VAL_UB 0 CM_0000 0 255 /end CHARACTERISTIC
/begin CHARACTERISTIC K_ED_INDEX_199_INJ.OK_SCHWELLE "Fault code INDEX_199_INJ - debounce filter threshold for clearing (healing) the fault [verified]" VALUE 0x71F03 RL_VAL_UB 0 CM_0000 0 255 /end CHARACTERISTIC
/begin CHARACTERISTIC K_ED_INDEX_199_INJ.P_CODE_OPENLOAD "Fault code INDEX_199_INJ - OBD P-code reported for open circuit [verified]" VALUE 0x71EFE RL_VAL_UW 0 CM_0000 0 65535 /end CHARACTERISTIC
/begin CHARACTERISTIC K_ED_INDEX_199_INJ.P_CODE_SH_TO_GND "Fault code INDEX_199_INJ - OBD P-code reported for short to ground [verified]" VALUE 0x71EFC RL_VAL_UW 0 CM_0000 0 65535 /end CHARACTERISTIC
/begin CHARACTERISTIC K_ED_INDEX_199_INJ.P_CODE_SH_TO_UB "Fault code INDEX_199_INJ - OBD P-code reported for short to battery voltage [verified]" VALUE 0x71EFA RL_VAL_UW 0 CM_0000 0 65535 /end CHARACTERISTIC
/begin CHARACTERISTIC K_ED_INDEX_199_INJ.P_CODE_UNPLAUSIBEL "Fault code INDEX_199_INJ - OBD P-code reported for implausible signal [verified]" VALUE 0x71F00 RL_VAL_UW 0 CM_0000 0 65535 /end CHARACTERISTIC
/begin CHARACTERISTIC K_ED_INDEX_200_INJ.DEC_NACH_EINTRAG "Fault code INDEX_200_INJ - debounce filter decrement after fault-memory entry [verified]" VALUE 0x71F21 RL_VAL_UB 0 CM_0000 0 255 /end CHARACTERISTIC
/begin CHARACTERISTIC K_ED_INDEX_200_INJ.DEC_VOR_EINTRAG "Fault code INDEX_200_INJ - debounce filter decrement before fault-memory entry [verified]" VALUE 0x71F1F RL_VAL_UB 0 CM_0000 0 255 /end CHARACTERISTIC
/begin CHARACTERISTIC K_ED_INDEX_200_INJ.FEHLERSCHWELLE "Fault code INDEX_200_INJ - debounce filter threshold for setting the fault [verified]" VALUE 0x71F1C RL_VAL_UB 0 CM_0000 0 255 /end CHARACTERISTIC
/begin CHARACTERISTIC K_ED_INDEX_200_INJ.INC_NACH_EINTRAG "Fault code INDEX_200_INJ - debounce filter increment after fault-memory entry [verified]" VALUE 0x71F20 RL_VAL_UB 0 CM_0000 0 255 /end CHARACTERISTIC
/begin CHARACTERISTIC K_ED_INDEX_200_INJ.INC_VOR_EINTRAG "Fault code INDEX_200_INJ - debounce filter increment before fault-memory entry [verified]" VALUE 0x71F1E RL_VAL_UB 0 CM_0000 0 255 /end CHARACTERISTIC
/begin CHARACTERISTIC K_ED_INDEX_200_INJ.KLASSENINDEX "Fault code INDEX_200_INJ - fault class selection (lamp / warning behaviour) [verified]" VALUE 0x71F22 RL_VAL_UB 0 CM_0000 0 255 /end CHARACTERISTIC
/begin CHARACTERISTIC K_ED_INDEX_200_INJ.OK_SCHWELLE "Fault code INDEX_200_INJ - debounce filter threshold for clearing (healing) the fault [verified]" VALUE 0x71F1D RL_VAL_UB 0 CM_0000 0 255 /end CHARACTERISTIC
/begin CHARACTERISTIC K_ED_INDEX_200_INJ.P_CODE_OPENLOAD "Fault code INDEX_200_INJ - OBD P-code reported for open circuit [verified]" VALUE 0x71F18 RL_VAL_UW 0 CM_0000 0 65535 /end CHARACTERISTIC
/begin CHARACTERISTIC K_ED_INDEX_200_INJ.P_CODE_SH_TO_GND "Fault code INDEX_200_INJ - OBD P-code reported for short to ground [verified]" VALUE 0x71F16 RL_VAL_UW 0 CM_0000 0 65535 /end CHARACTERISTIC
/begin CHARACTERISTIC K_ED_INDEX_200_INJ.P_CODE_SH_TO_UB "Fault code INDEX_200_INJ - OBD P-code reported for short to battery voltage [verified]" VALUE 0x71F14 RL_VAL_UW 0 CM_0000 0 65535 /end CHARACTERISTIC
/begin CHARACTERISTIC K_ED_INDEX_200_INJ.P_CODE_UNPLAUSIBEL "Fault code INDEX_200_INJ - OBD P-code reported for implausible signal [verified]" VALUE 0x71F1A RL_VAL_UW 0 CM_0000 0 65535 /end CHARACTERISTIC
/begin CHARACTERISTIC K_ED_INDEX_201_INJ.DEC_NACH_EINTRAG "Fault code INDEX_201_INJ - debounce filter decrement after fault-memory entry [verified]" VALUE 0x71F3B RL_VAL_UB 0 CM_0000 0 255 /end CHARACTERISTIC
/begin CHARACTERISTIC K_ED_INDEX_201_INJ.DEC_VOR_EINTRAG "Fault code INDEX_201_INJ - debounce filter decrement before fault-memory entry [verified]" VALUE 0x71F39 RL_VAL_UB 0 CM_0000 0 255 /end CHARACTERISTIC
/begin CHARACTERISTIC K_ED_INDEX_201_INJ.FEHLERSCHWELLE "Fault code INDEX_201_INJ - debounce filter threshold for setting the fault [verified]" VALUE 0x71F36 RL_VAL_UB 0 CM_0000 0 255 /end CHARACTERISTIC
/begin CHARACTERISTIC K_ED_INDEX_201_INJ.INC_NACH_EINTRAG "Fault code INDEX_201_INJ - debounce filter increment after fault-memory entry [verified]" VALUE 0x71F3A RL_VAL_UB 0 CM_0000 0 255 /end CHARACTERISTIC
/begin CHARACTERISTIC K_ED_INDEX_201_INJ.INC_VOR_EINTRAG "Fault code INDEX_201_INJ - debounce filter increment before fault-memory entry [verified]" VALUE 0x71F38 RL_VAL_UB 0 CM_0000 0 255 /end CHARACTERISTIC
/begin CHARACTERISTIC K_ED_INDEX_201_INJ.KLASSENINDEX "Fault code INDEX_201_INJ - fault class selection (lamp / warning behaviour) [verified]" VALUE 0x71F3C RL_VAL_UB 0 CM_0000 0 255 /end CHARACTERISTIC
/begin CHARACTERISTIC K_ED_INDEX_201_INJ.OK_SCHWELLE "Fault code INDEX_201_INJ - debounce filter threshold for clearing (healing) the fault [verified]" VALUE 0x71F37 RL_VAL_UB 0 CM_0000 0 255 /end CHARACTERISTIC
/begin CHARACTERISTIC K_ED_INDEX_201_INJ.P_CODE_OPENLOAD "Fault code INDEX_201_INJ - OBD P-code reported for open circuit [verified]" VALUE 0x71F32 RL_VAL_UW 0 CM_0000 0 65535 /end CHARACTERISTIC
/begin CHARACTERISTIC K_ED_INDEX_201_INJ.P_CODE_SH_TO_GND "Fault code INDEX_201_INJ - OBD P-code reported for short to ground [verified]" VALUE 0x71F30 RL_VAL_UW 0 CM_0000 0 65535 /end CHARACTERISTIC
/begin CHARACTERISTIC K_ED_INDEX_201_INJ.P_CODE_SH_TO_UB "Fault code INDEX_201_INJ - OBD P-code reported for short to battery voltage [verified]" VALUE 0x71F2E RL_VAL_UW 0 CM_0000 0 65535 /end CHARACTERISTIC
/begin CHARACTERISTIC K_ED_INDEX_201_INJ.P_CODE_UNPLAUSIBEL "Fault code INDEX_201_INJ - OBD P-code reported for implausible signal [verified]" VALUE 0x71F34 RL_VAL_UW 0 CM_0000 0 65535 /end CHARACTERISTIC
/begin CHARACTERISTIC K_ED_INDEX_202_INJ.DEC_NACH_EINTRAG "Fault code INDEX_202_INJ - debounce filter decrement after fault-memory entry [verified]" VALUE 0x71F55 RL_VAL_UB 0 CM_0000 0 255 /end CHARACTERISTIC
/begin CHARACTERISTIC K_ED_INDEX_202_INJ.DEC_VOR_EINTRAG "Fault code INDEX_202_INJ - debounce filter decrement before fault-memory entry [verified]" VALUE 0x71F53 RL_VAL_UB 0 CM_0000 0 255 /end CHARACTERISTIC
/begin CHARACTERISTIC K_ED_INDEX_202_INJ.FEHLERSCHWELLE "Fault code INDEX_202_INJ - debounce filter threshold for setting the fault [verified]" VALUE 0x71F50 RL_VAL_UB 0 CM_0000 0 255 /end CHARACTERISTIC
/begin CHARACTERISTIC K_ED_INDEX_202_INJ.INC_NACH_EINTRAG "Fault code INDEX_202_INJ - debounce filter increment after fault-memory entry [verified]" VALUE 0x71F54 RL_VAL_UB 0 CM_0000 0 255 /end CHARACTERISTIC
/begin CHARACTERISTIC K_ED_INDEX_202_INJ.INC_VOR_EINTRAG "Fault code INDEX_202_INJ - debounce filter increment before fault-memory entry [verified]" VALUE 0x71F52 RL_VAL_UB 0 CM_0000 0 255 /end CHARACTERISTIC
/begin CHARACTERISTIC K_ED_INDEX_202_INJ.KLASSENINDEX "Fault code INDEX_202_INJ - fault class selection (lamp / warning behaviour) [verified]" VALUE 0x71F56 RL_VAL_UB 0 CM_0000 0 255 /end CHARACTERISTIC
/begin CHARACTERISTIC K_ED_INDEX_202_INJ.OK_SCHWELLE "Fault code INDEX_202_INJ - debounce filter threshold for clearing (healing) the fault [verified]" VALUE 0x71F51 RL_VAL_UB 0 CM_0000 0 255 /end CHARACTERISTIC
/begin CHARACTERISTIC K_ED_INDEX_202_INJ.P_CODE_OPENLOAD "Fault code INDEX_202_INJ - OBD P-code reported for open circuit [verified]" VALUE 0x71F4C RL_VAL_UW 0 CM_0000 0 65535 /end CHARACTERISTIC
/begin CHARACTERISTIC K_ED_INDEX_202_INJ.P_CODE_SH_TO_GND "Fault code INDEX_202_INJ - OBD P-code reported for short to ground [verified]" VALUE 0x71F4A RL_VAL_UW 0 CM_0000 0 65535 /end CHARACTERISTIC
/begin CHARACTERISTIC K_ED_INDEX_202_INJ.P_CODE_SH_TO_UB "Fault code INDEX_202_INJ - OBD P-code reported for short to battery voltage [verified]" VALUE 0x71F48 RL_VAL_UW 0 CM_0000 0 65535 /end CHARACTERISTIC
/begin CHARACTERISTIC K_ED_INDEX_202_INJ.P_CODE_UNPLAUSIBEL "Fault code INDEX_202_INJ - OBD P-code reported for implausible signal [verified]" VALUE 0x71F4E RL_VAL_UW 0 CM_0000 0 65535 /end CHARACTERISTIC
/begin CHARACTERISTIC K_ED_INDEX_203_INJ.DEC_NACH_EINTRAG "Fault code INDEX_203_INJ - debounce filter decrement after fault-memory entry [verified]" VALUE 0x71F6F RL_VAL_UB 0 CM_0000 0 255 /end CHARACTERISTIC
/begin CHARACTERISTIC K_ED_INDEX_203_INJ.DEC_VOR_EINTRAG "Fault code INDEX_203_INJ - debounce filter decrement before fault-memory entry [verified]" VALUE 0x71F6D RL_VAL_UB 0 CM_0000 0 255 /end CHARACTERISTIC
/begin CHARACTERISTIC K_ED_INDEX_203_INJ.FEHLERSCHWELLE "Fault code INDEX_203_INJ - debounce filter threshold for setting the fault [verified]" VALUE 0x71F6A RL_VAL_UB 0 CM_0000 0 255 /end CHARACTERISTIC
/begin CHARACTERISTIC K_ED_INDEX_203_INJ.INC_NACH_EINTRAG "Fault code INDEX_203_INJ - debounce filter increment after fault-memory entry [verified]" VALUE 0x71F6E RL_VAL_UB 0 CM_0000 0 255 /end CHARACTERISTIC
/begin CHARACTERISTIC K_ED_INDEX_203_INJ.INC_VOR_EINTRAG "Fault code INDEX_203_INJ - debounce filter increment before fault-memory entry [verified]" VALUE 0x71F6C RL_VAL_UB 0 CM_0000 0 255 /end CHARACTERISTIC
/begin CHARACTERISTIC K_ED_INDEX_203_INJ.KLASSENINDEX "Fault code INDEX_203_INJ - fault class selection (lamp / warning behaviour) [verified]" VALUE 0x71F70 RL_VAL_UB 0 CM_0000 0 255 /end CHARACTERISTIC
/begin CHARACTERISTIC K_ED_INDEX_203_INJ.OK_SCHWELLE "Fault code INDEX_203_INJ - debounce filter threshold for clearing (healing) the fault [verified]" VALUE 0x71F6B RL_VAL_UB 0 CM_0000 0 255 /end CHARACTERISTIC
/begin CHARACTERISTIC K_ED_INDEX_203_INJ.P_CODE_OPENLOAD "Fault code INDEX_203_INJ - OBD P-code reported for open circuit [verified]" VALUE 0x71F66 RL_VAL_UW 0 CM_0000 0 65535 /end CHARACTERISTIC
/begin CHARACTERISTIC K_ED_INDEX_203_INJ.P_CODE_SH_TO_GND "Fault code INDEX_203_INJ - OBD P-code reported for short to ground [verified]" VALUE 0x71F64 RL_VAL_UW 0 CM_0000 0 65535 /end CHARACTERISTIC
/begin CHARACTERISTIC K_ED_INDEX_203_INJ.P_CODE_SH_TO_UB "Fault code INDEX_203_INJ - OBD P-code reported for short to battery voltage [verified]" VALUE 0x71F62 RL_VAL_UW 0 CM_0000 0 65535 /end CHARACTERISTIC
/begin CHARACTERISTIC K_ED_INDEX_203_INJ.P_CODE_UNPLAUSIBEL "Fault code INDEX_203_INJ - OBD P-code reported for implausible signal [verified]" VALUE 0x71F68 RL_VAL_UW 0 CM_0000 0 65535 /end CHARACTERISTIC
/begin CHARACTERISTIC K_ED_INDEX_204_INJ.DEC_NACH_EINTRAG "Fault code INDEX_204_INJ - debounce filter decrement after fault-memory entry [verified]" VALUE 0x71F89 RL_VAL_UB 0 CM_0000 0 255 /end CHARACTERISTIC
/begin CHARACTERISTIC K_ED_INDEX_204_INJ.DEC_VOR_EINTRAG "Fault code INDEX_204_INJ - debounce filter decrement before fault-memory entry [verified]" VALUE 0x71F87 RL_VAL_UB 0 CM_0000 0 255 /end CHARACTERISTIC
/begin CHARACTERISTIC K_ED_INDEX_204_INJ.FEHLERSCHWELLE "Fault code INDEX_204_INJ - debounce filter threshold for setting the fault [verified]" VALUE 0x71F84 RL_VAL_UB 0 CM_0000 0 255 /end CHARACTERISTIC
/begin CHARACTERISTIC K_ED_INDEX_204_INJ.INC_NACH_EINTRAG "Fault code INDEX_204_INJ - debounce filter increment after fault-memory entry [verified]" VALUE 0x71F88 RL_VAL_UB 0 CM_0000 0 255 /end CHARACTERISTIC
/begin CHARACTERISTIC K_ED_INDEX_204_INJ.INC_VOR_EINTRAG "Fault code INDEX_204_INJ - debounce filter increment before fault-memory entry [verified]" VALUE 0x71F86 RL_VAL_UB 0 CM_0000 0 255 /end CHARACTERISTIC
/begin CHARACTERISTIC K_ED_INDEX_204_INJ.KLASSENINDEX "Fault code INDEX_204_INJ - fault class selection (lamp / warning behaviour) [verified]" VALUE 0x71F8A RL_VAL_UB 0 CM_0000 0 255 /end CHARACTERISTIC
/begin CHARACTERISTIC K_ED_INDEX_204_INJ.OK_SCHWELLE "Fault code INDEX_204_INJ - debounce filter threshold for clearing (healing) the fault [verified]" VALUE 0x71F85 RL_VAL_UB 0 CM_0000 0 255 /end CHARACTERISTIC
/begin CHARACTERISTIC K_ED_INDEX_204_INJ.P_CODE_OPENLOAD "Fault code INDEX_204_INJ - OBD P-code reported for open circuit [verified]" VALUE 0x71F80 RL_VAL_UW 0 CM_0000 0 65535 /end CHARACTERISTIC
/begin CHARACTERISTIC K_ED_INDEX_204_INJ.P_CODE_SH_TO_GND "Fault code INDEX_204_INJ - OBD P-code reported for short to ground [verified]" VALUE 0x71F7E RL_VAL_UW 0 CM_0000 0 65535 /end CHARACTERISTIC
/begin CHARACTERISTIC K_ED_INDEX_204_INJ.P_CODE_SH_TO_UB "Fault code INDEX_204_INJ - OBD P-code reported for short to battery voltage [verified]" VALUE 0x71F7C RL_VAL_UW 0 CM_0000 0 65535 /end CHARACTERISTIC
/begin CHARACTERISTIC K_ED_INDEX_204_INJ.P_CODE_UNPLAUSIBEL "Fault code INDEX_204_INJ - OBD P-code reported for implausible signal [verified]" VALUE 0x71F82 RL_VAL_UW 0 CM_0000 0 65535 /end CHARACTERISTIC
/begin CHARACTERISTIC K_ED_INDEX_205_INJ.DEC_NACH_EINTRAG "Fault code INDEX_205_INJ - debounce filter decrement after fault-memory entry [verified]" VALUE 0x71FA3 RL_VAL_UB 0 CM_0000 0 255 /end CHARACTERISTIC
/begin CHARACTERISTIC K_ED_INDEX_205_INJ.DEC_VOR_EINTRAG "Fault code INDEX_205_INJ - debounce filter decrement before fault-memory entry [verified]" VALUE 0x71FA1 RL_VAL_UB 0 CM_0000 0 255 /end CHARACTERISTIC
/begin CHARACTERISTIC K_ED_INDEX_205_INJ.FEHLERSCHWELLE "Fault code INDEX_205_INJ - debounce filter threshold for setting the fault [verified]" VALUE 0x71F9E RL_VAL_UB 0 CM_0000 0 255 /end CHARACTERISTIC
/begin CHARACTERISTIC K_ED_INDEX_205_INJ.INC_NACH_EINTRAG "Fault code INDEX_205_INJ - debounce filter increment after fault-memory entry [verified]" VALUE 0x71FA2 RL_VAL_UB 0 CM_0000 0 255 /end CHARACTERISTIC
/begin CHARACTERISTIC K_ED_INDEX_205_INJ.INC_VOR_EINTRAG "Fault code INDEX_205_INJ - debounce filter increment before fault-memory entry [verified]" VALUE 0x71FA0 RL_VAL_UB 0 CM_0000 0 255 /end CHARACTERISTIC
/begin CHARACTERISTIC K_ED_INDEX_205_INJ.KLASSENINDEX "Fault code INDEX_205_INJ - fault class selection (lamp / warning behaviour) [verified]" VALUE 0x71FA4 RL_VAL_UB 0 CM_0000 0 255 /end CHARACTERISTIC
/begin CHARACTERISTIC K_ED_INDEX_205_INJ.OK_SCHWELLE "Fault code INDEX_205_INJ - debounce filter threshold for clearing (healing) the fault [verified]" VALUE 0x71F9F RL_VAL_UB 0 CM_0000 0 255 /end CHARACTERISTIC
/begin CHARACTERISTIC K_ED_INDEX_205_INJ.P_CODE_OPENLOAD "Fault code INDEX_205_INJ - OBD P-code reported for open circuit [verified]" VALUE 0x71F9A RL_VAL_UW 0 CM_0000 0 65535 /end CHARACTERISTIC
/begin CHARACTERISTIC K_ED_INDEX_205_INJ.P_CODE_SH_TO_GND "Fault code INDEX_205_INJ - OBD P-code reported for short to ground [verified]" VALUE 0x71F98 RL_VAL_UW 0 CM_0000 0 65535 /end CHARACTERISTIC
/begin CHARACTERISTIC K_ED_INDEX_205_INJ.P_CODE_SH_TO_UB "Fault code INDEX_205_INJ - OBD P-code reported for short to battery voltage [verified]" VALUE 0x71F96 RL_VAL_UW 0 CM_0000 0 65535 /end CHARACTERISTIC
/begin CHARACTERISTIC K_ED_INDEX_205_INJ.P_CODE_UNPLAUSIBEL "Fault code INDEX_205_INJ - OBD P-code reported for implausible signal [verified]" VALUE 0x71F9C RL_VAL_UW 0 CM_0000 0 65535 /end CHARACTERISTIC
/begin CHARACTERISTIC K_ED_INDEX_206_INJ.DEC_NACH_EINTRAG "Fault code INDEX_206_INJ - debounce filter decrement after fault-memory entry [verified]" VALUE 0x71FBD RL_VAL_UB 0 CM_0000 0 255 /end CHARACTERISTIC
/begin CHARACTERISTIC K_ED_INDEX_206_INJ.DEC_VOR_EINTRAG "Fault code INDEX_206_INJ - debounce filter decrement before fault-memory entry [verified]" VALUE 0x71FBB RL_VAL_UB 0 CM_0000 0 255 /end CHARACTERISTIC
/begin CHARACTERISTIC K_ED_INDEX_206_INJ.FEHLERSCHWELLE "Fault code INDEX_206_INJ - debounce filter threshold for setting the fault [verified]" VALUE 0x71FB8 RL_VAL_UB 0 CM_0000 0 255 /end CHARACTERISTIC
/begin CHARACTERISTIC K_ED_INDEX_206_INJ.INC_NACH_EINTRAG "Fault code INDEX_206_INJ - debounce filter increment after fault-memory entry [verified]" VALUE 0x71FBC RL_VAL_UB 0 CM_0000 0 255 /end CHARACTERISTIC
/begin CHARACTERISTIC K_ED_INDEX_206_INJ.INC_VOR_EINTRAG "Fault code INDEX_206_INJ - debounce filter increment before fault-memory entry [verified]" VALUE 0x71FBA RL_VAL_UB 0 CM_0000 0 255 /end CHARACTERISTIC
/begin CHARACTERISTIC K_ED_INDEX_206_INJ.KLASSENINDEX "Fault code INDEX_206_INJ - fault class selection (lamp / warning behaviour) [verified]" VALUE 0x71FBE RL_VAL_UB 0 CM_0000 0 255 /end CHARACTERISTIC
/begin CHARACTERISTIC K_ED_INDEX_206_INJ.OK_SCHWELLE "Fault code INDEX_206_INJ - debounce filter threshold for clearing (healing) the fault [verified]" VALUE 0x71FB9 RL_VAL_UB 0 CM_0000 0 255 /end CHARACTERISTIC
/begin CHARACTERISTIC K_ED_INDEX_206_INJ.P_CODE_OPENLOAD "Fault code INDEX_206_INJ - OBD P-code reported for open circuit [verified]" VALUE 0x71FB4 RL_VAL_UW 0 CM_0000 0 65535 /end CHARACTERISTIC
/begin CHARACTERISTIC K_ED_INDEX_206_INJ.P_CODE_SH_TO_GND "Fault code INDEX_206_INJ - OBD P-code reported for short to ground [verified]" VALUE 0x71FB2 RL_VAL_UW 0 CM_0000 0 65535 /end CHARACTERISTIC
/begin CHARACTERISTIC K_ED_INDEX_206_INJ.P_CODE_SH_TO_UB "Fault code INDEX_206_INJ - OBD P-code reported for short to battery voltage [verified]" VALUE 0x71FB0 RL_VAL_UW 0 CM_0000 0 65535 /end CHARACTERISTIC
/begin CHARACTERISTIC K_ED_INDEX_206_INJ.P_CODE_UNPLAUSIBEL "Fault code INDEX_206_INJ - OBD P-code reported for implausible signal [verified]" VALUE 0x71FB6 RL_VAL_UW 0 CM_0000 0 65535 /end CHARACTERISTIC
/begin CHARACTERISTIC K_ED_KATS_B1.DEC_NACH_EINTRAG "Fault code KATS_B1 - debounce filter decrement after fault-memory entry [verified]" VALUE 0x71C49 RL_VAL_UB 0 CM_0000 0 255 /end CHARACTERISTIC
/begin CHARACTERISTIC K_ED_KATS_B1.DEC_VOR_EINTRAG "Fault code KATS_B1 - debounce filter decrement before fault-memory entry [verified]" VALUE 0x71C47 RL_VAL_UB 0 CM_0000 0 255 /end CHARACTERISTIC
/begin CHARACTERISTIC K_ED_KATS_B1.FEHLERSCHWELLE "Fault code KATS_B1 - debounce filter threshold for setting the fault [verified]" VALUE 0x71C44 RL_VAL_UB 0 CM_0000 0 255 /end CHARACTERISTIC
/begin CHARACTERISTIC K_ED_KATS_B1.INC_NACH_EINTRAG "Fault code KATS_B1 - debounce filter increment after fault-memory entry [verified]" VALUE 0x71C48 RL_VAL_UB 0 CM_0000 0 255 /end CHARACTERISTIC
/begin CHARACTERISTIC K_ED_KATS_B1.INC_VOR_EINTRAG "Fault code KATS_B1 - debounce filter increment before fault-memory entry [verified]" VALUE 0x71C46 RL_VAL_UB 0 CM_0000 0 255 /end CHARACTERISTIC
/begin CHARACTERISTIC K_ED_KATS_B1.KLASSENINDEX "Fault code KATS_B1 - fault class selection (lamp / warning behaviour) [verified]" VALUE 0x71C4A RL_VAL_UB 0 CM_0000 0 255 /end CHARACTERISTIC
/begin CHARACTERISTIC K_ED_KATS_B1.OK_SCHWELLE "Fault code KATS_B1 - debounce filter threshold for clearing (healing) the fault [verified]" VALUE 0x71C45 RL_VAL_UB 0 CM_0000 0 255 /end CHARACTERISTIC
/begin CHARACTERISTIC K_ED_KATS_B1.P_CODE_OPENLOAD "Fault code KATS_B1 - OBD P-code reported for open circuit [verified]" VALUE 0x71C40 RL_VAL_UW 0 CM_0000 0 65535 /end CHARACTERISTIC
/begin CHARACTERISTIC K_ED_KATS_B1.P_CODE_SH_TO_GND "Fault code KATS_B1 - OBD P-code reported for short to ground [verified]" VALUE 0x71C3E RL_VAL_UW 0 CM_0000 0 65535 /end CHARACTERISTIC
/begin CHARACTERISTIC K_ED_KATS_B1.P_CODE_SH_TO_UB "Fault code KATS_B1 - OBD P-code reported for short to battery voltage [verified]" VALUE 0x71C3C RL_VAL_UW 0 CM_0000 0 65535 /end CHARACTERISTIC
/begin CHARACTERISTIC K_ED_KATS_B1.P_CODE_UNPLAUSIBEL "Fault code KATS_B1 - OBD P-code reported for implausible signal [verified]" VALUE 0x71C42 RL_VAL_UW 0 CM_0000 0 65535 /end CHARACTERISTIC
/begin CHARACTERISTIC K_ED_KATS_B2.DEC_NACH_EINTRAG "Fault code KATS_B2 - debounce filter decrement after fault-memory entry [verified]" VALUE 0x71C63 RL_VAL_UB 0 CM_0000 0 255 /end CHARACTERISTIC
/begin CHARACTERISTIC K_ED_KATS_B2.DEC_VOR_EINTRAG "Fault code KATS_B2 - debounce filter decrement before fault-memory entry [verified]" VALUE 0x71C61 RL_VAL_UB 0 CM_0000 0 255 /end CHARACTERISTIC
/begin CHARACTERISTIC K_ED_KATS_B2.FEHLERSCHWELLE "Fault code KATS_B2 - debounce filter threshold for setting the fault [verified]" VALUE 0x71C5E RL_VAL_UB 0 CM_0000 0 255 /end CHARACTERISTIC
/begin CHARACTERISTIC K_ED_KATS_B2.INC_NACH_EINTRAG "Fault code KATS_B2 - debounce filter increment after fault-memory entry [verified]" VALUE 0x71C62 RL_VAL_UB 0 CM_0000 0 255 /end CHARACTERISTIC
/begin CHARACTERISTIC K_ED_KATS_B2.INC_VOR_EINTRAG "Fault code KATS_B2 - debounce filter increment before fault-memory entry [verified]" VALUE 0x71C60 RL_VAL_UB 0 CM_0000 0 255 /end CHARACTERISTIC
/begin CHARACTERISTIC K_ED_KATS_B2.KLASSENINDEX "Fault code KATS_B2 - fault class selection (lamp / warning behaviour) [verified]" VALUE 0x71C64 RL_VAL_UB 0 CM_0000 0 255 /end CHARACTERISTIC
/begin CHARACTERISTIC K_ED_KATS_B2.OK_SCHWELLE "Fault code KATS_B2 - debounce filter threshold for clearing (healing) the fault [verified]" VALUE 0x71C5F RL_VAL_UB 0 CM_0000 0 255 /end CHARACTERISTIC
/begin CHARACTERISTIC K_ED_KATS_B2.P_CODE_OPENLOAD "Fault code KATS_B2 - OBD P-code reported for open circuit [verified]" VALUE 0x71C5A RL_VAL_UW 0 CM_0000 0 65535 /end CHARACTERISTIC
/begin CHARACTERISTIC K_ED_KATS_B2.P_CODE_SH_TO_GND "Fault code KATS_B2 - OBD P-code reported for short to ground [verified]" VALUE 0x71C58 RL_VAL_UW 0 CM_0000 0 65535 /end CHARACTERISTIC
/begin CHARACTERISTIC K_ED_KATS_B2.P_CODE_SH_TO_UB "Fault code KATS_B2 - OBD P-code reported for short to battery voltage [verified]" VALUE 0x71C56 RL_VAL_UW 0 CM_0000 0 65535 /end CHARACTERISTIC
/begin CHARACTERISTIC K_ED_KATS_B2.P_CODE_UNPLAUSIBEL "Fault code KATS_B2 - OBD P-code reported for implausible signal [verified]" VALUE 0x71C5C RL_VAL_UW 0 CM_0000 0 65535 /end CHARACTERISTIC
/begin CHARACTERISTIC K_ED_KAT_OBD1.DEC_NACH_EINTRAG "Fault code KAT_OBD1 - debounce filter decrement after fault-memory entry [verified]" VALUE 0x7171B RL_VAL_UB 0 CM_0000 0 255 /end CHARACTERISTIC
/begin CHARACTERISTIC K_ED_KAT_OBD1.DEC_VOR_EINTRAG "Fault code KAT_OBD1 - debounce filter decrement before fault-memory entry [verified]" VALUE 0x71719 RL_VAL_UB 0 CM_0000 0 255 /end CHARACTERISTIC
/begin CHARACTERISTIC K_ED_KAT_OBD1.FEHLERSCHWELLE "Fault code KAT_OBD1 - debounce filter threshold for setting the fault [verified]" VALUE 0x71716 RL_VAL_UB 0 CM_0000 0 255 /end CHARACTERISTIC
/begin CHARACTERISTIC K_ED_KAT_OBD1.INC_NACH_EINTRAG "Fault code KAT_OBD1 - debounce filter increment after fault-memory entry [verified]" VALUE 0x7171A RL_VAL_UB 0 CM_0000 0 255 /end CHARACTERISTIC
/begin CHARACTERISTIC K_ED_KAT_OBD1.INC_VOR_EINTRAG "Fault code KAT_OBD1 - debounce filter increment before fault-memory entry [verified]" VALUE 0x71718 RL_VAL_UB 0 CM_0000 0 255 /end CHARACTERISTIC
/begin CHARACTERISTIC K_ED_KAT_OBD1.KLASSENINDEX "Fault code KAT_OBD1 - fault class selection (lamp / warning behaviour) [verified]" VALUE 0x7171C RL_VAL_UB 0 CM_0000 0 255 /end CHARACTERISTIC
/begin CHARACTERISTIC K_ED_KAT_OBD1.OK_SCHWELLE "Fault code KAT_OBD1 - debounce filter threshold for clearing (healing) the fault [verified]" VALUE 0x71717 RL_VAL_UB 0 CM_0000 0 255 /end CHARACTERISTIC
/begin CHARACTERISTIC K_ED_KAT_OBD1.P_CODE_OPENLOAD "Fault code KAT_OBD1 - OBD P-code reported for open circuit [verified]" VALUE 0x71712 RL_VAL_UW 0 CM_0000 0 65535 /end CHARACTERISTIC
/begin CHARACTERISTIC K_ED_KAT_OBD1.P_CODE_SH_TO_GND "Fault code KAT_OBD1 - OBD P-code reported for short to ground [verified]" VALUE 0x71710 RL_VAL_UW 0 CM_0000 0 65535 /end CHARACTERISTIC
/begin CHARACTERISTIC K_ED_KAT_OBD1.P_CODE_SH_TO_UB "Fault code KAT_OBD1 - OBD P-code reported for short to battery voltage [verified]" VALUE 0x7170E RL_VAL_UW 0 CM_0000 0 65535 /end CHARACTERISTIC
/begin CHARACTERISTIC K_ED_KAT_OBD1.P_CODE_UNPLAUSIBEL "Fault code KAT_OBD1 - OBD P-code reported for implausible signal [verified]" VALUE 0x71714 RL_VAL_UW 0 CM_0000 0 65535 /end CHARACTERISTIC
/begin CHARACTERISTIC K_ED_KAT_OBD2.DEC_NACH_EINTRAG "Fault code KAT_OBD2 - debounce filter decrement after fault-memory entry [verified]" VALUE 0x71735 RL_VAL_UB 0 CM_0000 0 255 /end CHARACTERISTIC
/begin CHARACTERISTIC K_ED_KAT_OBD2.DEC_VOR_EINTRAG "Fault code KAT_OBD2 - debounce filter decrement before fault-memory entry [verified]" VALUE 0x71733 RL_VAL_UB 0 CM_0000 0 255 /end CHARACTERISTIC
/begin CHARACTERISTIC K_ED_KAT_OBD2.FEHLERSCHWELLE "Fault code KAT_OBD2 - debounce filter threshold for setting the fault [verified]" VALUE 0x71730 RL_VAL_UB 0 CM_0000 0 255 /end CHARACTERISTIC
/begin CHARACTERISTIC K_ED_KAT_OBD2.INC_NACH_EINTRAG "Fault code KAT_OBD2 - debounce filter increment after fault-memory entry [verified]" VALUE 0x71734 RL_VAL_UB 0 CM_0000 0 255 /end CHARACTERISTIC
/begin CHARACTERISTIC K_ED_KAT_OBD2.INC_VOR_EINTRAG "Fault code KAT_OBD2 - debounce filter increment before fault-memory entry [verified]" VALUE 0x71732 RL_VAL_UB 0 CM_0000 0 255 /end CHARACTERISTIC
/begin CHARACTERISTIC K_ED_KAT_OBD2.KLASSENINDEX "Fault code KAT_OBD2 - fault class selection (lamp / warning behaviour) [verified]" VALUE 0x71736 RL_VAL_UB 0 CM_0000 0 255 /end CHARACTERISTIC
/begin CHARACTERISTIC K_ED_KAT_OBD2.OK_SCHWELLE "Fault code KAT_OBD2 - debounce filter threshold for clearing (healing) the fault [verified]" VALUE 0x71731 RL_VAL_UB 0 CM_0000 0 255 /end CHARACTERISTIC
/begin CHARACTERISTIC K_ED_KAT_OBD2.P_CODE_OPENLOAD "Fault code KAT_OBD2 - OBD P-code reported for open circuit [verified]" VALUE 0x7172C RL_VAL_UW 0 CM_0000 0 65535 /end CHARACTERISTIC
/begin CHARACTERISTIC K_ED_KAT_OBD2.P_CODE_SH_TO_GND "Fault code KAT_OBD2 - OBD P-code reported for short to ground [verified]" VALUE 0x7172A RL_VAL_UW 0 CM_0000 0 65535 /end CHARACTERISTIC
/begin CHARACTERISTIC K_ED_KAT_OBD2.P_CODE_SH_TO_UB "Fault code KAT_OBD2 - OBD P-code reported for short to battery voltage [verified]" VALUE 0x71728 RL_VAL_UW 0 CM_0000 0 65535 /end CHARACTERISTIC
/begin CHARACTERISTIC K_ED_KAT_OBD2.P_CODE_UNPLAUSIBEL "Fault code KAT_OBD2 - OBD P-code reported for implausible signal [verified]" VALUE 0x7172E RL_VAL_UW 0 CM_0000 0 65535 /end CHARACTERISTIC
/begin CHARACTERISTIC K_ED_KGE1.DEC_NACH_EINTRAG "Fault code KGE1 - debounce filter decrement after fault-memory entry [verified]" VALUE 0x71AA9 RL_VAL_UB 0 CM_0000 0 255 /end CHARACTERISTIC
/begin CHARACTERISTIC K_ED_KGE1.DEC_VOR_EINTRAG "Fault code KGE1 - debounce filter decrement before fault-memory entry [verified]" VALUE 0x71AA7 RL_VAL_UB 0 CM_0000 0 255 /end CHARACTERISTIC
/begin CHARACTERISTIC K_ED_KGE1.FEHLERSCHWELLE "Fault code KGE1 - debounce filter threshold for setting the fault [verified]" VALUE 0x71AA4 RL_VAL_UB 0 CM_0000 0 255 /end CHARACTERISTIC
/begin CHARACTERISTIC K_ED_KGE1.INC_NACH_EINTRAG "Fault code KGE1 - debounce filter increment after fault-memory entry [verified]" VALUE 0x71AA8 RL_VAL_UB 0 CM_0000 0 255 /end CHARACTERISTIC
/begin CHARACTERISTIC K_ED_KGE1.INC_VOR_EINTRAG "Fault code KGE1 - debounce filter increment before fault-memory entry [verified]" VALUE 0x71AA6 RL_VAL_UB 0 CM_0000 0 255 /end CHARACTERISTIC
/begin CHARACTERISTIC K_ED_KGE1.KLASSENINDEX "Fault code KGE1 - fault class selection (lamp / warning behaviour) [verified]" VALUE 0x71AAA RL_VAL_UB 0 CM_0000 0 255 /end CHARACTERISTIC
/begin CHARACTERISTIC K_ED_KGE1.OK_SCHWELLE "Fault code KGE1 - debounce filter threshold for clearing (healing) the fault [verified]" VALUE 0x71AA5 RL_VAL_UB 0 CM_0000 0 255 /end CHARACTERISTIC
/begin CHARACTERISTIC K_ED_KGE1.P_CODE_OPENLOAD "Fault code KGE1 - OBD P-code reported for open circuit [verified]" VALUE 0x71AA0 RL_VAL_UW 0 CM_0000 0 65535 /end CHARACTERISTIC
/begin CHARACTERISTIC K_ED_KGE1.P_CODE_SH_TO_GND "Fault code KGE1 - OBD P-code reported for short to ground [verified]" VALUE 0x71A9E RL_VAL_UW 0 CM_0000 0 65535 /end CHARACTERISTIC
/begin CHARACTERISTIC K_ED_KGE1.P_CODE_SH_TO_UB "Fault code KGE1 - OBD P-code reported for short to battery voltage [verified]" VALUE 0x71A9C RL_VAL_UW 0 CM_0000 0 65535 /end CHARACTERISTIC
/begin CHARACTERISTIC K_ED_KGE1.P_CODE_UNPLAUSIBEL "Fault code KGE1 - OBD P-code reported for implausible signal [verified]" VALUE 0x71AA2 RL_VAL_UW 0 CM_0000 0 65535 /end CHARACTERISTIC
/begin CHARACTERISTIC K_ED_KGE2.DEC_NACH_EINTRAG "Fault code KGE2 - debounce filter decrement after fault-memory entry [verified]" VALUE 0x71AC3 RL_VAL_UB 0 CM_0000 0 255 /end CHARACTERISTIC
/begin CHARACTERISTIC K_ED_KGE2.DEC_VOR_EINTRAG "Fault code KGE2 - debounce filter decrement before fault-memory entry [verified]" VALUE 0x71AC1 RL_VAL_UB 0 CM_0000 0 255 /end CHARACTERISTIC
/begin CHARACTERISTIC K_ED_KGE2.FEHLERSCHWELLE "Fault code KGE2 - debounce filter threshold for setting the fault [verified]" VALUE 0x71ABE RL_VAL_UB 0 CM_0000 0 255 /end CHARACTERISTIC
/begin CHARACTERISTIC K_ED_KGE2.INC_NACH_EINTRAG "Fault code KGE2 - debounce filter increment after fault-memory entry [verified]" VALUE 0x71AC2 RL_VAL_UB 0 CM_0000 0 255 /end CHARACTERISTIC
/begin CHARACTERISTIC K_ED_KGE2.INC_VOR_EINTRAG "Fault code KGE2 - debounce filter increment before fault-memory entry [verified]" VALUE 0x71AC0 RL_VAL_UB 0 CM_0000 0 255 /end CHARACTERISTIC
/begin CHARACTERISTIC K_ED_KGE2.KLASSENINDEX "Fault code KGE2 - fault class selection (lamp / warning behaviour) [verified]" VALUE 0x71AC4 RL_VAL_UB 0 CM_0000 0 255 /end CHARACTERISTIC
/begin CHARACTERISTIC K_ED_KGE2.OK_SCHWELLE "Fault code KGE2 - debounce filter threshold for clearing (healing) the fault [verified]" VALUE 0x71ABF RL_VAL_UB 0 CM_0000 0 255 /end CHARACTERISTIC
/begin CHARACTERISTIC K_ED_KGE2.P_CODE_OPENLOAD "Fault code KGE2 - OBD P-code reported for open circuit [verified]" VALUE 0x71ABA RL_VAL_UW 0 CM_0000 0 65535 /end CHARACTERISTIC
/begin CHARACTERISTIC K_ED_KGE2.P_CODE_SH_TO_GND "Fault code KGE2 - OBD P-code reported for short to ground [verified]" VALUE 0x71AB8 RL_VAL_UW 0 CM_0000 0 65535 /end CHARACTERISTIC
/begin CHARACTERISTIC K_ED_KGE2.P_CODE_SH_TO_UB "Fault code KGE2 - OBD P-code reported for short to battery voltage [verified]" VALUE 0x71AB6 RL_VAL_UW 0 CM_0000 0 65535 /end CHARACTERISTIC
/begin CHARACTERISTIC K_ED_KGE2.P_CODE_UNPLAUSIBEL "Fault code KGE2 - OBD P-code reported for implausible signal [verified]" VALUE 0x71ABC RL_VAL_UW 0 CM_0000 0 65535 /end CHARACTERISTIC
/begin CHARACTERISTIC K_ED_KSD1.DEC_NACH_EINTRAG "Fault code KSD1 - debounce filter decrement after fault-memory entry [verified]" VALUE 0x71C15 RL_VAL_UB 0 CM_0000 0 255 /end CHARACTERISTIC
/begin CHARACTERISTIC K_ED_KSD1.DEC_VOR_EINTRAG "Fault code KSD1 - debounce filter decrement before fault-memory entry [verified]" VALUE 0x71C13 RL_VAL_UB 0 CM_0000 0 255 /end CHARACTERISTIC
/begin CHARACTERISTIC K_ED_KSD1.FEHLERSCHWELLE "Fault code KSD1 - debounce filter threshold for setting the fault [verified]" VALUE 0x71C10 RL_VAL_UB 0 CM_0000 0 255 /end CHARACTERISTIC
/begin CHARACTERISTIC K_ED_KSD1.INC_NACH_EINTRAG "Fault code KSD1 - debounce filter increment after fault-memory entry [verified]" VALUE 0x71C14 RL_VAL_UB 0 CM_0000 0 255 /end CHARACTERISTIC
/begin CHARACTERISTIC K_ED_KSD1.INC_VOR_EINTRAG "Fault code KSD1 - debounce filter increment before fault-memory entry [verified]" VALUE 0x71C12 RL_VAL_UB 0 CM_0000 0 255 /end CHARACTERISTIC
/begin CHARACTERISTIC K_ED_KSD1.KLASSENINDEX "Fault code KSD1 - fault class selection (lamp / warning behaviour) [verified]" VALUE 0x71C16 RL_VAL_UB 0 CM_0000 0 255 /end CHARACTERISTIC
/begin CHARACTERISTIC K_ED_KSD1.OK_SCHWELLE "Fault code KSD1 - debounce filter threshold for clearing (healing) the fault [verified]" VALUE 0x71C11 RL_VAL_UB 0 CM_0000 0 255 /end CHARACTERISTIC
/begin CHARACTERISTIC K_ED_KSD1.P_CODE_OPENLOAD "Fault code KSD1 - OBD P-code reported for open circuit [verified]" VALUE 0x71C0C RL_VAL_UW 0 CM_0000 0 65535 /end CHARACTERISTIC
/begin CHARACTERISTIC K_ED_KSD1.P_CODE_SH_TO_GND "Fault code KSD1 - OBD P-code reported for short to ground [verified]" VALUE 0x71C0A RL_VAL_UW 0 CM_0000 0 65535 /end CHARACTERISTIC
/begin CHARACTERISTIC K_ED_KSD1.P_CODE_SH_TO_UB "Fault code KSD1 - OBD P-code reported for short to battery voltage [verified]" VALUE 0x71C08 RL_VAL_UW 0 CM_0000 0 65535 /end CHARACTERISTIC
/begin CHARACTERISTIC K_ED_KSD1.P_CODE_UNPLAUSIBEL "Fault code KSD1 - OBD P-code reported for implausible signal [verified]" VALUE 0x71C0E RL_VAL_UW 0 CM_0000 0 65535 /end CHARACTERISTIC
/begin CHARACTERISTIC K_ED_KSD2.DEC_NACH_EINTRAG "Fault code KSD2 - debounce filter decrement after fault-memory entry [verified]" VALUE 0x71C2F RL_VAL_UB 0 CM_0000 0 255 /end CHARACTERISTIC
/begin CHARACTERISTIC K_ED_KSD2.DEC_VOR_EINTRAG "Fault code KSD2 - debounce filter decrement before fault-memory entry [verified]" VALUE 0x71C2D RL_VAL_UB 0 CM_0000 0 255 /end CHARACTERISTIC
/begin CHARACTERISTIC K_ED_KSD2.FEHLERSCHWELLE "Fault code KSD2 - debounce filter threshold for setting the fault [verified]" VALUE 0x71C2A RL_VAL_UB 0 CM_0000 0 255 /end CHARACTERISTIC
/begin CHARACTERISTIC K_ED_KSD2.INC_NACH_EINTRAG "Fault code KSD2 - debounce filter increment after fault-memory entry [verified]" VALUE 0x71C2E RL_VAL_UB 0 CM_0000 0 255 /end CHARACTERISTIC
/begin CHARACTERISTIC K_ED_KSD2.INC_VOR_EINTRAG "Fault code KSD2 - debounce filter increment before fault-memory entry [verified]" VALUE 0x71C2C RL_VAL_UB 0 CM_0000 0 255 /end CHARACTERISTIC
/begin CHARACTERISTIC K_ED_KSD2.KLASSENINDEX "Fault code KSD2 - fault class selection (lamp / warning behaviour) [verified]" VALUE 0x71C30 RL_VAL_UB 0 CM_0000 0 255 /end CHARACTERISTIC
/begin CHARACTERISTIC K_ED_KSD2.OK_SCHWELLE "Fault code KSD2 - debounce filter threshold for clearing (healing) the fault [verified]" VALUE 0x71C2B RL_VAL_UB 0 CM_0000 0 255 /end CHARACTERISTIC
/begin CHARACTERISTIC K_ED_KSD2.P_CODE_OPENLOAD "Fault code KSD2 - OBD P-code reported for open circuit [verified]" VALUE 0x71C26 RL_VAL_UW 0 CM_0000 0 65535 /end CHARACTERISTIC
/begin CHARACTERISTIC K_ED_KSD2.P_CODE_SH_TO_GND "Fault code KSD2 - OBD P-code reported for short to ground [verified]" VALUE 0x71C24 RL_VAL_UW 0 CM_0000 0 65535 /end CHARACTERISTIC
/begin CHARACTERISTIC K_ED_KSD2.P_CODE_SH_TO_UB "Fault code KSD2 - OBD P-code reported for short to battery voltage [verified]" VALUE 0x71C22 RL_VAL_UW 0 CM_0000 0 65535 /end CHARACTERISTIC
/begin CHARACTERISTIC K_ED_KSD2.P_CODE_UNPLAUSIBEL "Fault code KSD2 - OBD P-code reported for implausible signal [verified]" VALUE 0x71C28 RL_VAL_UW 0 CM_0000 0 65535 /end CHARACTERISTIC
/begin CHARACTERISTIC K_ED_KW.DEC_NACH_EINTRAG "Fault code KW - debounce filter decrement after fault-memory entry [verified]" VALUE 0x71A5B RL_VAL_UB 0 CM_0000 0 255 /end CHARACTERISTIC
/begin CHARACTERISTIC K_ED_KW.DEC_VOR_EINTRAG "Fault code KW - debounce filter decrement before fault-memory entry [verified]" VALUE 0x71A59 RL_VAL_UB 0 CM_0000 0 255 /end CHARACTERISTIC
/begin CHARACTERISTIC K_ED_KW.FEHLERSCHWELLE "Fault code KW - debounce filter threshold for setting the fault [verified]" VALUE 0x71A56 RL_VAL_UB 0 CM_0000 0 255 /end CHARACTERISTIC
/begin CHARACTERISTIC K_ED_KW.INC_NACH_EINTRAG "Fault code KW - debounce filter increment after fault-memory entry [verified]" VALUE 0x71A5A RL_VAL_UB 0 CM_0000 0 255 /end CHARACTERISTIC
/begin CHARACTERISTIC K_ED_KW.INC_VOR_EINTRAG "Fault code KW - debounce filter increment before fault-memory entry [verified]" VALUE 0x71A58 RL_VAL_UB 0 CM_0000 0 255 /end CHARACTERISTIC
/begin CHARACTERISTIC K_ED_KW.KLASSENINDEX "Fault code KW - fault class selection (lamp / warning behaviour) [verified]" VALUE 0x71A5C RL_VAL_UB 0 CM_0000 0 255 /end CHARACTERISTIC
/begin CHARACTERISTIC K_ED_KW.OK_SCHWELLE "Fault code KW - debounce filter threshold for clearing (healing) the fault [verified]" VALUE 0x71A57 RL_VAL_UB 0 CM_0000 0 255 /end CHARACTERISTIC
/begin CHARACTERISTIC K_ED_KW.P_CODE_OPENLOAD "Fault code KW - OBD P-code reported for open circuit [verified]" VALUE 0x71A52 RL_VAL_UW 0 CM_0000 0 65535 /end CHARACTERISTIC
/begin CHARACTERISTIC K_ED_KW.P_CODE_SH_TO_GND "Fault code KW - OBD P-code reported for short to ground [verified]" VALUE 0x71A50 RL_VAL_UW 0 CM_0000 0 65535 /end CHARACTERISTIC
/begin CHARACTERISTIC K_ED_KW.P_CODE_SH_TO_UB "Fault code KW - OBD P-code reported for short to battery voltage [verified]" VALUE 0x71A4E RL_VAL_UW 0 CM_0000 0 65535 /end CHARACTERISTIC
/begin CHARACTERISTIC K_ED_KW.P_CODE_UNPLAUSIBEL "Fault code KW - OBD P-code reported for implausible signal [verified]" VALUE 0x71A54 RL_VAL_UW 0 CM_0000 0 65535 /end CHARACTERISTIC
/begin CHARACTERISTIC K_ED_LA1_ADAPT.DEC_NACH_EINTRAG "Fault code LA1_ADAPT - debounce filter decrement after fault-memory entry [verified]" VALUE 0x71A75 RL_VAL_UB 0 CM_0000 0 255 /end CHARACTERISTIC
/begin CHARACTERISTIC K_ED_LA1_ADAPT.DEC_VOR_EINTRAG "Fault code LA1_ADAPT - debounce filter decrement before fault-memory entry [verified]" VALUE 0x71A73 RL_VAL_UB 0 CM_0000 0 255 /end CHARACTERISTIC
/begin CHARACTERISTIC K_ED_LA1_ADAPT.FEHLERSCHWELLE "Fault code LA1_ADAPT - debounce filter threshold for setting the fault [verified]" VALUE 0x71A70 RL_VAL_UB 0 CM_0000 0 255 /end CHARACTERISTIC
/begin CHARACTERISTIC K_ED_LA1_ADAPT.INC_NACH_EINTRAG "Fault code LA1_ADAPT - debounce filter increment after fault-memory entry [verified]" VALUE 0x71A74 RL_VAL_UB 0 CM_0000 0 255 /end CHARACTERISTIC
/begin CHARACTERISTIC K_ED_LA1_ADAPT.INC_VOR_EINTRAG "Fault code LA1_ADAPT - debounce filter increment before fault-memory entry [verified]" VALUE 0x71A72 RL_VAL_UB 0 CM_0000 0 255 /end CHARACTERISTIC
/begin CHARACTERISTIC K_ED_LA1_ADAPT.KLASSENINDEX "Fault code LA1_ADAPT - fault class selection (lamp / warning behaviour) [verified]" VALUE 0x71A76 RL_VAL_UB 0 CM_0000 0 255 /end CHARACTERISTIC
/begin CHARACTERISTIC K_ED_LA1_ADAPT.OK_SCHWELLE "Fault code LA1_ADAPT - debounce filter threshold for clearing (healing) the fault [verified]" VALUE 0x71A71 RL_VAL_UB 0 CM_0000 0 255 /end CHARACTERISTIC
/begin CHARACTERISTIC K_ED_LA1_ADAPT.P_CODE_OPENLOAD "Fault code LA1_ADAPT - OBD P-code reported for open circuit [verified]" VALUE 0x71A6C RL_VAL_UW 0 CM_0000 0 65535 /end CHARACTERISTIC
/begin CHARACTERISTIC K_ED_LA1_ADAPT.P_CODE_SH_TO_GND "Fault code LA1_ADAPT - OBD P-code reported for short to ground [verified]" VALUE 0x71A6A RL_VAL_UW 0 CM_0000 0 65535 /end CHARACTERISTIC
/begin CHARACTERISTIC K_ED_LA1_ADAPT.P_CODE_SH_TO_UB "Fault code LA1_ADAPT - OBD P-code reported for short to battery voltage [verified]" VALUE 0x71A68 RL_VAL_UW 0 CM_0000 0 65535 /end CHARACTERISTIC
/begin CHARACTERISTIC K_ED_LA1_ADAPT.P_CODE_UNPLAUSIBEL "Fault code LA1_ADAPT - OBD P-code reported for implausible signal [verified]" VALUE 0x71A6E RL_VAL_UW 0 CM_0000 0 65535 /end CHARACTERISTIC
/begin CHARACTERISTIC K_ED_LA1_TRIM_AD.DEC_NACH_EINTRAG "Fault code LA1_TRIM_AD - debounce filter decrement after fault-memory entry [verified]" VALUE 0x71D4D RL_VAL_UB 0 CM_0000 0 255 /end CHARACTERISTIC
/begin CHARACTERISTIC K_ED_LA1_TRIM_AD.DEC_VOR_EINTRAG "Fault code LA1_TRIM_AD - debounce filter decrement before fault-memory entry [verified]" VALUE 0x71D4B RL_VAL_UB 0 CM_0000 0 255 /end CHARACTERISTIC
/begin CHARACTERISTIC K_ED_LA1_TRIM_AD.FEHLERSCHWELLE "Fault code LA1_TRIM_AD - debounce filter threshold for setting the fault [verified]" VALUE 0x71D48 RL_VAL_UB 0 CM_0000 0 255 /end CHARACTERISTIC
/begin CHARACTERISTIC K_ED_LA1_TRIM_AD.INC_NACH_EINTRAG "Fault code LA1_TRIM_AD - debounce filter increment after fault-memory entry [verified]" VALUE 0x71D4C RL_VAL_UB 0 CM_0000 0 255 /end CHARACTERISTIC
/begin CHARACTERISTIC K_ED_LA1_TRIM_AD.INC_VOR_EINTRAG "Fault code LA1_TRIM_AD - debounce filter increment before fault-memory entry [verified]" VALUE 0x71D4A RL_VAL_UB 0 CM_0000 0 255 /end CHARACTERISTIC
/begin CHARACTERISTIC K_ED_LA1_TRIM_AD.KLASSENINDEX "Fault code LA1_TRIM_AD - fault class selection (lamp / warning behaviour) [verified]" VALUE 0x71D4E RL_VAL_UB 0 CM_0000 0 255 /end CHARACTERISTIC
/begin CHARACTERISTIC K_ED_LA1_TRIM_AD.OK_SCHWELLE "Fault code LA1_TRIM_AD - debounce filter threshold for clearing (healing) the fault [verified]" VALUE 0x71D49 RL_VAL_UB 0 CM_0000 0 255 /end CHARACTERISTIC
/begin CHARACTERISTIC K_ED_LA1_TRIM_AD.P_CODE_OPENLOAD "Fault code LA1_TRIM_AD - OBD P-code reported for open circuit [verified]" VALUE 0x71D44 RL_VAL_UW 0 CM_0000 0 65535 /end CHARACTERISTIC
/begin CHARACTERISTIC K_ED_LA1_TRIM_AD.P_CODE_SH_TO_GND "Fault code LA1_TRIM_AD - OBD P-code reported for short to ground [verified]" VALUE 0x71D42 RL_VAL_UW 0 CM_0000 0 65535 /end CHARACTERISTIC
/begin CHARACTERISTIC K_ED_LA1_TRIM_AD.P_CODE_SH_TO_UB "Fault code LA1_TRIM_AD - OBD P-code reported for short to battery voltage [verified]" VALUE 0x71D40 RL_VAL_UW 0 CM_0000 0 65535 /end CHARACTERISTIC
/begin CHARACTERISTIC K_ED_LA1_TRIM_AD.P_CODE_UNPLAUSIBEL "Fault code LA1_TRIM_AD - OBD P-code reported for implausible signal [verified]" VALUE 0x71D46 RL_VAL_UW 0 CM_0000 0 65535 /end CHARACTERISTIC
/begin CHARACTERISTIC K_ED_LA2_ADAPT.DEC_NACH_EINTRAG "Fault code LA2_ADAPT - debounce filter decrement after fault-memory entry [verified]" VALUE 0x71A8F RL_VAL_UB 0 CM_0000 0 255 /end CHARACTERISTIC
/begin CHARACTERISTIC K_ED_LA2_ADAPT.DEC_VOR_EINTRAG "Fault code LA2_ADAPT - debounce filter decrement before fault-memory entry [verified]" VALUE 0x71A8D RL_VAL_UB 0 CM_0000 0 255 /end CHARACTERISTIC
/begin CHARACTERISTIC K_ED_LA2_ADAPT.FEHLERSCHWELLE "Fault code LA2_ADAPT - debounce filter threshold for setting the fault [verified]" VALUE 0x71A8A RL_VAL_UB 0 CM_0000 0 255 /end CHARACTERISTIC
/begin CHARACTERISTIC K_ED_LA2_ADAPT.INC_NACH_EINTRAG "Fault code LA2_ADAPT - debounce filter increment after fault-memory entry [verified]" VALUE 0x71A8E RL_VAL_UB 0 CM_0000 0 255 /end CHARACTERISTIC
/begin CHARACTERISTIC K_ED_LA2_ADAPT.INC_VOR_EINTRAG "Fault code LA2_ADAPT - debounce filter increment before fault-memory entry [verified]" VALUE 0x71A8C RL_VAL_UB 0 CM_0000 0 255 /end CHARACTERISTIC
/begin CHARACTERISTIC K_ED_LA2_ADAPT.KLASSENINDEX "Fault code LA2_ADAPT - fault class selection (lamp / warning behaviour) [verified]" VALUE 0x71A90 RL_VAL_UB 0 CM_0000 0 255 /end CHARACTERISTIC
/begin CHARACTERISTIC K_ED_LA2_ADAPT.OK_SCHWELLE "Fault code LA2_ADAPT - debounce filter threshold for clearing (healing) the fault [verified]" VALUE 0x71A8B RL_VAL_UB 0 CM_0000 0 255 /end CHARACTERISTIC
/begin CHARACTERISTIC K_ED_LA2_ADAPT.P_CODE_OPENLOAD "Fault code LA2_ADAPT - OBD P-code reported for open circuit [verified]" VALUE 0x71A86 RL_VAL_UW 0 CM_0000 0 65535 /end CHARACTERISTIC
/begin CHARACTERISTIC K_ED_LA2_ADAPT.P_CODE_SH_TO_GND "Fault code LA2_ADAPT - OBD P-code reported for short to ground [verified]" VALUE 0x71A84 RL_VAL_UW 0 CM_0000 0 65535 /end CHARACTERISTIC
/begin CHARACTERISTIC K_ED_LA2_ADAPT.P_CODE_SH_TO_UB "Fault code LA2_ADAPT - OBD P-code reported for short to battery voltage [verified]" VALUE 0x71A82 RL_VAL_UW 0 CM_0000 0 65535 /end CHARACTERISTIC
/begin CHARACTERISTIC K_ED_LA2_ADAPT.P_CODE_UNPLAUSIBEL "Fault code LA2_ADAPT - OBD P-code reported for implausible signal [verified]" VALUE 0x71A88 RL_VAL_UW 0 CM_0000 0 65535 /end CHARACTERISTIC
/begin CHARACTERISTIC K_ED_LA2_TRIM_AD.DEC_NACH_EINTRAG "Fault code LA2_TRIM_AD - debounce filter decrement after fault-memory entry [verified]" VALUE 0x71D67 RL_VAL_UB 0 CM_0000 0 255 /end CHARACTERISTIC
/begin CHARACTERISTIC K_ED_LA2_TRIM_AD.DEC_VOR_EINTRAG "Fault code LA2_TRIM_AD - debounce filter decrement before fault-memory entry [verified]" VALUE 0x71D65 RL_VAL_UB 0 CM_0000 0 255 /end CHARACTERISTIC
/begin CHARACTERISTIC K_ED_LA2_TRIM_AD.FEHLERSCHWELLE "Fault code LA2_TRIM_AD - debounce filter threshold for setting the fault [verified]" VALUE 0x71D62 RL_VAL_UB 0 CM_0000 0 255 /end CHARACTERISTIC
/begin CHARACTERISTIC K_ED_LA2_TRIM_AD.INC_NACH_EINTRAG "Fault code LA2_TRIM_AD - debounce filter increment after fault-memory entry [verified]" VALUE 0x71D66 RL_VAL_UB 0 CM_0000 0 255 /end CHARACTERISTIC
/begin CHARACTERISTIC K_ED_LA2_TRIM_AD.INC_VOR_EINTRAG "Fault code LA2_TRIM_AD - debounce filter increment before fault-memory entry [verified]" VALUE 0x71D64 RL_VAL_UB 0 CM_0000 0 255 /end CHARACTERISTIC
/begin CHARACTERISTIC K_ED_LA2_TRIM_AD.KLASSENINDEX "Fault code LA2_TRIM_AD - fault class selection (lamp / warning behaviour) [verified]" VALUE 0x71D68 RL_VAL_UB 0 CM_0000 0 255 /end CHARACTERISTIC
/begin CHARACTERISTIC K_ED_LA2_TRIM_AD.OK_SCHWELLE "Fault code LA2_TRIM_AD - debounce filter threshold for clearing (healing) the fault [verified]" VALUE 0x71D63 RL_VAL_UB 0 CM_0000 0 255 /end CHARACTERISTIC
/begin CHARACTERISTIC K_ED_LA2_TRIM_AD.P_CODE_OPENLOAD "Fault code LA2_TRIM_AD - OBD P-code reported for open circuit [verified]" VALUE 0x71D5E RL_VAL_UW 0 CM_0000 0 65535 /end CHARACTERISTIC
/begin CHARACTERISTIC K_ED_LA2_TRIM_AD.P_CODE_SH_TO_GND "Fault code LA2_TRIM_AD - OBD P-code reported for short to ground [verified]" VALUE 0x71D5C RL_VAL_UW 0 CM_0000 0 65535 /end CHARACTERISTIC
/begin CHARACTERISTIC K_ED_LA2_TRIM_AD.P_CODE_SH_TO_UB "Fault code LA2_TRIM_AD - OBD P-code reported for short to battery voltage [verified]" VALUE 0x71D5A RL_VAL_UW 0 CM_0000 0 65535 /end CHARACTERISTIC
/begin CHARACTERISTIC K_ED_LA2_TRIM_AD.P_CODE_UNPLAUSIBEL "Fault code LA2_TRIM_AD - OBD P-code reported for implausible signal [verified]" VALUE 0x71D60 RL_VAL_UW 0 CM_0000 0 65535 /end CHARACTERISTIC
/begin CHARACTERISTIC K_ED_LAM1_REG.DEC_NACH_EINTRAG "Fault code LAM1_REG - debounce filter decrement after fault-memory entry [verified]" VALUE 0x712A3 RL_VAL_UB 0 CM_0000 0 255 /end CHARACTERISTIC
/begin CHARACTERISTIC K_ED_LAM1_REG.DEC_VOR_EINTRAG "Fault code LAM1_REG - debounce filter decrement before fault-memory entry [verified]" VALUE 0x712A1 RL_VAL_UB 0 CM_0000 0 255 /end CHARACTERISTIC
/begin CHARACTERISTIC K_ED_LAM1_REG.FEHLERSCHWELLE "Fault code LAM1_REG - debounce filter threshold for setting the fault [verified]" VALUE 0x7129E RL_VAL_UB 0 CM_0000 0 255 /end CHARACTERISTIC
/begin CHARACTERISTIC K_ED_LAM1_REG.INC_NACH_EINTRAG "Fault code LAM1_REG - debounce filter increment after fault-memory entry [verified]" VALUE 0x712A2 RL_VAL_UB 0 CM_0000 0 255 /end CHARACTERISTIC
/begin CHARACTERISTIC K_ED_LAM1_REG.INC_VOR_EINTRAG "Fault code LAM1_REG - debounce filter increment before fault-memory entry [verified]" VALUE 0x712A0 RL_VAL_UB 0 CM_0000 0 255 /end CHARACTERISTIC
/begin CHARACTERISTIC K_ED_LAM1_REG.KLASSENINDEX "Fault code LAM1_REG - fault class selection (lamp / warning behaviour) [verified]" VALUE 0x712A4 RL_VAL_UB 0 CM_0000 0 255 /end CHARACTERISTIC
/begin CHARACTERISTIC K_ED_LAM1_REG.OK_SCHWELLE "Fault code LAM1_REG - debounce filter threshold for clearing (healing) the fault [verified]" VALUE 0x7129F RL_VAL_UB 0 CM_0000 0 255 /end CHARACTERISTIC
/begin CHARACTERISTIC K_ED_LAM1_REG.P_CODE_OPENLOAD "Fault code LAM1_REG - OBD P-code reported for open circuit [verified]" VALUE 0x7129A RL_VAL_UW 0 CM_0000 0 65535 /end CHARACTERISTIC
/begin CHARACTERISTIC K_ED_LAM1_REG.P_CODE_SH_TO_GND "Fault code LAM1_REG - OBD P-code reported for short to ground [verified]" VALUE 0x71298 RL_VAL_UW 0 CM_0000 0 65535 /end CHARACTERISTIC
/begin CHARACTERISTIC K_ED_LAM1_REG.P_CODE_SH_TO_UB "Fault code LAM1_REG - OBD P-code reported for short to battery voltage [verified]" VALUE 0x71296 RL_VAL_UW 0 CM_0000 0 65535 /end CHARACTERISTIC
/begin CHARACTERISTIC K_ED_LAM1_REG.P_CODE_UNPLAUSIBEL "Fault code LAM1_REG - OBD P-code reported for implausible signal [verified]" VALUE 0x7129C RL_VAL_UW 0 CM_0000 0 65535 /end CHARACTERISTIC
/begin CHARACTERISTIC K_ED_LAM2_REG.DEC_NACH_EINTRAG "Fault code LAM2_REG - debounce filter decrement after fault-memory entry [verified]" VALUE 0x712BD RL_VAL_UB 0 CM_0000 0 255 /end CHARACTERISTIC
/begin CHARACTERISTIC K_ED_LAM2_REG.DEC_VOR_EINTRAG "Fault code LAM2_REG - debounce filter decrement before fault-memory entry [verified]" VALUE 0x712BB RL_VAL_UB 0 CM_0000 0 255 /end CHARACTERISTIC
/begin CHARACTERISTIC K_ED_LAM2_REG.FEHLERSCHWELLE "Fault code LAM2_REG - debounce filter threshold for setting the fault [verified]" VALUE 0x712B8 RL_VAL_UB 0 CM_0000 0 255 /end CHARACTERISTIC
/begin CHARACTERISTIC K_ED_LAM2_REG.INC_NACH_EINTRAG "Fault code LAM2_REG - debounce filter increment after fault-memory entry [verified]" VALUE 0x712BC RL_VAL_UB 0 CM_0000 0 255 /end CHARACTERISTIC
/begin CHARACTERISTIC K_ED_LAM2_REG.INC_VOR_EINTRAG "Fault code LAM2_REG - debounce filter increment before fault-memory entry [verified]" VALUE 0x712BA RL_VAL_UB 0 CM_0000 0 255 /end CHARACTERISTIC
/begin CHARACTERISTIC K_ED_LAM2_REG.KLASSENINDEX "Fault code LAM2_REG - fault class selection (lamp / warning behaviour) [verified]" VALUE 0x712BE RL_VAL_UB 0 CM_0000 0 255 /end CHARACTERISTIC
/begin CHARACTERISTIC K_ED_LAM2_REG.OK_SCHWELLE "Fault code LAM2_REG - debounce filter threshold for clearing (healing) the fault [verified]" VALUE 0x712B9 RL_VAL_UB 0 CM_0000 0 255 /end CHARACTERISTIC
/begin CHARACTERISTIC K_ED_LAM2_REG.P_CODE_OPENLOAD "Fault code LAM2_REG - OBD P-code reported for open circuit [verified]" VALUE 0x712B4 RL_VAL_UW 0 CM_0000 0 65535 /end CHARACTERISTIC
/begin CHARACTERISTIC K_ED_LAM2_REG.P_CODE_SH_TO_GND "Fault code LAM2_REG - OBD P-code reported for short to ground [verified]" VALUE 0x712B2 RL_VAL_UW 0 CM_0000 0 65535 /end CHARACTERISTIC
/begin CHARACTERISTIC K_ED_LAM2_REG.P_CODE_SH_TO_UB "Fault code LAM2_REG - OBD P-code reported for short to battery voltage [verified]" VALUE 0x712B0 RL_VAL_UW 0 CM_0000 0 65535 /end CHARACTERISTIC
/begin CHARACTERISTIC K_ED_LAM2_REG.P_CODE_UNPLAUSIBEL "Fault code LAM2_REG - OBD P-code reported for implausible signal [verified]" VALUE 0x712B6 RL_VAL_UW 0 CM_0000 0 65535 /end CHARACTERISTIC
/begin CHARACTERISTIC K_ED_LANK1.DEC_NACH_EINTRAG "Fault code LANK1 - debounce filter decrement after fault-memory entry [verified]" VALUE 0x70D75 RL_VAL_UB 0 CM_0000 0 255 /end CHARACTERISTIC
/begin CHARACTERISTIC K_ED_LANK1.DEC_VOR_EINTRAG "Fault code LANK1 - debounce filter decrement before fault-memory entry [verified]" VALUE 0x70D73 RL_VAL_UB 0 CM_0000 0 255 /end CHARACTERISTIC
/begin CHARACTERISTIC K_ED_LANK1.FEHLERSCHWELLE "Fault code LANK1 - debounce filter threshold for setting the fault [verified]" VALUE 0x70D70 RL_VAL_UB 0 CM_0000 0 255 /end CHARACTERISTIC
/begin CHARACTERISTIC K_ED_LANK1.INC_NACH_EINTRAG "Fault code LANK1 - debounce filter increment after fault-memory entry [verified]" VALUE 0x70D74 RL_VAL_UB 0 CM_0000 0 255 /end CHARACTERISTIC
/begin CHARACTERISTIC K_ED_LANK1.INC_VOR_EINTRAG "Fault code LANK1 - debounce filter increment before fault-memory entry [verified]" VALUE 0x70D72 RL_VAL_UB 0 CM_0000 0 255 /end CHARACTERISTIC
/begin CHARACTERISTIC K_ED_LANK1.KLASSENINDEX "Fault code LANK1 - fault class selection (lamp / warning behaviour) [verified]" VALUE 0x70D76 RL_VAL_UB 0 CM_0000 0 255 /end CHARACTERISTIC
/begin CHARACTERISTIC K_ED_LANK1.OK_SCHWELLE "Fault code LANK1 - debounce filter threshold for clearing (healing) the fault [verified]" VALUE 0x70D71 RL_VAL_UB 0 CM_0000 0 255 /end CHARACTERISTIC
/begin CHARACTERISTIC K_ED_LANK1.P_CODE_OPENLOAD "Fault code LANK1 - OBD P-code reported for open circuit [verified]" VALUE 0x70D6C RL_VAL_UW 0 CM_0000 0 65535 /end CHARACTERISTIC
/begin CHARACTERISTIC K_ED_LANK1.P_CODE_SH_TO_GND "Fault code LANK1 - OBD P-code reported for short to ground [verified]" VALUE 0x70D6A RL_VAL_UW 0 CM_0000 0 65535 /end CHARACTERISTIC
/begin CHARACTERISTIC K_ED_LANK1.P_CODE_SH_TO_UB "Fault code LANK1 - OBD P-code reported for short to battery voltage [verified]" VALUE 0x70D68 RL_VAL_UW 0 CM_0000 0 65535 /end CHARACTERISTIC
/begin CHARACTERISTIC K_ED_LANK1.P_CODE_UNPLAUSIBEL "Fault code LANK1 - OBD P-code reported for implausible signal [verified]" VALUE 0x70D6E RL_VAL_UW 0 CM_0000 0 65535 /end CHARACTERISTIC
/begin CHARACTERISTIC K_ED_LANK1_OBD_S.DEC_NACH_EINTRAG "Fault code LANK1_OBD_S - debounce filter decrement after fault-memory entry [verified]" VALUE 0x70F15 RL_VAL_UB 0 CM_0000 0 255 /end CHARACTERISTIC
/begin CHARACTERISTIC K_ED_LANK1_OBD_S.DEC_VOR_EINTRAG "Fault code LANK1_OBD_S - debounce filter decrement before fault-memory entry [verified]" VALUE 0x70F13 RL_VAL_UB 0 CM_0000 0 255 /end CHARACTERISTIC
/begin CHARACTERISTIC K_ED_LANK1_OBD_S.FEHLERSCHWELLE "Fault code LANK1_OBD_S - debounce filter threshold for setting the fault [verified]" VALUE 0x70F10 RL_VAL_UB 0 CM_0000 0 255 /end CHARACTERISTIC
/begin CHARACTERISTIC K_ED_LANK1_OBD_S.INC_NACH_EINTRAG "Fault code LANK1_OBD_S - debounce filter increment after fault-memory entry [verified]" VALUE 0x70F14 RL_VAL_UB 0 CM_0000 0 255 /end CHARACTERISTIC
/begin CHARACTERISTIC K_ED_LANK1_OBD_S.INC_VOR_EINTRAG "Fault code LANK1_OBD_S - debounce filter increment before fault-memory entry [verified]" VALUE 0x70F12 RL_VAL_UB 0 CM_0000 0 255 /end CHARACTERISTIC
/begin CHARACTERISTIC K_ED_LANK1_OBD_S.KLASSENINDEX "Fault code LANK1_OBD_S - fault class selection (lamp / warning behaviour) [verified]" VALUE 0x70F16 RL_VAL_UB 0 CM_0000 0 255 /end CHARACTERISTIC
/begin CHARACTERISTIC K_ED_LANK1_OBD_S.OK_SCHWELLE "Fault code LANK1_OBD_S - debounce filter threshold for clearing (healing) the fault [verified]" VALUE 0x70F11 RL_VAL_UB 0 CM_0000 0 255 /end CHARACTERISTIC
/begin CHARACTERISTIC K_ED_LANK1_OBD_S.P_CODE_OPENLOAD "Fault code LANK1_OBD_S - OBD P-code reported for open circuit [verified]" VALUE 0x70F0C RL_VAL_UW 0 CM_0000 0 65535 /end CHARACTERISTIC
/begin CHARACTERISTIC K_ED_LANK1_OBD_S.P_CODE_SH_TO_GND "Fault code LANK1_OBD_S - OBD P-code reported for short to ground [verified]" VALUE 0x70F0A RL_VAL_UW 0 CM_0000 0 65535 /end CHARACTERISTIC
/begin CHARACTERISTIC K_ED_LANK1_OBD_S.P_CODE_SH_TO_UB "Fault code LANK1_OBD_S - OBD P-code reported for short to battery voltage [verified]" VALUE 0x70F08 RL_VAL_UW 0 CM_0000 0 65535 /end CHARACTERISTIC
/begin CHARACTERISTIC K_ED_LANK1_OBD_S.P_CODE_UNPLAUSIBEL "Fault code LANK1_OBD_S - OBD P-code reported for implausible signal [verified]" VALUE 0x70F0E RL_VAL_UW 0 CM_0000 0 65535 /end CHARACTERISTIC
/begin CHARACTERISTIC K_ED_LANK1_OBD_WE.DEC_NACH_EINTRAG "Fault code LANK1_OBD_WE - debounce filter decrement after fault-memory entry [verified]" VALUE 0x71DB5 RL_VAL_UB 0 CM_0000 0 255 /end CHARACTERISTIC
/begin CHARACTERISTIC K_ED_LANK1_OBD_WE.DEC_VOR_EINTRAG "Fault code LANK1_OBD_WE - debounce filter decrement before fault-memory entry [verified]" VALUE 0x71DB3 RL_VAL_UB 0 CM_0000 0 255 /end CHARACTERISTIC
/begin CHARACTERISTIC K_ED_LANK1_OBD_WE.FEHLERSCHWELLE "Fault code LANK1_OBD_WE - debounce filter threshold for setting the fault [verified]" VALUE 0x71DB0 RL_VAL_UB 0 CM_0000 0 255 /end CHARACTERISTIC
/begin CHARACTERISTIC K_ED_LANK1_OBD_WE.INC_NACH_EINTRAG "Fault code LANK1_OBD_WE - debounce filter increment after fault-memory entry [verified]" VALUE 0x71DB4 RL_VAL_UB 0 CM_0000 0 255 /end CHARACTERISTIC
/begin CHARACTERISTIC K_ED_LANK1_OBD_WE.INC_VOR_EINTRAG "Fault code LANK1_OBD_WE - debounce filter increment before fault-memory entry [verified]" VALUE 0x71DB2 RL_VAL_UB 0 CM_0000 0 255 /end CHARACTERISTIC
/begin CHARACTERISTIC K_ED_LANK1_OBD_WE.KLASSENINDEX "Fault code LANK1_OBD_WE - fault class selection (lamp / warning behaviour) [verified]" VALUE 0x71DB6 RL_VAL_UB 0 CM_0000 0 255 /end CHARACTERISTIC
/begin CHARACTERISTIC K_ED_LANK1_OBD_WE.OK_SCHWELLE "Fault code LANK1_OBD_WE - debounce filter threshold for clearing (healing) the fault [verified]" VALUE 0x71DB1 RL_VAL_UB 0 CM_0000 0 255 /end CHARACTERISTIC
/begin CHARACTERISTIC K_ED_LANK1_OBD_WE.P_CODE_OPENLOAD "Fault code LANK1_OBD_WE - OBD P-code reported for open circuit [verified]" VALUE 0x71DAC RL_VAL_UW 0 CM_0000 0 65535 /end CHARACTERISTIC
/begin CHARACTERISTIC K_ED_LANK1_OBD_WE.P_CODE_SH_TO_GND "Fault code LANK1_OBD_WE - OBD P-code reported for short to ground [verified]" VALUE 0x71DAA RL_VAL_UW 0 CM_0000 0 65535 /end CHARACTERISTIC
/begin CHARACTERISTIC K_ED_LANK1_OBD_WE.P_CODE_SH_TO_UB "Fault code LANK1_OBD_WE - OBD P-code reported for short to battery voltage [verified]" VALUE 0x71DA8 RL_VAL_UW 0 CM_0000 0 65535 /end CHARACTERISTIC
/begin CHARACTERISTIC K_ED_LANK1_OBD_WE.P_CODE_UNPLAUSIBEL "Fault code LANK1_OBD_WE - OBD P-code reported for implausible signal [verified]" VALUE 0x71DAE RL_VAL_UW 0 CM_0000 0 65535 /end CHARACTERISTIC
/begin CHARACTERISTIC K_ED_LANK1_OPENLOAD.DEC_NACH_EINTRAG "Fault code LANK1_OPENLOAD - debounce filter decrement after fault-memory entry [verified]" VALUE 0x71D81 RL_VAL_UB 0 CM_0000 0 255 /end CHARACTERISTIC
/begin CHARACTERISTIC K_ED_LANK1_OPENLOAD.DEC_VOR_EINTRAG "Fault code LANK1_OPENLOAD - debounce filter decrement before fault-memory entry [verified]" VALUE 0x71D7F RL_VAL_UB 0 CM_0000 0 255 /end CHARACTERISTIC
/begin CHARACTERISTIC K_ED_LANK1_OPENLOAD.FEHLERSCHWELLE "Fault code LANK1_OPENLOAD - debounce filter threshold for setting the fault [verified]" VALUE 0x71D7C RL_VAL_UB 0 CM_0000 0 255 /end CHARACTERISTIC
/begin CHARACTERISTIC K_ED_LANK1_OPENLOAD.INC_NACH_EINTRAG "Fault code LANK1_OPENLOAD - debounce filter increment after fault-memory entry [verified]" VALUE 0x71D80 RL_VAL_UB 0 CM_0000 0 255 /end CHARACTERISTIC
/begin CHARACTERISTIC K_ED_LANK1_OPENLOAD.INC_VOR_EINTRAG "Fault code LANK1_OPENLOAD - debounce filter increment before fault-memory entry [verified]" VALUE 0x71D7E RL_VAL_UB 0 CM_0000 0 255 /end CHARACTERISTIC
/begin CHARACTERISTIC K_ED_LANK1_OPENLOAD.KLASSENINDEX "Fault code LANK1_OPENLOAD - fault class selection (lamp / warning behaviour) [verified]" VALUE 0x71D82 RL_VAL_UB 0 CM_0000 0 255 /end CHARACTERISTIC
/begin CHARACTERISTIC K_ED_LANK1_OPENLOAD.OK_SCHWELLE "Fault code LANK1_OPENLOAD - debounce filter threshold for clearing (healing) the fault [verified]" VALUE 0x71D7D RL_VAL_UB 0 CM_0000 0 255 /end CHARACTERISTIC
/begin CHARACTERISTIC K_ED_LANK1_OPENLOAD.P_CODE_OPENLOAD "Fault code LANK1_OPENLOAD - OBD P-code reported for open circuit [verified]" VALUE 0x71D78 RL_VAL_UW 0 CM_0000 0 65535 /end CHARACTERISTIC
/begin CHARACTERISTIC K_ED_LANK1_OPENLOAD.P_CODE_SH_TO_GND "Fault code LANK1_OPENLOAD - OBD P-code reported for short to ground [verified]" VALUE 0x71D76 RL_VAL_UW 0 CM_0000 0 65535 /end CHARACTERISTIC
/begin CHARACTERISTIC K_ED_LANK1_OPENLOAD.P_CODE_SH_TO_UB "Fault code LANK1_OPENLOAD - OBD P-code reported for short to battery voltage [verified]" VALUE 0x71D74 RL_VAL_UW 0 CM_0000 0 65535 /end CHARACTERISTIC
/begin CHARACTERISTIC K_ED_LANK1_OPENLOAD.P_CODE_UNPLAUSIBEL "Fault code LANK1_OPENLOAD - OBD P-code reported for implausible signal [verified]" VALUE 0x71D7A RL_VAL_UW 0 CM_0000 0 65535 /end CHARACTERISTIC
/begin CHARACTERISTIC K_ED_LANK2.DEC_NACH_EINTRAG "Fault code LANK2 - debounce filter decrement after fault-memory entry [verified]" VALUE 0x70D8F RL_VAL_UB 0 CM_0000 0 255 /end CHARACTERISTIC
/begin CHARACTERISTIC K_ED_LANK2.DEC_VOR_EINTRAG "Fault code LANK2 - debounce filter decrement before fault-memory entry [verified]" VALUE 0x70D8D RL_VAL_UB 0 CM_0000 0 255 /end CHARACTERISTIC
/begin CHARACTERISTIC K_ED_LANK2.FEHLERSCHWELLE "Fault code LANK2 - debounce filter threshold for setting the fault [verified]" VALUE 0x70D8A RL_VAL_UB 0 CM_0000 0 255 /end CHARACTERISTIC
/begin CHARACTERISTIC K_ED_LANK2.INC_NACH_EINTRAG "Fault code LANK2 - debounce filter increment after fault-memory entry [verified]" VALUE 0x70D8E RL_VAL_UB 0 CM_0000 0 255 /end CHARACTERISTIC
/begin CHARACTERISTIC K_ED_LANK2.INC_VOR_EINTRAG "Fault code LANK2 - debounce filter increment before fault-memory entry [verified]" VALUE 0x70D8C RL_VAL_UB 0 CM_0000 0 255 /end CHARACTERISTIC
/begin CHARACTERISTIC K_ED_LANK2.KLASSENINDEX "Fault code LANK2 - fault class selection (lamp / warning behaviour) [verified]" VALUE 0x70D90 RL_VAL_UB 0 CM_0000 0 255 /end CHARACTERISTIC
/begin CHARACTERISTIC K_ED_LANK2.OK_SCHWELLE "Fault code LANK2 - debounce filter threshold for clearing (healing) the fault [verified]" VALUE 0x70D8B RL_VAL_UB 0 CM_0000 0 255 /end CHARACTERISTIC
/begin CHARACTERISTIC K_ED_LANK2.P_CODE_OPENLOAD "Fault code LANK2 - OBD P-code reported for open circuit [verified]" VALUE 0x70D86 RL_VAL_UW 0 CM_0000 0 65535 /end CHARACTERISTIC
/begin CHARACTERISTIC K_ED_LANK2.P_CODE_SH_TO_GND "Fault code LANK2 - OBD P-code reported for short to ground [verified]" VALUE 0x70D84 RL_VAL_UW 0 CM_0000 0 65535 /end CHARACTERISTIC
/begin CHARACTERISTIC K_ED_LANK2.P_CODE_SH_TO_UB "Fault code LANK2 - OBD P-code reported for short to battery voltage [verified]" VALUE 0x70D82 RL_VAL_UW 0 CM_0000 0 65535 /end CHARACTERISTIC
/begin CHARACTERISTIC K_ED_LANK2.P_CODE_UNPLAUSIBEL "Fault code LANK2 - OBD P-code reported for implausible signal [verified]" VALUE 0x70D88 RL_VAL_UW 0 CM_0000 0 65535 /end CHARACTERISTIC
/begin CHARACTERISTIC K_ED_LANK2_OBD_S.DEC_NACH_EINTRAG "Fault code LANK2_OBD_S - debounce filter decrement after fault-memory entry [verified]" VALUE 0x70F2F RL_VAL_UB 0 CM_0000 0 255 /end CHARACTERISTIC
/begin CHARACTERISTIC K_ED_LANK2_OBD_S.DEC_VOR_EINTRAG "Fault code LANK2_OBD_S - debounce filter decrement before fault-memory entry [verified]" VALUE 0x70F2D RL_VAL_UB 0 CM_0000 0 255 /end CHARACTERISTIC
/begin CHARACTERISTIC K_ED_LANK2_OBD_S.FEHLERSCHWELLE "Fault code LANK2_OBD_S - debounce filter threshold for setting the fault [verified]" VALUE 0x70F2A RL_VAL_UB 0 CM_0000 0 255 /end CHARACTERISTIC
/begin CHARACTERISTIC K_ED_LANK2_OBD_S.INC_NACH_EINTRAG "Fault code LANK2_OBD_S - debounce filter increment after fault-memory entry [verified]" VALUE 0x70F2E RL_VAL_UB 0 CM_0000 0 255 /end CHARACTERISTIC
/begin CHARACTERISTIC K_ED_LANK2_OBD_S.INC_VOR_EINTRAG "Fault code LANK2_OBD_S - debounce filter increment before fault-memory entry [verified]" VALUE 0x70F2C RL_VAL_UB 0 CM_0000 0 255 /end CHARACTERISTIC
/begin CHARACTERISTIC K_ED_LANK2_OBD_S.KLASSENINDEX "Fault code LANK2_OBD_S - fault class selection (lamp / warning behaviour) [verified]" VALUE 0x70F30 RL_VAL_UB 0 CM_0000 0 255 /end CHARACTERISTIC
/begin CHARACTERISTIC K_ED_LANK2_OBD_S.OK_SCHWELLE "Fault code LANK2_OBD_S - debounce filter threshold for clearing (healing) the fault [verified]" VALUE 0x70F2B RL_VAL_UB 0 CM_0000 0 255 /end CHARACTERISTIC
/begin CHARACTERISTIC K_ED_LANK2_OBD_S.P_CODE_OPENLOAD "Fault code LANK2_OBD_S - OBD P-code reported for open circuit [verified]" VALUE 0x70F26 RL_VAL_UW 0 CM_0000 0 65535 /end CHARACTERISTIC
/begin CHARACTERISTIC K_ED_LANK2_OBD_S.P_CODE_SH_TO_GND "Fault code LANK2_OBD_S - OBD P-code reported for short to ground [verified]" VALUE 0x70F24 RL_VAL_UW 0 CM_0000 0 65535 /end CHARACTERISTIC
/begin CHARACTERISTIC K_ED_LANK2_OBD_S.P_CODE_SH_TO_UB "Fault code LANK2_OBD_S - OBD P-code reported for short to battery voltage [verified]" VALUE 0x70F22 RL_VAL_UW 0 CM_0000 0 65535 /end CHARACTERISTIC
/begin CHARACTERISTIC K_ED_LANK2_OBD_S.P_CODE_UNPLAUSIBEL "Fault code LANK2_OBD_S - OBD P-code reported for implausible signal [verified]" VALUE 0x70F28 RL_VAL_UW 0 CM_0000 0 65535 /end CHARACTERISTIC
/begin CHARACTERISTIC K_ED_LANK2_OBD_WE.DEC_NACH_EINTRAG "Fault code LANK2_OBD_WE - debounce filter decrement after fault-memory entry [verified]" VALUE 0x71DCF RL_VAL_UB 0 CM_0000 0 255 /end CHARACTERISTIC
/begin CHARACTERISTIC K_ED_LANK2_OBD_WE.DEC_VOR_EINTRAG "Fault code LANK2_OBD_WE - debounce filter decrement before fault-memory entry [verified]" VALUE 0x71DCD RL_VAL_UB 0 CM_0000 0 255 /end CHARACTERISTIC
/begin CHARACTERISTIC K_ED_LANK2_OBD_WE.FEHLERSCHWELLE "Fault code LANK2_OBD_WE - debounce filter threshold for setting the fault [verified]" VALUE 0x71DCA RL_VAL_UB 0 CM_0000 0 255 /end CHARACTERISTIC
/begin CHARACTERISTIC K_ED_LANK2_OBD_WE.INC_NACH_EINTRAG "Fault code LANK2_OBD_WE - debounce filter increment after fault-memory entry [verified]" VALUE 0x71DCE RL_VAL_UB 0 CM_0000 0 255 /end CHARACTERISTIC
/begin CHARACTERISTIC K_ED_LANK2_OBD_WE.INC_VOR_EINTRAG "Fault code LANK2_OBD_WE - debounce filter increment before fault-memory entry [verified]" VALUE 0x71DCC RL_VAL_UB 0 CM_0000 0 255 /end CHARACTERISTIC
/begin CHARACTERISTIC K_ED_LANK2_OBD_WE.KLASSENINDEX "Fault code LANK2_OBD_WE - fault class selection (lamp / warning behaviour) [verified]" VALUE 0x71DD0 RL_VAL_UB 0 CM_0000 0 255 /end CHARACTERISTIC
/begin CHARACTERISTIC K_ED_LANK2_OBD_WE.OK_SCHWELLE "Fault code LANK2_OBD_WE - debounce filter threshold for clearing (healing) the fault [verified]" VALUE 0x71DCB RL_VAL_UB 0 CM_0000 0 255 /end CHARACTERISTIC
/begin CHARACTERISTIC K_ED_LANK2_OBD_WE.P_CODE_OPENLOAD "Fault code LANK2_OBD_WE - OBD P-code reported for open circuit [verified]" VALUE 0x71DC6 RL_VAL_UW 0 CM_0000 0 65535 /end CHARACTERISTIC
/begin CHARACTERISTIC K_ED_LANK2_OBD_WE.P_CODE_SH_TO_GND "Fault code LANK2_OBD_WE - OBD P-code reported for short to ground [verified]" VALUE 0x71DC4 RL_VAL_UW 0 CM_0000 0 65535 /end CHARACTERISTIC
/begin CHARACTERISTIC K_ED_LANK2_OBD_WE.P_CODE_SH_TO_UB "Fault code LANK2_OBD_WE - OBD P-code reported for short to battery voltage [verified]" VALUE 0x71DC2 RL_VAL_UW 0 CM_0000 0 65535 /end CHARACTERISTIC
/begin CHARACTERISTIC K_ED_LANK2_OBD_WE.P_CODE_UNPLAUSIBEL "Fault code LANK2_OBD_WE - OBD P-code reported for implausible signal [verified]" VALUE 0x71DC8 RL_VAL_UW 0 CM_0000 0 65535 /end CHARACTERISTIC
/begin CHARACTERISTIC K_ED_LANK2_OPENLOAD.DEC_NACH_EINTRAG "Fault code LANK2_OPENLOAD - debounce filter decrement after fault-memory entry [verified]" VALUE 0x71D9B RL_VAL_UB 0 CM_0000 0 255 /end CHARACTERISTIC
/begin CHARACTERISTIC K_ED_LANK2_OPENLOAD.DEC_VOR_EINTRAG "Fault code LANK2_OPENLOAD - debounce filter decrement before fault-memory entry [verified]" VALUE 0x71D99 RL_VAL_UB 0 CM_0000 0 255 /end CHARACTERISTIC
/begin CHARACTERISTIC K_ED_LANK2_OPENLOAD.FEHLERSCHWELLE "Fault code LANK2_OPENLOAD - debounce filter threshold for setting the fault [verified]" VALUE 0x71D96 RL_VAL_UB 0 CM_0000 0 255 /end CHARACTERISTIC
/begin CHARACTERISTIC K_ED_LANK2_OPENLOAD.INC_NACH_EINTRAG "Fault code LANK2_OPENLOAD - debounce filter increment after fault-memory entry [verified]" VALUE 0x71D9A RL_VAL_UB 0 CM_0000 0 255 /end CHARACTERISTIC
/begin CHARACTERISTIC K_ED_LANK2_OPENLOAD.INC_VOR_EINTRAG "Fault code LANK2_OPENLOAD - debounce filter increment before fault-memory entry [verified]" VALUE 0x71D98 RL_VAL_UB 0 CM_0000 0 255 /end CHARACTERISTIC
/begin CHARACTERISTIC K_ED_LANK2_OPENLOAD.KLASSENINDEX "Fault code LANK2_OPENLOAD - fault class selection (lamp / warning behaviour) [verified]" VALUE 0x71D9C RL_VAL_UB 0 CM_0000 0 255 /end CHARACTERISTIC
/begin CHARACTERISTIC K_ED_LANK2_OPENLOAD.OK_SCHWELLE "Fault code LANK2_OPENLOAD - debounce filter threshold for clearing (healing) the fault [verified]" VALUE 0x71D97 RL_VAL_UB 0 CM_0000 0 255 /end CHARACTERISTIC
/begin CHARACTERISTIC K_ED_LANK2_OPENLOAD.P_CODE_OPENLOAD "Fault code LANK2_OPENLOAD - OBD P-code reported for open circuit [verified]" VALUE 0x71D92 RL_VAL_UW 0 CM_0000 0 65535 /end CHARACTERISTIC
/begin CHARACTERISTIC K_ED_LANK2_OPENLOAD.P_CODE_SH_TO_GND "Fault code LANK2_OPENLOAD - OBD P-code reported for short to ground [verified]" VALUE 0x71D90 RL_VAL_UW 0 CM_0000 0 65535 /end CHARACTERISTIC
/begin CHARACTERISTIC K_ED_LANK2_OPENLOAD.P_CODE_SH_TO_UB "Fault code LANK2_OPENLOAD - OBD P-code reported for short to battery voltage [verified]" VALUE 0x71D8E RL_VAL_UW 0 CM_0000 0 65535 /end CHARACTERISTIC
/begin CHARACTERISTIC K_ED_LANK2_OPENLOAD.P_CODE_UNPLAUSIBEL "Fault code LANK2_OPENLOAD - OBD P-code reported for implausible signal [verified]" VALUE 0x71D94 RL_VAL_UW 0 CM_0000 0 65535 /end CHARACTERISTIC
/begin CHARACTERISTIC K_ED_LAVK1.DEC_NACH_EINTRAG "Fault code LAVK1 - debounce filter decrement after fault-memory entry [verified]" VALUE 0x70CD9 RL_VAL_UB 0 CM_0000 0 255 /end CHARACTERISTIC
/begin CHARACTERISTIC K_ED_LAVK1.DEC_VOR_EINTRAG "Fault code LAVK1 - debounce filter decrement before fault-memory entry [verified]" VALUE 0x70CD7 RL_VAL_UB 0 CM_0000 0 255 /end CHARACTERISTIC
/begin CHARACTERISTIC K_ED_LAVK1.FEHLERSCHWELLE "Fault code LAVK1 - debounce filter threshold for setting the fault [verified]" VALUE 0x70CD4 RL_VAL_UB 0 CM_0000 0 255 /end CHARACTERISTIC
/begin CHARACTERISTIC K_ED_LAVK1.INC_NACH_EINTRAG "Fault code LAVK1 - debounce filter increment after fault-memory entry [verified]" VALUE 0x70CD8 RL_VAL_UB 0 CM_0000 0 255 /end CHARACTERISTIC
/begin CHARACTERISTIC K_ED_LAVK1.INC_VOR_EINTRAG "Fault code LAVK1 - debounce filter increment before fault-memory entry [verified]" VALUE 0x70CD6 RL_VAL_UB 0 CM_0000 0 255 /end CHARACTERISTIC
/begin CHARACTERISTIC K_ED_LAVK1.KLASSENINDEX "Fault code LAVK1 - fault class selection (lamp / warning behaviour) [verified]" VALUE 0x70CDA RL_VAL_UB 0 CM_0000 0 255 /end CHARACTERISTIC
/begin CHARACTERISTIC K_ED_LAVK1.OK_SCHWELLE "Fault code LAVK1 - debounce filter threshold for clearing (healing) the fault [verified]" VALUE 0x70CD5 RL_VAL_UB 0 CM_0000 0 255 /end CHARACTERISTIC
/begin CHARACTERISTIC K_ED_LAVK1.P_CODE_OPENLOAD "Fault code LAVK1 - OBD P-code reported for open circuit [verified]" VALUE 0x70CD0 RL_VAL_UW 0 CM_0000 0 65535 /end CHARACTERISTIC
/begin CHARACTERISTIC K_ED_LAVK1.P_CODE_SH_TO_GND "Fault code LAVK1 - OBD P-code reported for short to ground [verified]" VALUE 0x70CCE RL_VAL_UW 0 CM_0000 0 65535 /end CHARACTERISTIC
/begin CHARACTERISTIC K_ED_LAVK1.P_CODE_SH_TO_UB "Fault code LAVK1 - OBD P-code reported for short to battery voltage [verified]" VALUE 0x70CCC RL_VAL_UW 0 CM_0000 0 65535 /end CHARACTERISTIC
/begin CHARACTERISTIC K_ED_LAVK1.P_CODE_UNPLAUSIBEL "Fault code LAVK1 - OBD P-code reported for implausible signal [verified]" VALUE 0x70CD2 RL_VAL_UW 0 CM_0000 0 65535 /end CHARACTERISTIC
/begin CHARACTERISTIC K_ED_LAVK1_DIAG.DEC_NACH_EINTRAG "Fault code LAVK1_DIAG - debounce filter decrement after fault-memory entry [verified]" VALUE 0x71081 RL_VAL_UB 0 CM_0000 0 255 /end CHARACTERISTIC
/begin CHARACTERISTIC K_ED_LAVK1_DIAG.DEC_VOR_EINTRAG "Fault code LAVK1_DIAG - debounce filter decrement before fault-memory entry [verified]" VALUE 0x7107F RL_VAL_UB 0 CM_0000 0 255 /end CHARACTERISTIC
/begin CHARACTERISTIC K_ED_LAVK1_DIAG.FEHLERSCHWELLE "Fault code LAVK1_DIAG - debounce filter threshold for setting the fault [verified]" VALUE 0x7107C RL_VAL_UB 0 CM_0000 0 255 /end CHARACTERISTIC
/begin CHARACTERISTIC K_ED_LAVK1_DIAG.INC_NACH_EINTRAG "Fault code LAVK1_DIAG - debounce filter increment after fault-memory entry [verified]" VALUE 0x71080 RL_VAL_UB 0 CM_0000 0 255 /end CHARACTERISTIC
/begin CHARACTERISTIC K_ED_LAVK1_DIAG.INC_VOR_EINTRAG "Fault code LAVK1_DIAG - debounce filter increment before fault-memory entry [verified]" VALUE 0x7107E RL_VAL_UB 0 CM_0000 0 255 /end CHARACTERISTIC
/begin CHARACTERISTIC K_ED_LAVK1_DIAG.KLASSENINDEX "Fault code LAVK1_DIAG - fault class selection (lamp / warning behaviour) [verified]" VALUE 0x71082 RL_VAL_UB 0 CM_0000 0 255 /end CHARACTERISTIC
/begin CHARACTERISTIC K_ED_LAVK1_DIAG.OK_SCHWELLE "Fault code LAVK1_DIAG - debounce filter threshold for clearing (healing) the fault [verified]" VALUE 0x7107D RL_VAL_UB 0 CM_0000 0 255 /end CHARACTERISTIC
/begin CHARACTERISTIC K_ED_LAVK1_DIAG.P_CODE_OPENLOAD "Fault code LAVK1_DIAG - OBD P-code reported for open circuit [verified]" VALUE 0x71078 RL_VAL_UW 0 CM_0000 0 65535 /end CHARACTERISTIC
/begin CHARACTERISTIC K_ED_LAVK1_DIAG.P_CODE_SH_TO_GND "Fault code LAVK1_DIAG - OBD P-code reported for short to ground [verified]" VALUE 0x71076 RL_VAL_UW 0 CM_0000 0 65535 /end CHARACTERISTIC
/begin CHARACTERISTIC K_ED_LAVK1_DIAG.P_CODE_SH_TO_UB "Fault code LAVK1_DIAG - OBD P-code reported for short to battery voltage [verified]" VALUE 0x71074 RL_VAL_UW 0 CM_0000 0 65535 /end CHARACTERISTIC
/begin CHARACTERISTIC K_ED_LAVK1_DIAG.P_CODE_UNPLAUSIBEL "Fault code LAVK1_DIAG - OBD P-code reported for implausible signal [verified]" VALUE 0x7107A RL_VAL_UW 0 CM_0000 0 65535 /end CHARACTERISTIC
/begin CHARACTERISTIC K_ED_LAVK1_IA_OPENLOAD.DEC_NACH_EINTRAG "Fault code LAVK1_IA_OPENLOAD - debounce filter decrement after fault-memory entry [verified]" VALUE 0x710B5 RL_VAL_UB 0 CM_0000 0 255 /end CHARACTERISTIC
/begin CHARACTERISTIC K_ED_LAVK1_IA_OPENLOAD.DEC_VOR_EINTRAG "Fault code LAVK1_IA_OPENLOAD - debounce filter decrement before fault-memory entry [verified]" VALUE 0x710B3 RL_VAL_UB 0 CM_0000 0 255 /end CHARACTERISTIC
/begin CHARACTERISTIC K_ED_LAVK1_IA_OPENLOAD.FEHLERSCHWELLE "Fault code LAVK1_IA_OPENLOAD - debounce filter threshold for setting the fault [verified]" VALUE 0x710B0 RL_VAL_UB 0 CM_0000 0 255 /end CHARACTERISTIC
/begin CHARACTERISTIC K_ED_LAVK1_IA_OPENLOAD.INC_NACH_EINTRAG "Fault code LAVK1_IA_OPENLOAD - debounce filter increment after fault-memory entry [verified]" VALUE 0x710B4 RL_VAL_UB 0 CM_0000 0 255 /end CHARACTERISTIC
/begin CHARACTERISTIC K_ED_LAVK1_IA_OPENLOAD.INC_VOR_EINTRAG "Fault code LAVK1_IA_OPENLOAD - debounce filter increment before fault-memory entry [verified]" VALUE 0x710B2 RL_VAL_UB 0 CM_0000 0 255 /end CHARACTERISTIC
/begin CHARACTERISTIC K_ED_LAVK1_IA_OPENLOAD.KLASSENINDEX "Fault code LAVK1_IA_OPENLOAD - fault class selection (lamp / warning behaviour) [verified]" VALUE 0x710B6 RL_VAL_UB 0 CM_0000 0 255 /end CHARACTERISTIC
/begin CHARACTERISTIC K_ED_LAVK1_IA_OPENLOAD.OK_SCHWELLE "Fault code LAVK1_IA_OPENLOAD - debounce filter threshold for clearing (healing) the fault [verified]" VALUE 0x710B1 RL_VAL_UB 0 CM_0000 0 255 /end CHARACTERISTIC
/begin CHARACTERISTIC K_ED_LAVK1_IA_OPENLOAD.P_CODE_OPENLOAD "Fault code LAVK1_IA_OPENLOAD - OBD P-code reported for open circuit [verified]" VALUE 0x710AC RL_VAL_UW 0 CM_0000 0 65535 /end CHARACTERISTIC
/begin CHARACTERISTIC K_ED_LAVK1_IA_OPENLOAD.P_CODE_SH_TO_GND "Fault code LAVK1_IA_OPENLOAD - OBD P-code reported for short to ground [verified]" VALUE 0x710AA RL_VAL_UW 0 CM_0000 0 65535 /end CHARACTERISTIC
/begin CHARACTERISTIC K_ED_LAVK1_IA_OPENLOAD.P_CODE_SH_TO_UB "Fault code LAVK1_IA_OPENLOAD - OBD P-code reported for short to battery voltage [verified]" VALUE 0x710A8 RL_VAL_UW 0 CM_0000 0 65535 /end CHARACTERISTIC
/begin CHARACTERISTIC K_ED_LAVK1_IA_OPENLOAD.P_CODE_UNPLAUSIBEL "Fault code LAVK1_IA_OPENLOAD - OBD P-code reported for implausible signal [verified]" VALUE 0x710AE RL_VAL_UW 0 CM_0000 0 65535 /end CHARACTERISTIC
/begin CHARACTERISTIC K_ED_LAVK1_IP_OPENLOAD.DEC_NACH_EINTRAG "Fault code LAVK1_IP_OPENLOAD - debounce filter decrement after fault-memory entry [verified]" VALUE 0x71151 RL_VAL_UB 0 CM_0000 0 255 /end CHARACTERISTIC
/begin CHARACTERISTIC K_ED_LAVK1_IP_OPENLOAD.DEC_VOR_EINTRAG "Fault code LAVK1_IP_OPENLOAD - debounce filter decrement before fault-memory entry [verified]" VALUE 0x7114F RL_VAL_UB 0 CM_0000 0 255 /end CHARACTERISTIC
/begin CHARACTERISTIC K_ED_LAVK1_IP_OPENLOAD.FEHLERSCHWELLE "Fault code LAVK1_IP_OPENLOAD - debounce filter threshold for setting the fault [verified]" VALUE 0x7114C RL_VAL_UB 0 CM_0000 0 255 /end CHARACTERISTIC
/begin CHARACTERISTIC K_ED_LAVK1_IP_OPENLOAD.INC_NACH_EINTRAG "Fault code LAVK1_IP_OPENLOAD - debounce filter increment after fault-memory entry [verified]" VALUE 0x71150 RL_VAL_UB 0 CM_0000 0 255 /end CHARACTERISTIC
/begin CHARACTERISTIC K_ED_LAVK1_IP_OPENLOAD.INC_VOR_EINTRAG "Fault code LAVK1_IP_OPENLOAD - debounce filter increment before fault-memory entry [verified]" VALUE 0x7114E RL_VAL_UB 0 CM_0000 0 255 /end CHARACTERISTIC
/begin CHARACTERISTIC K_ED_LAVK1_IP_OPENLOAD.KLASSENINDEX "Fault code LAVK1_IP_OPENLOAD - fault class selection (lamp / warning behaviour) [verified]" VALUE 0x71152 RL_VAL_UB 0 CM_0000 0 255 /end CHARACTERISTIC
/begin CHARACTERISTIC K_ED_LAVK1_IP_OPENLOAD.OK_SCHWELLE "Fault code LAVK1_IP_OPENLOAD - debounce filter threshold for clearing (healing) the fault [verified]" VALUE 0x7114D RL_VAL_UB 0 CM_0000 0 255 /end CHARACTERISTIC
/begin CHARACTERISTIC K_ED_LAVK1_IP_OPENLOAD.P_CODE_OPENLOAD "Fault code LAVK1_IP_OPENLOAD - OBD P-code reported for open circuit [verified]" VALUE 0x71148 RL_VAL_UW 0 CM_0000 0 65535 /end CHARACTERISTIC
/begin CHARACTERISTIC K_ED_LAVK1_IP_OPENLOAD.P_CODE_SH_TO_GND "Fault code LAVK1_IP_OPENLOAD - OBD P-code reported for short to ground [verified]" VALUE 0x71146 RL_VAL_UW 0 CM_0000 0 65535 /end CHARACTERISTIC
/begin CHARACTERISTIC K_ED_LAVK1_IP_OPENLOAD.P_CODE_SH_TO_UB "Fault code LAVK1_IP_OPENLOAD - OBD P-code reported for short to battery voltage [verified]" VALUE 0x71144 RL_VAL_UW 0 CM_0000 0 65535 /end CHARACTERISTIC
/begin CHARACTERISTIC K_ED_LAVK1_IP_OPENLOAD.P_CODE_UNPLAUSIBEL "Fault code LAVK1_IP_OPENLOAD - OBD P-code reported for implausible signal [verified]" VALUE 0x7114A RL_VAL_UW 0 CM_0000 0 65535 /end CHARACTERISTIC
/begin CHARACTERISTIC K_ED_LAVK1_OBD_DYN.DEC_NACH_EINTRAG "Fault code LAVK1_OBD_DYN - debounce filter decrement after fault-memory entry [verified]" VALUE 0x714AB RL_VAL_UB 0 CM_0000 0 255 /end CHARACTERISTIC
/begin CHARACTERISTIC K_ED_LAVK1_OBD_DYN.DEC_VOR_EINTRAG "Fault code LAVK1_OBD_DYN - debounce filter decrement before fault-memory entry [verified]" VALUE 0x714A9 RL_VAL_UB 0 CM_0000 0 255 /end CHARACTERISTIC
/begin CHARACTERISTIC K_ED_LAVK1_OBD_DYN.FEHLERSCHWELLE "Fault code LAVK1_OBD_DYN - debounce filter threshold for setting the fault [verified]" VALUE 0x714A6 RL_VAL_UB 0 CM_0000 0 255 /end CHARACTERISTIC
/begin CHARACTERISTIC K_ED_LAVK1_OBD_DYN.INC_NACH_EINTRAG "Fault code LAVK1_OBD_DYN - debounce filter increment after fault-memory entry [verified]" VALUE 0x714AA RL_VAL_UB 0 CM_0000 0 255 /end CHARACTERISTIC
/begin CHARACTERISTIC K_ED_LAVK1_OBD_DYN.INC_VOR_EINTRAG "Fault code LAVK1_OBD_DYN - debounce filter increment before fault-memory entry [verified]" VALUE 0x714A8 RL_VAL_UB 0 CM_0000 0 255 /end CHARACTERISTIC
/begin CHARACTERISTIC K_ED_LAVK1_OBD_DYN.KLASSENINDEX "Fault code LAVK1_OBD_DYN - fault class selection (lamp / warning behaviour) [verified]" VALUE 0x714AC RL_VAL_UB 0 CM_0000 0 255 /end CHARACTERISTIC
/begin CHARACTERISTIC K_ED_LAVK1_OBD_DYN.OK_SCHWELLE "Fault code LAVK1_OBD_DYN - debounce filter threshold for clearing (healing) the fault [verified]" VALUE 0x714A7 RL_VAL_UB 0 CM_0000 0 255 /end CHARACTERISTIC
/begin CHARACTERISTIC K_ED_LAVK1_OBD_DYN.P_CODE_OPENLOAD "Fault code LAVK1_OBD_DYN - OBD P-code reported for open circuit [verified]" VALUE 0x714A2 RL_VAL_UW 0 CM_0000 0 65535 /end CHARACTERISTIC
/begin CHARACTERISTIC K_ED_LAVK1_OBD_DYN.P_CODE_SH_TO_GND "Fault code LAVK1_OBD_DYN - OBD P-code reported for short to ground [verified]" VALUE 0x714A0 RL_VAL_UW 0 CM_0000 0 65535 /end CHARACTERISTIC
/begin CHARACTERISTIC K_ED_LAVK1_OBD_DYN.P_CODE_SH_TO_UB "Fault code LAVK1_OBD_DYN - OBD P-code reported for short to battery voltage [verified]" VALUE 0x7149E RL_VAL_UW 0 CM_0000 0 65535 /end CHARACTERISTIC
/begin CHARACTERISTIC K_ED_LAVK1_OBD_DYN.P_CODE_UNPLAUSIBEL "Fault code LAVK1_OBD_DYN - OBD P-code reported for implausible signal [verified]" VALUE 0x714A4 RL_VAL_UW 0 CM_0000 0 65535 /end CHARACTERISTIC
/begin CHARACTERISTIC K_ED_LAVK1_OBD_PLAU.DEC_NACH_EINTRAG "Fault code LAVK1_OBD_PLAU - debounce filter decrement after fault-memory entry [verified]" VALUE 0x70D0D RL_VAL_UB 0 CM_0000 0 255 /end CHARACTERISTIC
/begin CHARACTERISTIC K_ED_LAVK1_OBD_PLAU.DEC_VOR_EINTRAG "Fault code LAVK1_OBD_PLAU - debounce filter decrement before fault-memory entry [verified]" VALUE 0x70D0B RL_VAL_UB 0 CM_0000 0 255 /end CHARACTERISTIC
/begin CHARACTERISTIC K_ED_LAVK1_OBD_PLAU.FEHLERSCHWELLE "Fault code LAVK1_OBD_PLAU - debounce filter threshold for setting the fault [verified]" VALUE 0x70D08 RL_VAL_UB 0 CM_0000 0 255 /end CHARACTERISTIC
/begin CHARACTERISTIC K_ED_LAVK1_OBD_PLAU.INC_NACH_EINTRAG "Fault code LAVK1_OBD_PLAU - debounce filter increment after fault-memory entry [verified]" VALUE 0x70D0C RL_VAL_UB 0 CM_0000 0 255 /end CHARACTERISTIC
/begin CHARACTERISTIC K_ED_LAVK1_OBD_PLAU.INC_VOR_EINTRAG "Fault code LAVK1_OBD_PLAU - debounce filter increment before fault-memory entry [verified]" VALUE 0x70D0A RL_VAL_UB 0 CM_0000 0 255 /end CHARACTERISTIC
/begin CHARACTERISTIC K_ED_LAVK1_OBD_PLAU.KLASSENINDEX "Fault code LAVK1_OBD_PLAU - fault class selection (lamp / warning behaviour) [verified]" VALUE 0x70D0E RL_VAL_UB 0 CM_0000 0 255 /end CHARACTERISTIC
/begin CHARACTERISTIC K_ED_LAVK1_OBD_PLAU.OK_SCHWELLE "Fault code LAVK1_OBD_PLAU - debounce filter threshold for clearing (healing) the fault [verified]" VALUE 0x70D09 RL_VAL_UB 0 CM_0000 0 255 /end CHARACTERISTIC
/begin CHARACTERISTIC K_ED_LAVK1_OBD_PLAU.P_CODE_OPENLOAD "Fault code LAVK1_OBD_PLAU - OBD P-code reported for open circuit [verified]" VALUE 0x70D04 RL_VAL_UW 0 CM_0000 0 65535 /end CHARACTERISTIC
/begin CHARACTERISTIC K_ED_LAVK1_OBD_PLAU.P_CODE_SH_TO_GND "Fault code LAVK1_OBD_PLAU - OBD P-code reported for short to ground [verified]" VALUE 0x70D02 RL_VAL_UW 0 CM_0000 0 65535 /end CHARACTERISTIC
/begin CHARACTERISTIC K_ED_LAVK1_OBD_PLAU.P_CODE_SH_TO_UB "Fault code LAVK1_OBD_PLAU - OBD P-code reported for short to battery voltage [verified]" VALUE 0x70D00 RL_VAL_UW 0 CM_0000 0 65535 /end CHARACTERISTIC
/begin CHARACTERISTIC K_ED_LAVK1_OBD_PLAU.P_CODE_UNPLAUSIBEL "Fault code LAVK1_OBD_PLAU - OBD P-code reported for implausible signal [verified]" VALUE 0x70D06 RL_VAL_UW 0 CM_0000 0 65535 /end CHARACTERISTIC
/begin CHARACTERISTIC K_ED_LAVK1_OBD_SA.DEC_NACH_EINTRAG "Fault code LAVK1_OBD_SA - debounce filter decrement after fault-memory entry [verified]" VALUE 0x70D41 RL_VAL_UB 0 CM_0000 0 255 /end CHARACTERISTIC
/begin CHARACTERISTIC K_ED_LAVK1_OBD_SA.DEC_VOR_EINTRAG "Fault code LAVK1_OBD_SA - debounce filter decrement before fault-memory entry [verified]" VALUE 0x70D3F RL_VAL_UB 0 CM_0000 0 255 /end CHARACTERISTIC
/begin CHARACTERISTIC K_ED_LAVK1_OBD_SA.FEHLERSCHWELLE "Fault code LAVK1_OBD_SA - debounce filter threshold for setting the fault [verified]" VALUE 0x70D3C RL_VAL_UB 0 CM_0000 0 255 /end CHARACTERISTIC
/begin CHARACTERISTIC K_ED_LAVK1_OBD_SA.INC_NACH_EINTRAG "Fault code LAVK1_OBD_SA - debounce filter increment after fault-memory entry [verified]" VALUE 0x70D40 RL_VAL_UB 0 CM_0000 0 255 /end CHARACTERISTIC
/begin CHARACTERISTIC K_ED_LAVK1_OBD_SA.INC_VOR_EINTRAG "Fault code LAVK1_OBD_SA - debounce filter increment before fault-memory entry [verified]" VALUE 0x70D3E RL_VAL_UB 0 CM_0000 0 255 /end CHARACTERISTIC
/begin CHARACTERISTIC K_ED_LAVK1_OBD_SA.KLASSENINDEX "Fault code LAVK1_OBD_SA - fault class selection (lamp / warning behaviour) [verified]" VALUE 0x70D42 RL_VAL_UB 0 CM_0000 0 255 /end CHARACTERISTIC
/begin CHARACTERISTIC K_ED_LAVK1_OBD_SA.OK_SCHWELLE "Fault code LAVK1_OBD_SA - debounce filter threshold for clearing (healing) the fault [verified]" VALUE 0x70D3D RL_VAL_UB 0 CM_0000 0 255 /end CHARACTERISTIC
/begin CHARACTERISTIC K_ED_LAVK1_OBD_SA.P_CODE_OPENLOAD "Fault code LAVK1_OBD_SA - OBD P-code reported for open circuit [verified]" VALUE 0x70D38 RL_VAL_UW 0 CM_0000 0 65535 /end CHARACTERISTIC
/begin CHARACTERISTIC K_ED_LAVK1_OBD_SA.P_CODE_SH_TO_GND "Fault code LAVK1_OBD_SA - OBD P-code reported for short to ground [verified]" VALUE 0x70D36 RL_VAL_UW 0 CM_0000 0 65535 /end CHARACTERISTIC
/begin CHARACTERISTIC K_ED_LAVK1_OBD_SA.P_CODE_SH_TO_UB "Fault code LAVK1_OBD_SA - OBD P-code reported for short to battery voltage [verified]" VALUE 0x70D34 RL_VAL_UW 0 CM_0000 0 65535 /end CHARACTERISTIC
/begin CHARACTERISTIC K_ED_LAVK1_OBD_SA.P_CODE_UNPLAUSIBEL "Fault code LAVK1_OBD_SA - OBD P-code reported for implausible signal [verified]" VALUE 0x70D3A RL_VAL_UW 0 CM_0000 0 65535 /end CHARACTERISTIC
/begin CHARACTERISTIC K_ED_LAVK1_OBD_TL.DEC_NACH_EINTRAG "Fault code LAVK1_OBD_TL - debounce filter decrement after fault-memory entry [verified]" VALUE 0x70F49 RL_VAL_UB 0 CM_0000 0 255 /end CHARACTERISTIC
/begin CHARACTERISTIC K_ED_LAVK1_OBD_TL.DEC_VOR_EINTRAG "Fault code LAVK1_OBD_TL - debounce filter decrement before fault-memory entry [verified]" VALUE 0x70F47 RL_VAL_UB 0 CM_0000 0 255 /end CHARACTERISTIC
/begin CHARACTERISTIC K_ED_LAVK1_OBD_TL.FEHLERSCHWELLE "Fault code LAVK1_OBD_TL - debounce filter threshold for setting the fault [verified]" VALUE 0x70F44 RL_VAL_UB 0 CM_0000 0 255 /end CHARACTERISTIC
/begin CHARACTERISTIC K_ED_LAVK1_OBD_TL.INC_NACH_EINTRAG "Fault code LAVK1_OBD_TL - debounce filter increment after fault-memory entry [verified]" VALUE 0x70F48 RL_VAL_UB 0 CM_0000 0 255 /end CHARACTERISTIC
/begin CHARACTERISTIC K_ED_LAVK1_OBD_TL.INC_VOR_EINTRAG "Fault code LAVK1_OBD_TL - debounce filter increment before fault-memory entry [verified]" VALUE 0x70F46 RL_VAL_UB 0 CM_0000 0 255 /end CHARACTERISTIC
/begin CHARACTERISTIC K_ED_LAVK1_OBD_TL.KLASSENINDEX "Fault code LAVK1_OBD_TL - fault class selection (lamp / warning behaviour) [verified]" VALUE 0x70F4A RL_VAL_UB 0 CM_0000 0 255 /end CHARACTERISTIC
/begin CHARACTERISTIC K_ED_LAVK1_OBD_TL.OK_SCHWELLE "Fault code LAVK1_OBD_TL - debounce filter threshold for clearing (healing) the fault [verified]" VALUE 0x70F45 RL_VAL_UB 0 CM_0000 0 255 /end CHARACTERISTIC
/begin CHARACTERISTIC K_ED_LAVK1_OBD_TL.P_CODE_OPENLOAD "Fault code LAVK1_OBD_TL - OBD P-code reported for open circuit [verified]" VALUE 0x70F40 RL_VAL_UW 0 CM_0000 0 65535 /end CHARACTERISTIC
/begin CHARACTERISTIC K_ED_LAVK1_OBD_TL.P_CODE_SH_TO_GND "Fault code LAVK1_OBD_TL - OBD P-code reported for short to ground [verified]" VALUE 0x70F3E RL_VAL_UW 0 CM_0000 0 65535 /end CHARACTERISTIC
/begin CHARACTERISTIC K_ED_LAVK1_OBD_TL.P_CODE_SH_TO_UB "Fault code LAVK1_OBD_TL - OBD P-code reported for short to battery voltage [verified]" VALUE 0x70F3C RL_VAL_UW 0 CM_0000 0 65535 /end CHARACTERISTIC
/begin CHARACTERISTIC K_ED_LAVK1_OBD_TL.P_CODE_UNPLAUSIBEL "Fault code LAVK1_OBD_TL - OBD P-code reported for implausible signal [verified]" VALUE 0x70F42 RL_VAL_UW 0 CM_0000 0 65535 /end CHARACTERISTIC
/begin CHARACTERISTIC K_ED_LAVK1_TRIM.DEC_NACH_EINTRAG "Fault code LAVK1_TRIM - debounce filter decrement after fault-memory entry [verified]" VALUE 0x715C9 RL_VAL_UB 0 CM_0000 0 255 /end CHARACTERISTIC
/begin CHARACTERISTIC K_ED_LAVK1_TRIM.DEC_VOR_EINTRAG "Fault code LAVK1_TRIM - debounce filter decrement before fault-memory entry [verified]" VALUE 0x715C7 RL_VAL_UB 0 CM_0000 0 255 /end CHARACTERISTIC
/begin CHARACTERISTIC K_ED_LAVK1_TRIM.FEHLERSCHWELLE "Fault code LAVK1_TRIM - debounce filter threshold for setting the fault [verified]" VALUE 0x715C4 RL_VAL_UB 0 CM_0000 0 255 /end CHARACTERISTIC
/begin CHARACTERISTIC K_ED_LAVK1_TRIM.INC_NACH_EINTRAG "Fault code LAVK1_TRIM - debounce filter increment after fault-memory entry [verified]" VALUE 0x715C8 RL_VAL_UB 0 CM_0000 0 255 /end CHARACTERISTIC
/begin CHARACTERISTIC K_ED_LAVK1_TRIM.INC_VOR_EINTRAG "Fault code LAVK1_TRIM - debounce filter increment before fault-memory entry [verified]" VALUE 0x715C6 RL_VAL_UB 0 CM_0000 0 255 /end CHARACTERISTIC
/begin CHARACTERISTIC K_ED_LAVK1_TRIM.KLASSENINDEX "Fault code LAVK1_TRIM - fault class selection (lamp / warning behaviour) [verified]" VALUE 0x715CA RL_VAL_UB 0 CM_0000 0 255 /end CHARACTERISTIC
/begin CHARACTERISTIC K_ED_LAVK1_TRIM.OK_SCHWELLE "Fault code LAVK1_TRIM - debounce filter threshold for clearing (healing) the fault [verified]" VALUE 0x715C5 RL_VAL_UB 0 CM_0000 0 255 /end CHARACTERISTIC
/begin CHARACTERISTIC K_ED_LAVK1_TRIM.P_CODE_OPENLOAD "Fault code LAVK1_TRIM - OBD P-code reported for open circuit [verified]" VALUE 0x715C0 RL_VAL_UW 0 CM_0000 0 65535 /end CHARACTERISTIC
/begin CHARACTERISTIC K_ED_LAVK1_TRIM.P_CODE_SH_TO_GND "Fault code LAVK1_TRIM - OBD P-code reported for short to ground [verified]" VALUE 0x715BE RL_VAL_UW 0 CM_0000 0 65535 /end CHARACTERISTIC
/begin CHARACTERISTIC K_ED_LAVK1_TRIM.P_CODE_SH_TO_UB "Fault code LAVK1_TRIM - OBD P-code reported for short to battery voltage [verified]" VALUE 0x715BC RL_VAL_UW 0 CM_0000 0 65535 /end CHARACTERISTIC
/begin CHARACTERISTIC K_ED_LAVK1_TRIM.P_CODE_UNPLAUSIBEL "Fault code LAVK1_TRIM - OBD P-code reported for implausible signal [verified]" VALUE 0x715C2 RL_VAL_UW 0 CM_0000 0 65535 /end CHARACTERISTIC
/begin CHARACTERISTIC K_ED_LAVK1_UN_OPENLOAD.DEC_NACH_EINTRAG "Fault code LAVK1_UN_OPENLOAD - debounce filter decrement after fault-memory entry [verified]" VALUE 0x7111D RL_VAL_UB 0 CM_0000 0 255 /end CHARACTERISTIC
/begin CHARACTERISTIC K_ED_LAVK1_UN_OPENLOAD.DEC_VOR_EINTRAG "Fault code LAVK1_UN_OPENLOAD - debounce filter decrement before fault-memory entry [verified]" VALUE 0x7111B RL_VAL_UB 0 CM_0000 0 255 /end CHARACTERISTIC
/begin CHARACTERISTIC K_ED_LAVK1_UN_OPENLOAD.FEHLERSCHWELLE "Fault code LAVK1_UN_OPENLOAD - debounce filter threshold for setting the fault [verified]" VALUE 0x71118 RL_VAL_UB 0 CM_0000 0 255 /end CHARACTERISTIC
/begin CHARACTERISTIC K_ED_LAVK1_UN_OPENLOAD.INC_NACH_EINTRAG "Fault code LAVK1_UN_OPENLOAD - debounce filter increment after fault-memory entry [verified]" VALUE 0x7111C RL_VAL_UB 0 CM_0000 0 255 /end CHARACTERISTIC
/begin CHARACTERISTIC K_ED_LAVK1_UN_OPENLOAD.INC_VOR_EINTRAG "Fault code LAVK1_UN_OPENLOAD - debounce filter increment before fault-memory entry [verified]" VALUE 0x7111A RL_VAL_UB 0 CM_0000 0 255 /end CHARACTERISTIC
/begin CHARACTERISTIC K_ED_LAVK1_UN_OPENLOAD.KLASSENINDEX "Fault code LAVK1_UN_OPENLOAD - fault class selection (lamp / warning behaviour) [verified]" VALUE 0x7111E RL_VAL_UB 0 CM_0000 0 255 /end CHARACTERISTIC
/begin COMPU_METHOD CM_0000 "X" RAT_FUNC "%.4g" "-" COEFFS 0 1 0 0 0 1 /end COMPU_METHOD
/begin RECORD_LAYOUT RL_VAL_UB FNC_VALUES 1 UBYTE COLUMN_DIR DIRECT /end RECORD_LAYOUT
/begin RECORD_LAYOUT RL_VAL_UW FNC_VALUES 1 UWORD COLUMN_DIR DIRECT /end RECORD_LAYOUT
/begin GROUP G_y_Fault_paths__K_ED_ "y Fault paths (K_ED)" ROOT
 /begin REF_CHARACTERISTIC K_ED_EV4.INC_VOR_EINTRAG K_ED_EV4.KLASSENINDEX K_ED_EV4.OK_SCHWELLE K_ED_EV4.P_CODE_OPENLOAD K_ED_EV4.P_CODE_SH_TO_GND K_ED_EV4.P_CODE_SH_TO_UB K_ED_EV4.P_CODE_UNPLAUSIBEL K_ED_EV5.DEC_NACH_EINTRAG K_ED_EV5.DEC_VOR_EINTRAG K_ED_EV5.FEHLERSCHWELLE K_ED_EV5.INC_NACH_EINTRAG K_ED_EV5.INC_VOR_EINTRAG K_ED_EV5.KLASSENINDEX K_ED_EV5.OK_SCHWELLE K_ED_EV5.P_CODE_OPENLOAD K_ED_EV5.P_CODE_SH_TO_GND K_ED_EV5.P_CODE_SH_TO_UB K_ED_EV5.P_CODE_UNPLAUSIBEL K_ED_EV6.DEC_NACH_EINTRAG K_ED_EV6.DEC_VOR_EINTRAG K_ED_EV6.FEHLERSCHWELLE K_ED_EV6.INC_NACH_EINTRAG K_ED_EV6.INC_VOR_EINTRAG K_ED_EV6.KLASSENINDEX K_ED_EV6.OK_SCHWELLE K_ED_EV6.P_CODE_OPENLOAD K_ED_EV6.P_CODE_SH_TO_GND K_ED_EV6.P_CODE_SH_TO_UB K_ED_EV6.P_CODE_UNPLAUSIBEL K_ED_EV7.DEC_NACH_EINTRAG K_ED_EV7.DEC_VOR_EINTRAG K_ED_EV7.FEHLERSCHWELLE K_ED_EV7.INC_NACH_EINTRAG K_ED_EV7.INC_VOR_EINTRAG K_ED_EV7.KLASSENINDEX K_ED_EV7.OK_SCHWELLE K_ED_EV7.P_CODE_OPENLOAD K_ED_EV7.P_CODE_SH_TO_GND K_ED_EV7.P_CODE_SH_TO_UB K_ED_EV7.P_CODE_UNPLAUSIBEL K_ED_EV8.DEC_NACH_EINTRAG K_ED_EV8.DEC_VOR_EINTRAG K_ED_EV8.FEHLERSCHWELLE K_ED_EV8.INC_NACH_EINTRAG K_ED_EV8.INC_VOR_EINTRAG K_ED_EV8.KLASSENINDEX K_ED_EV8.OK_SCHWELLE K_ED_EV8.P_CODE_OPENLOAD K_ED_EV8.P_CODE_SH_TO_GND K_ED_EV8.P_CODE_SH_TO_UB K_ED_EV8.P_CODE_UNPLAUSIBEL K_ED_EV9.DEC_NACH_EINTRAG K_ED_EV9.DEC_VOR_EINTRAG K_ED_EV9.FEHLERSCHWELLE K_ED_EV9.INC_NACH_EINTRAG K_ED_EV9.INC_VOR_EINTRAG K_ED_EV9.KLASSENINDEX K_ED_EV9.OK_SCHWELLE K_ED_EV9.P_CODE_OPENLOAD K_ED_EV9.P_CODE_SH_TO_GND K_ED_EV9.P_CODE_SH_TO_UB K_ED_EV9.P_CODE_UNPLAUSIBEL K_ED_EWS_MAN.DEC_NACH_EINTRAG K_ED_EWS_MAN.DEC_VOR_EINTRAG K_ED_EWS_MAN.FEHLERSCHWELLE K_ED_EWS_MAN.INC_NACH_EINTRAG K_ED_EWS_MAN.INC_VOR_EINTRAG K_ED_EWS_MAN.KLASSENINDEX K_ED_EWS_MAN.OK_SCHWELLE K_ED_EWS_MAN.P_CODE_OPENLOAD K_ED_EWS_MAN.P_CODE_SH_TO_GND K_ED_EWS_MAN.P_CODE_SH_TO_UB K_ED_EWS_MAN.P_CODE_UNPLAUSIBEL K_ED_EWS_SCI.DEC_NACH_EINTRAG K_ED_EWS_SCI.DEC_VOR_EINTRAG K_ED_EWS_SCI.FEHLERSCHWELLE K_ED_EWS_SCI.INC_NACH_EINTRAG K_ED_EWS_SCI.INC_VOR_EINTRAG K_ED_EWS_SCI.KLASSENINDEX K_ED_EWS_SCI.OK_SCHWELLE K_ED_EWS_SCI.P_CODE_OPENLOAD K_ED_EWS_SCI.P_CODE_SH_TO_GND K_ED_EWS_SCI.P_CODE_SH_TO_UB K_ED_EWS_SCI.P_CODE_UNPLAUSIBEL K_ED_FETRAWE.DEC_NACH_EINTRAG K_ED_FETRAWE.DEC_VOR_EINTRAG K_ED_FETRAWE.FEHLERSCHWELLE K_ED_FETRAWE.INC_NACH_EINTRAG K_ED_FETRAWE.INC_VOR_EINTRAG K_ED_FETRAWE.KLASSENINDEX K_ED_FETRAWE.OK_SCHWELLE K_ED_FETRAWE.P_CODE_OPENLOAD K_ED_FETRAWE.P_CODE_SH_TO_GND K_ED_FETRAWE.P_CODE_SH_TO_UB K_ED_FETRAWE.P_CODE_UNPLAUSIBEL K_ED_FI_BSD.DEC_NACH_EINTRAG K_ED_FI_BSD.DEC_VOR_EINTRAG K_ED_FI_BSD.FEHLERSCHWELLE K_ED_FI_BSD.INC_NACH_EINTRAG K_ED_FI_BSD.INC_VOR_EINTRAG K_ED_FI_BSD.KLASSENINDEX K_ED_FI_BSD.OK_SCHWELLE K_ED_FI_BSD.P_CODE_OPENLOAD K_ED_FI_BSD.P_CODE_SH_TO_GND K_ED_FI_BSD.P_CODE_SH_TO_UB K_ED_FI_BSD.P_CODE_UNPLAUSIBEL K_ED_FI_BSDGLOB.DEC_NACH_EINTRAG K_ED_FI_BSDGLOB.DEC_VOR_EINTRAG K_ED_FI_BSDGLOB.FEHLERSCHWELLE K_ED_FI_BSDGLOB.INC_NACH_EINTRAG K_ED_FI_BSDGLOB.INC_VOR_EINTRAG K_ED_FI_BSDGLOB.KLASSENINDEX K_ED_FI_BSDGLOB.OK_SCHWELLE K_ED_FI_BSDGLOB.P_CODE_OPENLOAD K_ED_FI_BSDGLOB.P_CODE_SH_TO_GND K_ED_FI_BSDGLOB.P_CODE_SH_TO_UB K_ED_FI_BSDGLOB.P_CODE_UNPLAUSIBEL K_ED_FI_BSD_0.DEC_NACH_EINTRAG K_ED_FI_BSD_0.DEC_VOR_EINTRAG K_ED_FI_BSD_0.FEHLERSCHWELLE K_ED_FI_BSD_0.INC_NACH_EINTRAG K_ED_FI_BSD_0.INC_VOR_EINTRAG K_ED_FI_BSD_0.KLASSENINDEX K_ED_FI_BSD_0.OK_SCHWELLE K_ED_FI_BSD_0.P_CODE_OPENLOAD K_ED_FI_BSD_0.P_CODE_SH_TO_GND K_ED_FI_BSD_0.P_CODE_SH_TO_UB K_ED_FI_BSD_0.P_CODE_UNPLAUSIBEL K_ED_FI_BSD_6.DEC_NACH_EINTRAG K_ED_FI_BSD_6.DEC_VOR_EINTRAG K_ED_FI_BSD_6.FEHLERSCHWELLE K_ED_FI_BSD_6.INC_NACH_EINTRAG K_ED_FI_BSD_6.INC_VOR_EINTRAG K_ED_FI_BSD_6.KLASSENINDEX K_ED_FI_BSD_6.OK_SCHWELLE K_ED_FI_BSD_6.P_CODE_OPENLOAD K_ED_FI_BSD_6.P_CODE_SH_TO_GND K_ED_FI_BSD_6.P_CODE_SH_TO_UB K_ED_FI_BSD_6.P_CODE_UNPLAUSIBEL K_ED_FI_GEN.DEC_NACH_EINTRAG K_ED_FI_GEN.DEC_VOR_EINTRAG K_ED_FI_GEN.FEHLERSCHWELLE K_ED_FI_GEN.INC_NACH_EINTRAG K_ED_FI_GEN.INC_VOR_EINTRAG K_ED_FI_GEN.KLASSENINDEX K_ED_FI_GEN.OK_SCHWELLE K_ED_FI_GEN.P_CODE_OPENLOAD K_ED_FI_GEN.P_CODE_SH_TO_GND K_ED_FI_GEN.P_CODE_SH_TO_UB K_ED_FI_GEN.P_CODE_UNPLAUSIBEL K_ED_FI_IBS1.DEC_NACH_EINTRAG K_ED_FI_IBS1.DEC_VOR_EINTRAG K_ED_FI_IBS1.FEHLERSCHWELLE K_ED_FI_IBS1.INC_NACH_EINTRAG K_ED_FI_IBS1.INC_VOR_EINTRAG K_ED_FI_IBS1.KLASSENINDEX K_ED_FI_IBS1.OK_SCHWELLE K_ED_FI_IBS1.P_CODE_OPENLOAD K_ED_FI_IBS1.P_CODE_SH_TO_GND K_ED_FI_IBS1.P_CODE_SH_TO_UB K_ED_FI_IBS1.P_CODE_UNPLAUSIBEL K_ED_FI_IBS2.DEC_NACH_EINTRAG K_ED_FI_IBS2.DEC_VOR_EINTRAG K_ED_FI_IBS2.FEHLERSCHWELLE K_ED_FI_IBS2.INC_NACH_EINTRAG K_ED_FI_IBS2.INC_VOR_EINTRAG K_ED_FI_IBS2.KLASSENINDEX K_ED_FI_IBS2.OK_SCHWELLE K_ED_FI_IBS2.P_CODE_OPENLOAD K_ED_FI_IBS2.P_CODE_SH_TO_GND K_ED_FI_IBS2.P_CODE_SH_TO_UB K_ED_FI_IBS2.P_CODE_UNPLAUSIBEL K_ED_FI_IBS3.DEC_NACH_EINTRAG K_ED_FI_IBS3.DEC_VOR_EINTRAG K_ED_FI_IBS3.FEHLERSCHWELLE K_ED_FI_IBS3.INC_NACH_EINTRAG K_ED_FI_IBS3.INC_VOR_EINTRAG K_ED_FI_IBS3.KLASSENINDEX K_ED_FI_IBS3.OK_SCHWELLE K_ED_FI_IBS3.P_CODE_OPENLOAD K_ED_FI_IBS3.P_CODE_SH_TO_GND K_ED_FI_IBS3.P_CODE_SH_TO_UB K_ED_FI_IBS3.P_CODE_UNPLAUSIBEL K_ED_FI_PMBATT.DEC_NACH_EINTRAG K_ED_FI_PMBATT.DEC_VOR_EINTRAG K_ED_FI_PMBATT.FEHLERSCHWELLE K_ED_FI_PMBATT.INC_NACH_EINTRAG K_ED_FI_PMBATT.INC_VOR_EINTRAG K_ED_FI_PMBATT.KLASSENINDEX K_ED_FI_PMBATT.OK_SCHWELLE K_ED_FI_PMBATT.P_CODE_OPENLOAD K_ED_FI_PMBATT.P_CODE_SH_TO_GND K_ED_FI_PMBATT.P_CODE_SH_TO_UB K_ED_FI_PMBATT.P_CODE_UNPLAUSIBEL K_ED_FI_PMBN.DEC_NACH_EINTRAG K_ED_FI_PMBN.DEC_VOR_EINTRAG K_ED_FI_PMBN.FEHLERSCHWELLE K_ED_FI_PMBN.INC_NACH_EINTRAG K_ED_FI_PMBN.INC_VOR_EINTRAG K_ED_FI_PMBN.KLASSENINDEX K_ED_FI_PMBN.OK_SCHWELLE K_ED_FI_PMBN.P_CODE_OPENLOAD K_ED_FI_PMBN.P_CODE_SH_TO_GND K_ED_FI_PMBN.P_CODE_SH_TO_UB K_ED_FI_PMBN.P_CODE_UNPLAUSIBEL K_ED_FI_PMRUHVERL.DEC_NACH_EINTRAG K_ED_FI_PMRUHVERL.DEC_VOR_EINTRAG K_ED_FI_PMRUHVERL.FEHLERSCHWELLE K_ED_FI_PMRUHVERL.INC_NACH_EINTRAG K_ED_FI_PMRUHVERL.INC_VOR_EINTRAG K_ED_FI_PMRUHVERL.KLASSENINDEX K_ED_FI_PMRUHVERL.OK_SCHWELLE K_ED_FI_PMRUHVERL.P_CODE_OPENLOAD K_ED_FI_PMRUHVERL.P_CODE_SH_TO_GND K_ED_FI_PMRUHVERL.P_CODE_SH_TO_UB K_ED_FI_PMRUHVERL.P_CODE_UNPLAUSIBEL K_ED_FI_QLT.DEC_NACH_EINTRAG K_ED_FI_QLT.DEC_VOR_EINTRAG K_ED_FI_QLT.FEHLERSCHWELLE K_ED_FI_QLT.INC_NACH_EINTRAG K_ED_FI_QLT.INC_VOR_EINTRAG K_ED_FI_QLT.KLASSENINDEX K_ED_FI_QLT.OK_SCHWELLE K_ED_FI_QLT.P_CODE_OPENLOAD K_ED_FI_QLT.P_CODE_SH_TO_GND K_ED_FI_QLT.P_CODE_SH_TO_UB K_ED_FI_QLT.P_CODE_UNPLAUSIBEL K_ED_FI_TOENS.DEC_NACH_EINTRAG K_ED_FI_TOENS.DEC_VOR_EINTRAG K_ED_FI_TOENS.FEHLERSCHWELLE K_ED_FI_TOENS.INC_NACH_EINTRAG K_ED_FI_TOENS.INC_VOR_EINTRAG K_ED_FI_TOENS.KLASSENINDEX K_ED_FI_TOENS.OK_SCHWELLE K_ED_FI_TOENS.P_CODE_OPENLOAD K_ED_FI_TOENS.P_CODE_SH_TO_GND K_ED_FI_TOENS.P_CODE_SH_TO_UB K_ED_FI_TOENS.P_CODE_UNPLAUSIBEL K_ED_FPLAU1.DEC_NACH_EINTRAG K_ED_FPLAU1.DEC_VOR_EINTRAG K_ED_FPLAU1.FEHLERSCHWELLE K_ED_FPLAU1.INC_NACH_EINTRAG K_ED_FPLAU1.INC_VOR_EINTRAG K_ED_FPLAU1.KLASSENINDEX K_ED_FPLAU1.OK_SCHWELLE K_ED_FPLAU1.P_CODE_OPENLOAD K_ED_FPLAU1.P_CODE_SH_TO_GND K_ED_FPLAU1.P_CODE_SH_TO_UB K_ED_FPLAU1.P_CODE_UNPLAUSIBEL K_ED_FPLAU2.DEC_NACH_EINTRAG K_ED_FPLAU2.DEC_VOR_EINTRAG K_ED_FPLAU2.FEHLERSCHWELLE K_ED_FPLAU2.INC_NACH_EINTRAG K_ED_FPLAU2.INC_VOR_EINTRAG K_ED_FPLAU2.KLASSENINDEX K_ED_FPLAU2.OK_SCHWELLE K_ED_FPLAU2.P_CODE_OPENLOAD K_ED_FPLAU2.P_CODE_SH_TO_GND K_ED_FPLAU2.P_CODE_SH_TO_UB K_ED_FPLAU2.P_CODE_UNPLAUSIBEL K_ED_FST.DEC_NACH_EINTRAG K_ED_FST.DEC_VOR_EINTRAG K_ED_FST.FEHLERSCHWELLE K_ED_FST.INC_NACH_EINTRAG K_ED_FST.INC_VOR_EINTRAG K_ED_FST.KLASSENINDEX K_ED_FST.OK_SCHWELLE K_ED_FST.P_CODE_OPENLOAD K_ED_FST.P_CODE_SH_TO_GND K_ED_FST.P_CODE_SH_TO_UB K_ED_FST.P_CODE_UNPLAUSIBEL K_ED_FST_GEBER.DEC_NACH_EINTRAG K_ED_FST_GEBER.DEC_VOR_EINTRAG K_ED_FST_GEBER.FEHLERSCHWELLE K_ED_FST_GEBER.INC_NACH_EINTRAG K_ED_FST_GEBER.INC_VOR_EINTRAG K_ED_FST_GEBER.KLASSENINDEX K_ED_FST_GEBER.OK_SCHWELLE K_ED_FST_GEBER.P_CODE_OPENLOAD K_ED_FST_GEBER.P_CODE_SH_TO_GND K_ED_FST_GEBER.P_CODE_SH_TO_UB K_ED_FST_GEBER.P_CODE_UNPLAUSIBEL K_ED_HFM1.DEC_NACH_EINTRAG K_ED_HFM1.DEC_VOR_EINTRAG K_ED_HFM1.FEHLERSCHWELLE K_ED_HFM1.INC_NACH_EINTRAG K_ED_HFM1.INC_VOR_EINTRAG K_ED_HFM1.KLASSENINDEX K_ED_HFM1.OK_SCHWELLE K_ED_HFM1.P_CODE_OPENLOAD K_ED_HFM1.P_CODE_SH_TO_GND K_ED_HFM1.P_CODE_SH_TO_UB K_ED_HFM1.P_CODE_UNPLAUSIBEL K_ED_HFM2.DEC_NACH_EINTRAG K_ED_HFM2.DEC_VOR_EINTRAG K_ED_HFM2.FEHLERSCHWELLE K_ED_HFM2.INC_NACH_EINTRAG K_ED_HFM2.INC_VOR_EINTRAG K_ED_HFM2.KLASSENINDEX K_ED_HFM2.OK_SCHWELLE K_ED_HFM2.P_CODE_OPENLOAD K_ED_HFM2.P_CODE_SH_TO_GND K_ED_HFM2.P_CODE_SH_TO_UB K_ED_HFM2.P_CODE_UNPLAUSIBEL K_ED_INDEX_135_INJ.DEC_NACH_EINTRAG K_ED_INDEX_135_INJ.DEC_VOR_EINTRAG K_ED_INDEX_135_INJ.FEHLERSCHWELLE K_ED_INDEX_135_INJ.INC_NACH_EINTRAG K_ED_INDEX_135_INJ.INC_VOR_EINTRAG K_ED_INDEX_135_INJ.KLASSENINDEX K_ED_INDEX_135_INJ.OK_SCHWELLE K_ED_INDEX_135_INJ.P_CODE_OPENLOAD K_ED_INDEX_135_INJ.P_CODE_SH_TO_GND K_ED_INDEX_135_INJ.P_CODE_SH_TO_UB K_ED_INDEX_135_INJ.P_CODE_UNPLAUSIBEL K_ED_INDEX_15_INJ.DEC_NACH_EINTRAG K_ED_INDEX_15_INJ.DEC_VOR_EINTRAG K_ED_INDEX_15_INJ.FEHLERSCHWELLE K_ED_INDEX_15_INJ.INC_NACH_EINTRAG K_ED_INDEX_15_INJ.INC_VOR_EINTRAG K_ED_INDEX_15_INJ.KLASSENINDEX K_ED_INDEX_15_INJ.OK_SCHWELLE K_ED_INDEX_15_INJ.P_CODE_OPENLOAD K_ED_INDEX_15_INJ.P_CODE_SH_TO_GND K_ED_INDEX_15_INJ.P_CODE_SH_TO_UB K_ED_INDEX_15_INJ.P_CODE_UNPLAUSIBEL K_ED_INDEX_196_INJ.DEC_NACH_EINTRAG K_ED_INDEX_196_INJ.DEC_VOR_EINTRAG K_ED_INDEX_196_INJ.FEHLERSCHWELLE K_ED_INDEX_196_INJ.INC_NACH_EINTRAG K_ED_INDEX_196_INJ.INC_VOR_EINTRAG K_ED_INDEX_196_INJ.KLASSENINDEX K_ED_INDEX_196_INJ.OK_SCHWELLE K_ED_INDEX_196_INJ.P_CODE_OPENLOAD K_ED_INDEX_196_INJ.P_CODE_SH_TO_GND K_ED_INDEX_196_INJ.P_CODE_SH_TO_UB K_ED_INDEX_196_INJ.P_CODE_UNPLAUSIBEL K_ED_INDEX_197_INJ.DEC_NACH_EINTRAG K_ED_INDEX_197_INJ.DEC_VOR_EINTRAG K_ED_INDEX_197_INJ.FEHLERSCHWELLE K_ED_INDEX_197_INJ.INC_NACH_EINTRAG K_ED_INDEX_197_INJ.INC_VOR_EINTRAG K_ED_INDEX_197_INJ.KLASSENINDEX K_ED_INDEX_197_INJ.OK_SCHWELLE K_ED_INDEX_197_INJ.P_CODE_OPENLOAD K_ED_INDEX_197_INJ.P_CODE_SH_TO_GND K_ED_INDEX_197_INJ.P_CODE_SH_TO_UB K_ED_INDEX_197_INJ.P_CODE_UNPLAUSIBEL K_ED_INDEX_198_INJ.DEC_NACH_EINTRAG K_ED_INDEX_198_INJ.DEC_VOR_EINTRAG K_ED_INDEX_198_INJ.FEHLERSCHWELLE K_ED_INDEX_198_INJ.INC_NACH_EINTRAG K_ED_INDEX_198_INJ.INC_VOR_EINTRAG K_ED_INDEX_198_INJ.KLASSENINDEX K_ED_INDEX_198_INJ.OK_SCHWELLE K_ED_INDEX_198_INJ.P_CODE_OPENLOAD K_ED_INDEX_198_INJ.P_CODE_SH_TO_GND K_ED_INDEX_198_INJ.P_CODE_SH_TO_UB K_ED_INDEX_198_INJ.P_CODE_UNPLAUSIBEL K_ED_INDEX_199_INJ.DEC_NACH_EINTRAG K_ED_INDEX_199_INJ.DEC_VOR_EINTRAG K_ED_INDEX_199_INJ.FEHLERSCHWELLE K_ED_INDEX_199_INJ.INC_NACH_EINTRAG K_ED_INDEX_199_INJ.INC_VOR_EINTRAG K_ED_INDEX_199_INJ.KLASSENINDEX K_ED_INDEX_199_INJ.OK_SCHWELLE K_ED_INDEX_199_INJ.P_CODE_OPENLOAD K_ED_INDEX_199_INJ.P_CODE_SH_TO_GND K_ED_INDEX_199_INJ.P_CODE_SH_TO_UB K_ED_INDEX_199_INJ.P_CODE_UNPLAUSIBEL K_ED_INDEX_200_INJ.DEC_NACH_EINTRAG K_ED_INDEX_200_INJ.DEC_VOR_EINTRAG K_ED_INDEX_200_INJ.FEHLERSCHWELLE K_ED_INDEX_200_INJ.INC_NACH_EINTRAG K_ED_INDEX_200_INJ.INC_VOR_EINTRAG K_ED_INDEX_200_INJ.KLASSENINDEX K_ED_INDEX_200_INJ.OK_SCHWELLE K_ED_INDEX_200_INJ.P_CODE_OPENLOAD K_ED_INDEX_200_INJ.P_CODE_SH_TO_GND K_ED_INDEX_200_INJ.P_CODE_SH_TO_UB K_ED_INDEX_200_INJ.P_CODE_UNPLAUSIBEL K_ED_INDEX_201_INJ.DEC_NACH_EINTRAG K_ED_INDEX_201_INJ.DEC_VOR_EINTRAG K_ED_INDEX_201_INJ.FEHLERSCHWELLE K_ED_INDEX_201_INJ.INC_NACH_EINTRAG K_ED_INDEX_201_INJ.INC_VOR_EINTRAG K_ED_INDEX_201_INJ.KLASSENINDEX K_ED_INDEX_201_INJ.OK_SCHWELLE K_ED_INDEX_201_INJ.P_CODE_OPENLOAD K_ED_INDEX_201_INJ.P_CODE_SH_TO_GND K_ED_INDEX_201_INJ.P_CODE_SH_TO_UB K_ED_INDEX_201_INJ.P_CODE_UNPLAUSIBEL K_ED_INDEX_202_INJ.DEC_NACH_EINTRAG K_ED_INDEX_202_INJ.DEC_VOR_EINTRAG K_ED_INDEX_202_INJ.FEHLERSCHWELLE K_ED_INDEX_202_INJ.INC_NACH_EINTRAG K_ED_INDEX_202_INJ.INC_VOR_EINTRAG K_ED_INDEX_202_INJ.KLASSENINDEX K_ED_INDEX_202_INJ.OK_SCHWELLE K_ED_INDEX_202_INJ.P_CODE_OPENLOAD K_ED_INDEX_202_INJ.P_CODE_SH_TO_GND K_ED_INDEX_202_INJ.P_CODE_SH_TO_UB K_ED_INDEX_202_INJ.P_CODE_UNPLAUSIBEL K_ED_INDEX_203_INJ.DEC_NACH_EINTRAG K_ED_INDEX_203_INJ.DEC_VOR_EINTRAG K_ED_INDEX_203_INJ.FEHLERSCHWELLE K_ED_INDEX_203_INJ.INC_NACH_EINTRAG K_ED_INDEX_203_INJ.INC_VOR_EINTRAG K_ED_INDEX_203_INJ.KLASSENINDEX K_ED_INDEX_203_INJ.OK_SCHWELLE K_ED_INDEX_203_INJ.P_CODE_OPENLOAD K_ED_INDEX_203_INJ.P_CODE_SH_TO_GND K_ED_INDEX_203_INJ.P_CODE_SH_TO_UB K_ED_INDEX_203_INJ.P_CODE_UNPLAUSIBEL K_ED_INDEX_204_INJ.DEC_NACH_EINTRAG K_ED_INDEX_204_INJ.DEC_VOR_EINTRAG K_ED_INDEX_204_INJ.FEHLERSCHWELLE K_ED_INDEX_204_INJ.INC_NACH_EINTRAG K_ED_INDEX_204_INJ.INC_VOR_EINTRAG K_ED_INDEX_204_INJ.KLASSENINDEX K_ED_INDEX_204_INJ.OK_SCHWELLE K_ED_INDEX_204_INJ.P_CODE_OPENLOAD K_ED_INDEX_204_INJ.P_CODE_SH_TO_GND K_ED_INDEX_204_INJ.P_CODE_SH_TO_UB K_ED_INDEX_204_INJ.P_CODE_UNPLAUSIBEL K_ED_INDEX_205_INJ.DEC_NACH_EINTRAG K_ED_INDEX_205_INJ.DEC_VOR_EINTRAG K_ED_INDEX_205_INJ.FEHLERSCHWELLE K_ED_INDEX_205_INJ.INC_NACH_EINTRAG K_ED_INDEX_205_INJ.INC_VOR_EINTRAG K_ED_INDEX_205_INJ.KLASSENINDEX K_ED_INDEX_205_INJ.OK_SCHWELLE K_ED_INDEX_205_INJ.P_CODE_OPENLOAD K_ED_INDEX_205_INJ.P_CODE_SH_TO_GND K_ED_INDEX_205_INJ.P_CODE_SH_TO_UB K_ED_INDEX_205_INJ.P_CODE_UNPLAUSIBEL K_ED_INDEX_206_INJ.DEC_NACH_EINTRAG K_ED_INDEX_206_INJ.DEC_VOR_EINTRAG K_ED_INDEX_206_INJ.FEHLERSCHWELLE K_ED_INDEX_206_INJ.INC_NACH_EINTRAG K_ED_INDEX_206_INJ.INC_VOR_EINTRAG K_ED_INDEX_206_INJ.KLASSENINDEX K_ED_INDEX_206_INJ.OK_SCHWELLE K_ED_INDEX_206_INJ.P_CODE_OPENLOAD K_ED_INDEX_206_INJ.P_CODE_SH_TO_GND K_ED_INDEX_206_INJ.P_CODE_SH_TO_UB K_ED_INDEX_206_INJ.P_CODE_UNPLAUSIBEL K_ED_KATS_B1.DEC_NACH_EINTRAG K_ED_KATS_B1.DEC_VOR_EINTRAG K_ED_KATS_B1.FEHLERSCHWELLE K_ED_KATS_B1.INC_NACH_EINTRAG K_ED_KATS_B1.INC_VOR_EINTRAG K_ED_KATS_B1.KLASSENINDEX K_ED_KATS_B1.OK_SCHWELLE K_ED_KATS_B1.P_CODE_OPENLOAD K_ED_KATS_B1.P_CODE_SH_TO_GND K_ED_KATS_B1.P_CODE_SH_TO_UB K_ED_KATS_B1.P_CODE_UNPLAUSIBEL K_ED_KATS_B2.DEC_NACH_EINTRAG K_ED_KATS_B2.DEC_VOR_EINTRAG K_ED_KATS_B2.FEHLERSCHWELLE K_ED_KATS_B2.INC_NACH_EINTRAG K_ED_KATS_B2.INC_VOR_EINTRAG K_ED_KATS_B2.KLASSENINDEX K_ED_KATS_B2.OK_SCHWELLE K_ED_KATS_B2.P_CODE_OPENLOAD K_ED_KATS_B2.P_CODE_SH_TO_GND K_ED_KATS_B2.P_CODE_SH_TO_UB K_ED_KATS_B2.P_CODE_UNPLAUSIBEL K_ED_KAT_OBD1.DEC_NACH_EINTRAG K_ED_KAT_OBD1.DEC_VOR_EINTRAG K_ED_KAT_OBD1.FEHLERSCHWELLE K_ED_KAT_OBD1.INC_NACH_EINTRAG K_ED_KAT_OBD1.INC_VOR_EINTRAG K_ED_KAT_OBD1.KLASSENINDEX K_ED_KAT_OBD1.OK_SCHWELLE K_ED_KAT_OBD1.P_CODE_OPENLOAD K_ED_KAT_OBD1.P_CODE_SH_TO_GND K_ED_KAT_OBD1.P_CODE_SH_TO_UB K_ED_KAT_OBD1.P_CODE_UNPLAUSIBEL K_ED_KAT_OBD2.DEC_NACH_EINTRAG K_ED_KAT_OBD2.DEC_VOR_EINTRAG K_ED_KAT_OBD2.FEHLERSCHWELLE K_ED_KAT_OBD2.INC_NACH_EINTRAG K_ED_KAT_OBD2.INC_VOR_EINTRAG K_ED_KAT_OBD2.KLASSENINDEX K_ED_KAT_OBD2.OK_SCHWELLE K_ED_KAT_OBD2.P_CODE_OPENLOAD K_ED_KAT_OBD2.P_CODE_SH_TO_GND K_ED_KAT_OBD2.P_CODE_SH_TO_UB K_ED_KAT_OBD2.P_CODE_UNPLAUSIBEL K_ED_KGE1.DEC_NACH_EINTRAG K_ED_KGE1.DEC_VOR_EINTRAG K_ED_KGE1.FEHLERSCHWELLE K_ED_KGE1.INC_NACH_EINTRAG K_ED_KGE1.INC_VOR_EINTRAG K_ED_KGE1.KLASSENINDEX K_ED_KGE1.OK_SCHWELLE K_ED_KGE1.P_CODE_OPENLOAD K_ED_KGE1.P_CODE_SH_TO_GND K_ED_KGE1.P_CODE_SH_TO_UB K_ED_KGE1.P_CODE_UNPLAUSIBEL K_ED_KGE2.DEC_NACH_EINTRAG K_ED_KGE2.DEC_VOR_EINTRAG K_ED_KGE2.FEHLERSCHWELLE K_ED_KGE2.INC_NACH_EINTRAG K_ED_KGE2.INC_VOR_EINTRAG K_ED_KGE2.KLASSENINDEX K_ED_KGE2.OK_SCHWELLE K_ED_KGE2.P_CODE_OPENLOAD K_ED_KGE2.P_CODE_SH_TO_GND K_ED_KGE2.P_CODE_SH_TO_UB K_ED_KGE2.P_CODE_UNPLAUSIBEL K_ED_KSD1.DEC_NACH_EINTRAG K_ED_KSD1.DEC_VOR_EINTRAG K_ED_KSD1.FEHLERSCHWELLE K_ED_KSD1.INC_NACH_EINTRAG K_ED_KSD1.INC_VOR_EINTRAG K_ED_KSD1.KLASSENINDEX K_ED_KSD1.OK_SCHWELLE K_ED_KSD1.P_CODE_OPENLOAD K_ED_KSD1.P_CODE_SH_TO_GND K_ED_KSD1.P_CODE_SH_TO_UB K_ED_KSD1.P_CODE_UNPLAUSIBEL K_ED_KSD2.DEC_NACH_EINTRAG K_ED_KSD2.DEC_VOR_EINTRAG K_ED_KSD2.FEHLERSCHWELLE K_ED_KSD2.INC_NACH_EINTRAG K_ED_KSD2.INC_VOR_EINTRAG K_ED_KSD2.KLASSENINDEX K_ED_KSD2.OK_SCHWELLE K_ED_KSD2.P_CODE_OPENLOAD K_ED_KSD2.P_CODE_SH_TO_GND K_ED_KSD2.P_CODE_SH_TO_UB K_ED_KSD2.P_CODE_UNPLAUSIBEL K_ED_KW.DEC_NACH_EINTRAG K_ED_KW.DEC_VOR_EINTRAG K_ED_KW.FEHLERSCHWELLE K_ED_KW.INC_NACH_EINTRAG K_ED_KW.INC_VOR_EINTRAG K_ED_KW.KLASSENINDEX K_ED_KW.OK_SCHWELLE K_ED_KW.P_CODE_OPENLOAD K_ED_KW.P_CODE_SH_TO_GND K_ED_KW.P_CODE_SH_TO_UB K_ED_KW.P_CODE_UNPLAUSIBEL K_ED_LA1_ADAPT.DEC_NACH_EINTRAG K_ED_LA1_ADAPT.DEC_VOR_EINTRAG K_ED_LA1_ADAPT.FEHLERSCHWELLE K_ED_LA1_ADAPT.INC_NACH_EINTRAG K_ED_LA1_ADAPT.INC_VOR_EINTRAG K_ED_LA1_ADAPT.KLASSENINDEX K_ED_LA1_ADAPT.OK_SCHWELLE K_ED_LA1_ADAPT.P_CODE_OPENLOAD K_ED_LA1_ADAPT.P_CODE_SH_TO_GND K_ED_LA1_ADAPT.P_CODE_SH_TO_UB K_ED_LA1_ADAPT.P_CODE_UNPLAUSIBEL K_ED_LA1_TRIM_AD.DEC_NACH_EINTRAG K_ED_LA1_TRIM_AD.DEC_VOR_EINTRAG K_ED_LA1_TRIM_AD.FEHLERSCHWELLE K_ED_LA1_TRIM_AD.INC_NACH_EINTRAG K_ED_LA1_TRIM_AD.INC_VOR_EINTRAG K_ED_LA1_TRIM_AD.KLASSENINDEX K_ED_LA1_TRIM_AD.OK_SCHWELLE K_ED_LA1_TRIM_AD.P_CODE_OPENLOAD K_ED_LA1_TRIM_AD.P_CODE_SH_TO_GND K_ED_LA1_TRIM_AD.P_CODE_SH_TO_UB K_ED_LA1_TRIM_AD.P_CODE_UNPLAUSIBEL K_ED_LA2_ADAPT.DEC_NACH_EINTRAG K_ED_LA2_ADAPT.DEC_VOR_EINTRAG K_ED_LA2_ADAPT.FEHLERSCHWELLE K_ED_LA2_ADAPT.INC_NACH_EINTRAG K_ED_LA2_ADAPT.INC_VOR_EINTRAG K_ED_LA2_ADAPT.KLASSENINDEX K_ED_LA2_ADAPT.OK_SCHWELLE K_ED_LA2_ADAPT.P_CODE_OPENLOAD K_ED_LA2_ADAPT.P_CODE_SH_TO_GND K_ED_LA2_ADAPT.P_CODE_SH_TO_UB K_ED_LA2_ADAPT.P_CODE_UNPLAUSIBEL K_ED_LA2_TRIM_AD.DEC_NACH_EINTRAG K_ED_LA2_TRIM_AD.DEC_VOR_EINTRAG K_ED_LA2_TRIM_AD.FEHLERSCHWELLE K_ED_LA2_TRIM_AD.INC_NACH_EINTRAG K_ED_LA2_TRIM_AD.INC_VOR_EINTRAG K_ED_LA2_TRIM_AD.KLASSENINDEX K_ED_LA2_TRIM_AD.OK_SCHWELLE K_ED_LA2_TRIM_AD.P_CODE_OPENLOAD K_ED_LA2_TRIM_AD.P_CODE_SH_TO_GND K_ED_LA2_TRIM_AD.P_CODE_SH_TO_UB K_ED_LA2_TRIM_AD.P_CODE_UNPLAUSIBEL K_ED_LAM1_REG.DEC_NACH_EINTRAG K_ED_LAM1_REG.DEC_VOR_EINTRAG K_ED_LAM1_REG.FEHLERSCHWELLE K_ED_LAM1_REG.INC_NACH_EINTRAG K_ED_LAM1_REG.INC_VOR_EINTRAG K_ED_LAM1_REG.KLASSENINDEX K_ED_LAM1_REG.OK_SCHWELLE K_ED_LAM1_REG.P_CODE_OPENLOAD K_ED_LAM1_REG.P_CODE_SH_TO_GND K_ED_LAM1_REG.P_CODE_SH_TO_UB K_ED_LAM1_REG.P_CODE_UNPLAUSIBEL K_ED_LAM2_REG.DEC_NACH_EINTRAG K_ED_LAM2_REG.DEC_VOR_EINTRAG K_ED_LAM2_REG.FEHLERSCHWELLE K_ED_LAM2_REG.INC_NACH_EINTRAG K_ED_LAM2_REG.INC_VOR_EINTRAG K_ED_LAM2_REG.KLASSENINDEX K_ED_LAM2_REG.OK_SCHWELLE K_ED_LAM2_REG.P_CODE_OPENLOAD K_ED_LAM2_REG.P_CODE_SH_TO_GND K_ED_LAM2_REG.P_CODE_SH_TO_UB K_ED_LAM2_REG.P_CODE_UNPLAUSIBEL K_ED_LANK1.DEC_NACH_EINTRAG K_ED_LANK1.DEC_VOR_EINTRAG K_ED_LANK1.FEHLERSCHWELLE K_ED_LANK1.INC_NACH_EINTRAG K_ED_LANK1.INC_VOR_EINTRAG K_ED_LANK1.KLASSENINDEX K_ED_LANK1.OK_SCHWELLE K_ED_LANK1.P_CODE_OPENLOAD K_ED_LANK1.P_CODE_SH_TO_GND K_ED_LANK1.P_CODE_SH_TO_UB K_ED_LANK1.P_CODE_UNPLAUSIBEL K_ED_LANK1_OBD_S.DEC_NACH_EINTRAG K_ED_LANK1_OBD_S.DEC_VOR_EINTRAG K_ED_LANK1_OBD_S.FEHLERSCHWELLE K_ED_LANK1_OBD_S.INC_NACH_EINTRAG K_ED_LANK1_OBD_S.INC_VOR_EINTRAG K_ED_LANK1_OBD_S.KLASSENINDEX K_ED_LANK1_OBD_S.OK_SCHWELLE K_ED_LANK1_OBD_S.P_CODE_OPENLOAD K_ED_LANK1_OBD_S.P_CODE_SH_TO_GND K_ED_LANK1_OBD_S.P_CODE_SH_TO_UB K_ED_LANK1_OBD_S.P_CODE_UNPLAUSIBEL K_ED_LANK1_OBD_WE.DEC_NACH_EINTRAG K_ED_LANK1_OBD_WE.DEC_VOR_EINTRAG K_ED_LANK1_OBD_WE.FEHLERSCHWELLE K_ED_LANK1_OBD_WE.INC_NACH_EINTRAG K_ED_LANK1_OBD_WE.INC_VOR_EINTRAG K_ED_LANK1_OBD_WE.KLASSENINDEX K_ED_LANK1_OBD_WE.OK_SCHWELLE K_ED_LANK1_OBD_WE.P_CODE_OPENLOAD K_ED_LANK1_OBD_WE.P_CODE_SH_TO_GND K_ED_LANK1_OBD_WE.P_CODE_SH_TO_UB K_ED_LANK1_OBD_WE.P_CODE_UNPLAUSIBEL K_ED_LANK1_OPENLOAD.DEC_NACH_EINTRAG K_ED_LANK1_OPENLOAD.DEC_VOR_EINTRAG K_ED_LANK1_OPENLOAD.FEHLERSCHWELLE K_ED_LANK1_OPENLOAD.INC_NACH_EINTRAG K_ED_LANK1_OPENLOAD.INC_VOR_EINTRAG K_ED_LANK1_OPENLOAD.KLASSENINDEX K_ED_LANK1_OPENLOAD.OK_SCHWELLE K_ED_LANK1_OPENLOAD.P_CODE_OPENLOAD K_ED_LANK1_OPENLOAD.P_CODE_SH_TO_GND K_ED_LANK1_OPENLOAD.P_CODE_SH_TO_UB K_ED_LANK1_OPENLOAD.P_CODE_UNPLAUSIBEL K_ED_LANK2.DEC_NACH_EINTRAG K_ED_LANK2.DEC_VOR_EINTRAG K_ED_LANK2.FEHLERSCHWELLE K_ED_LANK2.INC_NACH_EINTRAG K_ED_LANK2.INC_VOR_EINTRAG K_ED_LANK2.KLASSENINDEX K_ED_LANK2.OK_SCHWELLE K_ED_LANK2.P_CODE_OPENLOAD K_ED_LANK2.P_CODE_SH_TO_GND K_ED_LANK2.P_CODE_SH_TO_UB K_ED_LANK2.P_CODE_UNPLAUSIBEL K_ED_LANK2_OBD_S.DEC_NACH_EINTRAG K_ED_LANK2_OBD_S.DEC_VOR_EINTRAG K_ED_LANK2_OBD_S.FEHLERSCHWELLE K_ED_LANK2_OBD_S.INC_NACH_EINTRAG K_ED_LANK2_OBD_S.INC_VOR_EINTRAG K_ED_LANK2_OBD_S.KLASSENINDEX K_ED_LANK2_OBD_S.OK_SCHWELLE K_ED_LANK2_OBD_S.P_CODE_OPENLOAD K_ED_LANK2_OBD_S.P_CODE_SH_TO_GND K_ED_LANK2_OBD_S.P_CODE_SH_TO_UB K_ED_LANK2_OBD_S.P_CODE_UNPLAUSIBEL K_ED_LANK2_OBD_WE.DEC_NACH_EINTRAG K_ED_LANK2_OBD_WE.DEC_VOR_EINTRAG K_ED_LANK2_OBD_WE.FEHLERSCHWELLE K_ED_LANK2_OBD_WE.INC_NACH_EINTRAG K_ED_LANK2_OBD_WE.INC_VOR_EINTRAG K_ED_LANK2_OBD_WE.KLASSENINDEX K_ED_LANK2_OBD_WE.OK_SCHWELLE K_ED_LANK2_OBD_WE.P_CODE_OPENLOAD K_ED_LANK2_OBD_WE.P_CODE_SH_TO_GND K_ED_LANK2_OBD_WE.P_CODE_SH_TO_UB K_ED_LANK2_OBD_WE.P_CODE_UNPLAUSIBEL K_ED_LANK2_OPENLOAD.DEC_NACH_EINTRAG K_ED_LANK2_OPENLOAD.DEC_VOR_EINTRAG K_ED_LANK2_OPENLOAD.FEHLERSCHWELLE K_ED_LANK2_OPENLOAD.INC_NACH_EINTRAG K_ED_LANK2_OPENLOAD.INC_VOR_EINTRAG K_ED_LANK2_OPENLOAD.KLASSENINDEX K_ED_LANK2_OPENLOAD.OK_SCHWELLE K_ED_LANK2_OPENLOAD.P_CODE_OPENLOAD K_ED_LANK2_OPENLOAD.P_CODE_SH_TO_GND K_ED_LANK2_OPENLOAD.P_CODE_SH_TO_UB K_ED_LANK2_OPENLOAD.P_CODE_UNPLAUSIBEL K_ED_LAVK1.DEC_NACH_EINTRAG K_ED_LAVK1.DEC_VOR_EINTRAG K_ED_LAVK1.FEHLERSCHWELLE K_ED_LAVK1.INC_NACH_EINTRAG K_ED_LAVK1.INC_VOR_EINTRAG K_ED_LAVK1.KLASSENINDEX K_ED_LAVK1.OK_SCHWELLE K_ED_LAVK1.P_CODE_OPENLOAD K_ED_LAVK1.P_CODE_SH_TO_GND K_ED_LAVK1.P_CODE_SH_TO_UB K_ED_LAVK1.P_CODE_UNPLAUSIBEL K_ED_LAVK1_DIAG.DEC_NACH_EINTRAG K_ED_LAVK1_DIAG.DEC_VOR_EINTRAG K_ED_LAVK1_DIAG.FEHLERSCHWELLE K_ED_LAVK1_DIAG.INC_NACH_EINTRAG K_ED_LAVK1_DIAG.INC_VOR_EINTRAG K_ED_LAVK1_DIAG.KLASSENINDEX K_ED_LAVK1_DIAG.OK_SCHWELLE K_ED_LAVK1_DIAG.P_CODE_OPENLOAD K_ED_LAVK1_DIAG.P_CODE_SH_TO_GND K_ED_LAVK1_DIAG.P_CODE_SH_TO_UB K_ED_LAVK1_DIAG.P_CODE_UNPLAUSIBEL K_ED_LAVK1_IA_OPENLOAD.DEC_NACH_EINTRAG K_ED_LAVK1_IA_OPENLOAD.DEC_VOR_EINTRAG K_ED_LAVK1_IA_OPENLOAD.FEHLERSCHWELLE K_ED_LAVK1_IA_OPENLOAD.INC_NACH_EINTRAG K_ED_LAVK1_IA_OPENLOAD.INC_VOR_EINTRAG K_ED_LAVK1_IA_OPENLOAD.KLASSENINDEX K_ED_LAVK1_IA_OPENLOAD.OK_SCHWELLE K_ED_LAVK1_IA_OPENLOAD.P_CODE_OPENLOAD K_ED_LAVK1_IA_OPENLOAD.P_CODE_SH_TO_GND K_ED_LAVK1_IA_OPENLOAD.P_CODE_SH_TO_UB K_ED_LAVK1_IA_OPENLOAD.P_CODE_UNPLAUSIBEL K_ED_LAVK1_IP_OPENLOAD.DEC_NACH_EINTRAG K_ED_LAVK1_IP_OPENLOAD.DEC_VOR_EINTRAG K_ED_LAVK1_IP_OPENLOAD.FEHLERSCHWELLE K_ED_LAVK1_IP_OPENLOAD.INC_NACH_EINTRAG K_ED_LAVK1_IP_OPENLOAD.INC_VOR_EINTRAG K_ED_LAVK1_IP_OPENLOAD.KLASSENINDEX K_ED_LAVK1_IP_OPENLOAD.OK_SCHWELLE K_ED_LAVK1_IP_OPENLOAD.P_CODE_OPENLOAD K_ED_LAVK1_IP_OPENLOAD.P_CODE_SH_TO_GND K_ED_LAVK1_IP_OPENLOAD.P_CODE_SH_TO_UB K_ED_LAVK1_IP_OPENLOAD.P_CODE_UNPLAUSIBEL K_ED_LAVK1_OBD_DYN.DEC_NACH_EINTRAG K_ED_LAVK1_OBD_DYN.DEC_VOR_EINTRAG K_ED_LAVK1_OBD_DYN.FEHLERSCHWELLE K_ED_LAVK1_OBD_DYN.INC_NACH_EINTRAG K_ED_LAVK1_OBD_DYN.INC_VOR_EINTRAG K_ED_LAVK1_OBD_DYN.KLASSENINDEX K_ED_LAVK1_OBD_DYN.OK_SCHWELLE K_ED_LAVK1_OBD_DYN.P_CODE_OPENLOAD K_ED_LAVK1_OBD_DYN.P_CODE_SH_TO_GND K_ED_LAVK1_OBD_DYN.P_CODE_SH_TO_UB K_ED_LAVK1_OBD_DYN.P_CODE_UNPLAUSIBEL K_ED_LAVK1_OBD_PLAU.DEC_NACH_EINTRAG K_ED_LAVK1_OBD_PLAU.DEC_VOR_EINTRAG K_ED_LAVK1_OBD_PLAU.FEHLERSCHWELLE K_ED_LAVK1_OBD_PLAU.INC_NACH_EINTRAG K_ED_LAVK1_OBD_PLAU.INC_VOR_EINTRAG K_ED_LAVK1_OBD_PLAU.KLASSENINDEX K_ED_LAVK1_OBD_PLAU.OK_SCHWELLE K_ED_LAVK1_OBD_PLAU.P_CODE_OPENLOAD K_ED_LAVK1_OBD_PLAU.P_CODE_SH_TO_GND K_ED_LAVK1_OBD_PLAU.P_CODE_SH_TO_UB K_ED_LAVK1_OBD_PLAU.P_CODE_UNPLAUSIBEL K_ED_LAVK1_OBD_SA.DEC_NACH_EINTRAG K_ED_LAVK1_OBD_SA.DEC_VOR_EINTRAG K_ED_LAVK1_OBD_SA.FEHLERSCHWELLE K_ED_LAVK1_OBD_SA.INC_NACH_EINTRAG K_ED_LAVK1_OBD_SA.INC_VOR_EINTRAG K_ED_LAVK1_OBD_SA.KLASSENINDEX K_ED_LAVK1_OBD_SA.OK_SCHWELLE K_ED_LAVK1_OBD_SA.P_CODE_OPENLOAD K_ED_LAVK1_OBD_SA.P_CODE_SH_TO_GND K_ED_LAVK1_OBD_SA.P_CODE_SH_TO_UB K_ED_LAVK1_OBD_SA.P_CODE_UNPLAUSIBEL K_ED_LAVK1_OBD_TL.DEC_NACH_EINTRAG K_ED_LAVK1_OBD_TL.DEC_VOR_EINTRAG K_ED_LAVK1_OBD_TL.FEHLERSCHWELLE K_ED_LAVK1_OBD_TL.INC_NACH_EINTRAG K_ED_LAVK1_OBD_TL.INC_VOR_EINTRAG K_ED_LAVK1_OBD_TL.KLASSENINDEX K_ED_LAVK1_OBD_TL.OK_SCHWELLE K_ED_LAVK1_OBD_TL.P_CODE_OPENLOAD K_ED_LAVK1_OBD_TL.P_CODE_SH_TO_GND K_ED_LAVK1_OBD_TL.P_CODE_SH_TO_UB K_ED_LAVK1_OBD_TL.P_CODE_UNPLAUSIBEL K_ED_LAVK1_TRIM.DEC_NACH_EINTRAG K_ED_LAVK1_TRIM.DEC_VOR_EINTRAG K_ED_LAVK1_TRIM.FEHLERSCHWELLE K_ED_LAVK1_TRIM.INC_NACH_EINTRAG K_ED_LAVK1_TRIM.INC_VOR_EINTRAG K_ED_LAVK1_TRIM.KLASSENINDEX K_ED_LAVK1_TRIM.OK_SCHWELLE K_ED_LAVK1_TRIM.P_CODE_OPENLOAD K_ED_LAVK1_TRIM.P_CODE_SH_TO_GND K_ED_LAVK1_TRIM.P_CODE_SH_TO_UB K_ED_LAVK1_TRIM.P_CODE_UNPLAUSIBEL K_ED_LAVK1_UN_OPENLOAD.DEC_NACH_EINTRAG K_ED_LAVK1_UN_OPENLOAD.DEC_VOR_EINTRAG K_ED_LAVK1_UN_OPENLOAD.FEHLERSCHWELLE K_ED_LAVK1_UN_OPENLOAD.INC_NACH_EINTRAG K_ED_LAVK1_UN_OPENLOAD.INC_VOR_EINTRAG K_ED_LAVK1_UN_OPENLOAD.KLASSENINDEX /end REF_CHARACTERISTIC
/end GROUP
/end MODULE
/end PROJECT
