ASAP2_VERSION 1 60
/begin PROJECT MSS60_V762_INJ "MSS60 (S65) V762 INJ CPU - generated 04.11.2026 from the reverse-engineered XDF"
/begin HEADER "Calibration description (characteristics from the XDF; measurements = V530 RAM names transferred to V762 addresses, confidence in each long identifier). Status tag in every long identifier: verified (checked against the code) / A2L-ref (placed from the V530 A2L) / EST (estimated) / unassigned (UNK placeholder)." VERSION "V762-RE-04112026" /end HEADER
/begin MODULE INJ "MSS60 V762 INJ"
/begin MOD_COMMON "" BYTE_ORDER MSB_FIRST ALIGNMENT_BYTE 1 ALIGNMENT_WORD 2 ALIGNMENT_LONG 4 /end MOD_COMMON
/begin MEASUREMENT cfg_boot_st "Bootstaus [RAM name from V530, voted 10]" ULONG M_FORMULA_0000 0 0 0 4294967295 ECU_ADDRESS 0x3F8010 /end MEASUREMENT
/begin MEASUREMENT vers_boot "Booterversion [RAM name from V530, voted 1]" UWORD M_FORMULA_0010 0 0 0 65535 ECU_ADDRESS 0x3F8014 /end MEASUREMENT
/begin MEASUREMENT sys_exc_lr "Linkregister nach Exception [RAM name from V530, voted 3]" ULONG M_FORMULA_0000 0 0 0 4294967295 ECU_ADDRESS 0x3F8018 /end MEASUREMENT
/begin MEASUREMENT md_kupp_ist_ve "Moment an der Kupplung vor Eingriff [RAM name from V530, voted 1]" SWORD M_FORMULA_0009 0 0 -3276.8 3276.7 ECU_ADDRESS 0x3F8B82 /end MEASUREMENT
/begin MEASUREMENT md_kupp_ist "Moment an der Kupplung [RAM name from V530, voted 2]" SWORD M_FORMULA_0009 0 0 -3276.8 3276.7 ECU_ADDRESS 0x3F8B84 /end MEASUREMENT
/begin MEASUREMENT md_ind_ne "ind. Moment nach Eingriff [RAM name from V530, voted 1]" SWORD M_FORMULA_0009 0 0 -3276.8 3276.7 ECU_ADDRESS 0x3F8B86 /end MEASUREMENT
/begin MEASUREMENT md_tz_soll_mittel "mittlerer Soll-TZ [RAM name from V530, voted 1]" SWORD M_FORMULA_0102 0 0 -3276.8 3276.7 ECU_ADDRESS 0x3F8B8E /end MEASUREMENT
/begin MEASUREMENT auss_erk "Zustandsvariable Aussetzererkennung. [RAM name from V530, voted 6]" UWORD NO_COMPU_METHOD 0 0 0 65535 ECU_ADDRESS 0x3F8B92 FORMAT "%.4g" /end MEASUREMENT
/begin MEASUREMENT auss_erk_zyl1 "Aussetzererkennung Zylinder 1. [RAM name from V530, voted 6]" UWORD NO_COMPU_METHOD 0 0 0 65535 ECU_ADDRESS 0x3F8B92 FORMAT "%.4g" /end MEASUREMENT
/begin MEASUREMENT auss_erk_zyl10 "Aussetzererkennung Zylinder 10. [RAM name from V530, voted 6]" UWORD NO_COMPU_METHOD 0 0 0 65535 ECU_ADDRESS 0x3F8B92 FORMAT "%.4g" /end MEASUREMENT
/begin MEASUREMENT auss_erk_zyl2 "Aussetzererkennung Zylinder 2. [RAM name from V530, voted 6]" UWORD NO_COMPU_METHOD 0 0 0 65535 ECU_ADDRESS 0x3F8B92 FORMAT "%.4g" /end MEASUREMENT
/begin MEASUREMENT auss_erk_zyl3 "Aussetzererkennung Zylinder 3. [RAM name from V530, voted 6]" UWORD NO_COMPU_METHOD 0 0 0 65535 ECU_ADDRESS 0x3F8B92 FORMAT "%.4g" /end MEASUREMENT
/begin MEASUREMENT auss_erk_zyl4 "Aussetzererkennung Zylinder 4. [RAM name from V530, voted 6]" UWORD NO_COMPU_METHOD 0 0 0 65535 ECU_ADDRESS 0x3F8B92 FORMAT "%.4g" /end MEASUREMENT
/begin MEASUREMENT auss_erk_zyl5 "Aussetzererkennung Zylinder 5. [RAM name from V530, voted 6]" UWORD NO_COMPU_METHOD 0 0 0 65535 ECU_ADDRESS 0x3F8B92 FORMAT "%.4g" /end MEASUREMENT
/begin MEASUREMENT auss_erk_zyl6 "Aussetzererkennung Zylinder 6. [RAM name from V530, voted 6]" UWORD NO_COMPU_METHOD 0 0 0 65535 ECU_ADDRESS 0x3F8B92 FORMAT "%.4g" /end MEASUREMENT
/begin MEASUREMENT auss_erk_zyl7 "Aussetzererkennung Zylinder 7. [RAM name from V530, voted 6]" UWORD NO_COMPU_METHOD 0 0 0 65535 ECU_ADDRESS 0x3F8B92 FORMAT "%.4g" /end MEASUREMENT
/begin MEASUREMENT auss_erk_zyl8 "Aussetzererkennung Zylinder 8. [RAM name from V530, voted 6]" UWORD NO_COMPU_METHOD 0 0 0 65535 ECU_ADDRESS 0x3F8B92 FORMAT "%.4g" /end MEASUREMENT
/begin MEASUREMENT auss_erk_zyl9 "Aussetzererkennung Zylinder 9. [RAM name from V530, voted 6]" UWORD NO_COMPU_METHOD 0 0 0 65535 ECU_ADDRESS 0x3F8B92 FORMAT "%.4g" /end MEASUREMENT
/begin MEASUREMENT ed_st_fehler_ign "ED-Gesamtstatus IGN-Fehler [RAM name from V530, voted 19]" ULONG M_FORMULA_0000 0 0 0 4294967295 ECU_ADDRESS 0x3F8B9C /end MEASUREMENT
/begin MEASUREMENT ed_st_filter_ign "ED-Gesamtstatus IGN-Filter [RAM name from V530, voted 17]" ULONG M_FORMULA_0000 0 0 0 4294967295 ECU_ADDRESS 0x3F8BAC /end MEASUREMENT
/begin MEASUREMENT ed_mil_bmw_ign "Mil-Status IGN [RAM name from V530, voted 1]" UBYTE NO_COMPU_METHOD 0 0 0 255 ECU_ADDRESS 0x3F8BBC FORMAT "%.4g" /end MEASUREMENT
/begin MEASUREMENT ed_mil_dme_ign "Mil-Status IGN [RAM name from V530, voted 1]" UBYTE NO_COMPU_METHOD 0 0 0 255 ECU_ADDRESS 0x3F8BBC FORMAT "%.4g" /end MEASUREMENT
/begin MEASUREMENT ed_mil_predrive_ign "Mil-Status IGN [RAM name from V530, voted 1]" UBYTE NO_COMPU_METHOD 0 0 0 255 ECU_ADDRESS 0x3F8BBC FORMAT "%.4g" /end MEASUREMENT
/begin MEASUREMENT ed_mil_smg_ign "Mil-Status IGN [RAM name from V530, voted 1]" UBYTE NO_COMPU_METHOD 0 0 0 255 ECU_ADDRESS 0x3F8BBC FORMAT "%.4g" /end MEASUREMENT
/begin MEASUREMENT ed_mil_st_ign "Mil-Status IGN [RAM name from V530, voted 1]" UBYTE M_FORMULA_0037 0 0 0 255 ECU_ADDRESS 0x3F8BBC /end MEASUREMENT
/begin MEASUREMENT ed_mil_zyl_off_ign "Mil-Status IGN [RAM name from V530, voted 1]" UBYTE NO_COMPU_METHOD 0 0 0 255 ECU_ADDRESS 0x3F8BBC FORMAT "%.4g" /end MEASUREMENT
/begin MEASUREMENT B_LLR_EINGEREGELT "Status eingeregelt [RAM name from V530, voted 2]" UBYTE NO_COMPU_METHOD 0 0 0 255 ECU_ADDRESS 0x3F8BC1 FORMAT "%.4g" /end MEASUREMENT
/begin MEASUREMENT B_LLR_GRUNDDREHZAHL "Grunddrehzahl aktiv [RAM name from V530, voted 2]" UBYTE NO_COMPU_METHOD 0 0 0 255 ECU_ADDRESS 0x3F8BC1 FORMAT "%.4g" /end MEASUREMENT
/begin MEASUREMENT B_LLR_MIN_BEGR "Begrenzung Min-Moment [RAM name from V530, voted 2]" UBYTE NO_COMPU_METHOD 0 0 0 255 ECU_ADDRESS 0x3F8BC1 FORMAT "%.4g" /end MEASUREMENT
/begin MEASUREMENT llr_flags "LLR-Flags [RAM name from V530, voted 2]" UBYTE M_FORMULA_0003 0 0 0 255 ECU_ADDRESS 0x3F8BC1 /end MEASUREMENT
/begin MEASUREMENT uext_korr_pin_111_219_514 "Korrekturfaktor fuer UEXT [RAM name from V530, voted 5]" UWORD M_FORMULA_0073 0 0 0 63.99902344 ECU_ADDRESS 0x3F8BCC /end MEASUREMENT
/begin MEASUREMENT uext_korr_pin_124_512 "Korrekturfaktor fuer UEXT [RAM name from V530, voted 1]" UWORD M_FORMULA_0073 0 0 0 63.99902344 ECU_ADDRESS 0x3F8BCE /end MEASUREMENT
/begin MEASUREMENT pwg_mode "Ausgabezustand der Pedalwertgebererfassung [RAM name from V530, voted 1]" UBYTE NO_COMPU_METHOD 0 0 0 255 ECU_ADDRESS 0x3F8BD1 FORMAT "%.4g" /end MEASUREMENT
/begin MEASUREMENT pwg_soll "Ausgegebener Pedalwert fuer andere Module [RAM name from V530, voted 1]" SWORD M_FORMULA_0001 0 0 -3276.8 3276.7 ECU_ADDRESS 0x3F8BD2 /end MEASUREMENT
/begin MEASUREMENT md_fw_rel "rel. Wunschmoment [RAM name from V530, voted 1]" SWORD M_FORMULA_0001 0 0 -3276.8 3276.7 ECU_ADDRESS 0x3F8BDA /end MEASUREMENT
/begin MEASUREMENT md_wunsch_rel "Ergebnis der Max-Auswahl [RAM name from V530, voted 6]" SWORD M_FORMULA_0001 0 0 -3276.8 3276.7 ECU_ADDRESS 0x3F8BDC /end MEASUREMENT
/begin MEASUREMENT md_kupp_wunsch "Wunschmoment [RAM name from V530, voted 1]" SWORD M_FORMULA_0009 0 0 -3276.8 3276.7 ECU_ADDRESS 0x3F8BDE /end MEASUREMENT
/begin MEASUREMENT md_kupp_wunsch_begr "begrenztes Wunschmoment fuer CAN [RAM name from V530, voted 2]" SWORD M_FORMULA_0009 0 0 -3276.8 3276.7 ECU_ADDRESS 0x3F8BE0 /end MEASUREMENT
/begin MEASUREMENT md_kupp_wunsch_filter_rel "gefiltertes Wunschmoment [RAM name from V530, voted 6]" SWORD M_FORMULA_0001 0 0 -3276.8 3276.7 ECU_ADDRESS 0x3F8BE2 /end MEASUREMENT
/begin MEASUREMENT md_max_fak_power "Powerfaktor [RAM name from V530, voted 1]" UWORD M_FORMULA_0073 0 0 0 63.99902344 ECU_ADDRESS 0x3F8BE6 /end MEASUREMENT
/begin MEASUREMENT md_st "MD-Stati [RAM name from V530, voted 2]" UWORD M_FORMULA_0010 0 0 0 65535 ECU_ADDRESS 0x3F8BE8 /end MEASUREMENT
/begin MEASUREMENT md_vbegr_st "Status v-Begrenzung [RAM name from V530, voted 1]" UBYTE NO_COMPU_METHOD 0 0 0 255 ECU_ADDRESS 0x3F8BF0 FORMAT "%.4g" /end MEASUREMENT
/begin MEASUREMENT md_nbegr_st "Status n-Begrenzung [RAM name from V530, voted 1]" UBYTE NO_COMPU_METHOD 0 0 0 255 ECU_ADDRESS 0x3F8BF1 FORMAT "%.4g" /end MEASUREMENT
/begin MEASUREMENT egas_ist_dk_b1 "Istwert (CAN) [RAM name from V530, voted 2]" SWORD M_FORMULA_0001 0 0 -3276.8 3276.7 ECU_ADDRESS 0x3F8C00 /end MEASUREMENT
/begin MEASUREMENT egas_ist_dk_b2 "Istwert (CAN) [RAM name from V530, voted 1]" SWORD M_FORMULA_0001 0 0 -3276.8 3276.7 ECU_ADDRESS 0x3F8C02 /end MEASUREMENT
/begin MEASUREMENT egas_st_b1 "DPR-Status [RAM name from V530, voted 6]" UBYTE M_FORMULA_0003 0 0 0 255 ECU_ADDRESS 0x3F8C0A /end MEASUREMENT
/begin MEASUREMENT egas_st_dk_b1 "Status Klappen [RAM name from V530, voted 6]" UBYTE NO_COMPU_METHOD 0 0 0 255 ECU_ADDRESS 0x3F8C0A FORMAT "%.4g" /end MEASUREMENT
/begin MEASUREMENT egas_st_ft_b1 "Status Federntest [RAM name from V530, voted 6]" UBYTE NO_COMPU_METHOD 0 0 0 255 ECU_ADDRESS 0x3F8C0A FORMAT "%.4g" /end MEASUREMENT
/begin MEASUREMENT egas_st_b2 "DPR-Status [RAM name from V530, voted 3]" UBYTE M_FORMULA_0003 0 0 0 255 ECU_ADDRESS 0x3F8C0B /end MEASUREMENT
/begin MEASUREMENT egas_st_dk_b2 "Status Klappen [RAM name from V530, voted 3]" UBYTE NO_COMPU_METHOD 0 0 0 255 ECU_ADDRESS 0x3F8C0B FORMAT "%.4g" /end MEASUREMENT
/begin MEASUREMENT egas_st_ft_b2 "Status Federntest [RAM name from V530, voted 3]" UBYTE NO_COMPU_METHOD 0 0 0 255 ECU_ADDRESS 0x3F8C0B FORMAT "%.4g" /end MEASUREMENT
/begin MEASUREMENT egas_sk_ti_st "SK-Ausblendmaske vom Egas [RAM name from V530, voted 1]" UWORD M_FORMULA_0010 0 0 0 65535 ECU_ADDRESS 0x3F8C0C /end MEASUREMENT
/begin MEASUREMENT aq_rf_b1 "Fuellung aus inv. Ipol gefiltert mit alle korrekturen [RAM name from V530, voted 1]" SWORD M_FORMULA_0007 0 0 -3.2768 3.2767 ECU_ADDRESS 0x3F8C16 /end MEASUREMENT
/begin MEASUREMENT md_dsc_freig_st "DSC-Freigabe [RAM name from V530, voted 7]" UBYTE NO_COMPU_METHOD 0 0 0 255 ECU_ADDRESS 0x3F8C1A FORMAT "%.4g" /end MEASUREMENT
/begin MEASUREMENT md_ml_soll "Soll-Luftmasse [RAM name from V530, voted 1]" SWORD M_FORMULA_0103 0 0 -3276.8 3276.7 ECU_ADDRESS 0x3F8C28 /end MEASUREMENT
/begin MEASUREMENT ub "Spannungswert U_KL87 [RAM name from V530, voted 46]" SWORD M_FORMULA_0008 0 0 -3276.8 3276.7 ECU_ADDRESS 0x3F8C2E /end MEASUREMENT
/begin MEASUREMENT ub_roh "Rohwert der U_KL87-Erfassung [RAM name from V530, voted 3]" SWORD M_FORMULA_0261 0 0 -51.08269056 51.08113164 ECU_ADDRESS 0x3F8C32 /end MEASUREMENT
/begin MEASUREMENT smg_can_n_getr_ziel "Getriebezieldrehzahl [RAM name from V530, voted 4]" SWORD M_FORMULA_0006 0 0 -32768 32767 ECU_ADDRESS 0x3F8C38 /end MEASUREMENT
/begin MEASUREMENT smg_can_flags "Allg. CAN-Flags [RAM name from V530, voted 1]" UBYTE M_FORMULA_0003 0 0 0 255 ECU_ADDRESS 0x3F8C3D /end MEASUREMENT
/begin MEASUREMENT smg_can_flags_kl87 "KL87 durch SMG ein [RAM name from V530, voted 1]" UBYTE NO_COMPU_METHOD 0 0 0 255 ECU_ADDRESS 0x3F8C3D FORMAT "%.4g" /end MEASUREMENT
/begin MEASUREMENT smg_can_flags_mm "Status MM-SMG [RAM name from V530, voted 1]" UBYTE NO_COMPU_METHOD 0 0 0 255 ECU_ADDRESS 0x3F8C3D FORMAT "%.4g" /end MEASUREMENT
/begin MEASUREMENT egas_wdk_adapt_b1 "Adaptionsstatus [RAM name from V530, voted 1]" UBYTE NO_COMPU_METHOD 0 0 0 255 ECU_ADDRESS 0x3F8C42 FORMAT "%.4g" /end MEASUREMENT
/begin MEASUREMENT smg_st_mot "SMG-Motoreingriff [RAM name from V530, voted 11]" UBYTE NO_COMPU_METHOD 0 0 0 255 ECU_ADDRESS 0x3F8C44 FORMAT "%.4g" /end MEASUREMENT
/begin MEASUREMENT smg_st_mot_sa "SMG-SA-Sperre [RAM name from V530, voted 11]" UBYTE NO_COMPU_METHOD 0 0 0 255 ECU_ADDRESS 0x3F8C44 FORMAT "%.4g" /end MEASUREMENT
/begin MEASUREMENT smg_st_mot_ti "SMG-TI-Eingriff [RAM name from V530, voted 11]" UBYTE NO_COMPU_METHOD 0 0 0 255 ECU_ADDRESS 0x3F8C44 FORMAT "%.4g" /end MEASUREMENT
/begin MEASUREMENT smg_st_mot_tl "SMG-TL-Eingriff [RAM name from V530, voted 11]" UBYTE NO_COMPU_METHOD 0 0 0 255 ECU_ADDRESS 0x3F8C44 FORMAT "%.4g" /end MEASUREMENT
/begin MEASUREMENT smg_can_modul "Modulstatus [RAM name from V530, voted 5]" UBYTE NO_COMPU_METHOD 0 0 0 255 ECU_ADDRESS 0x3F8C45 FORMAT "%.4g" /end MEASUREMENT
/begin MEASUREMENT egas_aq_soll_grad_b1 "Gradient AQ-Soll [RAM name from V530, voted 2]" SWORD M_FORMULA_0020 0 0 -655360 655340 ECU_ADDRESS 0x3F8C48 /end MEASUREMENT
/begin MEASUREMENT md_rad_min "min. Radmoment [RAM name from V530, voted 1]" SLONG M_FORMULA_0272 0 0 -214748364.8 214748364.7 ECU_ADDRESS 0x3F8C50 /end MEASUREMENT
/begin MEASUREMENT md_rad_can_mdrv "max. Radmoment [RAM name from V530, voted 1]" SLONG M_FORMULA_0272 0 0 -214748364.8 214748364.7 ECU_ADDRESS 0x3F8C58 /end MEASUREMENT
/begin MEASUREMENT md_rad_soll "Radsollmoment [RAM name from V530, voted 1]" SLONG M_FORMULA_0272 0 0 -214748364.8 214748364.7 ECU_ADDRESS 0x3F8C5C /end MEASUREMENT
/begin MEASUREMENT md_rad_ist "Radistmoment [RAM name from V530, voted 1]" SLONG M_FORMULA_0272 0 0 -214748364.8 214748364.7 ECU_ADDRESS 0x3F8C60 /end MEASUREMENT
/begin MEASUREMENT dkg_freig_st "DKG-Freigabe [RAM name from V530, voted 3]" UBYTE NO_COMPU_METHOD 0 0 0 255 ECU_ADDRESS 0x3F8C64 FORMAT "%.4g" /end MEASUREMENT
/begin MEASUREMENT md_kupp_wunsch_ml "Wunschmoment fuer den Luftpfad [RAM name from V530, voted 1]" SWORD M_FORMULA_0009 0 0 -3276.8 3276.7 ECU_ADDRESS 0x3F8C68 /end MEASUREMENT
/begin MEASUREMENT md_kupp_min_filter "SAWE-Filter bei min Moment [RAM name from V530, voted 1]" SWORD M_FORMULA_0009 0 0 -3276.8 3276.7 ECU_ADDRESS 0x3F8C6A /end MEASUREMENT
/begin MEASUREMENT n_getr_ein "Getriebeeingangsdrehzahl [RAM name from V530, voted 1]" SWORD M_FORMULA_0006 0 0 -32768 32767 ECU_ADDRESS 0x3F8C6E /end MEASUREMENT
/begin MEASUREMENT j_gesamt "ges. Tr???gheitsmoment [RAM name from V530, voted 1]" UWORD M_FORMULA_0276 0 0 0 127.9980469 ECU_ADDRESS 0x3F8C72 /end MEASUREMENT
/begin MEASUREMENT s_kraftschluss_smg "Kraftschluss beim SMG [RAM name from V530, voted 25]" UWORD NO_COMPU_METHOD 0 0 0 65535 ECU_ADDRESS 0x3F8CA2 FORMAT "%.4g" /end MEASUREMENT
/begin MEASUREMENT schalter_bls_ign "Schalterstatus [RAM name from V530, voted 25]" UWORD NO_COMPU_METHOD 0 0 0 65535 ECU_ADDRESS 0x3F8CA2 FORMAT "%.4g" /end MEASUREMENT
/begin MEASUREMENT schalter_blts "Schalterstatus [RAM name from V530, voted 25]" UWORD NO_COMPU_METHOD 0 0 0 65535 ECU_ADDRESS 0x3F8CA2 FORMAT "%.4g" /end MEASUREMENT
/begin MEASUREMENT schalter_kl87 "Schalterstatus [RAM name from V530, voted 25]" UWORD NO_COMPU_METHOD 0 0 0 65535 ECU_ADDRESS 0x3F8CA2 FORMAT "%.4g" /end MEASUREMENT
/begin MEASUREMENT schalter_st_ign "Schalterstatus [RAM name from V530, voted 25]" UWORD M_FORMULA_0080 0 0 0 65535 ECU_ADDRESS 0x3F8CA2 /end MEASUREMENT
/begin MEASUREMENT schalter_wakeup_ign "Schalterstatus [RAM name from V530, voted 25]" UWORD NO_COMPU_METHOD 0 0 0 65535 ECU_ADDRESS 0x3F8CA2 FORMAT "%.4g" /end MEASUREMENT
/begin MEASUREMENT pctrl_t_ign "Werte fuer die Prozessorkontrolle [RAM name from V530, voted 1]" ULONG M_FORMULA_0000 0 0 0 4294967295 ECU_ADDRESS 0x3F8CA8 /end MEASUREMENT
/begin MEASUREMENT toel_start_ok "Bedingung Oeltemperatur gemessen [RAM name from V530, voted 1]" UBYTE M_FORMULA_0003 0 0 0 255 ECU_ADDRESS 0x3F8CAC /end MEASUREMENT
/begin MEASUREMENT tz_min_b1 "minimal zulaessiger Zuendwinkel [RAM name from V530, voted 1]" SWORD M_FORMULA_0102 0 0 -3276.8 3276.7 ECU_ADDRESS 0x3F8CAE /end MEASUREMENT
/begin MEASUREMENT kh_st "Katheizstatus Aktiv bzw. Inaktiv [RAM name from V530, voted 9]" UWORD NO_COMPU_METHOD 0 0 0 65535 ECU_ADDRESS 0x3F8CBA FORMAT "%.4g" /end MEASUREMENT
/begin MEASUREMENT kh_st_ed "KH Sperrstatus wegen ED(Fehlermatrix) [RAM name from V530, voted 9]" UWORD NO_COMPU_METHOD 0 0 0 65535 ECU_ADDRESS 0x3F8CBA FORMAT "%.4g" /end MEASUREMENT
/begin MEASUREMENT kh_st_eingriff "aktive, KH Eingriffe [RAM name from V530, voted 9]" UWORD NO_COMPU_METHOD 0 0 0 65535 ECU_ADDRESS 0x3F8CBA FORMAT "%.4g" /end MEASUREMENT
/begin MEASUREMENT kh_st_n "KH Sperrstatus wegen Drehzahlschwelle [RAM name from V530, voted 9]" UWORD NO_COMPU_METHOD 0 0 0 65535 ECU_ADDRESS 0x3F8CBA FORMAT "%.4g" /end MEASUREMENT
/begin MEASUREMENT kh_st_pksrpl "KH Sperrstatus wegen pksr PL [RAM name from V530, voted 9]" UWORD NO_COMPU_METHOD 0 0 0 65535 ECU_ADDRESS 0x3F8CBA FORMAT "%.4g" /end MEASUREMENT
/begin MEASUREMENT kh_st_pumg "KH Sperrstatus wegen pumg [RAM name from V530, voted 9]" UWORD NO_COMPU_METHOD 0 0 0 65535 ECU_ADDRESS 0x3F8CBA FORMAT "%.4g" /end MEASUREMENT
/begin MEASUREMENT kh_st_rf "KH Sperrstatus wegen rf-Schwelle [RAM name from V530, voted 9]" UWORD NO_COMPU_METHOD 0 0 0 65535 ECU_ADDRESS 0x3F8CBA FORMAT "%.4g" /end MEASUREMENT
/begin MEASUREMENT kh_st_sk "KH Sperrstatus wegen SK [RAM name from V530, voted 9]" UWORD NO_COMPU_METHOD 0 0 0 65535 ECU_ADDRESS 0x3F8CBA FORMAT "%.4g" /end MEASUREMENT
/begin MEASUREMENT kh_st_sl "KH Sperrstatus SL [RAM name from V530, voted 9]" UWORD NO_COMPU_METHOD 0 0 0 65535 ECU_ADDRESS 0x3F8CBA FORMAT "%.4g" /end MEASUREMENT
/begin MEASUREMENT kh_st_smg "KH BIT fuer SMG [RAM name from V530, voted 9]" UWORD NO_COMPU_METHOD 0 0 0 65535 ECU_ADDRESS 0x3F8CBA FORMAT "%.4g" /end MEASUREMENT
/begin MEASUREMENT kh_st_t_ml "KH Sperrstatus wegen Zeit seit Motor laeuft [RAM name from V530, voted 9]" UWORD NO_COMPU_METHOD 0 0 0 65535 ECU_ADDRESS 0x3F8CBA FORMAT "%.4g" /end MEASUREMENT
/begin MEASUREMENT kh_st_tan "KH Sperrstatus wegen tan [RAM name from V530, voted 9]" UWORD NO_COMPU_METHOD 0 0 0 65535 ECU_ADDRESS 0x3F8CBA FORMAT "%.4g" /end MEASUREMENT
/begin MEASUREMENT kh_st_tkat "KH Sperrstatus wegen tkat [RAM name from V530, voted 9]" UWORD NO_COMPU_METHOD 0 0 0 65535 ECU_ADDRESS 0x3F8CBA FORMAT "%.4g" /end MEASUREMENT
/begin MEASUREMENT kh_st_tkat_zyklus "KH Zyklusflag fuer TKAT Schwelle erreicht [RAM name from V530, voted 9]" UWORD NO_COMPU_METHOD 0 0 0 65535 ECU_ADDRESS 0x3F8CBA FORMAT "%.4g" /end MEASUREMENT
/begin MEASUREMENT kh_st_van "KH Sperrstatus, Vanos Katheizen [RAM name from V530, voted 9]" UWORD NO_COMPU_METHOD 0 0 0 65535 ECU_ADDRESS 0x3F8CBA FORMAT "%.4g" /end MEASUREMENT
/begin MEASUREMENT kh_st_vtkat "KH Sperrstatus wegen v [RAM name from V530, voted 9]" UWORD NO_COMPU_METHOD 0 0 0 65535 ECU_ADDRESS 0x3F8CBA FORMAT "%.4g" /end MEASUREMENT
/begin MEASUREMENT kh_st_vtkat_zyklus "KH Zyklusflag fuer v ungleich 0 und TKAT erreicht [RAM name from V530, voted 9]" UWORD NO_COMPU_METHOD 0 0 0 65535 ECU_ADDRESS 0x3F8CBA FORMAT "%.4g" /end MEASUREMENT
/begin MEASUREMENT kh_st_xx "Alle Statusflags vom kh_st [RAM name from V530, voted 9]" UWORD M_FORMULA_0010 0 0 0 65535 ECU_ADDRESS 0x3F8CBA /end MEASUREMENT
/begin MEASUREMENT smg_t_aufregel "Aufregelzeit [RAM name from V530, voted 1]" UBYTE M_FORMULA_0306 0 0 0 2.55 ECU_ADDRESS 0x3F8CC3 /end MEASUREMENT
/begin MEASUREMENT md_sk_mode "SK-Mode Momentenmanager [RAM name from V530, voted 1]" UBYTE NO_COMPU_METHOD 0 0 0 255 ECU_ADDRESS 0x3F8CC5 FORMAT "%.4g" /end MEASUREMENT
/begin MEASUREMENT gang_n_verh "Getriebeeingangsdrehzahl / Getriebeabtriebsdrehzahl [RAM name from V530, voted 1]" SWORD M_FORMULA_0073 0 0 -32 31.99902344 ECU_ADDRESS 0x3F8CC6 /end MEASUREMENT
/begin MEASUREMENT gang_berech_st "Status berechneter Gang [RAM name from V530, voted 3]" UWORD M_FORMULA_0080 0 0 0 65535 ECU_ADDRESS 0x3F8CCA /end MEASUREMENT
/begin MEASUREMENT gang_berech_st_aktion "Aktion am Schalthebel [RAM name from V530, voted 3]" UWORD NO_COMPU_METHOD 0 0 0 65535 ECU_ADDRESS 0x3F8CCA FORMAT "%.4g" /end MEASUREMENT
/begin MEASUREMENT gang_berech_st_gerade "berechneter Gang gerade [RAM name from V530, voted 3]" UWORD NO_COMPU_METHOD 0 0 0 65535 ECU_ADDRESS 0x3F8CCA FORMAT "%.4g" /end MEASUREMENT
/begin MEASUREMENT gang_berech_st_neu "Gang neu berechnen [RAM name from V530, voted 3]" UWORD NO_COMPU_METHOD 0 0 0 65535 ECU_ADDRESS 0x3F8CCA FORMAT "%.4g" /end MEASUREMENT
/begin MEASUREMENT gang_berech_st_plaus "berechneter Gang plausibel [RAM name from V530, voted 3]" UWORD NO_COMPU_METHOD 0 0 0 65535 ECU_ADDRESS 0x3F8CCA FORMAT "%.4g" /end MEASUREMENT
/begin MEASUREMENT gang_berech_st_uebern "Gang neu berechnen [RAM name from V530, voted 3]" UWORD NO_COMPU_METHOD 0 0 0 65535 ECU_ADDRESS 0x3F8CCA FORMAT "%.4g" /end MEASUREMENT
/begin MEASUREMENT gang_berech_st_unbek "berechneter Gang unbekannt [RAM name from V530, voted 3]" UWORD NO_COMPU_METHOD 0 0 0 65535 ECU_ADDRESS 0x3F8CCA FORMAT "%.4g" /end MEASUREMENT
/begin MEASUREMENT gang_berech_st_ungerade "berechneter Gang ungerade [RAM name from V530, voted 3]" UWORD NO_COMPU_METHOD 0 0 0 65535 ECU_ADDRESS 0x3F8CCA FORMAT "%.4g" /end MEASUREMENT
/begin MEASUREMENT gang_berech_kl_i "Getriebeuebersetzungsverhaeltnis aus Kennlinie [RAM name from V530, voted 1]" SWORD M_FORMULA_0073 0 0 -32 31.99902344 ECU_ADDRESS 0x3F8CCC /end MEASUREMENT
/begin MEASUREMENT gang_berech_kl_i_dist "Abstand Getriebeuebersetzungsverhaeltnis naechster Gang [RAM name from V530, voted 1]" SWORD M_FORMULA_0073 0 0 -32 31.99902344 ECU_ADDRESS 0x3F8CCE /end MEASUREMENT
/begin MEASUREMENT gang "Gang [RAM name from V530, voted 4]" SBYTE M_FORMULA_0135 0 0 -128 127 ECU_ADDRESS 0x3F8CD0 /end MEASUREMENT
/begin MEASUREMENT gang_ks "Gang mit Kraftschluss [RAM name from V530, voted 1]" SBYTE M_FORMULA_0135 0 0 -128 127 ECU_ADDRESS 0x3F8CD1 /end MEASUREMENT
/begin MEASUREMENT egas_sk_mode "SK-Mode Egas [RAM name from V530, voted 16]" UBYTE NO_COMPU_METHOD 0 0 0 255 ECU_ADDRESS 0x3F8CD3 FORMAT "%.4g" /end MEASUREMENT
/begin MEASUREMENT sk_md_begr_ign "SK-Begrenzungsstufe [RAM name from V530, voted 3]" UBYTE NO_COMPU_METHOD 0 0 0 255 ECU_ADDRESS 0x3F8CD5 FORMAT "%.4g" /end MEASUREMENT
/begin MEASUREMENT sk_md_eingr_ign "SK-Md-Eingriff [RAM name from V530, voted 4]" UBYTE M_FORMULA_0003 0 0 0 255 ECU_ADDRESS 0x3F8CD6 /end MEASUREMENT
/begin MEASUREMENT sk_ti_eingr_ign "SK-TI-Eingriff [RAM name from V530, voted 4]" UBYTE NO_COMPU_METHOD 0 0 0 255 ECU_ADDRESS 0x3F8CD6 FORMAT "%.4g" /end MEASUREMENT
/begin MEASUREMENT sk_tz_eingr_ign "SK-TZ-Eingriff [RAM name from V530, voted 4]" UBYTE NO_COMPU_METHOD 0 0 0 255 ECU_ADDRESS 0x3F8CD6 FORMAT "%.4g" /end MEASUREMENT
/begin MEASUREMENT sk_lam_st_ign_b1 "SK-LAM-Eingriff [RAM name from V530, voted 11]" UBYTE NO_COMPU_METHOD 0 0 0 255 ECU_ADDRESS 0x3F8CD7 FORMAT "%.4g" /end MEASUREMENT
/begin MEASUREMENT sk_lam_st_ign_b2 "SK-LAM-Eingriff [RAM name from V530, voted 11]" UBYTE NO_COMPU_METHOD 0 0 0 255 ECU_ADDRESS 0x3F8CD7 FORMAT "%.4g" /end MEASUREMENT
/begin MEASUREMENT sk_van_st_ign "SK-Vanos-Eingriff [RAM name from V530, voted 3]" UBYTE NO_COMPU_METHOD 0 0 0 255 ECU_ADDRESS 0x3F8CD8 FORMAT "%.4g" /end MEASUREMENT
/begin MEASUREMENT sk_eingr_st_ign "SK-Eingriff [RAM name from V530, voted 5]" UBYTE M_FORMULA_0003 0 0 0 255 ECU_ADDRESS 0x3F8CD9 /end MEASUREMENT
/begin MEASUREMENT sk_fr_st_ign "SK-Eingriff FR [RAM name from V530, voted 5]" UBYTE NO_COMPU_METHOD 0 0 0 255 ECU_ADDRESS 0x3F8CD9 FORMAT "%.4g" /end MEASUREMENT
/begin MEASUREMENT sk_fra_st_ign "SK-Eingriff FRA [RAM name from V530, voted 5]" UBYTE NO_COMPU_METHOD 0 0 0 255 ECU_ADDRESS 0x3F8CD9 FORMAT "%.4g" /end MEASUREMENT
/begin MEASUREMENT sk_kh_st_ign "SK-Eingriff KH [RAM name from V530, voted 5]" UBYTE NO_COMPU_METHOD 0 0 0 255 ECU_ADDRESS 0x3F8CD9 FORMAT "%.4g" /end MEASUREMENT
/begin MEASUREMENT sk_llra_st_ign "SK-Eingriff LLRA [RAM name from V530, voted 5]" UBYTE NO_COMPU_METHOD 0 0 0 255 ECU_ADDRESS 0x3F8CD9 FORMAT "%.4g" /end MEASUREMENT
/begin MEASUREMENT sk_mzyl_st_ign "SK-Eingriff MZYL [RAM name from V530, voted 5]" UBYTE NO_COMPU_METHOD 0 0 0 255 ECU_ADDRESS 0x3F8CD9 FORMAT "%.4g" /end MEASUREMENT
/begin MEASUREMENT sk_pks_st_ign "SK-Eingriff PKS [RAM name from V530, voted 5]" UBYTE NO_COMPU_METHOD 0 0 0 255 ECU_ADDRESS 0x3F8CD9 FORMAT "%.4g" /end MEASUREMENT
/begin MEASUREMENT sk_ti_zyl_off_ign "SK-Ausblendungen [RAM name from V530, voted 11]" UWORD NO_COMPU_METHOD 0 0 0 65535 ECU_ADDRESS 0x3F8CDA FORMAT "%.4g" /end MEASUREMENT
/begin MEASUREMENT fgr_status_kombi "FGR Status zum Kombi [RAM name from V530, voted 1]" UBYTE NO_COMPU_METHOD 0 0 0 255 ECU_ADDRESS 0x3F8CDC FORMAT "%.4g" /end MEASUREMENT
/begin MEASUREMENT fgr_status_hud "FGR Status HUD [RAM name from V530, voted 1]" UBYTE NO_COMPU_METHOD 0 0 0 255 ECU_ADDRESS 0x3F8CDE FORMAT "%.4g" /end MEASUREMENT
/begin MEASUREMENT fgr_v_kombi "FGR Geschwindigkeit zum Kombi [RAM name from V530, voted 1]" SWORD M_FORMULA_0317 0 0 -3276.8 3276.7 ECU_ADDRESS 0x3F8CE0 /end MEASUREMENT
/begin MEASUREMENT fgr_status "Fgr Status [RAM name from V530, voted 1]" UBYTE NO_COMPU_METHOD 0 0 0 255 ECU_ADDRESS 0x3F8CE2 FORMAT "%.4g" /end MEASUREMENT
/begin MEASUREMENT tabg_vkat_b1 "Abgastemperatur vorm Kat [RAM name from V530, voted 5]" SWORD M_FORMULA_0023 0 0 -3550 3003.5 ECU_ADDRESS 0x3F8D1A /end MEASUREMENT
/begin MEASUREMENT tabg_nkat_b1 "Abgastemperatur nach dem Kat [RAM name from V530, voted 8]" SWORD M_FORMULA_0023 0 0 -3550 3003.5 ECU_ADDRESS 0x3F8D1E /end MEASUREMENT
/begin MEASUREMENT tabg_nkat_b2 "Abgastemperatur nach dem Kat [RAM name from V530, voted 1]" SWORD M_FORMULA_0023 0 0 -3550 3003.5 ECU_ADDRESS 0x3F8D20 /end MEASUREMENT
/begin MEASUREMENT tabg_lw_verh_b1 "Verhaeltnis der Ladungswechseltemperaturen [RAM name from V530, voted 1]" UWORD M_FORMULA_0073 0 0 0 63.99902344 ECU_ADDRESS 0x3F8D26 /end MEASUREMENT
/begin MEASUREMENT tan_b1 "Ansauglufttemperatur [RAM name from V530, voted 3]" SWORD M_FORMULA_0023 0 0 -3550 3003.5 ECU_ADDRESS 0x3F8D30 /end MEASUREMENT
/begin MEASUREMENT tan_b2 "Ansauglufttemperatur [RAM name from V530, voted 2]" SWORD M_FORMULA_0023 0 0 -3550 3003.5 ECU_ADDRESS 0x3F8D32 /end MEASUREMENT
/begin MEASUREMENT tan_mw "Mittelwert der Ansauglufttemperatur [RAM name from V530, voted 4]" SWORD M_FORMULA_0023 0 0 -3550 3003.5 ECU_ADDRESS 0x3F8D34 /end MEASUREMENT
/begin MEASUREMENT tdme "Steuergeraetetemperatur [RAM name from V530, voted 7]" SWORD M_FORMULA_0023 0 0 -3550 3003.5 ECU_ADDRESS 0x3F8D36 /end MEASUREMENT
/begin MEASUREMENT tmot "Motortemperatur-Kuehlwasser [RAM name from V530, voted 39]" SWORD M_FORMULA_0023 0 0 -3550 3003.5 ECU_ADDRESS 0x3F8D38 /end MEASUREMENT
/begin MEASUREMENT tmot_modell "OBD-Modelltemperatur [RAM name from V530, voted 1]" SLONG M_FORMULA_0343 0 0 -209988.35 209442.0499 ECU_ADDRESS 0x3F8D3C /end MEASUREMENT
/begin MEASUREMENT tmot_sta "Status Uebertemperaturanzeige [RAM name from V530, voted 1]" UBYTE NO_COMPU_METHOD 0 0 0 255 ECU_ADDRESS 0x3F8D40 FORMAT "%.4g" /end MEASUREMENT
/begin MEASUREMENT tmot_sta_zws "Status Zwangsschaltung [RAM name from V530, voted 1]" UBYTE NO_COMPU_METHOD 0 0 0 255 ECU_ADDRESS 0x3F8D40 FORMAT "%.4g" /end MEASUREMENT
/begin MEASUREMENT toel "Temperatur am Oelfilterkopf [RAM name from V530, voted 3]" SWORD M_FORMULA_0023 0 0 -3550 3003.5 ECU_ADDRESS 0x3F8D44 /end MEASUREMENT
/begin MEASUREMENT tsgrw_m "Mittelwert Saugrohrwandtemperatur [RAM name from V530, voted 9]" SWORD M_FORMULA_0023 0 0 -3550 3003.5 ECU_ADDRESS 0x3F8D48 /end MEASUREMENT
/begin MEASUREMENT tumg_ersatz "Ersatzwert der Umgebungstemperatur [RAM name from V530, voted 2]" SWORD M_FORMULA_0023 0 0 -3550 3003.5 ECU_ADDRESS 0x3F8D4E /end MEASUREMENT
/begin MEASUREMENT llr_n_soll "Leerlaufdrehzahl [RAM name from V530, voted 2]" SWORD M_FORMULA_0006 0 0 -32768 32767 ECU_ADDRESS 0x3F8D50 /end MEASUREMENT
/begin MEASUREMENT kw_diag "AD-Wert Kurbelwellendiagnose [RAM name from V530, voted 3]" SWORD M_FORMULA_0114 0 0 -32768 32767 ECU_ADDRESS 0x3F8D5C /end MEASUREMENT
/begin MEASUREMENT fgr_cc_message "Fgr CC-Message senden [RAM name from V530, voted 1]" UBYTE NO_COMPU_METHOD 0 0 0 255 ECU_ADDRESS 0x3F8D5E FORMAT "%.4g" /end MEASUREMENT
/begin MEASUREMENT start_rl_diag_dpr "Bestaetigung der Treiberinfo [RAM name from V530, voted 1]" UBYTE M_FORMULA_0003 0 0 0 255 ECU_ADDRESS 0x3F8D6C /end MEASUREMENT
/begin MEASUREMENT md_kupp_max "Maximalmoment an der Kupplung [RAM name from V530, voted 1]" SWORD M_FORMULA_0009 0 0 -3276.8 3276.7 ECU_ADDRESS 0x3F8D6E /end MEASUREMENT
/begin MEASUREMENT md_kupp_max_can "CAN-Maximalmoment an der Kupplung [RAM name from V530, voted 2]" SWORD M_FORMULA_0009 0 0 -3276.8 3276.7 ECU_ADDRESS 0x3F8D70 /end MEASUREMENT
/begin MEASUREMENT md_ind_schlepp_ist "Schleppmoment (aktuell) [RAM name from V530, voted 1]" SWORD M_FORMULA_0009 0 0 -3276.8 3276.7 ECU_ADDRESS 0x3F8D76 /end MEASUREMENT
/begin MEASUREMENT md_rf_soll_pt_fr_wicht "Soll-rf mit pt-,fr,fra-Korr und Wichtung [RAM name from V530, voted 1]" SWORD M_FORMULA_0007 0 0 -3.2768 3.2767 ECU_ADDRESS 0x3F8D7E /end MEASUREMENT
/begin MEASUREMENT auss_obd_zyl_off "Abgeschaltene Zylinder. [RAM name from V530, voted 6]" UWORD NO_COMPU_METHOD 0 0 0 65535 ECU_ADDRESS 0x3F8D84 FORMAT "%.4g" /end MEASUREMENT
/begin MEASUREMENT ccp_fp_st_ign "Status CCP-FP [RAM name from V530, voted 2]" UBYTE NO_COMPU_METHOD 0 0 0 255 ECU_ADDRESS 0x3F8D86 FORMAT "%.4g" /end MEASUREMENT
/begin MEASUREMENT egas_rec_dk_r_hw_vers_b1 "HW-Version [RAM name from V530, voted 1]" UWORD M_FORMULA_0010 0 0 0 65535 ECU_ADDRESS 0x3F8D88 /end MEASUREMENT
/begin MEASUREMENT k2KB_resp_ign "KWP [RAM name from V530, voted 19]" UBYTE NO_COMPU_METHOD 0 0 0 255 ECU_ADDRESS 0x3F8D98 FORMAT "%.4g" /end MEASUREMENT
/begin MEASUREMENT k2KB_sid_ign "KWP [RAM name from V530, voted 1]" UBYTE M_FORMULA_0003 0 0 0 255 ECU_ADDRESS 0x3F8D99 /end MEASUREMENT
/begin MEASUREMENT k2KB_bytes_ign "KWP [RAM name from V530, voted 1]" UWORD M_FORMULA_0010 0 0 0 65535 ECU_ADDRESS 0x3F8D9A /end MEASUREMENT
/begin MEASUREMENT lam_soll_b1 "ausgegebenes SOLL-Lambda [RAM name from V530, voted 6]" UWORD M_FORMULA_0025 0 0 0 3.999938965 ECU_ADDRESS 0x3F8E34 /end MEASUREMENT
/begin MEASUREMENT lam_soll_b2 "ausgegebenes SOLL-Lambda [RAM name from V530, voted 2]" UWORD M_FORMULA_0025 0 0 0 3.999938965 ECU_ADDRESS 0x3F8E36 /end MEASUREMENT
/begin MEASUREMENT lam_reg_f_b1 "Regeleingriff [RAM name from V530, voted 15]" UWORD M_FORMULA_0024 0 0 0 1.999969482 ECU_ADDRESS 0x3F8E38 /end MEASUREMENT
/begin MEASUREMENT lam_reg_f_b2 "Regeleingriff [RAM name from V530, voted 2]" UWORD M_FORMULA_0024 0 0 0 1.999969482 ECU_ADDRESS 0x3F8E3A /end MEASUREMENT
/begin MEASUREMENT lam_reg_max_b1 "max. Reglereingriff [RAM name from V530, voted 34]" UWORD NO_COMPU_METHOD 0 0 0 65535 ECU_ADDRESS 0x3F8E3C FORMAT "%.4g" /end MEASUREMENT
/begin MEASUREMENT lam_reg_min_b1 "min. Reglereingriff [RAM name from V530, voted 34]" UWORD NO_COMPU_METHOD 0 0 0 65535 ECU_ADDRESS 0x3F8E3C FORMAT "%.4g" /end MEASUREMENT
/begin MEASUREMENT lam_reg_reset_sa_b1 "LA-Regler RESET - SA [RAM name from V530, voted 34]" UWORD NO_COMPU_METHOD 0 0 0 65535 ECU_ADDRESS 0x3F8E3C FORMAT "%.4g" /end MEASUREMENT
/begin MEASUREMENT lam_reg_reset_slp_b1 "LA-Regler-RESET - SLP [RAM name from V530, voted 34]" UWORD NO_COMPU_METHOD 0 0 0 65535 ECU_ADDRESS 0x3F8E3C FORMAT "%.4g" /end MEASUREMENT
/begin MEASUREMENT lam_reg_st_b1 "LA-Regler-Status [RAM name from V530, voted 34]" UWORD M_FORMULA_0080 0 0 0 65535 ECU_ADDRESS 0x3F8E3C /end MEASUREMENT
/begin MEASUREMENT lam_reg_stat_b1 "LA-Regler Position [RAM name from V530, voted 34]" UWORD NO_COMPU_METHOD 0 0 0 65535 ECU_ADDRESS 0x3F8E3C FORMAT "%.4g" /end MEASUREMENT
/begin MEASUREMENT lam_reg_stat_trim_b1 "LA-Regler Position fuer TRIM-Regelung [RAM name from V530, voted 34]" UWORD NO_COMPU_METHOD 0 0 0 65535 ECU_ADDRESS 0x3F8E3C FORMAT "%.4g" /end MEASUREMENT
/begin MEASUREMENT lam_regler_st_b1 "LA-Regler-Status [RAM name from V530, voted 34]" UWORD NO_COMPU_METHOD 0 0 0 65535 ECU_ADDRESS 0x3F8E3C FORMAT "%.4g" /end MEASUREMENT
/begin MEASUREMENT lam_ti_min_b1 "min. TI fuer LA-Regelung [RAM name from V530, voted 34]" UWORD NO_COMPU_METHOD 0 0 0 65535 ECU_ADDRESS 0x3F8E3C FORMAT "%.4g" /end MEASUREMENT
/begin MEASUREMENT lam_wf_verz_b1 "WF-Verzoegerung [RAM name from V530, voted 34]" UWORD NO_COMPU_METHOD 0 0 0 65535 ECU_ADDRESS 0x3F8E3C FORMAT "%.4g" /end MEASUREMENT
/begin MEASUREMENT lam_reg_max_b2 "max. Reglereingriff [RAM name from V530, voted 6]" UWORD NO_COMPU_METHOD 0 0 0 65535 ECU_ADDRESS 0x3F8E3E FORMAT "%.4g" /end MEASUREMENT
/begin MEASUREMENT lam_reg_min_b2 "min. Reglereingriff [RAM name from V530, voted 6]" UWORD NO_COMPU_METHOD 0 0 0 65535 ECU_ADDRESS 0x3F8E3E FORMAT "%.4g" /end MEASUREMENT
/begin MEASUREMENT lam_reg_reset_sa_b2 "LA-Regler RESET - SA [RAM name from V530, voted 6]" UWORD NO_COMPU_METHOD 0 0 0 65535 ECU_ADDRESS 0x3F8E3E FORMAT "%.4g" /end MEASUREMENT
/begin MEASUREMENT lam_reg_reset_slp_b2 "LA-Regler-RESET - SLP [RAM name from V530, voted 6]" UWORD NO_COMPU_METHOD 0 0 0 65535 ECU_ADDRESS 0x3F8E3E FORMAT "%.4g" /end MEASUREMENT
/begin MEASUREMENT lam_reg_st_b2 "LA-Regler-Status [RAM name from V530, voted 6]" UWORD M_FORMULA_0080 0 0 0 65535 ECU_ADDRESS 0x3F8E3E /end MEASUREMENT
/begin MEASUREMENT lam_reg_stat_b2 "LA-Regler Position [RAM name from V530, voted 6]" UWORD NO_COMPU_METHOD 0 0 0 65535 ECU_ADDRESS 0x3F8E3E FORMAT "%.4g" /end MEASUREMENT
/begin MEASUREMENT lam_reg_stat_trim_b2 "LA-Regler Position fuer TRIM-Regelung [RAM name from V530, voted 6]" UWORD NO_COMPU_METHOD 0 0 0 65535 ECU_ADDRESS 0x3F8E3E FORMAT "%.4g" /end MEASUREMENT
/begin MEASUREMENT lam_regler_st_b2 "LA-Regler-Status [RAM name from V530, voted 6]" UWORD NO_COMPU_METHOD 0 0 0 65535 ECU_ADDRESS 0x3F8E3E FORMAT "%.4g" /end MEASUREMENT
/begin MEASUREMENT lam_ti_min_b2 "min. TI fuer LA-Regelung [RAM name from V530, voted 6]" UWORD NO_COMPU_METHOD 0 0 0 65535 ECU_ADDRESS 0x3F8E3E FORMAT "%.4g" /end MEASUREMENT
/begin MEASUREMENT lam_wf_verz_b2 "WF-Verzoegerung [RAM name from V530, voted 6]" UWORD NO_COMPU_METHOD 0 0 0 65535 ECU_ADDRESS 0x3F8E3E FORMAT "%.4g" /end MEASUREMENT
/begin MEASUREMENT lam_ist_mw_b1 "Mittelwert IST-Lambda [RAM name from V530, voted 13]" UWORD M_FORMULA_0025 0 0 0 3.999938965 ECU_ADDRESS 0x3F8E40 /end MEASUREMENT
/begin MEASUREMENT lam_ist_mw_b2 "Mittelwert IST-Lambda [RAM name from V530, voted 3]" UWORD M_FORMULA_0025 0 0 0 3.999938965 ECU_ADDRESS 0x3F8E42 /end MEASUREMENT
/begin MEASUREMENT lam_ist_ers_b1 "LAM-IST - Ersatz [RAM name from V530, voted 1]" UWORD M_FORMULA_0025 0 0 0 3.999938965 ECU_ADDRESS 0x3F8E44 /end MEASUREMENT
/begin MEASUREMENT lam_soll_wl "SOLL-Lambda - Warmlauf [RAM name from V530, voted 1]" UWORD M_FORMULA_0025 0 0 0 3.999938965 ECU_ADDRESS 0x3F8E48 /end MEASUREMENT
/begin MEASUREMENT lam_soll_ms_kat_b1 "gespeicherte Sauerstoffmasse im KAT [RAM name from V530, voted 3]" SWORD M_FORMULA_0090 0 0 -3276.8 3276.7 ECU_ADDRESS 0x3F8E4A /end MEASUREMENT
/begin MEASUREMENT lam_soll_puls_adapt_fett_b1 "Adaption FETT [RAM name from V530, voted 14]" UWORD NO_COMPU_METHOD 0 0 0 65535 ECU_ADDRESS 0x3F8E4E FORMAT "%.4g" /end MEASUREMENT
/begin MEASUREMENT lam_soll_puls_adapt_mager_b1 "Adaption MAGER [RAM name from V530, voted 14]" UWORD NO_COMPU_METHOD 0 0 0 65535 ECU_ADDRESS 0x3F8E4E FORMAT "%.4g" /end MEASUREMENT
/begin MEASUREMENT lam_soll_puls_ausr_b1 "O2-Ausraeumfunktion [RAM name from V530, voted 14]" UWORD NO_COMPU_METHOD 0 0 0 65535 ECU_ADDRESS 0x3F8E4E FORMAT "%.4g" /end MEASUREMENT
/begin MEASUREMENT lam_soll_puls_ausr_sl_b1 "O2-Ausraeumfunktion nach SLP [RAM name from V530, voted 14]" UWORD NO_COMPU_METHOD 0 0 0 65535 ECU_ADDRESS 0x3F8E4E FORMAT "%.4g" /end MEASUREMENT
/begin MEASUREMENT lam_soll_puls_ausr_sl_trig_b1 "Trigger O2-Ausraeumfunktion nach SLP [RAM name from V530, voted 14]" UWORD NO_COMPU_METHOD 0 0 0 65535 ECU_ADDRESS 0x3F8E4E FORMAT "%.4g" /end MEASUREMENT
/begin MEASUREMENT lam_soll_puls_b1 "Pulsgenerator [RAM name from V530, voted 14]" UWORD NO_COMPU_METHOD 0 0 0 65535 ECU_ADDRESS 0x3F8E4E FORMAT "%.4g" /end MEASUREMENT
/begin MEASUREMENT lam_soll_puls_fett_betrieb_b1 "FETT-Betrieb [RAM name from V530, voted 14]" UWORD NO_COMPU_METHOD 0 0 0 65535 ECU_ADDRESS 0x3F8E4E FORMAT "%.4g" /end MEASUREMENT
/begin MEASUREMENT lam_soll_puls_freigabe_b1 "Freigabe Pulsgenerator [RAM name from V530, voted 14]" UWORD NO_COMPU_METHOD 0 0 0 65535 ECU_ADDRESS 0x3F8E4E FORMAT "%.4g" /end MEASUREMENT
/begin MEASUREMENT lam_soll_puls_lam_filt_b1 "LAM-SOLL-Filterung [RAM name from V530, voted 14]" UWORD NO_COMPU_METHOD 0 0 0 65535 ECU_ADDRESS 0x3F8E4E FORMAT "%.4g" /end MEASUREMENT
/begin MEASUREMENT lam_soll_puls_st_b1 "Status-Pulsgenerator [RAM name from V530, voted 14]" UWORD M_FORMULA_0080 0 0 0 65535 ECU_ADDRESS 0x3F8E4E /end MEASUREMENT
/begin MEASUREMENT lam_soll_puls_adapt_fett_b2 "Adaption FETT [RAM name from V530, voted 1]" UWORD NO_COMPU_METHOD 0 0 0 65535 ECU_ADDRESS 0x3F8E50 FORMAT "%.4g" /end MEASUREMENT
/begin MEASUREMENT lam_soll_puls_adapt_mager_b2 "Adaption MAGER [RAM name from V530, voted 1]" UWORD NO_COMPU_METHOD 0 0 0 65535 ECU_ADDRESS 0x3F8E50 FORMAT "%.4g" /end MEASUREMENT
/begin MEASUREMENT lam_soll_puls_ausr_b2 "O2-Ausraeumfunktion [RAM name from V530, voted 1]" UWORD NO_COMPU_METHOD 0 0 0 65535 ECU_ADDRESS 0x3F8E50 FORMAT "%.4g" /end MEASUREMENT
/begin MEASUREMENT lam_soll_puls_ausr_sl_b2 "O2-Ausraeumfunktion nach SLP [RAM name from V530, voted 1]" UWORD NO_COMPU_METHOD 0 0 0 65535 ECU_ADDRESS 0x3F8E50 FORMAT "%.4g" /end MEASUREMENT
/begin MEASUREMENT lam_soll_puls_ausr_sl_trig_b2 "Trigger O2-Ausraeumfunktion nach SLP [RAM name from V530, voted 1]" UWORD NO_COMPU_METHOD 0 0 0 65535 ECU_ADDRESS 0x3F8E50 FORMAT "%.4g" /end MEASUREMENT
/begin MEASUREMENT lam_soll_puls_b2 "Pulsgenerator [RAM name from V530, voted 1]" UWORD NO_COMPU_METHOD 0 0 0 65535 ECU_ADDRESS 0x3F8E50 FORMAT "%.4g" /end MEASUREMENT
/begin MEASUREMENT lam_soll_puls_fett_betrieb_b2 "FETT-Betrieb [RAM name from V530, voted 1]" UWORD NO_COMPU_METHOD 0 0 0 65535 ECU_ADDRESS 0x3F8E50 FORMAT "%.4g" /end MEASUREMENT
/begin MEASUREMENT lam_soll_puls_freigabe_b2 "Freigabe Pulsgenerator [RAM name from V530, voted 1]" UWORD NO_COMPU_METHOD 0 0 0 65535 ECU_ADDRESS 0x3F8E50 FORMAT "%.4g" /end MEASUREMENT
/begin MEASUREMENT lam_soll_puls_lam_filt_b2 "LAM-SOLL-Filterung [RAM name from V530, voted 1]" UWORD NO_COMPU_METHOD 0 0 0 65535 ECU_ADDRESS 0x3F8E50 FORMAT "%.4g" /end MEASUREMENT
/begin MEASUREMENT lam_soll_puls_st_b2 "Status-Pulsgenerator [RAM name from V530, voted 1]" UWORD M_FORMULA_0080 0 0 0 65535 ECU_ADDRESS 0x3F8E50 /end MEASUREMENT
/begin MEASUREMENT lam_delta_lim_b1 "begrenzte Regelabweichung [RAM name from V530, voted 5]" SWORD M_FORMULA_0025 0 0 -2 1.999938965 ECU_ADDRESS 0x3F8E52 /end MEASUREMENT
/begin MEASUREMENT rf_b1 "relative Fuellung [RAM name from V530, voted 10]" SWORD M_FORMULA_0007 0 0 -3.2768 3.2767 ECU_ADDRESS 0x3F8FA2 /end MEASUREMENT
/begin MEASUREMENT nw_st "Synchronisationsstatus Nockenwelle [RAM name from V530, voted 19]" UBYTE NO_COMPU_METHOD 0 0 0 255 ECU_ADDRESS 0x3F8E56 FORMAT "%.4g" /end MEASUREMENT
/begin MEASUREMENT diag_ev_tz_st "Bankabschaltung bei EV-/TZ-Fehlern [RAM name from V530, voted 5]" UWORD M_FORMULA_0010 0 0 0 65535 ECU_ADDRESS 0x3F8E58 /end MEASUREMENT
/begin MEASUREMENT ti_ev_ed_b1 "EV-Treiberdiag. [RAM name from V530, voted 15]" UWORD M_FORMULA_0010 0 0 0 65535 ECU_ADDRESS 0x3F8E5A /end MEASUREMENT
/begin MEASUREMENT ti_ev_ed_b2 "EV-Treiberdiag. [RAM name from V530, voted 5]" UWORD M_FORMULA_0010 0 0 0 65535 ECU_ADDRESS 0x3F8E5C /end MEASUREMENT
/begin MEASUREMENT van_ist_E1 "Istposition [RAM name from V530, voted 1]" SWORD M_FORMULA_0102 0 0 -3276.8 3276.7 ECU_ADDRESS 0x3F8E5E /end MEASUREMENT
/begin MEASUREMENT van_ist_filt_E1 "gefilterte Istposition [RAM name from V530, voted 5]" SWORD M_FORMULA_0102 0 0 -3276.8 3276.7 ECU_ADDRESS 0x3F8E66 /end MEASUREMENT
/begin MEASUREMENT rf_m "relative Fuellung Mittel zwischen Bank 1 und 2 [RAM name from V530, voted 41]" SWORD M_FORMULA_0007 0 0 -3.2768 3.2767 ECU_ADDRESS 0x3F8E74 /end MEASUREMENT
/begin MEASUREMENT ml_ges "Luftmassenstrom Bank 1 und 2 [RAM name from V530, voted 3]" SWORD M_FORMULA_0103 0 0 -3276.8 3276.7 ECU_ADDRESS 0x3F8E76 /end MEASUREMENT
/begin MEASUREMENT rps_zyl_nr "Zylinder-RPS [RAM name from V530, voted 3]" UBYTE M_FORMULA_0003 0 0 0 255 ECU_ADDRESS 0x3F8E78 /end MEASUREMENT
/begin MEASUREMENT rps_ionen_st "Status Ionen-RPS [RAM name from V530, voted 1]" UWORD M_FORMULA_0010 0 0 0 65535 ECU_ADDRESS 0x3F8E7A /end MEASUREMENT
/begin MEASUREMENT rps_ionen_stufe "Stufe Ionen-RPS [RAM name from V530, voted 1]" UWORD M_FORMULA_0010 0 0 0 65535 ECU_ADDRESS 0x3F8E7C /end MEASUREMENT
/begin MEASUREMENT n "Motordrehzahl [RAM name from V530, voted 119]" SWORD M_FORMULA_0006 0 0 -32768 32767 ECU_ADDRESS 0x3F8E80 /end MEASUREMENT
/begin MEASUREMENT n_grad_segment "Drehzahlgradient [RAM name from V530, voted 2]" SWORD M_FORMULA_0105 0 0 -32768 32767 ECU_ADDRESS 0x3F8E82 /end MEASUREMENT
/begin MEASUREMENT n_grad_asp "Drehzahlgradient (Arbeitsspiel) [RAM name from V530, voted 2]" SWORD M_FORMULA_0105 0 0 -32768 32767 ECU_ADDRESS 0x3F8E84 /end MEASUREMENT
/begin MEASUREMENT lam_soll_vl_max "Soll-Lambda bei max VL [RAM name from V530, voted 1]" UWORD M_FORMULA_0025 0 0 0 3.999938965 ECU_ADDRESS 0x3F8E86 /end MEASUREMENT
/begin MEASUREMENT te_tv_b1 "auszugebendes TE-Tastverhaeltnis [RAM name from V530, voted 11]" UWORD M_FORMULA_0107 0 0 0 6399.902344 ECU_ADDRESS 0x3F900A /end MEASUREMENT
/begin MEASUREMENT te_tv_b2 "auszugebendes TE-Tastverhaeltnis [RAM name from V530, voted 3]" UWORD M_FORMULA_0107 0 0 0 6399.902344 ECU_ADDRESS 0x3F900C /end MEASUREMENT
/begin MEASUREMENT ed_st_fehler_inj "ED-Gesamtstatus INJ-Fehler [RAM name from V530, voted 27]" ULONG M_FORMULA_0000 0 0 0 4294967295 ECU_ADDRESS 0x3F8EB0 /end MEASUREMENT
/begin MEASUREMENT ed_st_filter_inj "ED-Gesamtstatus INJ-Filter [RAM name from V530, voted 8]" ULONG M_FORMULA_0000 0 0 0 4294967295 ECU_ADDRESS 0x3F8ECC /end MEASUREMENT
/begin MEASUREMENT ed_mil_bmw_inj "Mil-Status INJ [RAM name from V530, voted 23]" UBYTE NO_COMPU_METHOD 0 0 0 255 ECU_ADDRESS 0x3F8EE8 FORMAT "%.4g" /end MEASUREMENT
/begin MEASUREMENT ed_mil_dme_inj "Mil-Status INJ [RAM name from V530, voted 23]" UBYTE NO_COMPU_METHOD 0 0 0 255 ECU_ADDRESS 0x3F8EE8 FORMAT "%.4g" /end MEASUREMENT
/begin MEASUREMENT ed_mil_predrive_inj "Mil-Status INJ [RAM name from V530, voted 23]" UBYTE NO_COMPU_METHOD 0 0 0 255 ECU_ADDRESS 0x3F8EE8 FORMAT "%.4g" /end MEASUREMENT
/begin MEASUREMENT ed_mil_st_inj "Mil-Status INJ [RAM name from V530, voted 23]" UBYTE M_FORMULA_0037 0 0 0 255 ECU_ADDRESS 0x3F8EE8 /end MEASUREMENT
/begin MEASUREMENT sa_we_st "SAWE-Status [RAM name from V530, voted 6]" UBYTE NO_COMPU_METHOD 0 0 0 255 ECU_ADDRESS 0x3F8EF6 FORMAT "%.4g" /end MEASUREMENT
/begin MEASUREMENT sa_n_we "Drehzahlschwelle fuer Wiedereinsetzdrehzahl [RAM name from V530, voted 1]" SWORD M_FORMULA_0006 0 0 -32768 32767 ECU_ADDRESS 0x3F8EF8 /end MEASUREMENT
/begin MEASUREMENT pks_ist "Kraftstoffdruck, absolut, gefiltert [RAM name from V530, voted 10]" SWORD M_FORMULA_0110 0 0 -32.768 32.767 ECU_ADDRESS 0x3F8EFC /end MEASUREMENT
/begin MEASUREMENT pks_rel "Kraftstoffdruck, relativ [RAM name from V530, voted 5]" SWORD M_FORMULA_0110 0 0 -32.768 32.767 ECU_ADDRESS 0x3F8EFE /end MEASUREMENT
/begin MEASUREMENT ti_ausblend_ist_b1 "Zyl-Ausblendung pro Bank [RAM name from V530, voted 2]" UBYTE M_FORMULA_0003 0 0 0 255 ECU_ADDRESS 0x3F8F04 /end MEASUREMENT
/begin MEASUREMENT ti_pks_up_st "TI-PKS-UP-Status [RAM name from V530, voted 8]" UWORD M_FORMULA_0080 0 0 0 65535 ECU_ADDRESS 0x3F8F0E /end MEASUREMENT
/begin MEASUREMENT Md_gennm_copy "gefiltertes Generatormoment absolut [RAM name from V530, voted 2]" SWORD M_FORMULA_0113 0 0 -3276.8 3276.7 ECU_ADDRESS 0x3F8F10 /end MEASUREMENT
/begin MEASUREMENT rps_cfg "Auswahl RPS-Modell [RAM name from V530, voted 4]" UBYTE M_FORMULA_0003 0 0 0 255 ECU_ADDRESS 0x3F8F15 /end MEASUREMENT
/begin MEASUREMENT rps_rec1_cnt "Rec1-Fehlerzaehler [RAM name from V530, voted 1]" UBYTE M_FORMULA_0003 0 0 0 255 ECU_ADDRESS 0x3F8F16 /end MEASUREMENT
/begin MEASUREMENT rps_rec2_cnt "Rec2-Fehlerzaehler [RAM name from V530, voted 1]" UBYTE M_FORMULA_0003 0 0 0 255 ECU_ADDRESS 0x3F8F17 /end MEASUREMENT
/begin MEASUREMENT can_st_atemp "Empfangsstatus ATemp [RAM name from V530, voted 6]" UWORD NO_COMPU_METHOD 0 0 0 65535 ECU_ADDRESS 0x3F90E8 FORMAT "%.4g" /end MEASUREMENT
/begin MEASUREMENT can_st_empf "Empfangsstatus aktuell [RAM name from V530, voted 30]" UWORD M_FORMULA_0010 0 0 0 65535 ECU_ADDRESS 0x3F8F1E /end MEASUREMENT
/begin MEASUREMENT can_st_empf_hys "Empfangsstatus pro SG-Zyklus [RAM name from V530, voted 13]" UWORD M_FORMULA_0010 0 0 0 65535 ECU_ADDRESS 0x3F8F20 /end MEASUREMENT
/begin MEASUREMENT can_st_dsc "Empfangsstatus DSC [RAM name from V530, voted 1]" UWORD NO_COMPU_METHOD 0 0 0 65535 ECU_ADDRESS 0x3F8F24 FORMAT "%.4g" /end MEASUREMENT
/begin MEASUREMENT can_st_vrad "Empfangsstatus vRad [RAM name from V530, voted 1]" UWORD NO_COMPU_METHOD 0 0 0 65535 ECU_ADDRESS 0x3F8F26 FORMAT "%.4g" /end MEASUREMENT
/begin MEASUREMENT can_st_klst "Empfangsstatus Klemmenstatus [RAM name from V530, voted 4]" UWORD NO_COMPU_METHOD 0 0 0 65535 ECU_ADDRESS 0x3F8F28 FORMAT "%.4g" /end MEASUREMENT
/begin MEASUREMENT can_st_vfzg "Empfangsstatus vFzg [RAM name from V530, voted 2]" UWORD NO_COMPU_METHOD 0 0 0 65535 ECU_ADDRESS 0x3F8F2A FORMAT "%.4g" /end MEASUREMENT
/begin MEASUREMENT can_st_torqdkg "Empfangsstatus DKG [RAM name from V530, voted 2]" UWORD NO_COMPU_METHOD 0 0 0 65535 ECU_ADDRESS 0x3F8F2C FORMAT "%.4g" /end MEASUREMENT
/begin MEASUREMENT can_st_grb "Empfangsstatus Getriebe [RAM name from V530, voted 2]" UWORD NO_COMPU_METHOD 0 0 0 65535 ECU_ADDRESS 0x3F8F2E FORMAT "%.4g" /end MEASUREMENT
/begin MEASUREMENT can_st_kkos "Empfangsstatus KKOS [RAM name from V530, voted 2]" UBYTE NO_COMPU_METHOD 0 0 0 255 ECU_ADDRESS 0x3F90EB FORMAT "%.4g" /end MEASUREMENT
/begin MEASUREMENT can_kkos_st "Stati KKOS [RAM name from V530, voted 3]" UBYTE M_FORMULA_0003 0 0 0 255 ECU_ADDRESS 0x3F90EC /end MEASUREMENT
/begin MEASUREMENT can_kkos_st_nll "Stati KKOS - n_ll [RAM name from V530, voted 3]" UBYTE NO_COMPU_METHOD 0 0 0 255 ECU_ADDRESS 0x3F90EC FORMAT "%.4g" /end MEASUREMENT
/begin MEASUREMENT can_kkos_st_zh "Stati KKOS - ZH [RAM name from V530, voted 3]" UBYTE NO_COMPU_METHOD 0 0 0 255 ECU_ADDRESS 0x3F90EC FORMAT "%.4g" /end MEASUREMENT
/begin MEASUREMENT can_kkos_md "Md-Aufnahme KKOS [RAM name from V530, voted 5]" SWORD M_FORMULA_0120 0 0 -16384 16383.5 ECU_ADDRESS 0x3F90EE /end MEASUREMENT
/begin MEASUREMENT v_vorne "v-Vorderachse [RAM name from V530, voted 19]" SWORD M_FORMULA_0076 0 0 -2048 2047.9375 ECU_ADDRESS 0x3F8F3A /end MEASUREMENT
/begin MEASUREMENT v_hinten "v-Hinterachse [RAM name from V530, voted 3]" SWORD M_FORMULA_0076 0 0 -2048 2047.9375 ECU_ADDRESS 0x3F8F3C /end MEASUREMENT
/begin MEASUREMENT can_v_st "v-CAN-Status [RAM name from V530, voted 22]" UWORD NO_COMPU_METHOD 0 0 0 65535 ECU_ADDRESS 0x3F8F3E FORMAT "%.4g" /end MEASUREMENT
/begin MEASUREMENT can_fzg_st "Fzg-Zustand [RAM name from V530, voted 7]" UBYTE NO_COMPU_METHOD 0 0 0 255 ECU_ADDRESS 0x3F8F4E FORMAT "%.4g" /end MEASUREMENT
/begin MEASUREMENT can_ax "Laengsbeschleunigung (roh) [RAM name from V530, voted 1]" SWORD M_FORMULA_0123 0 0 -819.2 819.175 ECU_ADDRESS 0x3F8F40 /end MEASUREMENT
/begin MEASUREMENT can_ay "Querbeschleunigung (roh) [RAM name from V530, voted 7]" SWORD M_FORMULA_0123 0 0 -819.2 819.175 ECU_ADDRESS 0x3F8F42 /end MEASUREMENT
/begin MEASUREMENT can_ax_mess "gem .Laengsbeschleunigung (roh) [RAM name from V530, voted 2]" SWORD M_FORMULA_0123 0 0 -819.2 819.175 ECU_ADDRESS 0x3F8F44 /end MEASUREMENT
/begin MEASUREMENT can_ax_offs "Offset aLaengs [RAM name from V530, voted 2]" SWORD M_FORMULA_0123 0 0 -819.2 819.175 ECU_ADDRESS 0x3F8F46 /end MEASUREMENT
/begin MEASUREMENT can_a_st "A-Status [RAM name from V530, voted 12]" UBYTE NO_COMPU_METHOD 0 0 0 255 ECU_ADDRESS 0x3F8F48 FORMAT "%.4g" /end MEASUREMENT
/begin MEASUREMENT can_dsc_reg "Regelungs-Status [RAM name from V530, voted 2]" UBYTE NO_COMPU_METHOD 0 0 0 255 ECU_ADDRESS 0x3F8F50 FORMAT "%.4g" /end MEASUREMENT
/begin MEASUREMENT can_brp_st "Bremsdruck-Status [RAM name from V530, voted 4]" UBYTE NO_COMPU_METHOD 0 0 0 255 ECU_ADDRESS 0x3F8F51 FORMAT "%.4g" /end MEASUREMENT
/begin MEASUREMENT can_brp "Bremsdruck [RAM name from V530, voted 6]" UBYTE M_FORMULA_0129 0 0 0 255 ECU_ADDRESS 0x3F8F52 /end MEASUREMENT
/begin MEASUREMENT can_lrw_st "Lenkradwinkel Status [RAM name from V530, voted 3]" UBYTE NO_COMPU_METHOD 0 0 0 255 ECU_ADDRESS 0x3F8F54 FORMAT "%.4g" /end MEASUREMENT
/begin MEASUREMENT can_brp_grad "Gradient Bremsdruck [RAM name from V530, voted 5]" SWORD M_FORMULA_0131 0 0 -1638400 1638350 ECU_ADDRESS 0x3F8F56 /end MEASUREMENT
/begin MEASUREMENT can_lrw "Lenkradwinkel [RAM name from V530, voted 3]" SWORD M_FORMULA_0132 0 0 -1440.1536 1440.10965 ECU_ADDRESS 0x3F8F58 /end MEASUREMENT
/begin MEASUREMENT can_lrw_v "Lenkradwinkel-Geschw [RAM name from V530, voted 1]" SWORD M_FORMULA_0133 0 0 -1440.1536 1440.10965 ECU_ADDRESS 0x3F8F5A /end MEASUREMENT
/begin MEASUREMENT can_klst_s "Klemmenstatus [RAM name from V530, voted 43]" UBYTE NO_COMPU_METHOD 0 0 0 255 ECU_ADDRESS 0x3F8F5C FORMAT "%.4g" /end MEASUREMENT
/begin MEASUREMENT can_dkg_kupp_ist "Kupplungsmoment [RAM name from V530, voted 2]" SWORD M_FORMULA_0120 0 0 -16384 16383.5 ECU_ADDRESS 0x3F8F64 /end MEASUREMENT
/begin MEASUREMENT can_st_bedfgr "Empfangsstatus BedFgr [RAM name from V530, voted 3]" UWORD NO_COMPU_METHOD 0 0 0 65535 ECU_ADDRESS 0x3F90E4 FORMAT "%.4g" /end MEASUREMENT
/begin MEASUREMENT can_bedfgr "FGR-Taster [RAM name from V530, voted 2]" UBYTE NO_COMPU_METHOD 0 0 0 255 ECU_ADDRESS 0x3F90E6 FORMAT "%.4g" /end MEASUREMENT
/begin MEASUREMENT kl87_st "KL87-Status [RAM name from V530, voted 14]" UBYTE NO_COMPU_METHOD 0 0 0 255 ECU_ADDRESS 0x3F8F9D FORMAT "%.4g" /end MEASUREMENT
/begin MEASUREMENT zust_tmot_start "tmot im Zustand START [RAM name from V530, voted 6]" SWORD M_FORMULA_0023 0 0 -3550 3003.5 ECU_ADDRESS 0x3F8F74 /end MEASUREMENT
/begin MEASUREMENT zust_tka_start "tka im Zustand START [RAM name from V530, voted 1]" SWORD M_FORMULA_0023 0 0 -3550 3003.5 ECU_ADDRESS 0x3F8F76 /end MEASUREMENT
/begin MEASUREMENT zustand_motor "Betriebszustand der Motorsteuerung [RAM name from V530, voted 71]" UWORD NO_COMPU_METHOD 0 0 0 65535 ECU_ADDRESS 0x3F8F7A FORMAT "%.4g" /end MEASUREMENT
/begin MEASUREMENT mvac_rf_sr "Fuellung MVAC [RAM name from V530, voted 5]" SWORD M_FORMULA_0007 0 0 -3.2768 3.2767 ECU_ADDRESS 0x3F8F84 /end MEASUREMENT
/begin MEASUREMENT mvac_rf_sr_b_b1 "Fuellung MVAC bankspezifisch [RAM name from V530, voted 1]" SWORD M_FORMULA_0007 0 0 -3.2768 3.2767 ECU_ADDRESS 0x3F8F86 /end MEASUREMENT
/begin MEASUREMENT kva_can "Letzter Kraftstoffverbrauch in ul (0xFFFF = Fehler) [RAM name from V530, voted 1]" UWORD M_FORMULA_0144 0 0 0 65.535 ECU_ADDRESS 0x3F8F8A /end MEASUREMENT
/begin MEASUREMENT v_max_delta "Delta zur Maximalgeschwindigkeit [RAM name from V530, voted 1]" SWORD M_FORMULA_0076 0 0 -2048 2047.9375 ECU_ADDRESS 0x3F8F8C /end MEASUREMENT
/begin MEASUREMENT sl_ml_hfm "gefilterter SLP-Luftmassenstrom [RAM name from V530, voted 1]" SWORD M_FORMULA_0103 0 0 -3276.8 3276.7 ECU_ADDRESS 0x3F8F8E /end MEASUREMENT
/begin MEASUREMENT time_ms "Zeit seit Motor steht [RAM name from V530, voted 6]" ULONG M_FORMULA_0145 0 0 0 71582788.25 ECU_ADDRESS 0x3F8F90 /end MEASUREMENT
/begin MEASUREMENT mvac_p_modell "Absolutdruck(Modell) im Mastervac [RAM name from V530, voted 3]" SWORD M_FORMULA_0075 0 0 -2048 2047.9375 ECU_ADDRESS 0x3F8F94 /end MEASUREMENT
/begin MEASUREMENT mvac_pdiff_um "Differenzdruck(Modell) Mastervac/Umgebung [RAM name from V530, voted 3]" SWORD M_FORMULA_0075 0 0 -2048 2047.9375 ECU_ADDRESS 0x3F8F96 /end MEASUREMENT
/begin MEASUREMENT mvac_p_mess "berechneter Absolutdruck(Sensor) im Mastervac [RAM name from V530, voted 3]" SWORD M_FORMULA_0075 0 0 -2048 2047.9375 ECU_ADDRESS 0x3F8F98 /end MEASUREMENT
/begin MEASUREMENT mvac_p "gemessener Differenzdruck(Senor) Mastervac/Umgebung [RAM name from V530, voted 11]" SWORD M_FORMULA_0075 0 0 -2048 2047.9375 ECU_ADDRESS 0x3F8F9A /end MEASUREMENT
/begin MEASUREMENT time_ml "3HaxenSchnurrZeit [RAM name from V530, voted 38]" ULONG M_FORMULA_0147 0 0 0 42949672.95 ECU_ADDRESS 0x3F8FC4 /end MEASUREMENT
/begin MEASUREMENT time_ll "Zeit seit Eintritt LL [RAM name from V530, voted 2]" ULONG M_FORMULA_0147 0 0 0 42949672.95 ECU_ADDRESS 0x3F8FD4 /end MEASUREMENT
/begin MEASUREMENT time_kl15_on "Zeit seit Kl15 an [RAM name from V530, voted 7]" ULONG M_FORMULA_0147 0 0 0 42949672.95 ECU_ADDRESS 0x3F8FD0 /end MEASUREMENT
/begin MEASUREMENT time_kl15_off "Zeit seit Kl15 aus [RAM name from V530, voted 2]" ULONG M_FORMULA_0147 0 0 0 42949672.95 ECU_ADDRESS 0x3F8FD4 /end MEASUREMENT
/begin MEASUREMENT time_sa "Zeit seit SA [RAM name from V530, voted 3]" ULONG M_FORMULA_0147 0 0 0 42949672.95 ECU_ADDRESS 0x3F8FD8 /end MEASUREMENT
/begin MEASUREMENT n_begr_egas "Drehzahlbegrenzung ueber Momenteneingriff [RAM name from V530, voted 2]" SWORD M_FORMULA_0006 0 0 -32768 32767 ECU_ADDRESS 0x3F8FE2 /end MEASUREMENT
/begin MEASUREMENT n_begr_st "Statusvariable Drehzahlbegrenzung [RAM name from V530, voted 6]" UBYTE NO_COMPU_METHOD 0 0 0 255 ECU_ADDRESS 0x3F8FE4 FORMAT "%.4g" /end MEASUREMENT
/begin MEASUREMENT n_dyn_st "Statusvariable Drehzahldynamik [RAM name from V530, voted 7]" UBYTE NO_COMPU_METHOD 0 0 0 255 ECU_ADDRESS 0x3F8FE5 FORMAT "%.4g" /end MEASUREMENT
/begin MEASUREMENT schalter_bls_inj "Schalterstatus [RAM name from V530, voted 51]" UWORD NO_COMPU_METHOD 0 0 0 65535 ECU_ADDRESS 0x3F8FE6 FORMAT "%.4g" /end MEASUREMENT
/begin MEASUREMENT schalter_getriebe "Schalterstatus [RAM name from V530, voted 51]" UWORD NO_COMPU_METHOD 0 0 0 65535 ECU_ADDRESS 0x3F8FE6 FORMAT "%.4g" /end MEASUREMENT
/begin MEASUREMENT schalter_kraft_hs "Kraftschluss beim Handschalter [RAM name from V530, voted 51]" UWORD NO_COMPU_METHOD 0 0 0 65535 ECU_ADDRESS 0x3F8FE6 FORMAT "%.4g" /end MEASUREMENT
/begin MEASUREMENT schalter_kupplung "Schalterstatus [RAM name from V530, voted 51]" UWORD NO_COMPU_METHOD 0 0 0 65535 ECU_ADDRESS 0x3F8FE6 FORMAT "%.4g" /end MEASUREMENT
/begin MEASUREMENT schalter_poel "Schalterstatus [RAM name from V530, voted 51]" UWORD NO_COMPU_METHOD 0 0 0 65535 ECU_ADDRESS 0x3F8FE6 FORMAT "%.4g" /end MEASUREMENT
/begin MEASUREMENT schalter_power "Schalterstatus [RAM name from V530, voted 51]" UWORD NO_COMPU_METHOD 0 0 0 65535 ECU_ADDRESS 0x3F8FE6 FORMAT "%.4g" /end MEASUREMENT
/begin MEASUREMENT schalter_schaltung "Schalterstatus [RAM name from V530, voted 51]" UWORD NO_COMPU_METHOD 0 0 0 65535 ECU_ADDRESS 0x3F8FE6 FORMAT "%.4g" /end MEASUREMENT
/begin MEASUREMENT schalter_st_inj "Schalterstatus [RAM name from V530, voted 51]" UWORD M_FORMULA_0080 0 0 0 65535 ECU_ADDRESS 0x3F8FE6 /end MEASUREMENT
/begin MEASUREMENT schalter_wakeup_inj "Schalterstatus [RAM name from V530, voted 51]" UWORD NO_COMPU_METHOD 0 0 0 65535 ECU_ADDRESS 0x3F8FE6 FORMAT "%.4g" /end MEASUREMENT
/begin MEASUREMENT schalter_zustand_poel "Schalterstatus [RAM name from V530, voted 51]" UWORD NO_COMPU_METHOD 0 0 0 65535 ECU_ADDRESS 0x3F8FE6 FORMAT "%.4g" /end MEASUREMENT
/begin MEASUREMENT schalter_bls_inj_e2 "Schalterstatus Ebene 2 [RAM name from V530, voted 1]" UWORD NO_COMPU_METHOD 0 0 0 65535 ECU_ADDRESS 0x3F8FE8 FORMAT "%.4g" /end MEASUREMENT
/begin MEASUREMENT schalter_getriebe_e2 "Schalterstatus Ebene 2 [RAM name from V530, voted 1]" UWORD NO_COMPU_METHOD 0 0 0 65535 ECU_ADDRESS 0x3F8FE8 FORMAT "%.4g" /end MEASUREMENT
/begin MEASUREMENT schalter_kraft_hs_e2 "Kraftschluss beim Handschalter Ebene 2 [RAM name from V530, voted 1]" UWORD NO_COMPU_METHOD 0 0 0 65535 ECU_ADDRESS 0x3F8FE8 FORMAT "%.4g" /end MEASUREMENT
/begin MEASUREMENT schalter_kupplung_e2 "Schalterstatus Ebene 2 [RAM name from V530, voted 1]" UWORD NO_COMPU_METHOD 0 0 0 65535 ECU_ADDRESS 0x3F8FE8 FORMAT "%.4g" /end MEASUREMENT
/begin MEASUREMENT schalter_poel_e2 "Schalterstatus Ebene 2 [RAM name from V530, voted 1]" UWORD NO_COMPU_METHOD 0 0 0 65535 ECU_ADDRESS 0x3F8FE8 FORMAT "%.4g" /end MEASUREMENT
/begin MEASUREMENT schalter_power_e2 "Schalterstatus Ebene 2 [RAM name from V530, voted 1]" UWORD NO_COMPU_METHOD 0 0 0 65535 ECU_ADDRESS 0x3F8FE8 FORMAT "%.4g" /end MEASUREMENT
/begin MEASUREMENT schalter_schaltung_e2 "Schalterstatus Ebene 2 [RAM name from V530, voted 1]" UWORD NO_COMPU_METHOD 0 0 0 65535 ECU_ADDRESS 0x3F8FE8 FORMAT "%.4g" /end MEASUREMENT
/begin MEASUREMENT schalter_st_inj_e2 "Schalterstatus Ebene 2 [RAM name from V530, voted 1]" UWORD M_FORMULA_0080 0 0 0 65535 ECU_ADDRESS 0x3F8FE8 /end MEASUREMENT
/begin MEASUREMENT schalter_wakeup_inj_e2 "Schalterstatus Ebene 2 [RAM name from V530, voted 1]" UWORD NO_COMPU_METHOD 0 0 0 65535 ECU_ADDRESS 0x3F8FE8 FORMAT "%.4g" /end MEASUREMENT
/begin MEASUREMENT schalter_zustand_poel_e2 "Schalterstatus Ebene 2 [RAM name from V530, voted 1]" UWORD NO_COMPU_METHOD 0 0 0 65535 ECU_ADDRESS 0x3F8FE8 FORMAT "%.4g" /end MEASUREMENT
/begin MEASUREMENT pksr_ekp_ansteuerung_cfg "Configuration EKP Ansteuerung [RAM name from V530, voted 2]" UBYTE NO_COMPU_METHOD 0 0 0 255 ECU_ADDRESS 0x3F8FED FORMAT "%.4g" /end MEASUREMENT
/begin MEASUREMENT pksr_tv_ekp "auszugebendes TV inkl. Hardware-Anpassung [RAM name from V530, voted 4]" SWORD M_FORMULA_0161 0 0 -3200 3199.902344 ECU_ADDRESS 0x3F8FEE /end MEASUREMENT
/begin MEASUREMENT pctrl_t_inj "Werte fuer die Prozessorkontrolle [RAM name from V530, voted 1]" ULONG M_FORMULA_0000 0 0 0 4294967295 ECU_ADDRESS 0x3F8FF4 /end MEASUREMENT
/begin MEASUREMENT nwm_state "Zustand vom NWM [RAM name from V530, voted 7]" UBYTE NO_COMPU_METHOD 0 0 0 255 ECU_ADDRESS 0x3F8FF8 FORMAT "%.4g" /end MEASUREMENT
/begin MEASUREMENT can_flags "Allg. CAN-Flags [RAM name from V530, voted 21]" UBYTE M_FORMULA_0003 0 0 0 255 ECU_ADDRESS 0x3F8FF9 /end MEASUREMENT
/begin MEASUREMENT mdrv_st "MDRV-Status (CAN) [RAM name from V530, voted 5]" UBYTE NO_COMPU_METHOD 0 0 0 255 ECU_ADDRESS 0x3F8FFA FORMAT "%.4g" /end MEASUREMENT
/begin MEASUREMENT mdrv_st_dme "MDRV-Status [RAM name from V530, voted 7]" UBYTE NO_COMPU_METHOD 0 0 0 255 ECU_ADDRESS 0x3F8FFB FORMAT "%.4g" /end MEASUREMENT
/begin MEASUREMENT toel_can "gefilterte Motoroeltemperatur (0xFF = Fehler). [RAM name from V530, voted 1]" UBYTE M_FORMULA_0165 0 0 -48 207 ECU_ADDRESS 0x3F8FFC /end MEASUREMENT
/begin MEASUREMENT dwf_n_orange "oranger Drehzahlbereich [RAM name from V530, voted 3]" UBYTE M_FORMULA_0166 0 0 0 12750 ECU_ADDRESS 0x3F8FFD /end MEASUREMENT
/begin MEASUREMENT sk_egas_off_inj "SK-Egasstufe [RAM name from V530, voted 3]" UBYTE NO_COMPU_METHOD 0 0 0 255 ECU_ADDRESS 0x3F8FFE FORMAT "%.4g" /end MEASUREMENT
/begin MEASUREMENT sk_md_begr_inj "SK-Begrenzungsstufe [RAM name from V530, voted 3]" UBYTE NO_COMPU_METHOD 0 0 0 255 ECU_ADDRESS 0x3F8FFF FORMAT "%.4g" /end MEASUREMENT
/begin MEASUREMENT sk_md_eingr_inj "SK-Md-Eingriff [RAM name from V530, voted 5]" UBYTE M_FORMULA_0003 0 0 0 255 ECU_ADDRESS 0x3F9000 /end MEASUREMENT
/begin MEASUREMENT sk_ti_eingr_inj "SK-TI-Eingriff [RAM name from V530, voted 5]" UBYTE NO_COMPU_METHOD 0 0 0 255 ECU_ADDRESS 0x3F9000 FORMAT "%.4g" /end MEASUREMENT
/begin MEASUREMENT sk_tz_eingr_inj "SK-TZ-Eingriff [RAM name from V530, voted 5]" UBYTE NO_COMPU_METHOD 0 0 0 255 ECU_ADDRESS 0x3F9000 FORMAT "%.4g" /end MEASUREMENT
/begin MEASUREMENT sk_lam_st_inj_b1 "SK-LAM-Eingriff [RAM name from V530, voted 12]" UBYTE NO_COMPU_METHOD 0 0 0 255 ECU_ADDRESS 0x3F9001 FORMAT "%.4g" /end MEASUREMENT
/begin MEASUREMENT sk_lam_st_inj_b2 "SK-LAM-Eingriff [RAM name from V530, voted 12]" UBYTE NO_COMPU_METHOD 0 0 0 255 ECU_ADDRESS 0x3F9001 FORMAT "%.4g" /end MEASUREMENT
/begin MEASUREMENT sk_van_st_inj "SK-Vanos-Eingriff [RAM name from V530, voted 4]" UBYTE NO_COMPU_METHOD 0 0 0 255 ECU_ADDRESS 0x3F9002 FORMAT "%.4g" /end MEASUREMENT
/begin MEASUREMENT sk_eingr_st_inj "SK-Eingriff [RAM name from V530, voted 6]" UBYTE M_FORMULA_0003 0 0 0 255 ECU_ADDRESS 0x3F9003 /end MEASUREMENT
/begin MEASUREMENT sk_fr_st_inj "SK-Eingriff FR [RAM name from V530, voted 6]" UBYTE NO_COMPU_METHOD 0 0 0 255 ECU_ADDRESS 0x3F9003 FORMAT "%.4g" /end MEASUREMENT
/begin MEASUREMENT sk_fra_st_inj "SK-Eingriff FRA [RAM name from V530, voted 6]" UBYTE NO_COMPU_METHOD 0 0 0 255 ECU_ADDRESS 0x3F9003 FORMAT "%.4g" /end MEASUREMENT
/begin MEASUREMENT sk_kh_st_inj "SK-Eingriff KH [RAM name from V530, voted 6]" UBYTE NO_COMPU_METHOD 0 0 0 255 ECU_ADDRESS 0x3F9003 FORMAT "%.4g" /end MEASUREMENT
/begin MEASUREMENT sk_llra_st_inj "SK-Eingriff LLRA [RAM name from V530, voted 6]" UBYTE NO_COMPU_METHOD 0 0 0 255 ECU_ADDRESS 0x3F9003 FORMAT "%.4g" /end MEASUREMENT
/begin MEASUREMENT sk_mzyl_st_inj "SK-Eingriff MZYL [RAM name from V530, voted 6]" UBYTE NO_COMPU_METHOD 0 0 0 255 ECU_ADDRESS 0x3F9003 FORMAT "%.4g" /end MEASUREMENT
/begin MEASUREMENT sk_pks_st_inj "SK-Eingriff PKS [RAM name from V530, voted 6]" UBYTE NO_COMPU_METHOD 0 0 0 255 ECU_ADDRESS 0x3F9003 FORMAT "%.4g" /end MEASUREMENT
/begin MEASUREMENT sk_ti_zyl_off_inj "SK-Ausblendungen [RAM name from V530, voted 12]" UWORD NO_COMPU_METHOD 0 0 0 65535 ECU_ADDRESS 0x3F9004 FORMAT "%.4g" /end MEASUREMENT
/begin MEASUREMENT sls_obdh_st "Status des SL-Systems [RAM name from V530, voted 20]" UWORD NO_COMPU_METHOD 0 0 0 65535 ECU_ADDRESS 0x3F9006 FORMAT "%.4g" /end MEASUREMENT
/begin MEASUREMENT zustand_fahrzeug "Fahrzeugzustand [RAM name from V530, voted 2]" UWORD NO_COMPU_METHOD 0 0 0 65535 ECU_ADDRESS 0x3F9008 FORMAT "%.4g" /end MEASUREMENT
/begin MEASUREMENT te_rf_ist_b2 "Fuellung aus Tankentlueftung [RAM name from V530, voted 1]" SWORD M_FORMULA_0007 0 0 -3.2768 3.2767 ECU_ADDRESS 0x3F900C /end MEASUREMENT
/begin MEASUREMENT elup_st "Status ELUP [RAM name from V530, voted 16]" UBYTE NO_COMPU_METHOD 0 0 0 255 ECU_ADDRESS 0x3F9016 FORMAT "%.4g" /end MEASUREMENT
/begin MEASUREMENT pksr_exd_zust_pl "Zustand Statemaschine Prueflauf [RAM name from V530, voted 3]" UWORD NO_COMPU_METHOD 0 0 0 65535 ECU_ADDRESS 0x3F9018 FORMAT "%.4g" /end MEASUREMENT
/begin MEASUREMENT toel_wanne "Oeltemperatur am QLT (Oelwanne) [RAM name from V530, voted 6]" SWORD M_FORMULA_0023 0 0 -3550 3003.5 ECU_ADDRESS 0x3F9044 /end MEASUREMENT
/begin MEASUREMENT laa_f_ber_nv_b1 "Faktor-Lambdaadaption ohne TE [RAM name from V530, voted 6]" UWORD M_FORMULA_0024 0 0 0 1.999969482 ECU_ADDRESS 0x3F9046 /end MEASUREMENT
/begin MEASUREMENT laa_f_ber_nv_b2 "Faktor-Lambdaadaption ohne TE [RAM name from V530, voted 1]" UWORD M_FORMULA_0024 0 0 0 1.999969482 ECU_ADDRESS 0x3F9048 /end MEASUREMENT
/begin MEASUREMENT kat_obd_wert_nv_b1 "gem., gewichtete Abweichung z. MW [RAM name from V530, voted 9]" UWORD M_FORMULA_0025 0 0 0 3.999938965 ECU_ADDRESS 0x3F904A /end MEASUREMENT
/begin MEASUREMENT kat_obd_wert_nv_b2 "gem., gewichtete Abweichung z. MW [RAM name from V530, voted 6]" UWORD M_FORMULA_0025 0 0 0 3.999938965 ECU_ADDRESS 0x3F904C /end MEASUREMENT
/begin MEASUREMENT kat_obd_wert_gesamt_nv "Gesamtsystemdiagnosewert [RAM name from V530, voted 3]" UWORD M_FORMULA_0025 0 0 0 3.999938965 ECU_ADDRESS 0x3F904E /end MEASUREMENT
/begin MEASUREMENT kwp_fetrawe_st "kwp_fetrawe_st [RAM name from V530, voted 10]" UBYTE NO_COMPU_METHOD 0 0 0 255 ECU_ADDRESS 0x3F9050 FORMAT "%.4g" /end MEASUREMENT
/begin MEASUREMENT ed_fsp_inj_fehlerzaehler_nv "Zaehler zum Fehlersortieren [RAM name from V530, voted 3]" UWORD M_FORMULA_0010 0 0 0 65535 ECU_ADDRESS 0x3F9052 /end MEASUREMENT
/begin MEASUREMENT can_km_stand_nv "Kilometerstand [RAM name from V530, voted 17]" ULONG M_FORMULA_0027 0 0 0 4294967295 ECU_ADDRESS 0x3F9054 /end MEASUREMENT
/begin MEASUREMENT can_fzgtyp_land_nv "Laendervariante [RAM name from V530, voted 1]" UBYTE NO_COMPU_METHOD 0 0 0 255 ECU_ADDRESS 0x3F9058 FORMAT "%.4g" /end MEASUREMENT
/begin MEASUREMENT can_fzgtyp_clas_pwr_nv "Variante v_max-Anhebung [RAM name from V530, voted 1]" UBYTE NO_COMPU_METHOD 0 0 0 255 ECU_ADDRESS 0x3F905B FORMAT "%.4g" /end MEASUREMENT
/begin MEASUREMENT can_fzgtyp_grb_nv "Getriebevariante [RAM name from V530, voted 16]" UBYTE NO_COMPU_METHOD 0 0 0 255 ECU_ADDRESS 0x3F905C FORMAT "%.4g" /end MEASUREMENT
/begin MEASUREMENT elu_nl_nv "PWM-Signal der letzten ELU-Nachlaufanforderung [RAM name from V530, voted 2]" UBYTE M_FORMULA_0032 0 0 0 255 ECU_ADDRESS 0x3F905D /end MEASUREMENT
/begin MEASUREMENT rf_dyn_delta "Delta gefiltert zum ungefiltertem [RAM name from V530, voted 5]" SWORD M_FORMULA_0186 0 0 -3.2768 3.2767 ECU_ADDRESS 0x3F907E /end MEASUREMENT
/begin MEASUREMENT rf_fil_b1 "PT1 gefiltertes rf. [RAM name from V530, voted 1]" SWORD M_FORMULA_0007 0 0 -3.2768 3.2767 ECU_ADDRESS 0x3F9080 /end MEASUREMENT
/begin MEASUREMENT rf_grad_b1 "Rf Gradient. [RAM name from V530, voted 1]" SWORD M_FORMULA_0187 0 0 -327.68 327.67 ECU_ADDRESS 0x3F9084 /end MEASUREMENT
/begin MEASUREMENT pumg "Gefilterter Messwert [RAM name from V530, voted 27]" SWORD M_FORMULA_0075 0 0 -2048 2047.9375 ECU_ADDRESS 0x3F9088 /end MEASUREMENT
/begin MEASUREMENT tumg "Umgebungstemperatur [RAM name from V530, voted 13]" SWORD M_FORMULA_0023 0 0 -3550 3003.5 ECU_ADDRESS 0x3F9094 /end MEASUREMENT
/begin MEASUREMENT tumg_st "Status Umgebungstemperatur [RAM name from V530, voted 9]" UBYTE NO_COMPU_METHOD 0 0 0 255 ECU_ADDRESS 0x3F9096 FORMAT "%.4g" /end MEASUREMENT
/begin MEASUREMENT time_st "Status Zeiten [RAM name from V530, voted 10]" UBYTE NO_COMPU_METHOD 0 0 0 255 ECU_ADDRESS 0x3F9097 FORMAT "%.4g" /end MEASUREMENT
/begin MEASUREMENT time_rel "Relativzeit [RAM name from V530, voted 9]" ULONG M_FORMULA_0145 0 0 0 71582788.25 ECU_ADDRESS 0x3F9098 /end MEASUREMENT
/begin MEASUREMENT time_abs "Absolutzeit seit 1.1.2000 [RAM name from V530, voted 1]" UWORD M_FORMULA_0190 0 0 0 65535 ECU_ADDRESS 0x3F909C /end MEASUREMENT
/begin MEASUREMENT can_kmst_st "Status km-Stand [RAM name from V530, voted 11]" UBYTE NO_COMPU_METHOD 0 0 0 255 ECU_ADDRESS 0x3F90A0 FORMAT "%.4g" /end MEASUREMENT
/begin MEASUREMENT Oz_tempr "Rohwert ???ltemperaturmessung vom Sensor [RAM name from V530, voted 2]" UBYTE M_FORMULA_0192 0 0 -55.2 174.3 ECU_ADDRESS 0x3F90A1 /end MEASUREMENT
/begin MEASUREMENT slp_st "SLP Status [RAM name from V530, voted 28]" UWORD NO_COMPU_METHOD 0 0 0 65535 ECU_ADDRESS 0x3F90A4 FORMAT "%.4g" /end MEASUREMENT
/begin MEASUREMENT v_tacho "Tachogeschwindigkeit [RAM name from V530, voted 1]" SWORD M_FORMULA_0076 0 0 -2048 2047.9375 ECU_ADDRESS 0x3F90A8 /end MEASUREMENT
/begin MEASUREMENT can_stkombi_fgr "FGR-Info vom Kombi [RAM name from V530, voted 2]" UBYTE NO_COMPU_METHOD 0 0 0 255 ECU_ADDRESS 0x3F90AA FORMAT "%.4g" /end MEASUREMENT
/begin MEASUREMENT B_CAN_ANHAENGER "Anhaenger [RAM name from V530, voted 12]" UBYTE NO_COMPU_METHOD 0 0 0 255 ECU_ADDRESS 0x3F90AB FORMAT "%.4g" /end MEASUREMENT
/begin MEASUREMENT B_CAN_HBR "Handbremse [RAM name from V530, voted 12]" UBYTE NO_COMPU_METHOD 0 0 0 255 ECU_ADDRESS 0x3F90AB FORMAT "%.4g" /end MEASUREMENT
/begin MEASUREMENT B_CAN_KOMBI_MIL "HMIL-Info vom Kombi [RAM name from V530, voted 12]" UBYTE NO_COMPU_METHOD 0 0 0 255 ECU_ADDRESS 0x3F90AB FORMAT "%.4g" /end MEASUREMENT
/begin MEASUREMENT can_stkombi_s "Schalter-Infos vom Kombi [RAM name from V530, voted 12]" UBYTE M_FORMULA_0003 0 0 0 255 ECU_ADDRESS 0x3F90AB /end MEASUREMENT
/begin MEASUREMENT van_exd_n_soll "Van Prueflauf LLR-Sollwert [RAM name from V530, voted 4]" SWORD M_FORMULA_0006 0 0 -32768 32767 ECU_ADDRESS 0x3F90AC /end MEASUREMENT
/begin MEASUREMENT te_c_akf "Konzentration - AKF [RAM name from V530, voted 10]" UWORD M_FORMULA_0199 0 0 0 3.999938965 ECU_ADDRESS 0x3F90B4 /end MEASUREMENT
/begin MEASUREMENT B_TE_OBD_ABBRUCH "Abbruch der LL-Messung [RAM name from V530, voted 29]" UBYTE NO_COMPU_METHOD 0 0 0 255 ECU_ADDRESS 0x3F90BC FORMAT "%.4g" /end MEASUREMENT
/begin MEASUREMENT B_TE_OBD_CHECK "TEV-Check laeuft [RAM name from V530, voted 29]" UBYTE NO_COMPU_METHOD 0 0 0 255 ECU_ADDRESS 0x3F90BC FORMAT "%.4g" /end MEASUREMENT
/begin MEASUREMENT B_TE_OBD_KKOS_ABSCH "Abwurf KKOS wegen Fehlmessung TE_OBD [RAM name from V530, voted 29]" UBYTE NO_COMPU_METHOD 0 0 0 255 ECU_ADDRESS 0x3F90BC FORMAT "%.4g" /end MEASUREMENT
/begin MEASUREMENT B_TE_OBD_KKOS_FAIL "Merker Fehler mit KKOS [RAM name from V530, voted 29]" UBYTE NO_COMPU_METHOD 0 0 0 255 ECU_ADDRESS 0x3F90BC FORMAT "%.4g" /end MEASUREMENT
/begin MEASUREMENT B_TE_OBD_LAM_REG_OFF "Abwurf Lambda Regler wegen TE_OBD [RAM name from V530, voted 29]" UBYTE NO_COMPU_METHOD 0 0 0 255 ECU_ADDRESS 0x3F90BC FORMAT "%.4g" /end MEASUREMENT
/begin MEASUREMENT B_TE_OBD_PRE_CHECK "TEV-Check laeuft (bald) [RAM name from V530, voted 29]" UBYTE NO_COMPU_METHOD 0 0 0 255 ECU_ADDRESS 0x3F90BC FORMAT "%.4g" /end MEASUREMENT
/begin MEASUREMENT B_TE_OBD_S_BLS_OLD "Merker Bremslichtschalter [RAM name from V530, voted 29]" UBYTE NO_COMPU_METHOD 0 0 0 255 ECU_ADDRESS 0x3F90BC FORMAT "%.4g" /end MEASUREMENT
/begin MEASUREMENT B_TE_OBD_START_EXD "Start ueber Tester [RAM name from V530, voted 29]" UBYTE NO_COMPU_METHOD 0 0 0 255 ECU_ADDRESS 0x3F90BC FORMAT "%.4g" /end MEASUREMENT
/begin MEASUREMENT te_obd_flags "Flags der TE_OBD [RAM name from V530, voted 29]" UBYTE M_FORMULA_0003 0 0 0 255 ECU_ADDRESS 0x3F90BC /end MEASUREMENT
/begin MEASUREMENT lavk_obd_error "Status LAMBDA-FEHLER im System [RAM name from V530, voted 27]" UWORD M_FORMULA_0010 0 0 0 65535 ECU_ADDRESS 0x3F90BE /end MEASUREMENT
/begin MEASUREMENT lavk_obd_act_exd_n_soll "Prueflauf - angeforderte Drehzahl [RAM name from V530, voted 2]" SWORD M_FORMULA_0006 0 0 -32768 32767 ECU_ADDRESS 0x3F90C2 /end MEASUREMENT
/begin MEASUREMENT lavk_obd_dyn_kat_exd_n_soll "Prueflauf - angeforderte Drehzahl [RAM name from V530, voted 3]" SWORD M_FORMULA_0006 0 0 -32768 32767 ECU_ADDRESS 0x3F90C4 /end MEASUREMENT
/begin MEASUREMENT hdw_inj_st "hdw_inj_st [RAM name from V530, voted 2]" UBYTE M_FORMULA_0003 0 0 0 255 ECU_ADDRESS 0x3F90C6 /end MEASUREMENT
/begin MEASUREMENT hdw_inj "hdw_inj [RAM name from V530, voted 2]" ULONG M_FORMULA_0000 0 0 0 4294967295 ECU_ADDRESS 0x3F90C8 /end MEASUREMENT
/begin MEASUREMENT sw_confg_betriebsmode_exd "vom Tester eingestellter Betriebsmode [RAM name from V530, voted 16]" UBYTE NO_COMPU_METHOD 0 0 0 255 ECU_ADDRESS 0x3F90CF FORMAT "%.4g" /end MEASUREMENT
/begin MEASUREMENT elup_ed_st "ELUP-Fehler [RAM name from V530, voted 1]" UBYTE NO_COMPU_METHOD 0 0 0 255 ECU_ADDRESS 0x3F90D0 FORMAT "%.4g" /end MEASUREMENT
/begin MEASUREMENT tgetr "Getriebetemperatur [RAM name from V530, voted 3]" SWORD M_FORMULA_0023 0 0 -3550 3003.5 ECU_ADDRESS 0x3F90D2 /end MEASUREMENT
/begin MEASUREMENT start_rl_atic39_dpr "Treiberinfo vom Startrelais [RAM name from V530, voted 5]" UBYTE NO_COMPU_METHOD 0 0 0 255 ECU_ADDRESS 0x3F90F4 FORMAT "%.4g" /end MEASUREMENT
/begin MEASUREMENT rf_pt_korr "Korrektur der relativen Fuellung [RAM name from V530, voted 2]" UWORD M_FORMULA_0073 0 0 0 63.99902344 ECU_ADDRESS 0x3F90F6 /end MEASUREMENT
/begin MEASUREMENT rf_pt_korr_zyl "Korrektur der relativen Fuellung im Zylinder [RAM name from V530, voted 1]" UWORD M_FORMULA_0073 0 0 0 63.99902344 ECU_ADDRESS 0x3F90F8 /end MEASUREMENT
/begin MEASUREMENT B_VAN_NICHT_NORM "Vanos Fehler oder ext. Diag [RAM name from V530, voted 17]" UBYTE NO_COMPU_METHOD 0 0 0 255 ECU_ADDRESS 0x3F90FC FORMAT "%.4g" /end MEASUREMENT
/begin MEASUREMENT van_exd_st "Diagnosestatus Vanos [RAM name from V530, voted 17]" UBYTE NO_COMPU_METHOD 0 0 0 255 ECU_ADDRESS 0x3F90FC FORMAT "%.4g" /end MEASUREMENT
/begin MEASUREMENT B_VAN_SK "Notprogramm wegen Vanos [RAM name from V530, voted 9]" UBYTE NO_COMPU_METHOD 0 0 0 255 ECU_ADDRESS 0x3F90FD FORMAT "%.4g" /end MEASUREMENT
/begin MEASUREMENT van_sk_st "Status Notprogramm wegen Vanos [RAM name from V530, voted 9]" UBYTE M_FORMULA_0003 0 0 0 255 ECU_ADDRESS 0x3F90FD /end MEASUREMENT
/begin MEASUREMENT ccp_fp_st_inj "Status CCP-FP [RAM name from V530, voted 3]" UBYTE NO_COMPU_METHOD 0 0 0 255 ECU_ADDRESS 0x3F90FE FORMAT "%.4g" /end MEASUREMENT
/begin MEASUREMENT kwp_fp_st_inj "Status KWP-FP [RAM name from V530, voted 1]" UBYTE M_FORMULA_0003 0 0 0 255 ECU_ADDRESS 0x3F90FF /end MEASUREMENT
/begin MEASUREMENT exd_tester_timeout "Testertimeout [RAM name from V530, voted 32]" UBYTE M_FORMULA_0214 0 0 0 255 ECU_ADDRESS 0x3F9100 /end MEASUREMENT
/begin MEASUREMENT mdrv_st_dsc_akt "MDRV-Status DSC (CAN) [RAM name from V530, voted 2]" UBYTE NO_COMPU_METHOD 0 0 0 255 ECU_ADDRESS 0x3F9101 FORMAT "%.4g" /end MEASUREMENT
/begin MEASUREMENT mdrv_st_mod_smg_akt "MDRV-Status SMG (CAN) [RAM name from V530, voted 2]" UBYTE NO_COMPU_METHOD 0 0 0 255 ECU_ADDRESS 0x3F9102 FORMAT "%.4g" /end MEASUREMENT
/begin MEASUREMENT mdrv_st_stg_smg_akt "MDRV-Status Drivelogic (CAN) [RAM name from V530, voted 2]" UBYTE NO_COMPU_METHOD 0 0 0 255 ECU_ADDRESS 0x3F9103 FORMAT "%.4g" /end MEASUREMENT
/begin MEASUREMENT mdrv_st_mod_eng_akt "MDRV-Status Motor (CAN) [RAM name from V530, voted 2]" UBYTE NO_COMPU_METHOD 0 0 0 255 ECU_ADDRESS 0x3F9104 FORMAT "%.4g" /end MEASUREMENT
/begin MEASUREMENT mdrv_st_mod_edck_akt "MDRV-Status EDCK (CAN) [RAM name from V530, voted 2]" UBYTE NO_COMPU_METHOD 0 0 0 255 ECU_ADDRESS 0x3F9105 FORMAT "%.4g" /end MEASUREMENT
/begin MEASUREMENT mdrv_st_mod_albv_akt "MDRV-Status aLBV (CAN) [RAM name from V530, voted 2]" UBYTE NO_COMPU_METHOD 0 0 0 255 ECU_ADDRESS 0x3F9106 FORMAT "%.4g" /end MEASUREMENT
/begin MEASUREMENT mdrv_st_mod_hud_akt "MDRV-Status HUD (CAN) [RAM name from V530, voted 1]" UBYTE NO_COMPU_METHOD 0 0 0 255 ECU_ADDRESS 0x3F9107 FORMAT "%.4g" /end MEASUREMENT
/begin MEASUREMENT v_max_schw_direkt "Maximalgeschwindigkeit [RAM name from V530, voted 1]" SWORD M_FORMULA_0076 0 0 -2048 2047.9375 ECU_ADDRESS 0x3F910A /end MEASUREMENT
/begin MEASUREMENT v_max_schw_can "Maximalgeschwindigkeit [RAM name from V530, voted 2]" SWORD M_FORMULA_0076 0 0 -2048 2047.9375 ECU_ADDRESS 0x3F910C /end MEASUREMENT
/begin MEASUREMENT can_gang_r "Empfangsstatus StatR [RAM name from V530, voted 3]" UBYTE NO_COMPU_METHOD 0 0 0 255 ECU_ADDRESS 0x3F910F FORMAT "%.4g" /end MEASUREMENT
/begin MEASUREMENT can_crash_ctr "Crash-Kontrolle [RAM name from V530, voted 4]" UBYTE NO_COMPU_METHOD 0 0 0 255 ECU_ADDRESS 0x3F9110 FORMAT "%.4g" /end MEASUREMENT
/begin MEASUREMENT rps_tz_offs "RPS-TZ-Offset [RAM name from V530, voted 1]" SWORD M_FORMULA_0102 0 0 -3276.8 3276.7 ECU_ADDRESS 0x3F9112 /end MEASUREMENT
/begin MEASUREMENT msg_rec_cc "Status [RAM name from V530, voted 2]" UBYTE M_FORMULA_0003 0 0 0 255 ECU_ADDRESS 0x3F9126 /end MEASUREMENT
/begin MEASUREMENT msg_rec_cc_dsc "Status - DSC [RAM name from V530, voted 2]" UBYTE NO_COMPU_METHOD 0 0 0 255 ECU_ADDRESS 0x3F9126 FORMAT "%.4g" /end MEASUREMENT
/begin MEASUREMENT k2KB_req_inj "KWP [RAM name from V530, voted 6]" UBYTE M_FORMULA_0003 0 0 0 255 ECU_ADDRESS 0x3F9136 /end MEASUREMENT
/begin MEASUREMENT Nwm_var_s.state "Status [RAM name from V530, voted 1]" UBYTE M_FORMULA_0003 0 0 0 255 ECU_ADDRESS 0x3F9628 /end MEASUREMENT
/begin MEASUREMENT eeprom_crc_wichtig_nv "Lebensdauer Adaptionsdaten [RAM name from V530, voted 11]" ULONG M_FORMULA_0000 0 0 0 4294967295 ECU_ADDRESS 0x3F9C7C /end MEASUREMENT
/begin MEASUREMENT eeprom_anzahl_schreiben_nv "Anzahl der Schreibvorgaenge ins Flash [RAM name from V530, voted 6]" ULONG M_FORMULA_0571 0 0 0 4294967295 ECU_ADDRESS 0x3F9C80 /end MEASUREMENT
/begin MEASUREMENT eeprom_datenlaenge_wichtig_nv "Anzahl der Datenbytes [RAM name from V530, voted 4]" UWORD M_FORMULA_0572 0 0 0 262140 ECU_ADDRESS 0x3F9C84 /end MEASUREMENT
/begin MEASUREMENT eeprom_version_prog_nv "Programmversion beim Abspeichern [RAM name from V530, voted 7]" UWORD M_FORMULA_0573 0 0 0 65535 ECU_ADDRESS 0x3F9C86 /end MEASUREMENT
/begin MEASUREMENT eeprom_crc_nv "Standstabile Adaptionsdaten [RAM name from V530, voted 3]" ULONG M_FORMULA_0000 0 0 0 4294967295 ECU_ADDRESS 0x3F9C88 /end MEASUREMENT
/begin MEASUREMENT eeprom_datenlaenge_nv "Anzahl der Datenbytes [RAM name from V530, voted 2]" UWORD M_FORMULA_0572 0 0 0 262140 ECU_ADDRESS 0x3F9C8C /end MEASUREMENT
/begin MEASUREMENT eeprom_date "Erstelldatum beim Abspeichern [RAM name from V530, voted 4]" UBYTE NO_COMPU_METHOD 0 0 0 255 ECU_ADDRESS 0x3F9C8E FORMAT "%.4g" /end MEASUREMENT
/begin MEASUREMENT eeprom_time "Erstellzeit beim Abspeichern [RAM name from V530, voted 4]" UBYTE NO_COMPU_METHOD 0 0 0 255 ECU_ADDRESS 0x3F9C97 FORMAT "%.4g" /end MEASUREMENT
/begin MEASUREMENT hdw_1_nv "HDW [RAM name from V530, voted 8]" ULONG M_FORMULA_0000 0 0 0 4294967295 ECU_ADDRESS 0x3F9CA0 /end MEASUREMENT
/begin MEASUREMENT hdw_2_nv "HDW [RAM name from V530, voted 3]" ULONG M_FORMULA_0000 0 0 0 4294967295 ECU_ADDRESS 0x3F9CA4 /end MEASUREMENT
/begin MEASUREMENT hdw_3_nv "HDW [RAM name from V530, voted 3]" ULONG M_FORMULA_0000 0 0 0 4294967295 ECU_ADDRESS 0x3F9CA8 /end MEASUREMENT
/begin MEASUREMENT time_bz_nv "Betriebszeit der DME [RAM name from V530, voted 3]" ULONG M_FORMULA_0542 0 0 0 4294967295 ECU_ADDRESS 0x3F9CAC /end MEASUREMENT
/begin MEASUREMENT v_max_ff_v_max "Maximalgeschwindigkeit [RAM name from V530, voted 4]" SWORD M_FORMULA_0076 0 0 -2048 2047.9375 ECU_ADDRESS 0x3F9CB0 /end MEASUREMENT
/begin MEASUREMENT v_max_ff_v_max_schw "Abregelgeschwindigkeit [RAM name from V530, voted 3]" SWORD M_FORMULA_0076 0 0 -2048 2047.9375 ECU_ADDRESS 0x3F9CB2 /end MEASUREMENT
/begin MEASUREMENT v_max_ff_v_hinten "mittl. Hinterachsgeschw. [RAM name from V530, voted 3]" SWORD M_FORMULA_0076 0 0 -2048 2047.9375 ECU_ADDRESS 0x3F9CB4 /end MEASUREMENT
/begin MEASUREMENT v_max_ff_v_direkt "direkt ermittelte Fzgeschw. [RAM name from V530, voted 3]" SWORD M_FORMULA_0076 0 0 -2048 2047.9375 ECU_ADDRESS 0x3F9CB6 /end MEASUREMENT
/begin MEASUREMENT v_max_ff_km_stand "Kilometerstand [RAM name from V530, voted 2]" ULONG M_FORMULA_0027 0 0 0 4294967295 ECU_ADDRESS 0x3F9CB8 /end MEASUREMENT
/begin MEASUREMENT v_max_ff_n "Motordrehzahl [RAM name from V530, voted 3]" SWORD M_FORMULA_0006 0 0 -32768 32767 ECU_ADDRESS 0x3F9CBC /end MEASUREMENT
/begin MEASUREMENT v_max_ff_md_fahrer "Fahrerwunschmoment [RAM name from V530, voted 3]" SWORD M_FORMULA_0009 0 0 -3276.8 3276.7 ECU_ADDRESS 0x3F9CBE /end MEASUREMENT
/begin MEASUREMENT v_max_ff_md_ist "Kupplungs-Istmoment [RAM name from V530, voted 3]" SWORD M_FORMULA_0009 0 0 -3276.8 3276.7 ECU_ADDRESS 0x3F9CC0 /end MEASUREMENT
/begin MEASUREMENT v_max_ff_gang "Istgang [RAM name from V530, voted 2]" SBYTE M_FORMULA_0135 0 0 -128 127 ECU_ADDRESS 0x3F9CC2 /end MEASUREMENT
/begin MEASUREMENT n_max_ff_anzahl "Anzahl der Begrenzungsphasen [RAM name from V530, voted 2]" UWORD M_FORMULA_0010 0 0 0 65535 ECU_ADDRESS 0x3F9CC4 /end MEASUREMENT
/begin MEASUREMENT n_max_ff_nmax "Erreichte Maximaldrehzahl [RAM name from V530, voted 1]" SWORD M_FORMULA_0006 0 0 -32768 32767 ECU_ADDRESS 0x3F9CC6 /end MEASUREMENT
/begin MEASUREMENT n_max_ff_t_nbegr_egas "Einzelzeit oberhalb nbegr_egas [RAM name from V530, voted 1]" UWORD M_FORMULA_0021 0 0 0 655.35 ECU_ADDRESS 0x3F9CD6 /end MEASUREMENT
/begin MEASUREMENT n_max_ff_gang "Gang [RAM name from V530, voted 1]" SBYTE M_FORMULA_0135 0 0 -128 127 ECU_ADDRESS 0x3F9CF0 /end MEASUREMENT
/begin MEASUREMENT can_st_empf_nv "Empfangsstatus NV [RAM name from V530, voted 6]" UBYTE M_FORMULA_0003 0 0 0 255 ECU_ADDRESS 0x3F9CF2 /end MEASUREMENT
/begin MEASUREMENT stat_data_tdme_nv "tdme-Statistik ueber ECU-life-time [RAM name from V530, voted 2]" ULONG M_FORMULA_0542 0 0 0 4294967295 ECU_ADDRESS 0x3F9CF4 /end MEASUREMENT
/begin MEASUREMENT stat_data_tmot_nv "tmot-Statistik ueber Motorlaufzeit [RAM name from V530, voted 2]" ULONG M_FORMULA_0542 0 0 0 4294967295 ECU_ADDRESS 0x3F9D14 /end MEASUREMENT
/begin MEASUREMENT mdrv_st_dsc_key0 "MDRV-Status DSC (CAN) [RAM name from V530, voted 5]" UBYTE NO_COMPU_METHOD 0 0 0 255 ECU_ADDRESS 0x3F9D54 FORMAT "%.4g" /end MEASUREMENT
/begin MEASUREMENT mdrv_st_dsc_key3 "MDRV-Status DSC (CAN) [RAM name from V530, voted 1]" UBYTE NO_COMPU_METHOD 0 0 0 255 ECU_ADDRESS 0x3F9D57 FORMAT "%.4g" /end MEASUREMENT
/begin MEASUREMENT mdrv_st_mod_smg_key0 "MDRV-Status SMG (CAN) [RAM name from V530, voted 5]" UBYTE NO_COMPU_METHOD 0 0 0 255 ECU_ADDRESS 0x3F9D5E FORMAT "%.4g" /end MEASUREMENT
/begin MEASUREMENT mdrv_st_stg_smg_key0 "MDRV-Status Drivelogic (CAN) [RAM name from V530, voted 5]" UBYTE NO_COMPU_METHOD 0 0 0 255 ECU_ADDRESS 0x3F9D68 FORMAT "%.4g" /end MEASUREMENT
/begin MEASUREMENT mdrv_st_mod_eng_key0 "MDRV-Status Motor (CAN) [RAM name from V530, voted 4]" UBYTE NO_COMPU_METHOD 0 0 0 255 ECU_ADDRESS 0x3F9D72 FORMAT "%.4g" /end MEASUREMENT
/begin MEASUREMENT mdrv_st_mod_edck_key0 "MDRV-Status EDCK (CAN) [RAM name from V530, voted 4]" UBYTE NO_COMPU_METHOD 0 0 0 255 ECU_ADDRESS 0x3F9D7C FORMAT "%.4g" /end MEASUREMENT
/begin MEASUREMENT mdrv_st_mod_albv_key0 "MDRV-Status aLBV (CAN) [RAM name from V530, voted 4]" UBYTE NO_COMPU_METHOD 0 0 0 255 ECU_ADDRESS 0x3F9D86 FORMAT "%.4g" /end MEASUREMENT
/begin MEASUREMENT mdrv_st_mod_hud_key0 "MDRV-Status HUD (CAN) [RAM name from V530, voted 3]" UBYTE NO_COMPU_METHOD 0 0 0 255 ECU_ADDRESS 0x3F9D90 FORMAT "%.4g" /end MEASUREMENT
/begin MEASUREMENT stat_data_nrf_nv "Statistik n/rf-Array [RAM name from V530, voted 5]" ULONG M_FORMULA_0542 0 0 0 4294967295 ECU_ADDRESS 0x3F9D9C /end MEASUREMENT
/begin MEASUREMENT mdrv_p400_only_nv "P400-Only [RAM name from V530, voted 4]" UWORD M_FORMULA_0010 0 0 0 65535 ECU_ADDRESS 0x3F9E7C /end MEASUREMENT
/begin MEASUREMENT mdrv_p500_start_nv "P500-Hochlauf [RAM name from V530, voted 5]" UWORD M_FORMULA_0010 0 0 0 65535 ECU_ADDRESS 0x3F9E7E /end MEASUREMENT
/begin MEASUREMENT crc32_prog_carb_nv "Programm-CRC fuer Mode 9 [RAM name from V530, voted 1]" ULONG M_FORMULA_0000 0 0 0 4294967295 ECU_ADDRESS 0x3FA140 /end MEASUREMENT
/begin MEASUREMENT crc32_data_carb_nv "Daten-CRC fuer Mode 9 [RAM name from V530, voted 1]" ULONG M_FORMULA_0000 0 0 0 4294967295 ECU_ADDRESS 0x3FA144 /end MEASUREMENT
/begin MEASUREMENT ram_chk_err_adr_nv "Fehleradresse vom RamCheck [RAM name from V530, voted 3]" ULONG M_FORMULA_0000 0 0 0 4294967295 ECU_ADDRESS 0x3FA148 /end MEASUREMENT
/begin MEASUREMENT sys_zust_cpu_last_max_nv "Maximale CPU Last [RAM name from V530, voted 3]" UWORD M_FORMULA_0001 0 0 0 6553.5 ECU_ADDRESS 0x3FA14C /end MEASUREMENT
/begin MEASUREMENT spim_errorcode_reinit_nv "Errorcode weswegen ein SPI-Reinit ausgefuehrt wurde [RAM name from V530, voted 2]" UBYTE NO_COMPU_METHOD 0 0 0 255 ECU_ADDRESS 0x3FA14F FORMAT "%.4g" /end MEASUREMENT
/begin MEASUREMENT spim_error_reinit_ctr_nv "SPI-reinits durch Fehlverhalten [RAM name from V530, voted 4]" UBYTE M_FORMULA_0003 0 0 0 255 ECU_ADDRESS 0x3FA150 /end MEASUREMENT
/begin MEASUREMENT spim_chain_error_nv "SPI Chains Fehler [RAM name from V530, voted 7]" UBYTE NO_COMPU_METHOD 0 0 0 255 ECU_ADDRESS 0x3FA151 FORMAT "%.4g" /end MEASUREMENT
/begin MEASUREMENT sk_ff.n "Drehzahl [RAM name from V530, voted 9]" SWORD M_FORMULA_0006 0 0 -32768 32767 ECU_ADDRESS 0x3FA154 /end MEASUREMENT
/begin MEASUREMENT sk_ff.rf_m "Fuellung [RAM name from V530, voted 1]" SWORD M_FORMULA_0007 0 0 -3.2768 3.2767 ECU_ADDRESS 0x3FA156 /end MEASUREMENT
/begin MEASUREMENT sk_ff.ub "Spannung [RAM name from V530, voted 1]" SWORD M_FORMULA_0008 0 0 -3276.8 3276.7 ECU_ADDRESS 0x3FA158 /end MEASUREMENT
/begin MEASUREMENT sk_ff.kupp_wunsch_ges "Wunschmoment [RAM name from V530, voted 1]" SWORD M_FORMULA_0009 0 0 -3276.8 3276.7 ECU_ADDRESS 0x3FA15A /end MEASUREMENT
/begin MEASUREMENT sk_ff.kupp_ist "Istmoment [RAM name from V530, voted 5]" SWORD M_FORMULA_0009 0 0 -3276.8 3276.7 ECU_ADDRESS 0x3FA15C /end MEASUREMENT
/begin MEASUREMENT sk_ff.pwg_soll "Pedalwert [RAM name from V530, voted 3]" SWORD M_FORMULA_0001 0 0 -3276.8 3276.7 ECU_ADDRESS 0x3FA15E /end MEASUREMENT
/begin MEASUREMENT sk_ff.fail_st_zyl "Ausblender [RAM name from V530, voted 1]" UWORD M_FORMULA_0010 0 0 0 65535 ECU_ADDRESS 0x3FA160 /end MEASUREMENT
/begin MEASUREMENT sk_ff.ursache "Ursache fuer SK-Eingriff [RAM name from V530, voted 1]" UWORD NO_COMPU_METHOD 0 0 0 65535 ECU_ADDRESS 0x3FA162 FORMAT "%.4g" /end MEASUREMENT
/begin MEASUREMENT sk_ff.egas_sk_mode "SK-Mode Egas [RAM name from V530, voted 1]" UBYTE NO_COMPU_METHOD 0 0 0 255 ECU_ADDRESS 0x3FA164 FORMAT "%.4g" /end MEASUREMENT
/begin MEASUREMENT sk_ff.md_sk_mode "SK-Mode Momentenmanager [RAM name from V530, voted 1]" UBYTE NO_COMPU_METHOD 0 0 0 255 ECU_ADDRESS 0x3FA165 FORMAT "%.4g" /end MEASUREMENT
/begin MEASUREMENT sk_ff.smg_sk_mode "SK-Mode SMG [RAM name from V530, voted 1]" UBYTE NO_COMPU_METHOD 0 0 0 255 ECU_ADDRESS 0x3FA166 FORMAT "%.4g" /end MEASUREMENT
/begin MEASUREMENT sk_ff.crc32_result "CRC-Fehler [RAM name from V530, voted 1]" UBYTE NO_COMPU_METHOD 0 0 0 255 ECU_ADDRESS 0x3FA167 FORMAT "%.4g" /end MEASUREMENT
/begin MEASUREMENT sk_ff.os_err_cnt "OS-Err: Summe [RAM name from V530, voted 1]" UBYTE M_FORMULA_0003 0 0 0 255 ECU_ADDRESS 0x3FA168 /end MEASUREMENT
/begin MEASUREMENT sk_ff.os_err_type "Fehlertyp [RAM name from V530, voted 1]" UBYTE NO_COMPU_METHOD 0 0 0 255 ECU_ADDRESS 0x3FA169 FORMAT "%.4g" /end MEASUREMENT
/begin MEASUREMENT sk_ff.reset_cnt "Resetzaehler [RAM name from V530, voted 1]" UBYTE M_FORMULA_0003 0 0 0 255 ECU_ADDRESS 0x3FA16A /end MEASUREMENT
/begin MEASUREMENT sk_ff.stufe "SK-Stufe [RAM name from V530, voted 1]" UBYTE M_FORMULA_0003 0 0 0 255 ECU_ADDRESS 0x3FA16B /end MEASUREMENT
/begin MEASUREMENT sk_ff.os_err_addr "OS-Err: Adresse [RAM name from V530, voted 1]" ULONG M_FORMULA_0000 0 0 0 4294967295 ECU_ADDRESS 0x3FA16C /end MEASUREMENT
/begin MEASUREMENT sk_ff.proz_err "Prozess-Fehler [RAM name from V530, voted 1]" UWORD M_FORMULA_0010 0 0 0 65535 ECU_ADDRESS 0x3FA170 /end MEASUREMENT
/begin MEASUREMENT sk_ff.task_err "Task-Fehler [RAM name from V530, voted 1]" UWORD M_FORMULA_0010 0 0 0 65535 ECU_ADDRESS 0x3FA172 /end MEASUREMENT
/begin MEASUREMENT tpu_kw_irq_info_cnt_nv_a "Anzahl Infointerrupts (+/- ein Zahn). [RAM name from V530, voted 6]" UBYTE M_FORMULA_0003 0 0 0 255 ECU_ADDRESS 0x3FA174 /end MEASUREMENT
/begin MEASUREMENT tpu_kw_irq_info_cnt_nv_b "Anzahl Infointerrupts (+/- ein Zahn). [RAM name from V530, voted 2]" UBYTE M_FORMULA_0003 0 0 0 255 ECU_ADDRESS 0x3FA175 /end MEASUREMENT
/begin MEASUREMENT pctrl_task_err_nv "Fehler Taskueberwachung [RAM name from V530, voted 3]" UBYTE M_FORMULA_0003 0 0 0 255 ECU_ADDRESS 0x3FA176 /end MEASUREMENT
/begin MEASUREMENT pctrl_proz_err_nv "Fehler Prozessueberwachung [RAM name from V530, voted 3]" UWORD M_FORMULA_0010 0 0 0 65535 ECU_ADDRESS 0x3FA178 /end MEASUREMENT
/begin MEASUREMENT sys_exc_vec_nv "Exception-Vector [RAM name from V530, voted 1]" UWORD NO_COMPU_METHOD 0 0 0 65535 ECU_ADDRESS 0x3FA17A FORMAT "%.4g" /end MEASUREMENT
/begin MEASUREMENT sys_exc_lr_nv "Exception-Linkregister [RAM name from V530, voted 1]" ULONG M_FORMULA_0000 0 0 0 4294967295 ECU_ADDRESS 0x3FA17C /end MEASUREMENT
/begin MEASUREMENT sys_exc_addr_nv "Exception-Adresse [RAM name from V530, voted 1]" ULONG M_FORMULA_0000 0 0 0 4294967295 ECU_ADDRESS 0x3FA180 /end MEASUREMENT
/begin MEASUREMENT sys_rsr_cnt_nv.ehrs "ExtHardReset [RAM name from V530, voted 3]" UBYTE M_FORMULA_0003 0 0 0 255 ECU_ADDRESS 0x3FA184 /end MEASUREMENT
/begin MEASUREMENT sys_rsr_cnt_nv.esrs "ExtSoftReset [RAM name from V530, voted 1]" UBYTE M_FORMULA_0003 0 0 0 255 ECU_ADDRESS 0x3FA185 /end MEASUREMENT
/begin MEASUREMENT tpu_kw_err_ff_a.state "Zustand der TPU [RAM name from V530, voted 3]" UBYTE NO_COMPU_METHOD 0 0 0 255 ECU_ADDRESS 0x3FA194 FORMAT "%.4g" /end MEASUREMENT
/begin MEASUREMENT os_proz_ff.mtime "Maximale Prozess Zeit [RAM name from V530, voted 4]" UWORD M_FORMULA_0018 0 0 0 65535 ECU_ADDRESS 0x3FA1E8 /end MEASUREMENT
/begin MEASUREMENT os_proz_ff.mtime_pid "PID des Prozesses mit max Zeit [RAM name from V530, voted 1]" UWORD M_FORMULA_0010 0 0 0 65535 ECU_ADDRESS 0x3FA1EA /end MEASUREMENT
/begin MEASUREMENT os_proz_ff.n "Motordrehzahl [RAM name from V530, voted 1]" SWORD M_FORMULA_0006 0 0 -32768 32767 ECU_ADDRESS 0x3FA1EC /end MEASUREMENT
/begin MEASUREMENT os_proz_ff.rf "relative Fuellung Mittel zwischen Bank 1 und 2 [RAM name from V530, voted 1]" SWORD M_FORMULA_0007 0 0 -3.2768 3.2767 ECU_ADDRESS 0x3FA1EE /end MEASUREMENT
/begin MEASUREMENT os_proz_ff.zustand_motor "Betriebszustand der Motorsteuerung [RAM name from V530, voted 1]" UWORD NO_COMPU_METHOD 0 0 0 65535 ECU_ADDRESS 0x3FA1F0 FORMAT "%.4g" /end MEASUREMENT
/begin MEASUREMENT os_proz_ff.aq_soll_grad "Gradient AQ-Soll von Bank1 [RAM name from V530, voted 1]" SWORD M_FORMULA_0020 0 0 -655360 655340 ECU_ADDRESS 0x3FA1F2 /end MEASUREMENT
/begin MEASUREMENT os_proz_ff.time_ml "Motor laeuft Zeit [RAM name from V530, voted 1]" UWORD M_FORMULA_0021 0 0 0 655.35 ECU_ADDRESS 0x3FA1F4 /end MEASUREMENT
/begin MEASUREMENT os_proz_irq_ff.mtime "Maximale Prozess Zeit [RAM name from V530, voted 2]" UWORD M_FORMULA_0018 0 0 0 65535 ECU_ADDRESS 0x3FA1F6 /end MEASUREMENT
/begin MEASUREMENT os_proz_irq_ff.mtime_pid "PID des Prozesses mit max Zeit [RAM name from V530, voted 1]" UWORD M_FORMULA_0010 0 0 0 65535 ECU_ADDRESS 0x3FA1F8 /end MEASUREMENT
/begin MEASUREMENT os_proz_irq_ff.n "Motordrehzahl [RAM name from V530, voted 1]" SWORD M_FORMULA_0006 0 0 -32768 32767 ECU_ADDRESS 0x3FA1FA /end MEASUREMENT
/begin MEASUREMENT os_proz_irq_ff.rf "relative Fuellung Mittel zwischen Bank 1 und 2 [RAM name from V530, voted 1]" SWORD M_FORMULA_0007 0 0 -3.2768 3.2767 ECU_ADDRESS 0x3FA1FC /end MEASUREMENT
/begin MEASUREMENT os_proz_irq_ff.zustand_motor "Betriebszustand der Motorsteuerung [RAM name from V530, voted 1]" UWORD NO_COMPU_METHOD 0 0 0 65535 ECU_ADDRESS 0x3FA1FE FORMAT "%.4g" /end MEASUREMENT
/begin MEASUREMENT os_proz_irq_ff.aq_soll_grad "Gradient AQ-Soll von Bank1 [RAM name from V530, voted 1]" SWORD M_FORMULA_0020 0 0 -655360 655340 ECU_ADDRESS 0x3FA200 /end MEASUREMENT
/begin MEASUREMENT os_proz_irq_ff.time_ml "Motor laeuft Zeit [RAM name from V530, voted 1]" UWORD M_FORMULA_0021 0 0 0 655.35 ECU_ADDRESS 0x3FA202 /end MEASUREMENT
/begin MEASUREMENT os_proz_irq_last_nv "CPU Last fuer diesen IRQ [RAM name from V530, voted 1]" UWORD M_FORMULA_0022 0 0 0 655.35 ECU_ADDRESS 0x3FA204 /end MEASUREMENT
/begin MEASUREMENT B_fahisrst "Bed. Histogramm Reset [RAM name from V530, voted 2]" UBYTE M_FORMULA_0003 0 0 0 255 ECU_ADDRESS 0x3FA231 /end MEASUREMENT
/begin MEASUREMENT Oz_anzeige_kombi "Peilstab-CAN-Nachr. an Kombi (st_fllv_eoi) [RAM name from V530, voted 10]" UBYTE M_FORMULA_0595 0 0 -10 15.5 ECU_ADDRESS 0x3FA23A /end MEASUREMENT
/begin MEASUREMENT Oz_anzeige_kombi_alt "gemerktes Oz_anzeige_kombi [RAM name from V530, voted 9]" UBYTE M_FORMULA_0595 0 0 -10 15.5 ECU_ADDRESS 0x3FA23B /end MEASUREMENT
/begin MEASUREMENT St_dibs0 "Statuswort [RAM name from V530, voted 1]" UBYTE M_FORMULA_0003 0 0 0 255 ECU_ADDRESS 0x3FA32E /end MEASUREMENT
/begin MEASUREMENT St_dibs0.B_dibloc1 "Signal nv lave loc zur Flankenerkennung [RAM name from V530, voted 1]" UBYTE NO_COMPU_METHOD 0 0 0 255 ECU_ADDRESS 0x3FA32E FORMAT "%.4g" /end MEASUREMENT
/begin MEASUREMENT St_dibs0.B_dibloc2 "Signal nv lave loc zur Flankenerkennung [RAM name from V530, voted 1]" UBYTE NO_COMPU_METHOD 0 0 0 255 ECU_ADDRESS 0x3FA32E FORMAT "%.4g" /end MEASUREMENT
/begin MEASUREMENT Ibsderrs2 "Fehlerz???hler IBS EBSD Kommunikation [RAM name from V530, voted 3]" UWORD M_FORMULA_0010 0 0 0 65535 ECU_ADDRESS 0x3FA330 /end MEASUREMENT
/begin MEASUREMENT Ibsderrs1 "Fehlerz???hler IBS BSD Kommunikation [RAM name from V530, voted 2]" UBYTE M_FORMULA_0003 0 0 0 255 ECU_ADDRESS 0x3FA332 /end MEASUREMENT
/begin MEASUREMENT Ibspreco2 "Vorteiler /10 fuer Ibsderrs2 [RAM name from V530, voted 2]" UBYTE M_FORMULA_0003 0 0 0 255 ECU_ADDRESS 0x3FA333 /end MEASUREMENT
/begin MEASUREMENT Oz_permerrz "Oz_permerrz [RAM name from V530, voted 3]" UBYTE M_FORMULA_0003 0 0 0 255 ECU_ADDRESS 0x3FA334 /end MEASUREMENT
/begin MEASUREMENT ed_st_nv "Status-Eigendiagnose [RAM name from V530, voted 5]" UBYTE M_FORMULA_0037 0 0 0 255 ECU_ADDRESS 0x3FA338 /end MEASUREMENT
/begin MEASUREMENT ed_st_nv_css_den "CSS-Denominator [RAM name from V530, voted 5]" UBYTE NO_COMPU_METHOD 0 0 0 255 ECU_ADDRESS 0x3FA338 FORMAT "%.4g" /end MEASUREMENT
/begin MEASUREMENT ed_st_nv_css_num "CSS-Numerator [RAM name from V530, voted 5]" UBYTE NO_COMPU_METHOD 0 0 0 255 ECU_ADDRESS 0x3FA338 FORMAT "%.4g" /end MEASUREMENT
/begin MEASUREMENT ed_st_nv_rbm_abbruch "Abbruch des RBM [RAM name from V530, voted 5]" UBYTE NO_COMPU_METHOD 0 0 0 255 ECU_ADDRESS 0x3FA338 FORMAT "%.4g" /end MEASUREMENT
/begin MEASUREMENT ed_st_nv_rbm_dcy "Rate-Based-DCY [RAM name from V530, voted 5]" UBYTE NO_COMPU_METHOD 0 0 0 255 ECU_ADDRESS 0x3FA338 FORMAT "%.4g" /end MEASUREMENT
/begin MEASUREMENT ed_st_nv_rbm_evap "RBM-EVAP-Bedingung [RAM name from V530, voted 5]" UBYTE NO_COMPU_METHOD 0 0 0 255 ECU_ADDRESS 0x3FA338 FORMAT "%.4g" /end MEASUREMENT
/begin MEASUREMENT ed_st_nv_rbm_slp "RBM-SLP-Bedingung [RAM name from V530, voted 5]" UBYTE NO_COMPU_METHOD 0 0 0 255 ECU_ADDRESS 0x3FA338 FORMAT "%.4g" /end MEASUREMENT
/begin MEASUREMENT ed_st_nv_wuc "Warmupcycleerkennung [RAM name from V530, voted 5]" UBYTE NO_COMPU_METHOD 0 0 0 255 ECU_ADDRESS 0x3FA338 FORMAT "%.4g" /end MEASUREMENT
/begin MEASUREMENT ed_rbm_denominator_nv "Status der Denominatorerhoehung [RAM name from V530, voted 1]" UBYTE M_FORMULA_0003 0 0 0 255 ECU_ADDRESS 0x3FA339 /end MEASUREMENT
/begin MEASUREMENT ed_mil_on_km_stand_nv "Kilometerstand MIL on [RAM name from V530, voted 6]" ULONG M_FORMULA_0027 0 0 0 4294967295 ECU_ADDRESS 0x3FA33C /end MEASUREMENT
/begin MEASUREMENT ed_scdn_st_nv "Welche Fehler muessen mit similar Conditions behandelt werden [RAM name from V530, voted 7]" ULONG M_FORMULA_0000 0 0 0 4294967295 ECU_ADDRESS 0x3FA344 /end MEASUREMENT
/begin MEASUREMENT ed_fil_sk_tr_inj.filter_nv "Filterwert vor und nach Eintrag [RAM name from V530, voted 29]" UBYTE M_FORMULA_0003 0 0 0 255 ECU_ADDRESS 0x3FA348 /end MEASUREMENT
/begin MEASUREMENT ed_fil_sk_tr_inj.art_aktuell_nv "Fehlerart und Statusbits [RAM name from V530, voted 4]" UWORD NO_COMPU_METHOD 0 0 0 65535 ECU_ADDRESS 0x3FA34A FORMAT "%.4g" /end MEASUREMENT
/begin MEASUREMENT ed_fil_pumg.art_aktuell_nv "Fehlerart und Statusbits [RAM name from V530, voted 3]" UWORD NO_COMPU_METHOD 0 0 0 65535 ECU_ADDRESS 0x3FA350 FORMAT "%.4g" /end MEASUREMENT
/begin MEASUREMENT ed_fil_van_hall_e1.art_aktuell_nv "Fehlerart und Statusbits [RAM name from V530, voted 3]" UWORD NO_COMPU_METHOD 0 0 0 65535 ECU_ADDRESS 0x3FA36E FORMAT "%.4g" /end MEASUREMENT
/begin MEASUREMENT ed_fil_van_hall_a1.art_aktuell_nv "Fehlerart und Statusbits [RAM name from V530, voted 4]" UWORD NO_COMPU_METHOD 0 0 0 65535 ECU_ADDRESS 0x3FA374 FORMAT "%.4g" /end MEASUREMENT
/begin MEASUREMENT ed_fil_van_hall_e2.art_aktuell_nv "Fehlerart und Statusbits [RAM name from V530, voted 4]" UWORD NO_COMPU_METHOD 0 0 0 65535 ECU_ADDRESS 0x3FA37A FORMAT "%.4g" /end MEASUREMENT
/begin MEASUREMENT ed_fil_van_hall_a2.art_aktuell_nv "Fehlerart und Statusbits [RAM name from V530, voted 4]" UWORD NO_COMPU_METHOD 0 0 0 65535 ECU_ADDRESS 0x3FA380 FORMAT "%.4g" /end MEASUREMENT
/begin MEASUREMENT ed_fil_van_regl_e1.art_aktuell_nv "Fehlerart und Statusbits [RAM name from V530, voted 1]" UWORD NO_COMPU_METHOD 0 0 0 65535 ECU_ADDRESS 0x3FA386 FORMAT "%.4g" /end MEASUREMENT
/begin MEASUREMENT ed_fil_van_regl_a1.art_aktuell_nv "Fehlerart und Statusbits [RAM name from V530, voted 1]" UWORD NO_COMPU_METHOD 0 0 0 65535 ECU_ADDRESS 0x3FA38C FORMAT "%.4g" /end MEASUREMENT
/begin MEASUREMENT ed_fil_van_regl_e2.art_aktuell_nv "Fehlerart und Statusbits [RAM name from V530, voted 1]" UWORD NO_COMPU_METHOD 0 0 0 65535 ECU_ADDRESS 0x3FA392 FORMAT "%.4g" /end MEASUREMENT
/begin MEASUREMENT ed_fil_van_regl_a2.art_aktuell_nv "Fehlerart und Statusbits [RAM name from V530, voted 1]" UWORD NO_COMPU_METHOD 0 0 0 65535 ECU_ADDRESS 0x3FA398 FORMAT "%.4g" /end MEASUREMENT
/begin MEASUREMENT ed_fil_pctrl_inj.art_aktuell_nv "Fehlerart und Statusbits [RAM name from V530, voted 1]" UWORD NO_COMPU_METHOD 0 0 0 65535 ECU_ADDRESS 0x3FA3AA FORMAT "%.4g" /end MEASUREMENT
/begin MEASUREMENT ed_fil_pks.art_aktuell_nv "Fehlerart und Statusbits [RAM name from V530, voted 4]" UWORD NO_COMPU_METHOD 0 0 0 65535 ECU_ADDRESS 0x3FA3B6 FORMAT "%.4g" /end MEASUREMENT
/begin MEASUREMENT ed_fil_lavk1.art_aktuell_nv "Fehlerart und Statusbits [RAM name from V530, voted 1]" UWORD NO_COMPU_METHOD 0 0 0 65535 ECU_ADDRESS 0x3FA3C2 FORMAT "%.4g" /end MEASUREMENT
/begin MEASUREMENT ed_fil_lshnk1.art_aktuell_nv "Fehlerart und Statusbits [RAM name from V530, voted 3]" UWORD NO_COMPU_METHOD 0 0 0 65535 ECU_ADDRESS 0x3FA3F2 FORMAT "%.4g" /end MEASUREMENT
/begin MEASUREMENT ed_fil_lshnk2.art_aktuell_nv "Fehlerart und Statusbits [RAM name from V530, voted 1]" UWORD NO_COMPU_METHOD 0 0 0 65535 ECU_ADDRESS 0x3FA3F8 FORMAT "%.4g" /end MEASUREMENT
/begin MEASUREMENT ed_fil_pt_busoff.art_aktuell_nv "Fehlerart und Statusbits [RAM name from V530, voted 2]" UWORD NO_COMPU_METHOD 0 0 0 65535 ECU_ADDRESS 0x3FA3FE FORMAT "%.4g" /end MEASUREMENT
/begin MEASUREMENT ed_fil_pt_klst.art_aktuell_nv "Fehlerart und Statusbits [RAM name from V530, voted 1]" UWORD NO_COMPU_METHOD 0 0 0 65535 ECU_ADDRESS 0x3FA422 FORMAT "%.4g" /end MEASUREMENT
/begin MEASUREMENT ed_fil_fplau1.art_aktuell_nv "Fehlerart und Statusbits [RAM name from V530, voted 1]" UWORD NO_COMPU_METHOD 0 0 0 65535 ECU_ADDRESS 0x3FA434 FORMAT "%.4g" /end MEASUREMENT
/begin MEASUREMENT ed_fil_fplau2.art_aktuell_nv "Fehlerart und Statusbits [RAM name from V530, voted 1]" UWORD NO_COMPU_METHOD 0 0 0 65535 ECU_ADDRESS 0x3FA43A FORMAT "%.4g" /end MEASUREMENT
/begin MEASUREMENT ed_fil_sl_ml_hfm.art_aktuell_nv "Fehlerart und Statusbits [RAM name from V530, voted 3]" UWORD NO_COMPU_METHOD 0 0 0 65535 ECU_ADDRESS 0x3FA440 FORMAT "%.4g" /end MEASUREMENT
/begin MEASUREMENT ed_fil_lshvk1.art_aktuell_nv "Fehlerart und Statusbits [RAM name from V530, voted 3]" UWORD NO_COMPU_METHOD 0 0 0 65535 ECU_ADDRESS 0x3FA45E FORMAT "%.4g" /end MEASUREMENT
/begin MEASUREMENT ed_fil_lshvk2.art_aktuell_nv "Fehlerart und Statusbits [RAM name from V530, voted 3]" UWORD NO_COMPU_METHOD 0 0 0 65535 ECU_ADDRESS 0x3FA464 FORMAT "%.4g" /end MEASUREMENT
/begin MEASUREMENT ed_fil_lsrvk2_obd_ref.art_aktuell_nv "Fehlerart und Statusbits [RAM name from V530, voted 1]" UWORD NO_COMPU_METHOD 0 0 0 65535 ECU_ADDRESS 0x3FA4A0 FORMAT "%.4g" /end MEASUREMENT
/begin MEASUREMENT ed_fil_lavk2_un_openload.art_aktuell_nv "Fehlerart und Statusbits [RAM name from V530, voted 2]" UWORD NO_COMPU_METHOD 0 0 0 65535 ECU_ADDRESS 0x3FA4D0 FORMAT "%.4g" /end MEASUREMENT
/begin MEASUREMENT ed_fil_lam1_reg.art_aktuell_nv "Fehlerart und Statusbits [RAM name from V530, voted 1]" UWORD NO_COMPU_METHOD 0 0 0 65535 ECU_ADDRESS 0x3FA518 FORMAT "%.4g" /end MEASUREMENT
/begin MEASUREMENT ed_fil_lam2_reg.art_aktuell_nv "Fehlerart und Statusbits [RAM name from V530, voted 1]" UWORD NO_COMPU_METHOD 0 0 0 65535 ECU_ADDRESS 0x3FA51E FORMAT "%.4g" /end MEASUREMENT
/begin MEASUREMENT ed_fil_van_anschl_e1.art_aktuell_nv "Fehlerart und Statusbits [RAM name from V530, voted 1]" UWORD NO_COMPU_METHOD 0 0 0 65535 ECU_ADDRESS 0x3FA524 FORMAT "%.4g" /end MEASUREMENT
/begin MEASUREMENT ed_fil_van_anschl_a1.art_aktuell_nv "Fehlerart und Statusbits [RAM name from V530, voted 1]" UWORD NO_COMPU_METHOD 0 0 0 65535 ECU_ADDRESS 0x3FA52A FORMAT "%.4g" /end MEASUREMENT
/begin MEASUREMENT ed_fil_van_anschl_e2.art_aktuell_nv "Fehlerart und Statusbits [RAM name from V530, voted 1]" UWORD NO_COMPU_METHOD 0 0 0 65535 ECU_ADDRESS 0x3FA530 FORMAT "%.4g" /end MEASUREMENT
/begin MEASUREMENT ed_fil_van_anschl_a2.art_aktuell_nv "Fehlerart und Statusbits [RAM name from V530, voted 1]" UWORD NO_COMPU_METHOD 0 0 0 65535 ECU_ADDRESS 0x3FA536 FORMAT "%.4g" /end MEASUREMENT
/begin MEASUREMENT ed_fil_van_vent_e1.art_aktuell_nv "Fehlerart und Statusbits [RAM name from V530, voted 5]" UWORD NO_COMPU_METHOD 0 0 0 65535 ECU_ADDRESS 0x3FA53C FORMAT "%.4g" /end MEASUREMENT
/begin MEASUREMENT ed_fil_van_vent_a1.art_aktuell_nv "Fehlerart und Statusbits [RAM name from V530, voted 3]" UWORD NO_COMPU_METHOD 0 0 0 65535 ECU_ADDRESS 0x3FA542 FORMAT "%.4g" /end MEASUREMENT
/begin MEASUREMENT ed_fil_van_vent_e2.art_aktuell_nv "Fehlerart und Statusbits [RAM name from V530, voted 3]" UWORD NO_COMPU_METHOD 0 0 0 65535 ECU_ADDRESS 0x3FA548 FORMAT "%.4g" /end MEASUREMENT
/begin MEASUREMENT ed_fil_van_vent_a2.art_aktuell_nv "Fehlerart und Statusbits [RAM name from V530, voted 3]" UWORD NO_COMPU_METHOD 0 0 0 65535 ECU_ADDRESS 0x3FA54E FORMAT "%.4g" /end MEASUREMENT
/begin MEASUREMENT ed_fil_ev1.art_aktuell_nv "Fehlerart und Statusbits [RAM name from V530, voted 5]" UWORD NO_COMPU_METHOD 0 0 0 65535 ECU_ADDRESS 0x3FA554 FORMAT "%.4g" /end MEASUREMENT
/begin MEASUREMENT ed_fil_ev2.art_aktuell_nv "Fehlerart und Statusbits [RAM name from V530, voted 1]" UWORD NO_COMPU_METHOD 0 0 0 65535 ECU_ADDRESS 0x3FA55A FORMAT "%.4g" /end MEASUREMENT
/begin MEASUREMENT ed_fil_ev3.art_aktuell_nv "Fehlerart und Statusbits [RAM name from V530, voted 1]" UWORD NO_COMPU_METHOD 0 0 0 65535 ECU_ADDRESS 0x3FA560 FORMAT "%.4g" /end MEASUREMENT
/begin MEASUREMENT ed_fil_ev4.art_aktuell_nv "Fehlerart und Statusbits [RAM name from V530, voted 1]" UWORD NO_COMPU_METHOD 0 0 0 65535 ECU_ADDRESS 0x3FA566 FORMAT "%.4g" /end MEASUREMENT
/begin MEASUREMENT ed_fil_ev5.art_aktuell_nv "Fehlerart und Statusbits [RAM name from V530, voted 1]" UWORD NO_COMPU_METHOD 0 0 0 65535 ECU_ADDRESS 0x3FA56C FORMAT "%.4g" /end MEASUREMENT
/begin MEASUREMENT ed_fil_dmtl_p.art_aktuell_nv "Fehlerart und Statusbits [RAM name from V530, voted 1]" UWORD NO_COMPU_METHOD 0 0 0 65535 ECU_ADDRESS 0x3FA5AE FORMAT "%.4g" /end MEASUREMENT
/begin MEASUREMENT ed_fil_dmtl_v.art_aktuell_nv "Fehlerart und Statusbits [RAM name from V530, voted 4]" UWORD NO_COMPU_METHOD 0 0 0 65535 ECU_ADDRESS 0x3FA5B4 FORMAT "%.4g" /end MEASUREMENT
/begin MEASUREMENT ed_fil_dmtl_h.art_aktuell_nv "Fehlerart und Statusbits [RAM name from V530, voted 4]" UWORD NO_COMPU_METHOD 0 0 0 65535 ECU_ADDRESS 0x3FA5BA FORMAT "%.4g" /end MEASUREMENT
/begin MEASUREMENT ed_fil_dmtl_grobleck.art_aktuell_nv "Fehlerart und Statusbits [RAM name from V530, voted 3]" UWORD NO_COMPU_METHOD 0 0 0 65535 ECU_ADDRESS 0x3FA5C0 FORMAT "%.4g" /end MEASUREMENT
/begin MEASUREMENT ed_fil_dmtl_feucht.art_aktuell_nv "Fehlerart und Statusbits [RAM name from V530, voted 2]" UWORD NO_COMPU_METHOD 0 0 0 65535 ECU_ADDRESS 0x3FA5C6 FORMAT "%.4g" /end MEASUREMENT
/begin MEASUREMENT ed_fil_dmtl_deckel.art_aktuell_nv "Fehlerart und Statusbits [RAM name from V530, voted 2]" UWORD NO_COMPU_METHOD 0 0 0 65535 ECU_ADDRESS 0x3FA5CC FORMAT "%.4g" /end MEASUREMENT
/begin MEASUREMENT ed_fil_ekp_pwm.art_aktuell_nv "Fehlerart und Statusbits [RAM name from V530, voted 3]" UWORD NO_COMPU_METHOD 0 0 0 65535 ECU_ADDRESS 0x3FA5E4 FORMAT "%.4g" /end MEASUREMENT
/begin MEASUREMENT ed_fil_codierung.art_aktuell_nv "Fehlerart und Statusbits [RAM name from V530, voted 2]" UWORD NO_COMPU_METHOD 0 0 0 65535 ECU_ADDRESS 0x3FA5EA FORMAT "%.4g" /end MEASUREMENT
/begin MEASUREMENT ed_fil_td.art_aktuell_nv "Fehlerart und Statusbits [RAM name from V530, voted 1]" UWORD NO_COMPU_METHOD 0 0 0 65535 ECU_ADDRESS 0x3FA5F0 FORMAT "%.4g" /end MEASUREMENT
/begin MEASUREMENT ed_fil_rlslp.art_aktuell_nv "Fehlerart und Statusbits [RAM name from V530, voted 6]" UWORD NO_COMPU_METHOD 0 0 0 65535 ECU_ADDRESS 0x3FA5F6 FORMAT "%.4g" /end MEASUREMENT
/begin MEASUREMENT ed_fil_pks_ll.art_aktuell_nv "Fehlerart und Statusbits [RAM name from V530, voted 4]" UWORD NO_COMPU_METHOD 0 0 0 65535 ECU_ADDRESS 0x3FA60E FORMAT "%.4g" /end MEASUREMENT
/begin MEASUREMENT ed_fil_pks_tl.art_aktuell_nv "Fehlerart und Statusbits [RAM name from V530, voted 3]" UWORD NO_COMPU_METHOD 0 0 0 65535 ECU_ADDRESS 0x3FA614 FORMAT "%.4g" /end MEASUREMENT
/begin MEASUREMENT ed_fil_pks_q.art_aktuell_nv "Fehlerart und Statusbits [RAM name from V530, voted 1]" UWORD NO_COMPU_METHOD 0 0 0 65535 ECU_ADDRESS 0x3FA61A FORMAT "%.4g" /end MEASUREMENT
/begin MEASUREMENT ed_fil_kat_obd1.art_aktuell_nv "Fehlerart und Statusbits [RAM name from V530, voted 2]" UWORD NO_COMPU_METHOD 0 0 0 65535 ECU_ADDRESS 0x3FA620 FORMAT "%.4g" /end MEASUREMENT
/begin MEASUREMENT ed_fil_kat_obd2.art_aktuell_nv "Fehlerart und Statusbits [RAM name from V530, voted 2]" UWORD NO_COMPU_METHOD 0 0 0 65535 ECU_ADDRESS 0x3FA626 FORMAT "%.4g" /end MEASUREMENT
/begin MEASUREMENT ed_fil_van_dsv.art_aktuell_nv "Fehlerart und Statusbits [RAM name from V530, voted 3]" UWORD NO_COMPU_METHOD 0 0 0 65535 ECU_ADDRESS 0x3FA62C FORMAT "%.4g" /end MEASUREMENT
/begin MEASUREMENT ed_fil_fi_ibs3.art_aktuell_nv "Fehlerart und Statusbits [RAM name from V530, voted 1]" UWORD NO_COMPU_METHOD 0 0 0 65535 ECU_ADDRESS 0x3FA650 FORMAT "%.4g" /end MEASUREMENT
/begin MEASUREMENT ed_fil_ews_sci.art_aktuell_nv "Fehlerart und Statusbits [RAM name from V530, voted 3]" UWORD NO_COMPU_METHOD 0 0 0 65535 ECU_ADDRESS 0x3FA67A FORMAT "%.4g" /end MEASUREMENT
/begin MEASUREMENT ed_fil_fi_toens.art_aktuell_nv "Fehlerart und Statusbits [RAM name from V530, voted 1]" UWORD NO_COMPU_METHOD 0 0 0 65535 ECU_ADDRESS 0x3FA69E FORMAT "%.4g" /end MEASUREMENT
/begin MEASUREMENT ed_fil_ebox_elu.art_aktuell_nv "Fehlerart und Statusbits [RAM name from V530, voted 1]" UWORD NO_COMPU_METHOD 0 0 0 65535 ECU_ADDRESS 0x3FA6A4 FORMAT "%.4g" /end MEASUREMENT
/begin MEASUREMENT ed_fil_s_poel_diag.art_aktuell_nv "Fehlerart und Statusbits [RAM name from V530, voted 2]" UWORD NO_COMPU_METHOD 0 0 0 65535 ECU_ADDRESS 0x3FA6BC FORMAT "%.4g" /end MEASUREMENT
/begin MEASUREMENT ed_fil_te_obd_1.art_aktuell_nv "Fehlerart und Statusbits [RAM name from V530, voted 1]" UWORD NO_COMPU_METHOD 0 0 0 65535 ECU_ADDRESS 0x3FA6C2 FORMAT "%.4g" /end MEASUREMENT
/begin MEASUREMENT ed_fil_te_obd_2.art_aktuell_nv "Fehlerart und Statusbits [RAM name from V530, voted 1]" UWORD NO_COMPU_METHOD 0 0 0 65535 ECU_ADDRESS 0x3FA6C8 FORMAT "%.4g" /end MEASUREMENT
/begin MEASUREMENT ed_fil_tev1.art_aktuell_nv "Fehlerart und Statusbits [RAM name from V530, voted 2]" UWORD NO_COMPU_METHOD 0 0 0 65535 ECU_ADDRESS 0x3FA6CE FORMAT "%.4g" /end MEASUREMENT
/begin MEASUREMENT ed_fil_tev2.art_aktuell_nv "Fehlerart und Statusbits [RAM name from V530, voted 1]" UWORD NO_COMPU_METHOD 0 0 0 65535 ECU_ADDRESS 0x3FA6D4 FORMAT "%.4g" /end MEASUREMENT
/begin MEASUREMENT ed_fil_e2_inj.art_aktuell_nv "Fehlerart und Statusbits [RAM name from V530, voted 1]" UWORD NO_COMPU_METHOD 0 0 0 65535 ECU_ADDRESS 0x3FA6DA FORMAT "%.4g" /end MEASUREMENT
/begin MEASUREMENT ed_fil_kw.art_aktuell_nv "Fehlerart und Statusbits [RAM name from V530, voted 2]" UWORD NO_COMPU_METHOD 0 0 0 65535 ECU_ADDRESS 0x3FA6E0 FORMAT "%.4g" /end MEASUREMENT
/begin MEASUREMENT ed_fil_sl_durchs_hstrang.art_aktuell_nv "Fehlerart und Statusbits [RAM name from V530, voted 2]" UWORD NO_COMPU_METHOD 0 0 0 65535 ECU_ADDRESS 0x3FA716 FORMAT "%.4g" /end MEASUREMENT
/begin MEASUREMENT ed_fil_fetrawe.art_aktuell_nv "Fehlerart und Statusbits [RAM name from V530, voted 2]" UWORD NO_COMPU_METHOD 0 0 0 65535 ECU_ADDRESS 0x3FA71C FORMAT "%.4g" /end MEASUREMENT
/begin MEASUREMENT ed_fil_s_getr_hs.art_aktuell_nv "Fehlerart und Statusbits [RAM name from V530, voted 3]" UWORD NO_COMPU_METHOD 0 0 0 65535 ECU_ADDRESS 0x3FA722 FORMAT "%.4g" /end MEASUREMENT
/begin MEASUREMENT ed_fil_s_kupp_hs.art_aktuell_nv "Fehlerart und Statusbits [RAM name from V530, voted 1]" UWORD NO_COMPU_METHOD 0 0 0 65535 ECU_ADDRESS 0x3FA728 FORMAT "%.4g" /end MEASUREMENT
/begin MEASUREMENT ed_fil_van_druck.art_aktuell_nv "Fehlerart und Statusbits [RAM name from V530, voted 3]" UWORD NO_COMPU_METHOD 0 0 0 65535 ECU_ADDRESS 0x3FA72E FORMAT "%.4g" /end MEASUREMENT
/begin MEASUREMENT ed_fil_elu.art_aktuell_nv "Fehlerart und Statusbits [RAM name from V530, voted 5]" UWORD NO_COMPU_METHOD 0 0 0 65535 ECU_ADDRESS 0x3FA73A FORMAT "%.4g" /end MEASUREMENT
/begin MEASUREMENT ed_fil_tank_leer.art_aktuell_nv "Fehlerart und Statusbits [RAM name from V530, voted 1]" UWORD NO_COMPU_METHOD 0 0 0 65535 ECU_ADDRESS 0x3FA770 FORMAT "%.4g" /end MEASUREMENT
/begin MEASUREMENT ed_fil_dmtl_feinleck.art_aktuell_nv "Fehlerart und Statusbits [RAM name from V530, voted 5]" UWORD NO_COMPU_METHOD 0 0 0 65535 ECU_ADDRESS 0x3FA77C FORMAT "%.4g" /end MEASUREMENT
/begin MEASUREMENT ed_fil_pumg_obd.art_aktuell_nv "Fehlerart und Statusbits [RAM name from V530, voted 2]" UWORD NO_COMPU_METHOD 0 0 0 65535 ECU_ADDRESS 0x3FA782 FORMAT "%.4g" /end MEASUREMENT
/begin MEASUREMENT ed_fil_sl_ml_hfm_obd.art_aktuell_nv "Fehlerart und Statusbits [RAM name from V530, voted 2]" UWORD NO_COMPU_METHOD 0 0 0 65535 ECU_ADDRESS 0x3FA788 FORMAT "%.4g" /end MEASUREMENT
/begin MEASUREMENT ed_fil_lshnk1_r.art_aktuell_nv "Fehlerart und Statusbits [RAM name from V530, voted 3]" UWORD NO_COMPU_METHOD 0 0 0 65535 ECU_ADDRESS 0x3FA7B2 FORMAT "%.4g" /end MEASUREMENT
/begin MEASUREMENT ed_fil_lshnk2_r.art_aktuell_nv "Fehlerart und Statusbits [RAM name from V530, voted 2]" UWORD NO_COMPU_METHOD 0 0 0 65535 ECU_ADDRESS 0x3FA7B8 FORMAT "%.4g" /end MEASUREMENT
/begin MEASUREMENT ed_fil_pks_modell.art_aktuell_nv "Fehlerart und Statusbits [RAM name from V530, voted 2]" UWORD NO_COMPU_METHOD 0 0 0 65535 ECU_ADDRESS 0x3FA7BE FORMAT "%.4g" /end MEASUREMENT
/begin MEASUREMENT ed_fil_pks_paufbau.art_aktuell_nv "Fehlerart und Statusbits [RAM name from V530, voted 2]" UWORD NO_COMPU_METHOD 0 0 0 65535 ECU_ADDRESS 0x3FA7C4 FORMAT "%.4g" /end MEASUREMENT
/begin MEASUREMENT ed_fil_tgetr_hs.art_aktuell_nv "Fehlerart und Statusbits [RAM name from V530, voted 1]" UWORD NO_COMPU_METHOD 0 0 0 65535 ECU_ADDRESS 0x3FA7D0 FORMAT "%.4g" /end MEASUREMENT
/begin MEASUREMENT ed_rbm_sk_tr_inj.numerator_nv "Diagnosezyklen [RAM name from V530, voted 7]" UWORD M_FORMULA_0010 0 0 0 65535 ECU_ADDRESS 0x3FA888 /end MEASUREMENT
/begin MEASUREMENT ed_rbm_van_regl_a1.numerator_nv "Diagnosezyklen [RAM name from V530, voted 2]" UWORD M_FORMULA_0010 0 0 0 65535 ECU_ADDRESS 0x3FA8B4 /end MEASUREMENT
/begin MEASUREMENT ed_rbm_van_regl_e2.numerator_nv "Diagnosezyklen [RAM name from V530, voted 2]" UWORD M_FORMULA_0010 0 0 0 65535 ECU_ADDRESS 0x3FA8B8 /end MEASUREMENT
/begin MEASUREMENT ed_rbm_van_regl_e2.denominator_nv "Fahrzyklen [RAM name from V530, voted 2]" UWORD M_FORMULA_0010 0 0 0 65535 ECU_ADDRESS 0x3FA8BA /end MEASUREMENT
/begin MEASUREMENT ed_rbm_van_regl_a2.numerator_nv "Diagnosezyklen [RAM name from V530, voted 2]" UWORD M_FORMULA_0010 0 0 0 65535 ECU_ADDRESS 0x3FA8BC /end MEASUREMENT
/begin MEASUREMENT ed_rbm_van_regl_a2.denominator_nv "Fahrzyklen [RAM name from V530, voted 2]" UWORD M_FORMULA_0010 0 0 0 65535 ECU_ADDRESS 0x3FA8BE /end MEASUREMENT
/begin MEASUREMENT ed_rbm_lavk1_obd_plau.numerator_nv "Diagnosezyklen [RAM name from V530, voted 2]" UWORD M_FORMULA_0010 0 0 0 65535 ECU_ADDRESS 0x3FA8E0 /end MEASUREMENT
/begin MEASUREMENT ed_rbm_lavk1_obd_plau.denominator_nv "Fahrzyklen [RAM name from V530, voted 2]" UWORD M_FORMULA_0010 0 0 0 65535 ECU_ADDRESS 0x3FA8E2 /end MEASUREMENT
/begin MEASUREMENT ed_rbm_lavk2_obd_plau.numerator_nv "Diagnosezyklen [RAM name from V530, voted 2]" UWORD M_FORMULA_0010 0 0 0 65535 ECU_ADDRESS 0x3FA8E4 /end MEASUREMENT
/begin MEASUREMENT ed_rbm_lavk2_obd_plau.denominator_nv "Fahrzyklen [RAM name from V530, voted 2]" UWORD M_FORMULA_0010 0 0 0 65535 ECU_ADDRESS 0x3FA8E6 /end MEASUREMENT
/begin MEASUREMENT ed_rbm_lavk1_obd_sa.numerator_nv "Diagnosezyklen [RAM name from V530, voted 2]" UWORD M_FORMULA_0010 0 0 0 65535 ECU_ADDRESS 0x3FA8E8 /end MEASUREMENT
/begin MEASUREMENT ed_rbm_lavk1_obd_sa.denominator_nv "Fahrzyklen [RAM name from V530, voted 2]" UWORD M_FORMULA_0010 0 0 0 65535 ECU_ADDRESS 0x3FA8EA /end MEASUREMENT
/begin MEASUREMENT ed_rbm_lavk2_obd_sa.numerator_nv "Diagnosezyklen [RAM name from V530, voted 2]" UWORD M_FORMULA_0010 0 0 0 65535 ECU_ADDRESS 0x3FA8EC /end MEASUREMENT
/begin MEASUREMENT ed_rbm_lavk2_obd_sa.denominator_nv "Fahrzyklen [RAM name from V530, voted 2]" UWORD M_FORMULA_0010 0 0 0 65535 ECU_ADDRESS 0x3FA8EE /end MEASUREMENT
/begin MEASUREMENT ed_rbm_fplau1.numerator_nv "Diagnosezyklen [RAM name from V530, voted 2]" UWORD M_FORMULA_0010 0 0 0 65535 ECU_ADDRESS 0x3FA950 /end MEASUREMENT
/begin MEASUREMENT ed_rbm_fplau1.denominator_nv "Fahrzyklen [RAM name from V530, voted 2]" UWORD M_FORMULA_0010 0 0 0 65535 ECU_ADDRESS 0x3FA952 /end MEASUREMENT
/begin MEASUREMENT ed_rbm_fplau2.numerator_nv "Diagnosezyklen [RAM name from V530, voted 2]" UWORD M_FORMULA_0010 0 0 0 65535 ECU_ADDRESS 0x3FA954 /end MEASUREMENT
/begin MEASUREMENT ed_rbm_fplau2.denominator_nv "Fahrzyklen [RAM name from V530, voted 2]" UWORD M_FORMULA_0010 0 0 0 65535 ECU_ADDRESS 0x3FA956 /end MEASUREMENT
/begin MEASUREMENT ed_rbm_lshvk1_r.numerator_nv "Diagnosezyklen [RAM name from V530, voted 2]" UWORD M_FORMULA_0010 0 0 0 65535 ECU_ADDRESS 0x3FAB78 /end MEASUREMENT
/begin MEASUREMENT ed_rbm_lshvk1_r.denominator_nv "Fahrzyklen [RAM name from V530, voted 2]" UWORD M_FORMULA_0010 0 0 0 65535 ECU_ADDRESS 0x3FAB7A /end MEASUREMENT
/begin MEASUREMENT ed_rbm_lshvk2_r.numerator_nv "Diagnosezyklen [RAM name from V530, voted 4]" UWORD M_FORMULA_0010 0 0 0 65535 ECU_ADDRESS 0x3FAB7C /end MEASUREMENT
/begin MEASUREMENT ed_rbm_lshvk2_r.denominator_nv "Fahrzyklen [RAM name from V530, voted 5]" UWORD M_FORMULA_0010 0 0 0 65535 ECU_ADDRESS 0x3FAB7E /end MEASUREMENT
/begin MEASUREMENT ed_rbm_lavk1_ia_openload.numerator_nv "Diagnosezyklen [RAM name from V530, voted 2]" UWORD M_FORMULA_0010 0 0 0 65535 ECU_ADDRESS 0x3FA970 /end MEASUREMENT
/begin MEASUREMENT ed_rbm_lavk1_ia_openload.denominator_nv "Fahrzyklen [RAM name from V530, voted 2]" UWORD M_FORMULA_0010 0 0 0 65535 ECU_ADDRESS 0x3FA972 /end MEASUREMENT
/begin MEASUREMENT ed_rbm_lavk2_ia_openload.numerator_nv "Diagnosezyklen [RAM name from V530, voted 2]" UWORD M_FORMULA_0010 0 0 0 65535 ECU_ADDRESS 0x3FA974 /end MEASUREMENT
/begin MEASUREMENT ed_rbm_lavk2_ia_openload.denominator_nv "Fahrzyklen [RAM name from V530, voted 2]" UWORD M_FORMULA_0010 0 0 0 65535 ECU_ADDRESS 0x3FA976 /end MEASUREMENT
/begin MEASUREMENT ed_rbm_lavk1_un_openload.numerator_nv "Diagnosezyklen [RAM name from V530, voted 2]" UWORD M_FORMULA_0010 0 0 0 65535 ECU_ADDRESS 0x3FA980 /end MEASUREMENT
/begin MEASUREMENT ed_rbm_lavk1_un_openload.denominator_nv "Fahrzyklen [RAM name from V530, voted 2]" UWORD M_FORMULA_0010 0 0 0 65535 ECU_ADDRESS 0x3FA982 /end MEASUREMENT
/begin MEASUREMENT ed_rbm_lavk2_un_openload.numerator_nv "Diagnosezyklen [RAM name from V530, voted 2]" UWORD M_FORMULA_0010 0 0 0 65535 ECU_ADDRESS 0x3FA984 /end MEASUREMENT
/begin MEASUREMENT ed_rbm_lavk2_un_openload.denominator_nv "Fahrzyklen [RAM name from V530, voted 2]" UWORD M_FORMULA_0010 0 0 0 65535 ECU_ADDRESS 0x3FA986 /end MEASUREMENT
/begin MEASUREMENT ed_rbm_lavk1_ip_openload.numerator_nv "Diagnosezyklen [RAM name from V530, voted 2]" UWORD M_FORMULA_0010 0 0 0 65535 ECU_ADDRESS 0x3FA988 /end MEASUREMENT
/begin MEASUREMENT ed_rbm_lavk1_ip_openload.denominator_nv "Fahrzyklen [RAM name from V530, voted 2]" UWORD M_FORMULA_0010 0 0 0 65535 ECU_ADDRESS 0x3FA98A /end MEASUREMENT
/begin MEASUREMENT ed_rbm_lavk2_ip_openload.numerator_nv "Diagnosezyklen [RAM name from V530, voted 2]" UWORD M_FORMULA_0010 0 0 0 65535 ECU_ADDRESS 0x3FA98C /end MEASUREMENT
/begin MEASUREMENT ed_rbm_lavk2_ip_openload.denominator_nv "Fahrzyklen [RAM name from V530, voted 2]" UWORD M_FORMULA_0010 0 0 0 65535 ECU_ADDRESS 0x3FA98E /end MEASUREMENT
/begin MEASUREMENT ed_rbm_van_anschl_e1.numerator_nv "Diagnosezyklen [RAM name from V530, voted 2]" UWORD M_FORMULA_0010 0 0 0 65535 ECU_ADDRESS 0x3FAB6C /end MEASUREMENT
/begin MEASUREMENT ed_rbm_van_anschl_e1.denominator_nv "Fahrzyklen [RAM name from V530, voted 2]" UWORD M_FORMULA_0010 0 0 0 65535 ECU_ADDRESS 0x3FAB6E /end MEASUREMENT
/begin MEASUREMENT ed_rbm_van_anschl_a1.numerator_nv "Diagnosezyklen [RAM name from V530, voted 2]" UWORD M_FORMULA_0010 0 0 0 65535 ECU_ADDRESS 0x3FAB20 /end MEASUREMENT
/begin MEASUREMENT ed_rbm_van_anschl_a1.denominator_nv "Fahrzyklen [RAM name from V530, voted 2]" UWORD M_FORMULA_0010 0 0 0 65535 ECU_ADDRESS 0x3FAB22 /end MEASUREMENT
/begin MEASUREMENT ed_rbm_van_anschl_e2.numerator_nv "Diagnosezyklen [RAM name from V530, voted 2]" UWORD M_FORMULA_0010 0 0 0 65535 ECU_ADDRESS 0x3FA9C4 /end MEASUREMENT
/begin MEASUREMENT ed_rbm_van_anschl_e2.denominator_nv "Fahrzyklen [RAM name from V530, voted 2]" UWORD M_FORMULA_0010 0 0 0 65535 ECU_ADDRESS 0x3FA9C6 /end MEASUREMENT
/begin MEASUREMENT ed_rbm_van_anschl_a2.numerator_nv "Diagnosezyklen [RAM name from V530, voted 2]" UWORD M_FORMULA_0010 0 0 0 65535 ECU_ADDRESS 0x3FA9C8 /end MEASUREMENT
/begin MEASUREMENT ed_rbm_van_anschl_a2.denominator_nv "Fahrzyklen [RAM name from V530, voted 2]" UWORD M_FORMULA_0010 0 0 0 65535 ECU_ADDRESS 0x3FA9CA /end MEASUREMENT
/begin MEASUREMENT ed_rbm_lavk1_obd_dyn.numerator_nv "Diagnosezyklen [RAM name from V530, voted 2]" UWORD M_FORMULA_0010 0 0 0 65535 ECU_ADDRESS 0x3FAA0C /end MEASUREMENT
/begin MEASUREMENT ed_rbm_lavk1_obd_dyn.denominator_nv "Fahrzyklen [RAM name from V530, voted 2]" UWORD M_FORMULA_0010 0 0 0 65535 ECU_ADDRESS 0x3FAA0E /end MEASUREMENT
/begin MEASUREMENT ed_rbm_lavk2_obd_dyn.numerator_nv "Diagnosezyklen [RAM name from V530, voted 2]" UWORD M_FORMULA_0010 0 0 0 65535 ECU_ADDRESS 0x3FAA10 /end MEASUREMENT
/begin MEASUREMENT ed_rbm_lavk2_obd_dyn.denominator_nv "Fahrzyklen [RAM name from V530, voted 2]" UWORD M_FORMULA_0010 0 0 0 65535 ECU_ADDRESS 0x3FAA12 /end MEASUREMENT
/begin MEASUREMENT ed_rbm_kat_obd1.numerator_nv "Diagnosezyklen [RAM name from V530, voted 4]" UWORD M_FORMULA_0010 0 0 0 65535 ECU_ADDRESS 0x3FAA6C /end MEASUREMENT
/begin MEASUREMENT ed_rbm_kat_obd1.denominator_nv "Fahrzyklen [RAM name from V530, voted 4]" UWORD M_FORMULA_0010 0 0 0 65535 ECU_ADDRESS 0x3FAA6E /end MEASUREMENT
/begin MEASUREMENT ed_rbm_kat_obd2.numerator_nv "Diagnosezyklen [RAM name from V530, voted 4]" UWORD M_FORMULA_0010 0 0 0 65535 ECU_ADDRESS 0x3FAA70 /end MEASUREMENT
/begin MEASUREMENT ed_rbm_kat_obd2.denominator_nv "Fahrzyklen [RAM name from V530, voted 4]" UWORD M_FORMULA_0010 0 0 0 65535 ECU_ADDRESS 0x3FAA72 /end MEASUREMENT
/begin MEASUREMENT ed_rbm_mvac_drucksensor.numerator_nv "Diagnosezyklen [RAM name from V530, voted 2]" UWORD M_FORMULA_0010 0 0 0 65535 ECU_ADDRESS 0x3FA928 /end MEASUREMENT
/begin MEASUREMENT ed_rbm_mvac_drucksensor.denominator_nv "Fahrzyklen [RAM name from V530, voted 2]" UWORD M_FORMULA_0010 0 0 0 65535 ECU_ADDRESS 0x3FA92A /end MEASUREMENT
/begin MEASUREMENT ed_rbm_te_obd_1.numerator_nv "Diagnosezyklen [RAM name from V530, voted 2]" UWORD M_FORMULA_0010 0 0 0 65535 ECU_ADDRESS 0x3FAAD8 /end MEASUREMENT
/begin MEASUREMENT ed_rbm_te_obd_1.denominator_nv "Fahrzyklen [RAM name from V530, voted 2]" UWORD M_FORMULA_0010 0 0 0 65535 ECU_ADDRESS 0x3FAADA /end MEASUREMENT
/begin MEASUREMENT ed_rbm_te_obd_2.numerator_nv "Diagnosezyklen [RAM name from V530, voted 2]" UWORD M_FORMULA_0010 0 0 0 65535 ECU_ADDRESS 0x3FAADC /end MEASUREMENT
/begin MEASUREMENT ed_rbm_te_obd_2.denominator_nv "Fahrzyklen [RAM name from V530, voted 2]" UWORD M_FORMULA_0010 0 0 0 65535 ECU_ADDRESS 0x3FAADE /end MEASUREMENT
/begin MEASUREMENT ed_rbm_kge1.numerator_nv "Diagnosezyklen [RAM name from V530, voted 2]" UWORD M_FORMULA_0010 0 0 0 65535 ECU_ADDRESS 0x3FA9D0 /end MEASUREMENT
/begin MEASUREMENT ed_rbm_kge1.denominator_nv "Fahrzyklen [RAM name from V530, voted 2]" UWORD M_FORMULA_0010 0 0 0 65535 ECU_ADDRESS 0x3FA9D2 /end MEASUREMENT
/begin MEASUREMENT ed_rbm_kge2.numerator_nv "Diagnosezyklen [RAM name from V530, voted 2]" UWORD M_FORMULA_0010 0 0 0 65535 ECU_ADDRESS 0x3FAA2C /end MEASUREMENT
/begin MEASUREMENT ed_rbm_kge2.denominator_nv "Fahrzyklen [RAM name from V530, voted 2]" UWORD M_FORMULA_0010 0 0 0 65535 ECU_ADDRESS 0x3FAA2E /end MEASUREMENT
/begin MEASUREMENT ed_rbm_fst.numerator_nv "Diagnosezyklen [RAM name from V530, voted 2]" UWORD M_FORMULA_0010 0 0 0 65535 ECU_ADDRESS 0x3FA9C4 /end MEASUREMENT
/begin MEASUREMENT ed_rbm_fst.denominator_nv "Fahrzyklen [RAM name from V530, voted 2]" UWORD M_FORMULA_0010 0 0 0 65535 ECU_ADDRESS 0x3FA9C6 /end MEASUREMENT
/begin MEASUREMENT ed_rbm_slp.numerator_nv "Diagnosezyklen [RAM name from V530, voted 4]" UWORD M_FORMULA_0010 0 0 0 65535 ECU_ADDRESS 0x3FAB04 /end MEASUREMENT
/begin MEASUREMENT ed_rbm_slp.denominator_nv "Fahrzyklen [RAM name from V530, voted 5]" UWORD M_FORMULA_0010 0 0 0 65535 ECU_ADDRESS 0x3FAB06 /end MEASUREMENT
/begin MEASUREMENT ed_rbm_sl_durchs_b1.numerator_nv "Diagnosezyklen [RAM name from V530, voted 4]" UWORD M_FORMULA_0010 0 0 0 65535 ECU_ADDRESS 0x3FAB08 /end MEASUREMENT
/begin MEASUREMENT ed_rbm_sl_durchs_b1.denominator_nv "Fahrzyklen [RAM name from V530, voted 5]" UWORD M_FORMULA_0010 0 0 0 65535 ECU_ADDRESS 0x3FAB0A /end MEASUREMENT
/begin MEASUREMENT ed_rbm_sl_durchs_b2.numerator_nv "Diagnosezyklen [RAM name from V530, voted 4]" UWORD M_FORMULA_0010 0 0 0 65535 ECU_ADDRESS 0x3FAB0C /end MEASUREMENT
/begin MEASUREMENT ed_rbm_sl_durchs_b2.denominator_nv "Fahrzyklen [RAM name from V530, voted 5]" UWORD M_FORMULA_0010 0 0 0 65535 ECU_ADDRESS 0x3FAB0E /end MEASUREMENT
/begin MEASUREMENT ed_rbm_sl_durchs_hstrang.numerator_nv "Diagnosezyklen [RAM name from V530, voted 4]" UWORD M_FORMULA_0010 0 0 0 65535 ECU_ADDRESS 0x3FAB10 /end MEASUREMENT
/begin MEASUREMENT ed_rbm_sl_durchs_hstrang.denominator_nv "Fahrzyklen [RAM name from V530, voted 5]" UWORD M_FORMULA_0010 0 0 0 65535 ECU_ADDRESS 0x3FAB12 /end MEASUREMENT
/begin MEASUREMENT ed_rbm_van_druck.numerator_nv "Diagnosezyklen [RAM name from V530, voted 2]" UWORD M_FORMULA_0010 0 0 0 65535 ECU_ADDRESS 0x3FAB68 /end MEASUREMENT
/begin MEASUREMENT ed_rbm_van_druck.denominator_nv "Fahrzyklen [RAM name from V530, voted 2]" UWORD M_FORMULA_0010 0 0 0 65535 ECU_ADDRESS 0x3FAB6A /end MEASUREMENT
/begin MEASUREMENT ed_rbm_pumg_obd.numerator_nv "Diagnosezyklen [RAM name from V530, voted 2]" UWORD M_FORMULA_0010 0 0 0 65535 ECU_ADDRESS 0x3FA924 /end MEASUREMENT
/begin MEASUREMENT ed_rbm_pumg_obd.denominator_nv "Fahrzyklen [RAM name from V530, voted 2]" UWORD M_FORMULA_0010 0 0 0 65535 ECU_ADDRESS 0x3FA926 /end MEASUREMENT
/begin MEASUREMENT ed_rbm_sl_ml_hfm_obd.numerator_nv "Diagnosezyklen [RAM name from V530, voted 4]" UWORD M_FORMULA_0010 0 0 0 65535 ECU_ADDRESS 0x3FAB5C /end MEASUREMENT
/begin MEASUREMENT ed_rbm_sl_ml_hfm_obd.denominator_nv "Fahrzyklen [RAM name from V530, voted 5]" UWORD M_FORMULA_0010 0 0 0 65535 ECU_ADDRESS 0x3FAB5E /end MEASUREMENT
/begin MEASUREMENT ed_rbm_lank1_openload.numerator_nv "Diagnosezyklen [RAM name from V530, voted 2]" UWORD M_FORMULA_0010 0 0 0 65535 ECU_ADDRESS 0x3FAB70 /end MEASUREMENT
/begin MEASUREMENT ed_rbm_lank1_openload.denominator_nv "Fahrzyklen [RAM name from V530, voted 2]" UWORD M_FORMULA_0010 0 0 0 65535 ECU_ADDRESS 0x3FAB72 /end MEASUREMENT
/begin MEASUREMENT ed_rbm_lank2_openload.numerator_nv "Diagnosezyklen [RAM name from V530, voted 2]" UWORD M_FORMULA_0010 0 0 0 65535 ECU_ADDRESS 0x3FAB74 /end MEASUREMENT
/begin MEASUREMENT ed_rbm_lank2_openload.denominator_nv "Fahrzyklen [RAM name from V530, voted 2]" UWORD M_FORMULA_0010 0 0 0 65535 ECU_ADDRESS 0x3FAB76 /end MEASUREMENT
/begin MEASUREMENT ed_rbm_lshnk1_r.numerator_nv "Diagnosezyklen [RAM name from V530, voted 2]" UWORD M_FORMULA_0010 0 0 0 65535 ECU_ADDRESS 0x3FA9C8 /end MEASUREMENT
/begin MEASUREMENT ed_rbm_lshnk1_r.denominator_nv "Fahrzyklen [RAM name from V530, voted 2]" UWORD M_FORMULA_0010 0 0 0 65535 ECU_ADDRESS 0x3FA9CA /end MEASUREMENT
/begin MEASUREMENT ed_fsp_1of20_.fehlercode_nv "Externer Fehlerort [RAM name from V530, voted 11]" UWORD NO_COMPU_METHOD 0 0 0 65535 ECU_ADDRESS 0x3FAC08 FORMAT "%.4g" /end MEASUREMENT
/begin MEASUREMENT hdw_z1_nv "HDW [RAM name from V530, voted 4]" UBYTE M_FORMULA_0003 0 0 0 255 ECU_ADDRESS 0x3FB2CB /end MEASUREMENT
/begin MEASUREMENT Oz_lgztwert_cbs_reset_st "Erkennung 1. Langztwert nach CBS-Reset [RAM name from V530, voted 3]" UBYTE NO_COMPU_METHOD 0 0 0 255 ECU_ADDRESS 0x3FB2CC FORMAT "%.4g" /end MEASUREMENT
/begin MEASUREMENT Oz_krzmsg_ctr "Zeitmesser fuer Kurzzeitmessung [RAM name from V530, voted 1]" UWORD M_FORMULA_0071 0 0 0 6553.5 ECU_ADDRESS 0x3FB2CE /end MEASUREMENT
/begin MEASUREMENT Oz_krzmsg_st "Kurzzeitmessung aktiv/inaktiv [RAM name from V530, voted 2]" UBYTE NO_COMPU_METHOD 0 0 0 255 ECU_ADDRESS 0x3FB2D0 FORMAT "%.4g" /end MEASUREMENT
/begin MEASUREMENT psau_adapt_nv_b1 "Adaptionswert zur PSAU1 im GLOBbereich [RAM name from V530, voted 2]" SWORD M_FORMULA_0075 0 0 -2048 2047.9375 ECU_ADDRESS 0x3FB2D2 /end MEASUREMENT
/begin MEASUREMENT laa_offs_nv_b1 "Offset-Lambdaadaption [RAM name from V530, voted 6]" SWORD M_FORMULA_0535 0 0 -512 511.984375 ECU_ADDRESS 0x3FB2E8 /end MEASUREMENT
/begin MEASUREMENT laa_offs_nv_b2 "Offset-Lambdaadaption [RAM name from V530, voted 1]" SWORD M_FORMULA_0535 0 0 -512 511.984375 ECU_ADDRESS 0x3FB2EA /end MEASUREMENT
/begin MEASUREMENT lavk_ad_gain_b1 "Faktor-Sondenadaption [RAM name from V530, voted 9]" UWORD M_FORMULA_0073 0 0 0 63.99902344 ECU_ADDRESS 0x3FB2EC /end MEASUREMENT
/begin MEASUREMENT lavk_ad_gain_b2 "Faktor-Sondenadaption [RAM name from V530, voted 1]" UWORD M_FORMULA_0073 0 0 0 63.99902344 ECU_ADDRESS 0x3FB2EE /end MEASUREMENT
/begin MEASUREMENT lavk_ad_offs_b1 "Offset-Sondenadaption [RAM name from V530, voted 12]" SWORD M_FORMULA_0536 0 0 -160000 159995.1172 ECU_ADDRESS 0x3FB2F0 /end MEASUREMENT
/begin MEASUREMENT lavk_ad_offs_b2 "Offset-Sondenadaption [RAM name from V530, voted 1]" SWORD M_FORMULA_0536 0 0 -160000 159995.1172 ECU_ADDRESS 0x3FB2F2 /end MEASUREMENT
/begin MEASUREMENT lavk_obd_dyn_wert_nv_b1 "Diagnosewert [RAM name from V530, voted 9]" UWORD M_FORMULA_0025 0 0 0 3.999938965 ECU_ADDRESS 0x3FB2F4 /end MEASUREMENT
/begin MEASUREMENT lavk_obd_dyn_wert_nv_b2 "Diagnosewert [RAM name from V530, voted 6]" UWORD M_FORMULA_0025 0 0 0 3.999938965 ECU_ADDRESS 0x3FB2F6 /end MEASUREMENT
/begin MEASUREMENT lavk_obd_dyn_wert_gesamt_nv "Gesamt-Diagnosewert [RAM name from V530, voted 2]" UWORD M_FORMULA_0025 0 0 0 3.999938965 ECU_ADDRESS 0x3FB2F8 /end MEASUREMENT
/begin MEASUREMENT lshvk_r_ad_gain_b1 "Faktor-Sonden-Ri-Adaption [RAM name from V530, voted 7]" UWORD M_FORMULA_0073 0 0 0 63.99902344 ECU_ADDRESS 0x3FB2FE /end MEASUREMENT
/begin MEASUREMENT lshvk_diag_aktiv_b1 "VKAT-LSH-Diag-AKTIV [RAM name from V530, voted 20]" UWORD NO_COMPU_METHOD 0 0 0 65535 ECU_ADDRESS 0x3FB302 FORMAT "%.4g" /end MEASUREMENT
/begin MEASUREMENT lshvk_diag_info_b1 "VKAT-LSH-Diag-INFO [RAM name from V530, voted 20]" UWORD NO_COMPU_METHOD 0 0 0 65535 ECU_ADDRESS 0x3FB302 FORMAT "%.4g" /end MEASUREMENT
/begin MEASUREMENT lshvk_diag_r_adaption_b1 "gueltige LSHVK-R-Adaption [RAM name from V530, voted 20]" UWORD NO_COMPU_METHOD 0 0 0 65535 ECU_ADDRESS 0x3FB302 FORMAT "%.4g" /end MEASUREMENT
/begin MEASUREMENT lshvk_diag_sh_to_x_sperren_b1 "VKAT-LSH-Einschalten aufgrund elektr. Diag. sperren [RAM name from V530, voted 20]" UWORD NO_COMPU_METHOD 0 0 0 65535 ECU_ADDRESS 0x3FB302 FORMAT "%.4g" /end MEASUREMENT
/begin MEASUREMENT lshvk_diag_st_nv_b1 "VKAT-LSH-Diag.-Status [RAM name from V530, voted 20]" UWORD M_FORMULA_0080 0 0 0 65535 ECU_ADDRESS 0x3FB302 /end MEASUREMENT
/begin MEASUREMENT lshvk_diag_aktiv_b2 "VKAT-LSH-Diag-AKTIV [RAM name from V530, voted 9]" UWORD NO_COMPU_METHOD 0 0 0 65535 ECU_ADDRESS 0x3FB304 FORMAT "%.4g" /end MEASUREMENT
/begin MEASUREMENT lshvk_diag_info_b2 "VKAT-LSH-Diag-INFO [RAM name from V530, voted 9]" UWORD NO_COMPU_METHOD 0 0 0 65535 ECU_ADDRESS 0x3FB304 FORMAT "%.4g" /end MEASUREMENT
/begin MEASUREMENT lshvk_diag_r_adaption_b2 "gueltige LSHVK-R-Adaption [RAM name from V530, voted 9]" UWORD NO_COMPU_METHOD 0 0 0 65535 ECU_ADDRESS 0x3FB304 FORMAT "%.4g" /end MEASUREMENT
/begin MEASUREMENT lshvk_diag_sh_to_x_sperren_b2 "VKAT-LSH-Einschalten aufgrund elektr. Diag. sperren [RAM name from V530, voted 9]" UWORD NO_COMPU_METHOD 0 0 0 65535 ECU_ADDRESS 0x3FB304 FORMAT "%.4g" /end MEASUREMENT
/begin MEASUREMENT lshvk_diag_st_nv_b2 "VKAT-LSH-Diag.-Status [RAM name from V530, voted 9]" UWORD M_FORMULA_0080 0 0 0 65535 ECU_ADDRESS 0x3FB304 /end MEASUREMENT
/begin MEASUREMENT lshvk_r_ad_offs_b1 "Offset-Sonden-Ri-Adaption [RAM name from V530, voted 7]" SWORD M_FORMULA_0536 0 0 -160000 159995.1172 ECU_ADDRESS 0x3FB306 /end MEASUREMENT
/begin MEASUREMENT lshvk_diag_r_gmw_nv_b1 "gem. Heizerwiderstand VKAT [RAM name from V530, voted 3]" UWORD M_FORMULA_0541 0 0 0 6553.5 ECU_ADDRESS 0x3FB30E /end MEASUREMENT
/begin MEASUREMENT t_mot_steht_1s_nv "Zeitpunkt sei dem Motor steht [RAM name from V530, voted 4]" ULONG M_FORMULA_0542 0 0 0 4294967295 ECU_ADDRESS 0x3FB354 /end MEASUREMENT
/begin MEASUREMENT slp_t_aus_nv "Auschalt-SLP rel. Zeit [RAM name from V530, voted 6]" ULONG M_FORMULA_0145 0 0 0 71582788.25 ECU_ADDRESS 0x3FB358 /end MEASUREMENT
/begin MEASUREMENT pks_obd_abw "Kraftstoffdruck Ist-Soll Verhaeltniss [RAM name from V530, voted 1]" SWORD M_FORMULA_0543 0 0 -32768 32767 ECU_ADDRESS 0x3FB35C /end MEASUREMENT
/begin MEASUREMENT nw_fehlerzaehler_nv "Anzahl Rueckschaltungen in 360??? Mode [RAM name from V530, voted 1]" UBYTE M_FORMULA_0003 0 0 0 255 ECU_ADDRESS 0x3FB388 /end MEASUREMENT
/begin MEASUREMENT pksr_st_nv "pksr Status Adaption [RAM name from V530, voted 5]" UBYTE NO_COMPU_METHOD 0 0 0 255 ECU_ADDRESS 0x3FB389 FORMAT "%.4g" /end MEASUREMENT
/begin MEASUREMENT dmtl_abbr_fein "Anzahl abgebrochene Feindiags [RAM name from V530, voted 9]" UBYTE M_FORMULA_0545 0 0 0 255 ECU_ADDRESS 0x3FB38B /end MEASUREMENT
/begin MEASUREMENT dmtl_abbr_ub "Anzahl Abbrueche wegen Spannung [RAM name from V530, voted 1]" UWORD M_FORMULA_0546 0 0 0 65535 ECU_ADDRESS 0x3FB38C /end MEASUREMENT
/begin MEASUREMENT dmtl_abbr_feucht_mil "Anzahl Feuchteabbrueche fuer MIL [RAM name from V530, voted 7]" UBYTE M_FORMULA_0545 0 0 0 255 ECU_ADDRESS 0x3FB38D /end MEASUREMENT
/begin MEASUREMENT dmtl_anz_deckel_leck "Anzahl erkannter Deckellecks [RAM name from V530, voted 8]" UBYTE M_FORMULA_0545 0 0 0 255 ECU_ADDRESS 0x3FB38E /end MEASUREMENT
/begin MEASUREMENT dmtl_anz_dia_deckel "Anzahl durchgelaufene Deckeldiagnosen [RAM name from V530, voted 10]" UWORD M_FORMULA_0546 0 0 0 65535 ECU_ADDRESS 0x3FB390 /end MEASUREMENT
/begin MEASUREMENT dmtl_anz_dia_grob "Anzahl durchgelaufene Grobleckdiagnosen [RAM name from V530, voted 8]" UWORD M_FORMULA_0546 0 0 0 65535 ECU_ADDRESS 0x3FB394 /end MEASUREMENT
/begin MEASUREMENT dmtl_anz_dia_fein "Anzahl durchgelaufene Feinleckdiagnosen [RAM name from V530, voted 8]" UWORD M_FORMULA_0546 0 0 0 65535 ECU_ADDRESS 0x3FB396 /end MEASUREMENT
/begin MEASUREMENT dmtl_anz_fahrten "Anzahl der langen Fahrten [RAM name from V530, voted 6]" UBYTE M_FORMULA_0003 0 0 0 255 ECU_ADDRESS 0x3FB398 /end MEASUREMENT
/begin MEASUREMENT B_DMTL_ABBRUCH_BETANK "Abbruch wegen starken Stromanstieg [RAM name from V530, voted 51]" UBYTE NO_COMPU_METHOD 0 0 0 255 ECU_ADDRESS 0x3FB39A FORMAT "%.4g" /end MEASUREMENT
/begin MEASUREMENT B_DMTL_ABBRUCH_FEUCHT "Abbruch wg. Stromschwankung [RAM name from V530, voted 51]" UBYTE NO_COMPU_METHOD 0 0 0 255 ECU_ADDRESS 0x3FB39A FORMAT "%.4g" /end MEASUREMENT
/begin MEASUREMENT B_DMTL_DECKEL_GEPRUEFT "Deckel nach Betankung geprueft [RAM name from V530, voted 51]" UBYTE NO_COMPU_METHOD 0 0 0 255 ECU_ADDRESS 0x3FB39A FORMAT "%.4g" /end MEASUREMENT
/begin MEASUREMENT B_DMTL_FST_GESTIEGEN "Nachtanken wurde erkannt [RAM name from V530, voted 51]" UBYTE NO_COMPU_METHOD 0 0 0 255 ECU_ADDRESS 0x3FB39A FORMAT "%.4g" /end MEASUREMENT
/begin MEASUREMENT B_DMTL_GROB_VERMUT "Grobleck wegen Betankung? [RAM name from V530, voted 51]" UBYTE NO_COMPU_METHOD 0 0 0 255 ECU_ADDRESS 0x3FB39A FORMAT "%.4g" /end MEASUREMENT
/begin MEASUREMENT B_DMTL_GROBLECK_1 "1x Grobleck Vermutung bestaetigt [RAM name from V530, voted 51]" UBYTE NO_COMPU_METHOD 0 0 0 255 ECU_ADDRESS 0x3FB39A FORMAT "%.4g" /end MEASUREMENT
/begin MEASUREMENT B_DMTL_GROBLECK_2 "2x Grobleck Vermutung bestaetigt [RAM name from V530, voted 51]" UBYTE NO_COMPU_METHOD 0 0 0 255 ECU_ADDRESS 0x3FB39A FORMAT "%.4g" /end MEASUREMENT
/begin MEASUREMENT B_DMTL_STANDZEIT "Standzeit fuer Diagnose erfuellt [RAM name from V530, voted 51]" UBYTE NO_COMPU_METHOD 0 0 0 255 ECU_ADDRESS 0x3FB39A FORMAT "%.4g" /end MEASUREMENT
/begin MEASUREMENT dmtl_flags_nv "Flags der DMTL [RAM name from V530, voted 51]" UBYTE M_FORMULA_0003 0 0 0 255 ECU_ADDRESS 0x3FB39A /end MEASUREMENT
/begin MEASUREMENT B_DMTL_DECKEL_DICHT "Deckel dicht bestaetigt durch Grobleckdia [RAM name from V530, voted 12]" UBYTE NO_COMPU_METHOD 0 0 0 255 ECU_ADDRESS 0x3FB39B FORMAT "%.4g" /end MEASUREMENT
/begin MEASUREMENT dmtl_flags_nv2 "Flags der DMTL [RAM name from V530, voted 12]" UBYTE M_FORMULA_0003 0 0 0 255 ECU_ADDRESS 0x3FB39B /end MEASUREMENT
/begin MEASUREMENT dmtl_grob_ohne_fein "Anzahl Grobleckdiags. ohne Feindiag [RAM name from V530, voted 8]" UBYTE M_FORMULA_0545 0 0 0 255 ECU_ADDRESS 0x3FB39C /end MEASUREMENT
/begin MEASUREMENT dmtl_i_filt "DMTL Strom korrigiert und gefiltert [RAM name from V530, voted 6]" UWORD M_FORMULA_0553 0 0 0 147.45375 ECU_ADDRESS 0x3FB39E /end MEASUREMENT
/begin MEASUREMENT dmtl_i_min "DMTL Strom minimal [RAM name from V530, voted 8]" UWORD M_FORMULA_0553 0 0 0 147.45375 ECU_ADDRESS 0x3FB3A2 /end MEASUREMENT
/begin MEASUREMENT dmtl_i_ref "DMTL Strom Referenzleck [RAM name from V530, voted 4]" UWORD M_FORMULA_0553 0 0 0 147.45375 ECU_ADDRESS 0x3FB3A4 /end MEASUREMENT
/begin MEASUREMENT dmtl_t_abstell "DMTL Abstellzeit [RAM name from V530, voted 2]" UWORD M_FORMULA_0556 0 0 0 65535 ECU_ADDRESS 0x3FB3A6 /end MEASUREMENT
/begin MEASUREMENT dmtl_t_mess "DMTL aktuelle Me???dauer [RAM name from V530, voted 8]" UWORD M_FORMULA_0071 0 0 0 6553.5 ECU_ADDRESS 0x3FB3A8 /end MEASUREMENT
/begin MEASUREMENT dmtl_crb_grenze "Strom Diagnosemodul Tankleck [RAM name from V530, voted 3]" UWORD M_FORMULA_0553 0 0 0 147.45375 ECU_ADDRESS 0x3FB3AE /end MEASUREMENT
/begin MEASUREMENT fst_max_nv "Fuellstand zu Beginn der Diagnose [RAM name from V530, voted 1]" UBYTE M_FORMULA_0559 0 0 0 127.5 ECU_ADDRESS 0x3FB3C8 /end MEASUREMENT
/begin MEASUREMENT fst_rechts "gefilterter Geberwert rechts [RAM name from V530, voted 2]" UBYTE M_FORMULA_0559 0 0 0 127.5 ECU_ADDRESS 0x3FB3CA /end MEASUREMENT
/begin MEASUREMENT kwp_ps_teststamp "kwp_ps_teststamp [RAM name from V530, voted 6]" UBYTE M_FORMULA_0003 0 0 0 255 ECU_ADDRESS 0x3FB3CE /end MEASUREMENT
/begin MEASUREMENT tksm_off_nv "Temperaturdifferenz TKS Modell zu ungefiltert. [RAM name from V530, voted 3]" SWORD M_FORMULA_0074 0 0 -3276.8 3276.7 ECU_ADDRESS 0x3FB3D2 /end MEASUREMENT
/begin MEASUREMENT tksm_mr_off_nv "Temperaturdifferenz Motorraum zu TMOT. [RAM name from V530, voted 3]" SWORD M_FORMULA_0074 0 0 -3276.8 3276.7 ECU_ADDRESS 0x3FB3D4 /end MEASUREMENT
/begin MEASUREMENT tpu_kw_n_drop_ff.state "Zustand der TPU [RAM name from V530, voted 4]" UBYTE NO_COMPU_METHOD 0 0 0 255 ECU_ADDRESS 0x3FB3D8 FORMAT "%.4g" /end MEASUREMENT
/begin MEASUREMENT tpu_kw_n_drop_ff.tooth "Abrisszahn [RAM name from V530, voted 2]" UBYTE M_FORMULA_0003 0 0 0 255 ECU_ADDRESS 0x3FB3D9 /end MEASUREMENT
/begin MEASUREMENT tpu_kw_n_drop_ff.irq "Interruptarten [RAM name from V530, voted 2]" UBYTE M_FORMULA_0003 0 0 0 255 ECU_ADDRESS 0x3FB3DA /end MEASUREMENT
/begin MEASUREMENT tpu_kw_n_drop_ff.cnt "Abrisszaehler [RAM name from V530, voted 2]" UBYTE M_FORMULA_0003 0 0 0 255 ECU_ADDRESS 0x3FB3DB /end MEASUREMENT
/begin MEASUREMENT tpu_kw_n_drop_ff.n "Abrissdrehzahl [RAM name from V530, voted 2]" SWORD M_FORMULA_0006 0 0 -32768 32767 ECU_ADDRESS 0x3FB3DC /end MEASUREMENT
/begin MEASUREMENT tpu_kw_n_drop_ff.n_zahn "Abrisszahndrehzahl [RAM name from V530, voted 1]" SWORD M_FORMULA_0006 0 0 -32768 32767 ECU_ADDRESS 0x3FB3DE /end MEASUREMENT
/begin MEASUREMENT tpu_kw_n_drop_ff.prev_period "vorletzte Zahnperiode [RAM name from V530, voted 2]" ULONG M_FORMULA_0017 0 0 0 613566.7564 ECU_ADDRESS 0x3FB3E0 /end MEASUREMENT
/begin MEASUREMENT tpu_kw_n_drop_ff.last_period "letzte Zahnperiode [RAM name from V530, voted 2]" ULONG M_FORMULA_0017 0 0 0 613566.7564 ECU_ADDRESS 0x3FB3E4 /end MEASUREMENT
/begin MEASUREMENT tpu_kw_n_drop_ff.event_time "letzte Ereigniszeit [RAM name from V530, voted 2]" ULONG M_FORMULA_0017 0 0 0 613566.7564 ECU_ADDRESS 0x3FB3E8 /end MEASUREMENT
/begin MEASUREMENT tpu_kw_n_drop_ff.tooth_time "letzte Zahnzeit [RAM name from V530, voted 2]" ULONG M_FORMULA_0017 0 0 0 613566.7564 ECU_ADDRESS 0x3FB3EC /end MEASUREMENT
/begin MEASUREMENT slp_time_on_nv "Laufzeit der SLP [RAM name from V530, voted 14]" UWORD M_FORMULA_0071 0 0 0 6553.5 ECU_ADDRESS 0x3FB3F0 /end MEASUREMENT
/begin MEASUREMENT ed_rbm_ignition_count_nv "Motorstartzaehler [RAM name from V530, voted 2]" UWORD M_FORMULA_0010 0 0 0 65535 ECU_ADDRESS 0x3FB3FA /end MEASUREMENT
/begin MEASUREMENT ed_rbm_general_dcy_nv "General Denominator [RAM name from V530, voted 2]" UWORD M_FORMULA_0010 0 0 0 65535 ECU_ADDRESS 0x3FB3FC /end MEASUREMENT
/begin MEASUREMENT ed_rbm_css_denominator_nv "CSS Denominator [RAM name from V530, voted 4]" UWORD M_FORMULA_0010 0 0 0 65535 ECU_ADDRESS 0x3FB3FE /end MEASUREMENT
/begin MEASUREMENT ed_rbm_css_numerator_nv "CSS Numerator [RAM name from V530, voted 5]" UWORD M_FORMULA_0010 0 0 0 65535 ECU_ADDRESS 0x3FB400 /end MEASUREMENT
/begin MEASUREMENT kats_nkat_t_nv "Zeit im Katschutz wegen Nkat-Tempereratur(Sensor) [RAM name from V530, voted 4]" UWORD M_FORMULA_0071 0 0 0 6553.5 ECU_ADDRESS 0x3FB428 /end MEASUREMENT
/begin MEASUREMENT kats_mdl_t_nv "Zeit im Katschutz wegen Modelltempereratur(Sensor) [RAM name from V530, voted 4]" UWORD M_FORMULA_0071 0 0 0 6553.5 ECU_ADDRESS 0x3FB42C /end MEASUREMENT
/begin MEASUREMENT kats_vkat_t_nv "Zeit im Katschutz wegen Vkat-Tempereratur(Sensor) [RAM name from V530, voted 4]" UWORD M_FORMULA_0071 0 0 0 6553.5 ECU_ADDRESS 0x3FB430 /end MEASUREMENT
/begin MEASUREMENT St_pmdiagnv "Statuswort [RAM name from V530, voted 3]" UBYTE M_FORMULA_0003 0 0 0 255 ECU_ADDRESS 0x3FB512 /end MEASUREMENT
/begin MEASUREMENT St_pmdiagnv.B_ruhverl "ruhestromverletzung vorhanden [RAM name from V530, voted 3]" UBYTE NO_COMPU_METHOD 0 0 0 255 ECU_ADDRESS 0x3FB512 FORMAT "%.4g" /end MEASUREMENT
/begin MEASUREMENT Pminfo1 "Infospeicher 1 vom Powermanagement [RAM name from V530, voted 3]" UWORD M_FORMULA_0010 0 0 0 65535 ECU_ADDRESS 0x3FB514 /end MEASUREMENT
/begin MEASUREMENT Ztageold "letzter Wert von ztageabs_w [RAM name from V530, voted 1]" UWORD M_FORMULA_0010 0 0 0 65535 ECU_ADDRESS 0x3FB562 /end MEASUREMENT
/begin MEASUREMENT Pminfo2 "Fehlerinfo2 vom Powermanagement [RAM name from V530, voted 3]" UBYTE M_FORMULA_0003 0 0 0 255 ECU_ADDRESS 0x3FB565 /end MEASUREMENT
/begin MEASUREMENT St_pmsocalc1 "Statuswort [RAM name from V530, voted 6]" UBYTE M_FORMULA_0003 0 0 0 255 ECU_ADDRESS 0x3FB5BC /end MEASUREMENT
/begin MEASUREMENT St_pmsocalc1.B_ibspwf_e "Bedingung Powerfail IBS erkannt [RAM name from V530, voted 6]" UBYTE NO_COMPU_METHOD 0 0 0 255 ECU_ADDRESS 0x3FB5BC FORMAT "%.4g" /end MEASUREMENT
/begin MEASUREMENT Q_bila "Kapazit???t Batterie (long) [RAM name from V530, voted 5]" ULONG M_FORMULA_0512 0 0 0 1193.046471 ECU_ADDRESS 0x3FB5C0 /end MEASUREMENT
/begin MEASUREMENT Qeladold "Kapazit???t Entladen vor Abstellen [RAM name from V530, voted 2]" UWORD M_FORMULA_0498 0 0 0 1192.750253 ECU_ADDRESS 0x3FB5C4 /end MEASUREMENT
/begin MEASUREMENT Qladold "Kapazit???t Getladen vor Abstellen [RAM name from V530, voted 1]" UWORD M_FORMULA_0498 0 0 0 1192.750253 ECU_ADDRESS 0x3FB5C6 /end MEASUREMENT
/begin MEASUREMENT Soc_b_loc "lokal soc_bila f. KFSOCLF [RAM name from V530, voted 1]" UWORD M_FORMULA_0462 0 0 0 99.99847412 ECU_ADDRESS 0x3FB5C8 /end MEASUREMENT
/begin MEASUREMENT Soc_q_loc "lokaler Z???hler Genauigkeit Ladeztustandsbestimmung [RAM name from V530, voted 5]" UWORD M_FORMULA_0498 0 0 0 1192.750253 ECU_ADDRESS 0x3FB5CA /end MEASUREMENT
/begin MEASUREMENT Soc_fit "SoC aus der Fitformel [RAM name from V530, voted 3]" UWORD M_FORMULA_0462 0 0 0 99.99847412 ECU_ADDRESS 0x3FB5CC /end MEASUREMENT
/begin MEASUREMENT Absch_korr "Korrekturwert Abschaltung [RAM name from V530, voted 6]" SWORD M_FORMULA_0499 0 0 -50 49.99847412 ECU_ADDRESS 0x3FB5CE /end MEASUREMENT
/begin MEASUREMENT D_soc "Abstand zur Startf???higkeitsgrenze [RAM name from V530, voted 7]" SWORD M_FORMULA_0479 0 0 -100 99.99694824 ECU_ADDRESS 0x3FB5D0 /end MEASUREMENT
/begin MEASUREMENT Soc_korr "Korrekturwert soc_bila [RAM name from V530, voted 4]" SWORD M_FORMULA_0479 0 0 -100 99.99694824 ECU_ADDRESS 0x3FB5D2 /end MEASUREMENT
/begin MEASUREMENT T_saison "Saison -Temperatur [RAM name from V530, voted 1]" SWORD M_FORMULA_0431 0 0 -3276.8 3276.7 ECU_ADDRESS 0x3FB5D4 /end MEASUREMENT
/begin MEASUREMENT Soc_stfgk "Startf???higkeitsgrenze [RAM name from V530, voted 1]" UWORD M_FORMULA_0462 0 0 0 99.99847412 ECU_ADDRESS 0x3FB5DA /end MEASUREMENT
/begin MEASUREMENT Pm_tsrdy "Status Berechnung Tsaison [RAM name from V530, voted 2]" UBYTE M_FORMULA_0478 0 0 0 255 ECU_ADDRESS 0x3FB5DC /end MEASUREMENT
/begin MEASUREMENT St_pmsocstart_nv0 "Statuswort [RAM name from V530, voted 3]" UBYTE M_FORMULA_0003 0 0 0 255 ECU_ADDRESS 0x3FB5DD /end MEASUREMENT
/begin MEASUREMENT St_pmsocstart_nv0.B_pmsqrdy "kt_ibs.dat [RAM name from V530, voted 3]" UBYTE NO_COMPU_METHOD 0 0 0 255 ECU_ADDRESS 0x3FB5DD FORMAT "%.4g" /end MEASUREMENT
/begin MEASUREMENT St_pmsocstart_nv0.B_pmstartq "Bedingung Startqualit???t [RAM name from V530, voted 3]" UBYTE NO_COMPU_METHOD 0 0 0 255 ECU_ADDRESS 0x3FB5DD FORMAT "%.4g" /end MEASUREMENT
/begin MEASUREMENT St_generator "Bitbasis Zustand Generator [RAM name from V530, voted 2]" UBYTE M_FORMULA_0003 0 0 0 255 ECU_ADDRESS 0x3FBBE0 /end MEASUREMENT
/begin MEASUREMENT St_generator.B_crashgen "Crash f???r Generatorabschaltung [RAM name from V530, voted 2]" UBYTE NO_COMPU_METHOD 0 0 0 255 ECU_ADDRESS 0x3FBBE0 FORMAT "%.4g" /end MEASUREMENT
/begin MEASUREMENT St_generator.B_genactiv "Interface aktiv Generator [RAM name from V530, voted 2]" UBYTE NO_COMPU_METHOD 0 0 0 255 ECU_ADDRESS 0x3FBBE0 FORMAT "%.4g" /end MEASUREMENT
/begin MEASUREMENT St_generator.B_genfbsd "BSD-Fehler Generator [RAM name from V530, voted 2]" UBYTE NO_COMPU_METHOD 0 0 0 255 ECU_ADDRESS 0x3FBBE0 FORMAT "%.4g" /end MEASUREMENT
/begin MEASUREMENT St_generator.B_genfel "Elektrischer Fehler Generator [RAM name from V530, voted 2]" UBYTE NO_COMPU_METHOD 0 0 0 255 ECU_ADDRESS 0x3FBBE0 FORMAT "%.4g" /end MEASUREMENT
/begin MEASUREMENT St_generator.B_genfht "Hohe Temperatur Generator [RAM name from V530, voted 2]" UBYTE NO_COMPU_METHOD 0 0 0 255 ECU_ADDRESS 0x3FBBE0 FORMAT "%.4g" /end MEASUREMENT
/begin MEASUREMENT St_generator.B_genfme "Mechanischer Fehler Generator [RAM name from V530, voted 2]" UBYTE NO_COMPU_METHOD 0 0 0 255 ECU_ADDRESS 0x3FBBE0 FORMAT "%.4g" /end MEASUREMENT
/begin MEASUREMENT Gen_manufak "Herstellerkennung Generator [RAM name from V530, voted 1]" UBYTE M_FORMULA_0003 0 0 0 255 ECU_ADDRESS 0x3FBBE2 /end MEASUREMENT
/begin MEASUREMENT U_fgen "Spannung Generator, empfangen vom Generator [RAM name from V530, voted 1]" UWORD M_FORMULA_0466 0 0 0 6553.5 ECU_ADDRESS 0x3FBBE6 /end MEASUREMENT
/begin MEASUREMENT Ebsd_varin "Index EBSD Variable [RAM name from V530, voted 6]" UBYTE M_FORMULA_0003 0 0 0 255 ECU_ADDRESS 0x3FBBF0 /end MEASUREMENT
/begin MEASUREMENT Ebsd_nbyt "L???nge EBSD Variable [RAM name from V530, voted 7]" UBYTE M_FORMULA_0003 0 0 0 255 ECU_ADDRESS 0x3FBBF1 /end MEASUREMENT
/begin MEASUREMENT Unind "EBSD Puffer Index [RAM name from V530, voted 9]" UBYTE M_FORMULA_0003 0 0 0 255 ECU_ADDRESS 0x3FBBF2 /end MEASUREMENT
/begin MEASUREMENT Ebsd_adr "EBSD Adresse im IBS [RAM name from V530, voted 3]" UBYTE M_FORMULA_0003 0 0 0 255 ECU_ADDRESS 0x3FBBF3 /end MEASUREMENT
/begin MEASUREMENT Ebsd_errdir "EBSD ???bertragungsrichtung bei Fehler [RAM name from V530, voted 1]" UBYTE M_FORMULA_0003 0 0 0 255 ECU_ADDRESS 0x3FBBF4 /end MEASUREMENT
/begin MEASUREMENT Ebsd_errin "EBSD Index bei Fehler [RAM name from V530, voted 4]" UBYTE M_FORMULA_0003 0 0 0 255 ECU_ADDRESS 0x3FBBF5 /end MEASUREMENT
/begin MEASUREMENT Ebsd_errep "EBSD Fehler repeat timer [RAM name from V530, voted 2]" UBYTE M_FORMULA_0003 0 0 0 255 ECU_ADDRESS 0x3FBBF6 /end MEASUREMENT
/begin MEASUREMENT Ebsd_timo "EBSD Fehler timeout counter [RAM name from V530, voted 1]" UBYTE M_FORMULA_0003 0 0 0 255 ECU_ADDRESS 0x3FBBF7 /end MEASUREMENT
/begin MEASUREMENT R5cyctim "Timer f. zyklisches Senden IBS Reg. 5 [RAM name from V530, voted 1]" UBYTE M_FORMULA_0003 0 0 0 255 ECU_ADDRESS 0x3FBBF8 /end MEASUREMENT
/begin MEASUREMENT Fsclctr "Hilfszaehler IBS Fehler loeschen [RAM name from V530, voted 3]" UBYTE M_FORMULA_0003 0 0 0 255 ECU_ADDRESS 0x3FBBF9 /end MEASUREMENT
/begin MEASUREMENT Ktib_chk16 "Checksumme EBSD ???bertragung intern [RAM name from V530, voted 8]" UWORD M_FORMULA_0010 0 0 0 65535 ECU_ADDRESS 0x3FBBFA /end MEASUREMENT
/begin MEASUREMENT Ib_chk16 "Checksumme EBSD ???bertragung aus IBS [RAM name from V530, voted 3]" UWORD M_FORMULA_0010 0 0 0 65535 ECU_ADDRESS 0x3FBBFC /end MEASUREMENT
/begin MEASUREMENT Chk16_ibs "Checksumme Parameter aus IBS [RAM name from V530, voted 2]" UWORD M_FORMULA_0010 0 0 0 65535 ECU_ADDRESS 0x3FBBFE /end MEASUREMENT
/begin MEASUREMENT Chkpara "Checksumme Parameter intern [RAM name from V530, voted 3]" UWORD M_FORMULA_0010 0 0 0 65535 ECU_ADDRESS 0x3FBC00 /end MEASUREMENT
/begin MEASUREMENT St_oz "Statuswort mit Biteingangsgroessen OZ [RAM name from V530, voted 25]" UBYTE M_FORMULA_0003 0 0 0 255 ECU_ADDRESS 0x3FCB0F /end MEASUREMENT
/begin MEASUREMENT St_oz.B_anhang "Bedingung Anh???nger erkannt [RAM name from V530, voted 25]" UBYTE NO_COMPU_METHOD 0 0 0 255 ECU_ADDRESS 0x3FCB0F FORMAT "%.4g" /end MEASUREMENT
/begin MEASUREMENT St_oz.B_ozfbsd "Bedingung Fehler BSD-Kommunikation [RAM name from V530, voted 25]" UBYTE NO_COMPU_METHOD 0 0 0 255 ECU_ADDRESS 0x3FCB0F FORMAT "%.4g" /end MEASUREMENT
/begin MEASUREMENT Oz_nivr "Rohwert ???lniveaumessung vom Sensor [RAM name from V530, voted 4]" UBYTE M_FORMULA_0731 0 0 0 75.66765579 ECU_ADDRESS 0x3FBC58 /end MEASUREMENT
/begin MEASUREMENT Oz_nivr_index "Rohwert-Index-Zaehler [RAM name from V530, voted 3]" UBYTE M_FORMULA_0037 0 0 0 255 ECU_ADDRESS 0x3FBC5C /end MEASUREMENT
/begin MEASUREMENT Oz_steigung "Oz_steigung [RAM name from V530, voted 1]" SWORD M_FORMULA_0442 0 0 -64 63.99804688 ECU_ADDRESS 0x3FBCD0 /end MEASUREMENT
/begin MEASUREMENT Oz_dkm "Oz_dkm [RAM name from V530, voted 3]" UWORD M_FORMULA_0443 0 0 0 9.999847412 ECU_ADDRESS 0x3FBCD4 /end MEASUREMENT
/begin MEASUREMENT Oz_peilkm "Max Ziel km im Fehlerfall [RAM name from V530, voted 1]" UWORD M_FORMULA_0437 0 0 0 655350 ECU_ADDRESS 0x3FBCD8 /end MEASUREMENT
/begin MEASUREMENT Oz_lbmw "Oz_lbmw [RAM name from V530, voted 1]" SBYTE M_FORMULA_0444 0 0 -2 1.984375 ECU_ADDRESS 0x3FBCDC /end MEASUREMENT
/begin MEASUREMENT Oz_peil "Oz_peil [RAM name from V530, voted 3]" UBYTE M_FORMULA_0436 0 0 0 74.70703125 ECU_ADDRESS 0x3FBCE2 /end MEASUREMENT
/begin MEASUREMENT Oz_peiloben "Obere Grenze aktuelles Balkens [RAM name from V530, voted 2]" UBYTE M_FORMULA_0436 0 0 0 74.70703125 ECU_ADDRESS 0x3FBCE3 /end MEASUREMENT
/begin MEASUREMENT Oz_peilunten "Obere Grenze aktuelles Balkens [RAM name from V530, voted 2]" UBYTE M_FORMULA_0436 0 0 0 74.70703125 ECU_ADDRESS 0x3FBCE4 /end MEASUREMENT
/begin MEASUREMENT T_chipfilsdt "Differenzenquotient schnellgefilterte Chiptemparatur [RAM name from V530, voted 1]" SWORD M_FORMULA_0431 0 0 -3276.8 3276.7 ECU_ADDRESS 0x3FDD08 /end MEASUREMENT
/begin MEASUREMENT T_diodedelta "Deltatemparatur Diode [RAM name from V530, voted 2]" SWORD M_FORMULA_0431 0 0 -3276.8 3276.7 ECU_ADDRESS 0x3FDD0C /end MEASUREMENT
/begin MEASUREMENT Tans_gen "Ansauglufttemparatur Generator [RAM name from V530, voted 2]" SWORD M_FORMULA_0431 0 0 -3276.8 3276.7 ECU_ADDRESS 0x3FDD0E /end MEASUREMENT
/begin MEASUREMENT Tchip_fil_s "Wirkliche Chiptemperatur vom Generatorregler als Mittelwert gefiltert [RAM name from V530, voted 2]" SWORD M_FORMULA_0431 0 0 -3276.8 3276.7 ECU_ADDRESS 0x3FDD02 /end MEASUREMENT
/begin MEASUREMENT U_vordiode "Diodenvorw???rtsspannung [RAM name from V530, voted 2]" UWORD M_FORMULA_0483 0 0 0 319.9951172 ECU_ADDRESS 0x3FDD36 /end MEASUREMENT
/begin MEASUREMENT Bsdcontrol "3 Byte Schnittstelle f???r kt_ibs [RAM name from V530, voted 2]" UBYTE NO_COMPU_METHOD 0 0 0 255 ECU_ADDRESS 0x3FC178 FORMAT "%.4g" /end MEASUREMENT
/begin MEASUREMENT Bsdregadr "3 Byte Schnittstelle f???r kt_ibs [RAM name from V530, voted 8]" UBYTE M_FORMULA_0003 0 0 0 255 ECU_ADDRESS 0x3FC179 /end MEASUREMENT
/begin MEASUREMENT Bsddata "3 Byte Schnittstelle kt_ibs [RAM name from V530, voted 11]" UBYTE M_FORMULA_0003 0 0 0 255 ECU_ADDRESS 0x3FC17A /end MEASUREMENT
/begin MEASUREMENT ag_ti_zyl "Naechster Zylinder der ausgeblendet wird. [RAM name from V530, voted 9]" UBYTE M_FORMULA_0408 0 0 1 256 ECU_ADDRESS 0x3FCACC /end MEASUREMENT
/begin MEASUREMENT ag_ti_exd_state "Exd-State. [RAM name from V530, voted 1]" UBYTE NO_COMPU_METHOD 0 0 0 255 ECU_ADDRESS 0x3FCACD FORMAT "%.4g" /end MEASUREMENT
/begin MEASUREMENT ag_ti_cfg_ctrl "Welcher Aussetzergenerator [RAM name from V530, voted 4]" UBYTE NO_COMPU_METHOD 0 0 0 255 ECU_ADDRESS 0x3FCACE FORMAT "%.4g" /end MEASUREMENT
/begin MEASUREMENT ag_ti_zyl_ctrl "Statisches Ausblendmuster. [RAM name from V530, voted 2]" UWORD M_FORMULA_0010 0 0 0 65535 ECU_ADDRESS 0x3FCAD0 /end MEASUREMENT
/begin MEASUREMENT ag_ti_anz_ctrl "Anzahl der unmittelbar aufeinanderfolgenden Ausblendungen. [RAM name from V530, voted 4]" UWORD M_FORMULA_0010 0 0 0 65535 ECU_ADDRESS 0x3FCAD2 /end MEASUREMENT
/begin MEASUREMENT ag_ti_pause_ctrl "Anzahl der Arbeitsspiele zwischen Ausblendungen. [RAM name from V530, voted 4]" UWORD M_FORMULA_0010 0 0 0 65535 ECU_ADDRESS 0x3FCAD4 /end MEASUREMENT
/begin MEASUREMENT ag_ti_anz "Zaehler der unmittelbar aufeinanderfolgenden Ausblendungen. [RAM name from V530, voted 12]" UWORD M_FORMULA_0010 0 0 0 65535 ECU_ADDRESS 0x3FCAD6 /end MEASUREMENT
/begin MEASUREMENT ag_ti_pause "Zaehler der Arbeitsspiele zwischen Ausblendungen. [RAM name from V530, voted 10]" UWORD M_FORMULA_0010 0 0 0 65535 ECU_ADDRESS 0x3FCAD8 /end MEASUREMENT
/begin MEASUREMENT ag_ti_mask "Status Aussetzergenerator. [RAM name from V530, voted 9]" UWORD NO_COMPU_METHOD 0 0 0 65535 ECU_ADDRESS 0x3FCADA FORMAT "%.4g" /end MEASUREMENT
/begin MEASUREMENT ag_ti_mask_zyl1 "Ausblendung Zylinder 1. [RAM name from V530, voted 9]" UWORD NO_COMPU_METHOD 0 0 0 65535 ECU_ADDRESS 0x3FCADA FORMAT "%.4g" /end MEASUREMENT
/begin MEASUREMENT ag_ti_mask_zyl10 "Ausblendung Zylinder 10. [RAM name from V530, voted 9]" UWORD NO_COMPU_METHOD 0 0 0 65535 ECU_ADDRESS 0x3FCADA FORMAT "%.4g" /end MEASUREMENT
/begin MEASUREMENT ag_ti_mask_zyl2 "Ausblendung Zylinder 2. [RAM name from V530, voted 9]" UWORD NO_COMPU_METHOD 0 0 0 65535 ECU_ADDRESS 0x3FCADA FORMAT "%.4g" /end MEASUREMENT
/begin MEASUREMENT ag_ti_mask_zyl3 "Ausblendung Zylinder 3. [RAM name from V530, voted 9]" UWORD NO_COMPU_METHOD 0 0 0 65535 ECU_ADDRESS 0x3FCADA FORMAT "%.4g" /end MEASUREMENT
/begin MEASUREMENT ag_ti_mask_zyl4 "Ausblendung Zylinder 4. [RAM name from V530, voted 9]" UWORD NO_COMPU_METHOD 0 0 0 65535 ECU_ADDRESS 0x3FCADA FORMAT "%.4g" /end MEASUREMENT
/begin MEASUREMENT ag_ti_mask_zyl5 "Ausblendung Zylinder 5. [RAM name from V530, voted 9]" UWORD NO_COMPU_METHOD 0 0 0 65535 ECU_ADDRESS 0x3FCADA FORMAT "%.4g" /end MEASUREMENT
/begin MEASUREMENT ag_ti_mask_zyl6 "Ausblendung Zylinder 6. [RAM name from V530, voted 9]" UWORD NO_COMPU_METHOD 0 0 0 65535 ECU_ADDRESS 0x3FCADA FORMAT "%.4g" /end MEASUREMENT
/begin MEASUREMENT ag_ti_mask_zyl7 "Ausblendung Zylinder 7. [RAM name from V530, voted 9]" UWORD NO_COMPU_METHOD 0 0 0 65535 ECU_ADDRESS 0x3FCADA FORMAT "%.4g" /end MEASUREMENT
/begin MEASUREMENT ag_ti_mask_zyl8 "Ausblendung Zylinder 8. [RAM name from V530, voted 9]" UWORD NO_COMPU_METHOD 0 0 0 65535 ECU_ADDRESS 0x3FCADA FORMAT "%.4g" /end MEASUREMENT
/begin MEASUREMENT ag_ti_mask_zyl9 "Ausblendung Zylinder 9. [RAM name from V530, voted 9]" UWORD NO_COMPU_METHOD 0 0 0 65535 ECU_ADDRESS 0x3FCADA FORMAT "%.4g" /end MEASUREMENT
/begin MEASUREMENT Id_bosrst "ID fuer BOSReset vom Kombi [RAM name from V530, voted 2]" UBYTE M_FORMULA_0003 0 0 0 255 ECU_ADDRESS 0x3FA22C /end MEASUREMENT
/begin MEASUREMENT Acfzgl "Fahrzeuglaengsbeschleunigung [RAM name from V530, voted 2]" SBYTE M_FORMULA_0589 0 0 -32 31.75 ECU_ADDRESS 0x3FCB27 /end MEASUREMENT
/begin MEASUREMENT Acfzgq "Fahrzeugquerbeschleunigung [RAM name from V530, voted 2]" SBYTE M_FORMULA_0589 0 0 -32 31.75 ECU_ADDRESS 0x3FCB28 /end MEASUREMENT
/begin MEASUREMENT T_jahr "Borddatum [RAM name from V530, voted 1]" UWORD M_FORMULA_0010 0 0 0 65535 ECU_ADDRESS 0x3FCB2A /end MEASUREMENT
/begin MEASUREMENT Oz_datstat "Status Datum/Uhrzeit [RAM name from V530, voted 1]" UBYTE M_FORMULA_0003 0 0 0 255 ECU_ADDRESS 0x3FCB2C /end MEASUREMENT
/begin MEASUREMENT T_monate "Borddatum [RAM name from V530, voted 1]" UBYTE M_FORMULA_0003 0 0 0 255 ECU_ADDRESS 0x3FCB2D /end MEASUREMENT
/begin MEASUREMENT B_kwdreht "Bed. Kurbelw. syncr. [RAM name from V530, voted 11]" UBYTE M_FORMULA_0003 0 0 0 255 ECU_ADDRESS 0x3FCB0A /end MEASUREMENT
/begin MEASUREMENT can_ay_10s_mw "Querbeschleunigung 10s-Mittelw. [RAM name from V530, voted 1]" SWORD M_FORMULA_0123 0 0 -819.2 819.175 ECU_ADDRESS 0x3FCB90 /end MEASUREMENT
/begin MEASUREMENT can_ay_10s_mw_sum "Querbeschleunigung Summe [RAM name from V530, voted 4]" SWORD M_FORMULA_0123 0 0 -819.2 819.175 ECU_ADDRESS 0x3FCB92 /end MEASUREMENT
/begin MEASUREMENT smg_ax_10s_mw "Laengsbeschleunigung 10s-Mittelw. [RAM name from V530, voted 1]" SWORD M_FORMULA_0123 0 0 -819.2 819.175 ECU_ADDRESS 0x3FCB94 /end MEASUREMENT
/begin MEASUREMENT smg_ax_10s_mw_sum "Laengsbeschleunigung 10s-Mittelw. [RAM name from V530, voted 4]" SWORD M_FORMULA_0123 0 0 -819.2 819.175 ECU_ADDRESS 0x3FCB96 /end MEASUREMENT
/begin MEASUREMENT cnt_mw_ax_ay "Counter fuer Mw.-Berechng. [RAM name from V530, voted 2]" UBYTE M_FORMULA_0003 0 0 0 255 ECU_ADDRESS 0x3FCBA2 /end MEASUREMENT
/begin MEASUREMENT Km_st "Kilometerstand [RAM name from V530, voted 2]" UWORD M_FORMULA_0591 0 0 0 655350 ECU_ADDRESS 0x3FCBA4 /end MEASUREMENT
/begin MEASUREMENT B_ll_niv_krz_alt "B_ll_niv_krz_alt [RAM name from V530, voted 3]" UBYTE M_FORMULA_0003 0 0 0 255 ECU_ADDRESS 0x3FCBD8 /end MEASUREMENT
/begin MEASUREMENT B_schnellmsg_bed "Schnellmessung-Diagnosebedingungen OK [RAM name from V530, voted 3]" UBYTE M_FORMULA_0003 0 0 0 255 ECU_ADDRESS 0x3FCBE1 /end MEASUREMENT
/begin MEASUREMENT B_schnellmsg_fertig "Niveauwerte-Schnellmessung gesammelt [RAM name from V530, voted 3]" UBYTE M_FORMULA_0003 0 0 0 255 ECU_ADDRESS 0x3FCBE2 /end MEASUREMENT
/begin MEASUREMENT B_schnellmsg_oel_ok "Schnellmessung: mind. ein Messwert ueber OK-Schwelle [RAM name from V530, voted 8]" UBYTE M_FORMULA_0003 0 0 0 255 ECU_ADDRESS 0x3FCBE3 /end MEASUREMENT
/begin MEASUREMENT can_fllv_eoi "akt. Oel-Fuellstand [RAM name from V530, voted 4]" UBYTE M_FORMULA_0037 0 0 0 255 ECU_ADDRESS 0x3FCBE5 /end MEASUREMENT
/begin MEASUREMENT can_recm_rflv_eoi "Auskunft Nachfuellen [RAM name from V530, voted 1]" UBYTE M_FORMULA_0037 0 0 0 255 ECU_ADDRESS 0x3FCBE6 /end MEASUREMENT
/begin MEASUREMENT can_st_fllv_eoi "M-spezif. Erweit. Oel-Fuellstand [RAM name from V530, voted 1]" UBYTE M_FORMULA_0037 0 0 0 255 ECU_ADDRESS 0x3FCBE7 /end MEASUREMENT
/begin MEASUREMENT Oz_krzmwkor_temp_kor "Temperaturkorr. Oelniveauwert [RAM name from V530, voted 2]" UBYTE M_FORMULA_0436 0 0 0 74.70703125 ECU_ADDRESS 0x3FCBED /end MEASUREMENT
/begin MEASUREMENT Oz_langmw_offset "Korrekturoffset Langzeitwert [RAM name from V530, voted 1]" UBYTE M_FORMULA_0436 0 0 0 74.70703125 ECU_ADDRESS 0x3FCBEE /end MEASUREMENT
/begin MEASUREMENT Oz_offset_ll_q "q-beschl. korr. Oelniveauwert [RAM name from V530, voted 2]" SBYTE M_FORMULA_0436 0 0 -37.5 37.20703125 ECU_ADDRESS 0x3FCBEF /end MEASUREMENT
/begin MEASUREMENT Oz_n_gesamtzeit "Zeitdauer Langzeitwertermittlung [RAM name from V530, voted 4]" UWORD M_FORMULA_0593 0 0 0 65535 ECU_ADDRESS 0x3FCBF2 /end MEASUREMENT
/begin MEASUREMENT Oz_n_messzeit "Zeitdauer im Drehzahlband [RAM name from V530, voted 2]" UWORD M_FORMULA_0593 0 0 0 65535 ECU_ADDRESS 0x3FCBF4 /end MEASUREMENT
/begin MEASUREMENT Oz_verbleib_verh "Verh. Zeit im Drehzahlband/Lgztmw [RAM name from V530, voted 3]" UBYTE M_FORMULA_0032 0 0 0 255 ECU_ADDRESS 0x3FCBF6 /end MEASUREMENT
/begin MEASUREMENT St_schnellmsg_check "State Schnellmessung [RAM name from V530, voted 3]" UBYTE M_FORMULA_0003 0 0 0 255 ECU_ADDRESS 0x3FCBF7 /end MEASUREMENT
/begin MEASUREMENT bsd_error "BSD Bus Fehler. [RAM name from V530, voted 1]" UBYTE NO_COMPU_METHOD 0 0 0 255 ECU_ADDRESS 0x3FCC19 FORMAT "%.4g" /end MEASUREMENT
/begin MEASUREMENT Bsd_status "Bearbeitungsstatus BSD pro Device: [RAM name from V530, voted 4]" UBYTE NO_COMPU_METHOD 0 0 0 255 ECU_ADDRESS 0x3FCC1A FORMAT "%.4g" /end MEASUREMENT
/begin MEASUREMENT Bsd_slot_idx "aktueller Slot der BSD fuer Device: [RAM name from V530, voted 4]" UBYTE M_FORMULA_0003 0 0 0 255 ECU_ADDRESS 0x3FCC22 /end MEASUREMENT
/begin MEASUREMENT Bsd_cur_dev "aktuelles Device BSD zugeordnet [RAM name from V530, voted 9]" UBYTE M_FORMULA_0003 0 0 0 255 ECU_ADDRESS 0x3FCC23 /end MEASUREMENT
/begin MEASUREMENT gen_exd_timeout "KWP-Ansteuerzeit [RAM name from V530, voted 2]" UBYTE M_FORMULA_0461 0 0 0 25.5 ECU_ADDRESS 0x3FCC46 /end MEASUREMENT
/begin MEASUREMENT U_gen_exd "Sollwert Generatorspannung (ext. Diagnose) [RAM name from V530, voted 2]" UWORD M_FORMULA_0466 0 0 0 6553.5 ECU_ADDRESS 0x3FCC4A /end MEASUREMENT
/begin MEASUREMENT Tlrgen_exd "Sollwert Load-Response Generator (ext. Diagnose) [RAM name from V530, voted 1]" UBYTE M_FORMULA_0461 0 0 0 25.5 ECU_ADDRESS 0x3FCC4C /end MEASUREMENT
/begin MEASUREMENT can_ed_tsperr "ED-Sperrzeit fuer BusOn [RAM name from V530, voted 14]" UWORD M_FORMULA_0606 0 0 0 327.675 ECU_ADDRESS 0x3FCC6C /end MEASUREMENT
/begin MEASUREMENT can_ed_tsperr_kl15 "ED-Sperrzeit fuer Kl15 [RAM name from V530, voted 15]" UWORD M_FORMULA_0606 0 0 0 327.675 ECU_ADDRESS 0x3FCC6E /end MEASUREMENT
/begin MEASUREMENT can_st_lrw "Empfangsstatus LRW [RAM name from V530, voted 1]" UBYTE NO_COMPU_METHOD 0 0 0 255 ECU_ADDRESS 0x3FCC70 FORMAT "%.4g" /end MEASUREMENT
/begin MEASUREMENT can_st_crash "Empfangsstatus Crashabschaltung [RAM name from V530, voted 2]" UBYTE NO_COMPU_METHOD 0 0 0 255 ECU_ADDRESS 0x3FCC71 FORMAT "%.4g" /end MEASUREMENT
/begin MEASUREMENT can_st_kmst "Empfangsstatus Kilometerstand [RAM name from V530, voted 2]" UBYTE NO_COMPU_METHOD 0 0 0 255 ECU_ADDRESS 0x3FCC72 FORMAT "%.4g" /end MEASUREMENT
/begin MEASUREMENT can_st_bedat "Empfangsstatus Bed. Audio Tel [RAM name from V530, voted 4]" UBYTE NO_COMPU_METHOD 0 0 0 255 ECU_ADDRESS 0x3FCC73 FORMAT "%.4g" /end MEASUREMENT
/begin MEASUREMENT can_st_grb3 "Empfangsstatus Getriebe 3 [RAM name from V530, voted 3]" UWORD NO_COMPU_METHOD 0 0 0 65535 ECU_ADDRESS 0x3FCC74 FORMAT "%.4g" /end MEASUREMENT
/begin MEASUREMENT can_st_ax "Empfangsstatus aLaengs [RAM name from V530, voted 3]" UWORD NO_COMPU_METHOD 0 0 0 65535 ECU_ADDRESS 0x3FCC76 FORMAT "%.4g" /end MEASUREMENT
/begin MEASUREMENT can_alive_klst_cnt "Fehler Alive [RAM name from V530, voted 3]" UBYTE M_FORMULA_0003 0 0 0 255 ECU_ADDRESS 0x3FCC80 /end MEASUREMENT
/begin MEASUREMENT can_chksum_klst_cnt "Fehler Checksumme [RAM name from V530, voted 4]" UBYTE M_FORMULA_0003 0 0 0 255 ECU_ADDRESS 0x3FCC82 /end MEASUREMENT
/begin MEASUREMENT can_klst_timeout "KLST-Timeout [RAM name from V530, voted 3]" UBYTE M_FORMULA_0461 0 0 0 25.5 ECU_ADDRESS 0x3FCC84 /end MEASUREMENT
/begin MEASUREMENT can_kkos_timeout "KKOS-Timeout [RAM name from V530, voted 3]" UBYTE M_FORMULA_0461 0 0 0 25.5 ECU_ADDRESS 0x3FCC86 /end MEASUREMENT
/begin MEASUREMENT can_kkos_elu "Anfoderung ELU [RAM name from V530, voted 1]" UBYTE M_FORMULA_0607 0 0 0 255 ECU_ADDRESS 0x3FCC87 /end MEASUREMENT
/begin MEASUREMENT can_alive_TorqReqDKG_cnt "Fehler Alive [RAM name from V530, voted 3]" UBYTE M_FORMULA_0003 0 0 0 255 ECU_ADDRESS 0x3FCC88 /end MEASUREMENT
/begin MEASUREMENT can_chksum_TorqReqDKG_cnt "Fehler Checksumme [RAM name from V530, voted 3]" UBYTE M_FORMULA_0003 0 0 0 255 ECU_ADDRESS 0x3FCC8A /end MEASUREMENT
/begin MEASUREMENT can_alive_grb_cnt "Fehler Alive [RAM name from V530, voted 3]" UBYTE M_FORMULA_0003 0 0 0 255 ECU_ADDRESS 0x3FCC8B /end MEASUREMENT
/begin MEASUREMENT can_chksum_grb_cnt "Fehler Checksumme [RAM name from V530, voted 3]" UBYTE M_FORMULA_0003 0 0 0 255 ECU_ADDRESS 0x3FCC8D /end MEASUREMENT
/begin MEASUREMENT can_grb3_timeout "Getriebe3-Timeout [RAM name from V530, voted 2]" UBYTE M_FORMULA_0461 0 0 0 25.5 ECU_ADDRESS 0x3FCC92 /end MEASUREMENT
/begin MEASUREMENT can_alive_grb3_cnt "Fehler Alive [RAM name from V530, voted 2]" UBYTE M_FORMULA_0003 0 0 0 255 ECU_ADDRESS 0x3FCC93 /end MEASUREMENT
/begin MEASUREMENT can_chksum_grb3_cnt "Fehler Checksumme [RAM name from V530, voted 2]" UBYTE M_FORMULA_0003 0 0 0 255 ECU_ADDRESS 0x3FCC95 /end MEASUREMENT
/begin MEASUREMENT can_verz_st "Verzoegerungs-Status [RAM name from V530, voted 1]" UBYTE NO_COMPU_METHOD 0 0 0 255 ECU_ADDRESS 0x3FCC9A FORMAT "%.4g" /end MEASUREMENT
/begin MEASUREMENT can_kmst_timeout "KMST-Timeout [RAM name from V530, voted 2]" UBYTE M_FORMULA_0609 0 0 0 255 ECU_ADDRESS 0x3FCC9B /end MEASUREMENT
/begin MEASUREMENT can_fst_sum "Fuellstand Tank [RAM name from V530, voted 8]" UWORD M_FORMULA_0610 0 0 0 32767.5 ECU_ADDRESS 0x3F909E /end MEASUREMENT
/begin MEASUREMENT can_fst_li "Fuellstand Tank-Links [RAM name from V530, voted 1]" UBYTE M_FORMULA_0559 0 0 0 127.5 ECU_ADDRESS 0x3FCC9C /end MEASUREMENT
/begin MEASUREMENT can_fst_re "Fuellstand Tank-Rechts [RAM name from V530, voted 1]" UBYTE M_FORMULA_0559 0 0 0 127.5 ECU_ADDRESS 0x3FCC9D /end MEASUREMENT
/begin MEASUREMENT can_no_key_update "Schluesselnr.-Aktualisierungsverriegelung bei B_ZUST_ML [RAM name from V530, voted 2]" UBYTE NO_COMPU_METHOD 0 0 0 255 ECU_ADDRESS 0x3FCC9F FORMAT "%.4g" /end MEASUREMENT
/begin MEASUREMENT can_reichweite "Reichweite [RAM name from V530, voted 1]" UWORD M_FORMULA_0613 0 0 0 65535 ECU_ADDRESS 0x3FCCA2 /end MEASUREMENT
/begin MEASUREMENT can_crash_timeout "KKOS-Timeout [RAM name from V530, voted 3]" UBYTE M_FORMULA_0461 0 0 0 25.5 ECU_ADDRESS 0x3FCCA4 /end MEASUREMENT
/begin MEASUREMENT can_alive_vfzg_cnt "Fehler Alive [RAM name from V530, voted 3]" UBYTE M_FORMULA_0003 0 0 0 255 ECU_ADDRESS 0x3FCCA5 /end MEASUREMENT
/begin MEASUREMENT can_chksum_vfzg_cnt "Fehler Checksumme [RAM name from V530, voted 3]" UBYTE M_FORMULA_0003 0 0 0 255 ECU_ADDRESS 0x3FCCA7 /end MEASUREMENT
/begin MEASUREMENT can_v_vorne "vVorne - Rohwert [RAM name from V530, voted 2]" SWORD M_FORMULA_0076 0 0 -2048 2047.9375 ECU_ADDRESS 0x3FCCA8 /end MEASUREMENT
/begin MEASUREMENT can_bedfgr_timeout "BedFgr-Timeout [RAM name from V530, voted 5]" UBYTE M_FORMULA_0461 0 0 0 25.5 ECU_ADDRESS 0x3FCCAA /end MEASUREMENT
/begin MEASUREMENT can_alive_BedFgr_cnt "Fehler Alive [RAM name from V530, voted 5]" UBYTE M_FORMULA_0003 0 0 0 255 ECU_ADDRESS 0x3FCCAB /end MEASUREMENT
/begin MEASUREMENT can_chksum_BedFgr_cnt "Fehler Checksumme [RAM name from V530, voted 3]" UBYTE M_FORMULA_0003 0 0 0 255 ECU_ADDRESS 0x3FCCAD /end MEASUREMENT
/begin MEASUREMENT can_ctr_ilicht "Steuerung Innenlicht [RAM name from V530, voted 1]" UBYTE NO_COMPU_METHOD 0 0 0 255 ECU_ADDRESS 0x3FCCB7 FORMAT "%.4g" /end MEASUREMENT
/begin MEASUREMENT can_fgr_v_idx_1 "FGR-Geschwindigkeit Index 1 [RAM name from V530, voted 1]" UWORD M_FORMULA_0619 0 0 0 6553.5 ECU_ADDRESS 0x3FCCBA /end MEASUREMENT
/begin MEASUREMENT can_fgr_v_idx_2 "FGR-Geschwindigkeit Index 2 [RAM name from V530, voted 1]" UWORD M_FORMULA_0619 0 0 0 6553.5 ECU_ADDRESS 0x3FCCC4 /end MEASUREMENT
/begin MEASUREMENT can_fgr_v_idx_3 "FGR-Geschwindigkeit Index 3 [RAM name from V530, voted 1]" UWORD M_FORMULA_0619 0 0 0 6553.5 ECU_ADDRESS 0x3FCCCE /end MEASUREMENT
/begin MEASUREMENT can_alive_stkombi_cnt "Fehler Alive [RAM name from V530, voted 2]" UBYTE M_FORMULA_0003 0 0 0 255 ECU_ADDRESS 0x3FCCD8 /end MEASUREMENT
/begin MEASUREMENT can_v_tacho "Tachogeschwindigkeit - Rohwert [RAM name from V530, voted 4]" SWORD M_FORMULA_0076 0 0 -2048 2047.9375 ECU_ADDRESS 0x3FCCDA /end MEASUREMENT
/begin MEASUREMENT can_bedat_timeout "BedAT-Timeout [RAM name from V530, voted 6]" UBYTE M_FORMULA_0214 0 0 0 255 ECU_ADDRESS 0x3FCCDC /end MEASUREMENT
/begin MEASUREMENT can_alive_bedat_cnt "Fehler Alive [RAM name from V530, voted 4]" UBYTE M_FORMULA_0003 0 0 0 255 ECU_ADDRESS 0x3FCCDD /end MEASUREMENT
/begin MEASUREMENT can_chksum_bedat_cnt "Fehler Komplement [RAM name from V530, voted 3]" UBYTE M_FORMULA_0003 0 0 0 255 ECU_ADDRESS 0x3FCCDF /end MEASUREMENT
/begin MEASUREMENT can_bedat_s "Schalter Bed. Audio Tel [RAM name from V530, voted 3]" UBYTE NO_COMPU_METHOD 0 0 0 255 ECU_ADDRESS 0x3FCCE0 FORMAT "%.4g" /end MEASUREMENT
/begin MEASUREMENT can_statanh_timeout "StatAnh-Timeout [RAM name from V530, voted 2]" UBYTE M_FORMULA_0214 0 0 0 255 ECU_ADDRESS 0x3FCCE1 /end MEASUREMENT
/begin MEASUREMENT can_st_statanh "Empfangsstatus StatAnh [RAM name from V530, voted 3]" UBYTE NO_COMPU_METHOD 0 0 0 255 ECU_ADDRESS 0x3FCCE2 FORMAT "%.4g" /end MEASUREMENT
/begin MEASUREMENT can_statr_timeout "StatR-Timeout [RAM name from V530, voted 4]" UBYTE M_FORMULA_0214 0 0 0 255 ECU_ADDRESS 0x3FCCE3 /end MEASUREMENT
/begin MEASUREMENT can_st_statr "Empfangsstatus StatR [RAM name from V530, voted 3]" UBYTE NO_COMPU_METHOD 0 0 0 255 ECU_ADDRESS 0x3FCCE4 FORMAT "%.4g" /end MEASUREMENT
/begin MEASUREMENT can_toma_timeout "RadToleranz-Timeout [RAM name from V530, voted 4]" UBYTE M_FORMULA_0214 0 0 0 255 ECU_ADDRESS 0x3FCCE5 /end MEASUREMENT
/begin MEASUREMENT can_st_toma "Empfangsstatus RadToleranz [RAM name from V530, voted 3]" UBYTE NO_COMPU_METHOD 0 0 0 255 ECU_ADDRESS 0x3FCCE6 FORMAT "%.4g" /end MEASUREMENT
/begin MEASUREMENT can_toma_vl "RadToleranz VL [RAM name from V530, voted 2]" SBYTE M_FORMULA_0623 0 0 -12.8 12.7 ECU_ADDRESS 0x3FCCE7 /end MEASUREMENT
/begin MEASUREMENT can_toma_vr "RadToleranz VR [RAM name from V530, voted 2]" SBYTE M_FORMULA_0623 0 0 -12.8 12.7 ECU_ADDRESS 0x3FCCE8 /end MEASUREMENT
/begin MEASUREMENT can_toma_hl "RadToleranz HL [RAM name from V530, voted 2]" SBYTE M_FORMULA_0623 0 0 -12.8 12.7 ECU_ADDRESS 0x3FCCE9 /end MEASUREMENT
/begin MEASUREMENT can_toma_hr "RadToleranz HR [RAM name from V530, voted 2]" SBYTE M_FORMULA_0623 0 0 -12.8 12.7 ECU_ADDRESS 0x3FCCEA /end MEASUREMENT
/begin MEASUREMENT coding_logistics "Startadresse des g???ltigen Codierbereiches [RAM name from V530, voted 28]" ULONG M_FORMULA_0000 0 0 0 4294967295 ECU_ADDRESS 0x3FCD48 /end MEASUREMENT
/begin MEASUREMENT coding_array_attribute "Attribute des aktuellen Codierbereiches [RAM name from V530, voted 6]" UBYTE NO_COMPU_METHOD 0 0 0 255 ECU_ADDRESS 0x3FCD58 FORMAT "%.4g" /end MEASUREMENT
/begin MEASUREMENT coding_init_laufzeit "Laufzeitmessung coding_init [RAM name from V530, voted 1]" ULONG M_FORMULA_0072 0 0 0 4294967295 ECU_ADDRESS 0x3FCD4C /end MEASUREMENT
/begin MEASUREMENT coding_umw0 "Umweltbedingung 0 Codierung [RAM name from V530, voted 1]" UWORD M_FORMULA_0010 0 0 0 65535 ECU_ADDRESS 0x3FCD50 /end MEASUREMENT
/begin MEASUREMENT coding_umw1 "Umweltbedingung 1 Codierung [RAM name from V530, voted 1]" UWORD M_FORMULA_0010 0 0 0 65535 ECU_ADDRESS 0x3FCD52 /end MEASUREMENT
/begin MEASUREMENT coding_umw2 "Umweltbedingung 2 Codierung [RAM name from V530, voted 1]" UWORD M_FORMULA_0010 0 0 0 65535 ECU_ADDRESS 0x3FCD54 /end MEASUREMENT
/begin MEASUREMENT coding_umw3 "Umweltbedingung 3 Codierung [RAM name from V530, voted 1]" UWORD M_FORMULA_0010 0 0 0 65535 ECU_ADDRESS 0x3FCD56 /end MEASUREMENT
/begin MEASUREMENT crc32_result "Ergebnis der CRC-Berechnungen [RAM name from V530, voted 14]" UBYTE NO_COMPU_METHOD 0 0 0 255 ECU_ADDRESS 0x3FCD78 FORMAT "%.4g" /end MEASUREMENT
/begin MEASUREMENT crc32_data_st "Status CRC-Berechnung [RAM name from V530, voted 4]" UBYTE NO_COMPU_METHOD 0 0 0 255 ECU_ADDRESS 0x3FCD79 FORMAT "%.4g" /end MEASUREMENT
/begin MEASUREMENT crc32_prog_st "Status CRC-Berechnung [RAM name from V530, voted 2]" UBYTE NO_COMPU_METHOD 0 0 0 255 ECU_ADDRESS 0x3FCD7A FORMAT "%.4g" /end MEASUREMENT
/begin MEASUREMENT crc32_boot_st "Status CRC-Berechnung [RAM name from V530, voted 2]" UBYTE NO_COMPU_METHOD 0 0 0 255 ECU_ADDRESS 0x3FCD7B FORMAT "%.4g" /end MEASUREMENT
/begin MEASUREMENT crc32_boot "Booter-CRC [RAM name from V530, voted 3]" ULONG M_FORMULA_0000 0 0 0 4294967295 ECU_ADDRESS 0x3FCD7C /end MEASUREMENT
/begin MEASUREMENT crc32_prog "Programm-CRC [RAM name from V530, voted 3]" ULONG M_FORMULA_0000 0 0 0 4294967295 ECU_ADDRESS 0x3FCD80 /end MEASUREMENT
/begin MEASUREMENT crc32_data "Daten-CRC [RAM name from V530, voted 5]" ULONG M_FORMULA_0000 0 0 0 4294967295 ECU_ADDRESS 0x3FCD84 /end MEASUREMENT
/begin MEASUREMENT hwTaskCtr "Counter [RAM name from V530, voted 4]" UWORD M_FORMULA_0010 0 0 0 65535 ECU_ADDRESS 0x3FCD88 /end MEASUREMENT
/begin MEASUREMENT syncTaskCtr "Counter [RAM name from V530, voted 4]" UWORD M_FORMULA_0010 0 0 0 65535 ECU_ADDRESS 0x3FCD8A /end MEASUREMENT
/begin MEASUREMENT r1msTaskCtr "Counter [RAM name from V530, voted 4]" UWORD M_FORMULA_0010 0 0 0 65535 ECU_ADDRESS 0x3FCD8C /end MEASUREMENT
/begin MEASUREMENT r5msTaskCtr "Counter [RAM name from V530, voted 6]" UWORD M_FORMULA_0010 0 0 0 65535 ECU_ADDRESS 0x3FCD8E /end MEASUREMENT
/begin MEASUREMENT r10msTaskCtr "Counter [RAM name from V530, voted 40]" ULONG M_FORMULA_0000 0 0 0 4294967295 ECU_ADDRESS 0x3FCD90 /end MEASUREMENT
/begin MEASUREMENT r100msTaskCtr "Counter [RAM name from V530, voted 16]" UWORD M_FORMULA_0010 0 0 0 65535 ECU_ADDRESS 0x3FCD94 /end MEASUREMENT
/begin MEASUREMENT r1sTaskCtr "Counter [RAM name from V530, voted 8]" UWORD M_FORMULA_0010 0 0 0 65535 ECU_ADDRESS 0x3FCD96 /end MEASUREMENT
/begin MEASUREMENT bgTaskCtr "Counter [RAM name from V530, voted 4]" UWORD M_FORMULA_0010 0 0 0 65535 ECU_ADDRESS 0x3FCD98 /end MEASUREMENT
/begin MEASUREMENT cana_ctBoffDbounce "BusOff-Counter [RAM name from V530, voted 1]" UBYTE M_FORMULA_0003 0 0 0 255 ECU_ADDRESS 0x3FCD9A /end MEASUREMENT
/begin MEASUREMENT canb_ctBoffDbounce "BusOff-Counter [RAM name from V530, voted 1]" UBYTE M_FORMULA_0003 0 0 0 255 ECU_ADDRESS 0x3FCD9B /end MEASUREMENT
/begin COMPU_METHOD M_FORMULA_0000 "V530 FORMULA_0000" RAT_FUNC "%.4g" "-" COEFFS 0 1 0 0 0 1 /end COMPU_METHOD
/begin COMPU_METHOD M_FORMULA_0001 "V530 FORMULA_0001" RAT_FUNC "%.4g" "%" COEFFS 0 10 0 0 0 1 /end COMPU_METHOD
/begin COMPU_METHOD M_FORMULA_0003 "V530 FORMULA_0003" RAT_FUNC "%.4g" "-" COEFFS 0 1 0 0 0 1 /end COMPU_METHOD
/begin COMPU_METHOD M_FORMULA_0006 "V530 FORMULA_0006" RAT_FUNC "%.4g" "Upm" COEFFS 0 1 0 0 0 1 /end COMPU_METHOD
/begin COMPU_METHOD M_FORMULA_0007 "V530 FORMULA_0007" RAT_FUNC "%.4g" "-" COEFFS 0 10000 0 0 0 1 /end COMPU_METHOD
/begin COMPU_METHOD M_FORMULA_0008 "V530 FORMULA_0008" RAT_FUNC "%.4g" "V" COEFFS 0 10 0 0 0 1 /end COMPU_METHOD
/begin COMPU_METHOD M_FORMULA_0009 "V530 FORMULA_0009" RAT_FUNC "%.4g" "Nm" COEFFS 0 10 0 0 0 1 /end COMPU_METHOD
/begin COMPU_METHOD M_FORMULA_0010 "V530 FORMULA_0010" RAT_FUNC "%.4g" "-" COEFFS 0 1 0 0 0 1 /end COMPU_METHOD
/begin COMPU_METHOD M_FORMULA_0017 "V530 FORMULA_0017" RAT_FUNC "%.4g" "ms" COEFFS 0 7000 0 0 0 1 /end COMPU_METHOD
/begin COMPU_METHOD M_FORMULA_0018 "V530 FORMULA_0018" RAT_FUNC "%.4g" "us" COEFFS 0 1 0 0 0 1 /end COMPU_METHOD
/begin COMPU_METHOD M_FORMULA_0020 "V530 FORMULA_0020" RAT_FUNC "%.4g" "qmm/s" COEFFS 0 0.05 0 0 0 1 /end COMPU_METHOD
/begin COMPU_METHOD M_FORMULA_0021 "V530 FORMULA_0021" RAT_FUNC "%.4g" "s" COEFFS 0 100 0 0 0 1 /end COMPU_METHOD
/begin COMPU_METHOD M_FORMULA_0022 "V530 FORMULA_0022" RAT_FUNC "%.4g" "%" COEFFS 0 100 0 0 0 1 /end COMPU_METHOD
/begin COMPU_METHOD M_FORMULA_0023 "V530 FORMULA_0023" RAT_FUNC "%.4g" "???C" COEFFS 0 10 2732 0 0 1 /end COMPU_METHOD
/begin COMPU_METHOD M_FORMULA_0024 "V530 FORMULA_0024" RAT_FUNC "%.4g" "-" COEFFS 0 32768 0 0 0 1 /end COMPU_METHOD
/begin COMPU_METHOD M_FORMULA_0025 "V530 FORMULA_0025" RAT_FUNC "%.4g" "-" COEFFS 0 16384 0 0 0 1 /end COMPU_METHOD
/begin COMPU_METHOD M_FORMULA_0027 "V530 FORMULA_0027" RAT_FUNC "%.4g" "km" COEFFS 0 1 0 0 0 1 /end COMPU_METHOD
/begin COMPU_METHOD M_FORMULA_0032 "V530 FORMULA_0032" RAT_FUNC "%.4g" "%" COEFFS 0 1 0 0 0 1 /end COMPU_METHOD
/begin COMPU_METHOD M_FORMULA_0037 "V530 FORMULA_0037" RAT_FUNC "%.4g" "-" COEFFS 0 1 0 0 0 1 /end COMPU_METHOD
/begin COMPU_METHOD M_FORMULA_0071 "V530 FORMULA_0071" RAT_FUNC "%.4g" "s" COEFFS 0 10 0 0 0 1 /end COMPU_METHOD
/begin COMPU_METHOD M_FORMULA_0072 "V530 FORMULA_0072" RAT_FUNC "%.4g" "us" COEFFS 0 1 0 0 0 1 /end COMPU_METHOD
/begin COMPU_METHOD M_FORMULA_0073 "V530 FORMULA_0073" RAT_FUNC "%.4g" "-" COEFFS 0 1024 0 0 0 1 /end COMPU_METHOD
/begin COMPU_METHOD M_FORMULA_0074 "V530 FORMULA_0074" RAT_FUNC "%.4g" "Kelvin" COEFFS 0 10 0 0 0 1 /end COMPU_METHOD
/begin COMPU_METHOD M_FORMULA_0075 "V530 FORMULA_0075" RAT_FUNC "%.4g" "mbar" COEFFS 0 16 0 0 0 1 /end COMPU_METHOD
/begin COMPU_METHOD M_FORMULA_0076 "V530 FORMULA_0076" RAT_FUNC "%.4g" "km/h" COEFFS 0 16 0 0 0 1 /end COMPU_METHOD
/begin COMPU_METHOD M_FORMULA_0080 "V530 FORMULA_0080" RAT_FUNC "%.4g" "-" COEFFS 0 1 0 0 0 1 /end COMPU_METHOD
/begin COMPU_METHOD M_FORMULA_0090 "V530 FORMULA_0090" RAT_FUNC "%.4g" "mg" COEFFS 0 10 0 0 0 1 /end COMPU_METHOD
/begin COMPU_METHOD M_FORMULA_0102 "V530 FORMULA_0102" RAT_FUNC "%.4g" "???KW" COEFFS 0 10 0 0 0 1 /end COMPU_METHOD
/begin COMPU_METHOD M_FORMULA_0103 "V530 FORMULA_0103" RAT_FUNC "%.4g" "kg/h" COEFFS 0 10 0 0 0 1 /end COMPU_METHOD
/begin COMPU_METHOD M_FORMULA_0105 "V530 FORMULA_0105" RAT_FUNC "%.4g" "Upm/s" COEFFS 0 1 0 0 0 1 /end COMPU_METHOD
/begin COMPU_METHOD M_FORMULA_0107 "V530 FORMULA_0107" RAT_FUNC "%.4g" "%" COEFFS 0 10.24 0 0 0 1 /end COMPU_METHOD
/begin COMPU_METHOD M_FORMULA_0110 "V530 FORMULA_0110" RAT_FUNC "%.4g" "bar" COEFFS 0 1000 0 0 0 1 /end COMPU_METHOD
/begin COMPU_METHOD M_FORMULA_0113 "V530 FORMULA_0113" RAT_FUNC "%.4g" "Nm" COEFFS 0 10 0 0 0 1 /end COMPU_METHOD
/begin COMPU_METHOD M_FORMULA_0114 "V530 FORMULA_0114" RAT_FUNC "%.4g" "digit" COEFFS 0 1 0 0 0 1 /end COMPU_METHOD
/begin COMPU_METHOD M_FORMULA_0120 "V530 FORMULA_0120" RAT_FUNC "%.4g" "Nm" COEFFS 0 2 0 0 0 1 /end COMPU_METHOD
/begin COMPU_METHOD M_FORMULA_0123 "V530 FORMULA_0123" RAT_FUNC "%.4g" "m/(s*s)" COEFFS 0 40 0 0 0 1 /end COMPU_METHOD
/begin COMPU_METHOD M_FORMULA_0129 "V530 FORMULA_0129" RAT_FUNC "%.4g" "bar" COEFFS 0 1 0 0 0 1 /end COMPU_METHOD
/begin COMPU_METHOD M_FORMULA_0131 "V530 FORMULA_0131" RAT_FUNC "%.4g" "bar/s" COEFFS 0 0.02 0 0 0 1 /end COMPU_METHOD
/begin COMPU_METHOD M_FORMULA_0132 "V530 FORMULA_0132" RAT_FUNC "%.4g" "Grad" COEFFS 0 22.75312856 0 0 0 1 /end COMPU_METHOD
/begin COMPU_METHOD M_FORMULA_0133 "V530 FORMULA_0133" RAT_FUNC "%.4g" "Grad/s" COEFFS 0 22.75312856 0 0 0 1 /end COMPU_METHOD
/begin COMPU_METHOD M_FORMULA_0135 "V530 FORMULA_0135" RAT_FUNC "%.4g" ".Gang" COEFFS 0 1 0 0 0 1 /end COMPU_METHOD
/begin COMPU_METHOD M_FORMULA_0144 "V530 FORMULA_0144" RAT_FUNC "%.4g" "ml" COEFFS 0 1000 0 0 0 1 /end COMPU_METHOD
/begin COMPU_METHOD M_FORMULA_0145 "V530 FORMULA_0145" RAT_FUNC "%.4g" "min" COEFFS 0 60 0 0 0 1 /end COMPU_METHOD
/begin COMPU_METHOD M_FORMULA_0147 "V530 FORMULA_0147" RAT_FUNC "%.4g" "s" COEFFS 0 100 0 0 0 1 /end COMPU_METHOD
/begin COMPU_METHOD M_FORMULA_0161 "V530 FORMULA_0161" RAT_FUNC "%.4g" "%" COEFFS 0 10.24 0 0 0 1 /end COMPU_METHOD
/begin COMPU_METHOD M_FORMULA_0165 "V530 FORMULA_0165" RAT_FUNC "%.4g" "???C" COEFFS 0 1 48 0 0 1 /end COMPU_METHOD
/begin COMPU_METHOD M_FORMULA_0166 "V530 FORMULA_0166" RAT_FUNC "%.4g" "Upm" COEFFS 0 0.02 0 0 0 1 /end COMPU_METHOD
/begin COMPU_METHOD M_FORMULA_0186 "V530 FORMULA_0186" RAT_FUNC "%.4g" "-/10ms" COEFFS 0 10000 0 0 0 1 /end COMPU_METHOD
/begin COMPU_METHOD M_FORMULA_0187 "V530 FORMULA_0187" RAT_FUNC "%.4g" "100/10ms" COEFFS 0 100 0 0 0 1 /end COMPU_METHOD
/begin COMPU_METHOD M_FORMULA_0190 "V530 FORMULA_0190" RAT_FUNC "%.4g" "Tage" COEFFS 0 1 0 0 0 1 /end COMPU_METHOD
/begin COMPU_METHOD M_FORMULA_0192 "V530 FORMULA_0192" RAT_FUNC "%.4g" "???C" COEFFS 0 1.111111111 61.33333333 0 0 1 /end COMPU_METHOD
/begin COMPU_METHOD M_FORMULA_0199 "V530 FORMULA_0199" RAT_FUNC "%.4g" "-" COEFFS 0 16384 0 0 0 1 /end COMPU_METHOD
/begin COMPU_METHOD M_FORMULA_0214 "V530 FORMULA_0214" RAT_FUNC "%.4g" "s" COEFFS 0 1 0 0 0 1 /end COMPU_METHOD
/begin COMPU_METHOD M_FORMULA_0261 "V530 FORMULA_0261" RAT_FUNC "%.4g" "V" COEFFS 0 641.4697355 0 0 0 1 /end COMPU_METHOD
/begin COMPU_METHOD M_FORMULA_0272 "V530 FORMULA_0272" RAT_FUNC "%.4g" "Nm" COEFFS 0 10 0 0 0 1 /end COMPU_METHOD
/begin COMPU_METHOD M_FORMULA_0276 "V530 FORMULA_0276" RAT_FUNC "%.4g" "Nms2" COEFFS 0 512 0 0 0 1 /end COMPU_METHOD
/begin COMPU_METHOD M_FORMULA_0306 "V530 FORMULA_0306" RAT_FUNC "%.4g" "s" COEFFS 0 100 0 0 0 1 /end COMPU_METHOD
/begin COMPU_METHOD M_FORMULA_0317 "V530 FORMULA_0317" RAT_FUNC "%.4g" "km/h" COEFFS 0 10 0 0 0 1 /end COMPU_METHOD
/begin COMPU_METHOD M_FORMULA_0343 "V530 FORMULA_0343" RAT_FUNC "%.4g" "???C" COEFFS 0 10240 2797056 0 0 1 /end COMPU_METHOD
/begin COMPU_METHOD M_FORMULA_0408 "V530 FORMULA_0408" RAT_FUNC "%.4g" "-" COEFFS 0 1 -1 0 0 1 /end COMPU_METHOD
/begin COMPU_METHOD M_FORMULA_0431 "V530 FORMULA_0431" RAT_FUNC "%.4g" "???C" COEFFS 0 10 0 0 0 1 /end COMPU_METHOD
/begin COMPU_METHOD M_FORMULA_0436 "V530 FORMULA_0436" RAT_FUNC "%.4g" "mm" COEFFS 0 3.413333333 0 0 0 1 /end COMPU_METHOD
/begin COMPU_METHOD M_FORMULA_0437 "V530 FORMULA_0437" RAT_FUNC "%.4g" "km" COEFFS 0 0.1 0 0 0 1 /end COMPU_METHOD
/begin COMPU_METHOD M_FORMULA_0442 "V530 FORMULA_0442" RAT_FUNC "%.4g" "-" COEFFS 0 512 0 0 0 1 /end COMPU_METHOD
/begin COMPU_METHOD M_FORMULA_0443 "V530 FORMULA_0443" RAT_FUNC "%.4g" "%" COEFFS 0 6553.6 0 0 0 1 /end COMPU_METHOD
/begin COMPU_METHOD M_FORMULA_0444 "V530 FORMULA_0444" RAT_FUNC "%.4g" "-" COEFFS 0 64 0 0 0 1 /end COMPU_METHOD
/begin COMPU_METHOD M_FORMULA_0461 "V530 FORMULA_0461" RAT_FUNC "%.4g" "s" COEFFS 0 10 0 0 0 1 /end COMPU_METHOD
/begin COMPU_METHOD M_FORMULA_0462 "V530 FORMULA_0462" RAT_FUNC "%.4g" "%" COEFFS 0 655.36 0 0 0 1 /end COMPU_METHOD
/begin COMPU_METHOD M_FORMULA_0466 "V530 FORMULA_0466" RAT_FUNC "%.4g" "V" COEFFS 0 10 0 0 0 1 /end COMPU_METHOD
/begin COMPU_METHOD M_FORMULA_0478 "V530 FORMULA_0478" RAT_FUNC "%.4g" "-" COEFFS 0 1 0 0 0 1 /end COMPU_METHOD
/begin COMPU_METHOD M_FORMULA_0479 "V530 FORMULA_0479" RAT_FUNC "%.4g" "-" COEFFS 0 327.68 0 0 0 1 /end COMPU_METHOD
/begin COMPU_METHOD M_FORMULA_0483 "V530 FORMULA_0483" RAT_FUNC "%.4g" "V" COEFFS 0 204.8 0 0 0 1 /end COMPU_METHOD
/begin COMPU_METHOD M_FORMULA_0498 "V530 FORMULA_0498" RAT_FUNC "%.4g" "Ah" COEFFS 0 54.94444444 0 0 0 1 /end COMPU_METHOD
/begin COMPU_METHOD M_FORMULA_0499 "V530 FORMULA_0499" RAT_FUNC "%.4g" "-" COEFFS 0 655.36 0 0 0 1 /end COMPU_METHOD
/begin COMPU_METHOD M_FORMULA_0512 "V530 FORMULA_0512" RAT_FUNC "%.4g" "Ah" COEFFS 0 3600000 0 0 0 1 /end COMPU_METHOD
/begin COMPU_METHOD M_FORMULA_0535 "V530 FORMULA_0535" RAT_FUNC "%.4g" "mg/ASP" COEFFS 0 64 0 0 0 1 /end COMPU_METHOD
/begin COMPU_METHOD M_FORMULA_0536 "V530 FORMULA_0536" RAT_FUNC "%.4g" "mV" COEFFS 0 0.2048 0 0 0 1 /end COMPU_METHOD
/begin COMPU_METHOD M_FORMULA_0541 "V530 FORMULA_0541" RAT_FUNC "%.4g" "Ohm" COEFFS 0 10 0 0 0 1 /end COMPU_METHOD
/begin COMPU_METHOD M_FORMULA_0542 "V530 FORMULA_0542" RAT_FUNC "%.4g" "s" COEFFS 0 1 0 0 0 1 /end COMPU_METHOD
/begin COMPU_METHOD M_FORMULA_0543 "V530 FORMULA_0543" RAT_FUNC "%.4g" "%" COEFFS 0 1 0 0 0 1 /end COMPU_METHOD
/begin COMPU_METHOD M_FORMULA_0545 "V530 FORMULA_0545" RAT_FUNC "%.4g" "Diags" COEFFS 0 1 0 0 0 1 /end COMPU_METHOD
/begin COMPU_METHOD M_FORMULA_0546 "V530 FORMULA_0546" RAT_FUNC "%.4g" "Diags" COEFFS 0 1 0 0 0 1 /end COMPU_METHOD
/begin COMPU_METHOD M_FORMULA_0553 "V530 FORMULA_0553" RAT_FUNC "%.4g" "mA" COEFFS 0 444.4444444 0 0 0 1 /end COMPU_METHOD
/begin COMPU_METHOD M_FORMULA_0556 "V530 FORMULA_0556" RAT_FUNC "%.4g" "min" COEFFS 0 1 0 0 0 1 /end COMPU_METHOD
/begin COMPU_METHOD M_FORMULA_0559 "V530 FORMULA_0559" RAT_FUNC "%.4g" "l" COEFFS 0 2 0 0 0 1 /end COMPU_METHOD
/begin COMPU_METHOD M_FORMULA_0571 "V530 FORMULA_0571" RAT_FUNC "%.4g" "mal" COEFFS 0 1 0 0 0 1 /end COMPU_METHOD
/begin COMPU_METHOD M_FORMULA_0572 "V530 FORMULA_0572" RAT_FUNC "%.4g" "bytes" COEFFS 0 0.25 0 0 0 1 /end COMPU_METHOD
/begin COMPU_METHOD M_FORMULA_0573 "V530 FORMULA_0573" RAT_FUNC "%.4g" "VERS" COEFFS 0 1 0 0 0 1 /end COMPU_METHOD
/begin COMPU_METHOD M_FORMULA_0589 "V530 FORMULA_0589" RAT_FUNC "%.4g" "m/s*s" COEFFS 0 4 0 0 0 1 /end COMPU_METHOD
/begin COMPU_METHOD M_FORMULA_0591 "V530 FORMULA_0591" RAT_FUNC "%.4g" "-" COEFFS 0 0.1 0 0 0 1 /end COMPU_METHOD
/begin COMPU_METHOD M_FORMULA_0593 "V530 FORMULA_0593" RAT_FUNC "%.4g" "s" COEFFS 0 1 0 0 0 1 /end COMPU_METHOD
/begin COMPU_METHOD M_FORMULA_0595 "V530 FORMULA_0595" RAT_FUNC "%.4g" "Liter" COEFFS 0 10 100 0 0 1 /end COMPU_METHOD
/begin COMPU_METHOD M_FORMULA_0606 "V530 FORMULA_0606" RAT_FUNC "%.4g" "s" COEFFS 0 200 0 0 0 1 /end COMPU_METHOD
/begin COMPU_METHOD M_FORMULA_0607 "V530 FORMULA_0607" RAT_FUNC "%.4g" "Sufe" COEFFS 0 1 0 0 0 1 /end COMPU_METHOD
/begin COMPU_METHOD M_FORMULA_0609 "V530 FORMULA_0609" RAT_FUNC "%.4g" "s" COEFFS 0 1 0 0 0 1 /end COMPU_METHOD
/begin COMPU_METHOD M_FORMULA_0610 "V530 FORMULA_0610" RAT_FUNC "%.4g" "l" COEFFS 0 2 0 0 0 1 /end COMPU_METHOD
/begin COMPU_METHOD M_FORMULA_0613 "V530 FORMULA_0613" RAT_FUNC "%.4g" "km" COEFFS 0 1 0 0 0 1 /end COMPU_METHOD
/begin COMPU_METHOD M_FORMULA_0619 "V530 FORMULA_0619" RAT_FUNC "%.4g" "-" COEFFS 0 10 0 0 0 1 /end COMPU_METHOD
/begin COMPU_METHOD M_FORMULA_0623 "V530 FORMULA_0623" RAT_FUNC "%.4g" "%" COEFFS 0 10 0 0 0 1 /end COMPU_METHOD
/begin COMPU_METHOD M_FORMULA_0731 "V530 FORMULA_0731" RAT_FUNC "%.4g" "mm" COEFFS 0 3.37 0 0 0 1 /end COMPU_METHOD
/begin COMPU_METHOD CM_0001 "X*0.01952206" RAT_FUNC "%.4g" "nSs" COEFFS 0 1 0 0 0 0.01952206 /end COMPU_METHOD
/begin COMPU_METHOD CM_0004 "X*0.0001428571" RAT_FUNC "%.4g" "ms" COEFFS 0 1 0 0 0 0.0001428571 /end COMPU_METHOD
/begin COMPU_METHOD CM_0007 "X*20.0" RAT_FUNC "%.4g" "Nm/s" COEFFS 0 1 0 0 0 20 /end COMPU_METHOD
/begin COMPU_METHOD CM_0008 "X*0.1" RAT_FUNC "%.4g" "?KW/Segm" COEFFS 0 1 0 0 0 0.1 /end COMPU_METHOD
/begin COMPU_METHOD CM_0018 "X*0.0000009537" RAT_FUNC "%.4g" "-" COEFFS 0 1 0 0 0 9.537e-07 /end COMPU_METHOD
/begin COMPU_METHOD CM_0029 "X*0.005" RAT_FUNC "%.4g" "sec" COEFFS 0 1 0 0 0 0.005 /end COMPU_METHOD
/begin COMPU_METHOD CM_0030 "X" RAT_FUNC "%.4g" "mal" COEFFS 0 1 0 0 0 1 /end COMPU_METHOD
/begin COMPU_METHOD CM_0031 "X*0.0048828125" RAT_FUNC "%.4g" "V" COEFFS 0 1 0 0 0 0.0048828125 /end COMPU_METHOD
/begin COMPU_METHOD CM_0033 "X*0.0099902344" RAT_FUNC "%.4g" "%/V" COEFFS 0 1 0 0 0 0.0099902344 /end COMPU_METHOD
/begin COMPU_METHOD CM_0034 "X*0.0015625" RAT_FUNC "%.4g" "%/km/h" COEFFS 0 1 0 0 0 0.0015625 /end COMPU_METHOD
/begin COMPU_METHOD CM_0035 "X*0.0015625" RAT_FUNC "%.4g" "sek" COEFFS 0 1 0 0 0 0.0015625 /end COMPU_METHOD
/begin COMPU_METHOD CM_0036 "X*0.0015625" RAT_FUNC "%.4g" "%" COEFFS 0 1 0 0 0 0.0015625 /end COMPU_METHOD
/begin COMPU_METHOD CM_0038 "X*0.0078125" RAT_FUNC "%.4g" "sek" COEFFS 0 1 0 0 0 0.0078125 /end COMPU_METHOD
/begin COMPU_METHOD CM_0039 "X*0.01" RAT_FUNC "%.4g" "-" COEFFS 0 1 0 0 0 0.01 /end COMPU_METHOD
/begin COMPU_METHOD CM_0040 "X*0.1" RAT_FUNC "%.4g" "-" COEFFS 0 1 0 0 0 0.1 /end COMPU_METHOD
/begin COMPU_METHOD CM_0041 "X*0.1" RAT_FUNC "%.4g" "%/sek" COEFFS 0 1 0 0 0 0.1 /end COMPU_METHOD
/begin COMPU_METHOD CM_0043 "X*0.0000038147" RAT_FUNC "%.4g" "-" COEFFS 0 1 0 0 0 3.8147e-06 /end COMPU_METHOD
/begin COMPU_METHOD CM_0045 "X*0.0625" RAT_FUNC "%.4g" "mph" COEFFS 0 1 0 0 0 0.0625 /end COMPU_METHOD
/begin COMPU_METHOD CM_0046 "X*0.01" RAT_FUNC "%.4g" "sek" COEFFS 0 1 0 0 0 0.01 /end COMPU_METHOD
/begin COMPU_METHOD CM_0047 "X*0.0000305185" RAT_FUNC "%.4g" "-" COEFFS 0 1 0 0 0 3.05185e-05 /end COMPU_METHOD
/begin COMPU_METHOD CM_0048 "X*0.0030517578" RAT_FUNC "%.4g" "1/s" COEFFS 0 1 0 0 0 0.0030517578 /end COMPU_METHOD
/begin COMPU_METHOD CM_0049 "X*20.0" RAT_FUNC "%.4g" "qmm/s" COEFFS 0 1 0 0 0 20 /end COMPU_METHOD
/begin COMPU_METHOD CM_0050 "X*0.0030517578" RAT_FUNC "%.4g" "%" COEFFS 0 1 0 0 0 0.0030517578 /end COMPU_METHOD
/begin COMPU_METHOD CM_0053 "X*0.001953125" RAT_FUNC "%.4g" "*" COEFFS 0 1 0 0 0 0.001953125 /end COMPU_METHOD
/begin COMPU_METHOD CM_0054 "X*0.00080566" RAT_FUNC "%.4g" "V" COEFFS 0 1 0 0 0 0.00080566 /end COMPU_METHOD
/begin COMPU_METHOD CM_0055 "X*0.0244140625" RAT_FUNC "%.4g" "%" COEFFS 0 1 0 0 0 0.0244140625 /end COMPU_METHOD
/begin COMPU_METHOD CM_0056 "X" RAT_FUNC "%.4g" "*" COEFFS 0 1 0 0 0 1 /end COMPU_METHOD
/begin COMPU_METHOD CM_0058 "X*0.001953125" RAT_FUNC "%.4g" "Nms2" COEFFS 0 1 0 0 0 0.001953125 /end COMPU_METHOD
/begin COMPU_METHOD CM_0059 "X*4" RAT_FUNC "%.4g" "km" COEFFS 0 1 0 0 0 4 /end COMPU_METHOD
/begin COMPU_METHOD CM_0061 "X*0.0109863281" RAT_FUNC "%.4g" "?KW" COEFFS 0 1 0 0 0 0.0109863281 /end COMPU_METHOD
/begin COMPU_METHOD CM_0062 "X*0.0008056640625" RAT_FUNC "%.4g" "V" COEFFS 0 1 0 0 0 0.0008056640625 /end COMPU_METHOD
/begin COMPU_METHOD CM_0063 "X*0.01" RAT_FUNC "%.4g" "Nm/Upm" COEFFS 0 1 0 0 0 0.01 /end COMPU_METHOD
/begin COMPU_METHOD CM_0066 "X*0.2" RAT_FUNC "%.4g" "Nm/s" COEFFS 0 1 0 0 0 0.2 /end COMPU_METHOD
/begin COMPU_METHOD CM_0068 "X" RAT_FUNC "%.4g" "Nm/s" COEFFS 0 1 0 0 0 1 /end COMPU_METHOD
/begin COMPU_METHOD CM_0069 "X*1.0+1.0" RAT_FUNC "%.4g" "-" COEFFS 0 1 -1 0 0 1 /end COMPU_METHOD
/begin COMPU_METHOD CM_0070 "X*0.001" RAT_FUNC "%.4g" "sec" COEFFS 0 1 0 0 0 0.001 /end COMPU_METHOD
/begin COMPU_METHOD CM_0071 "X*0.01" RAT_FUNC "%.4g" "10E-4" COEFFS 0 1 0 0 0 0.01 /end COMPU_METHOD
/begin COMPU_METHOD CM_0072 "X*0.01" RAT_FUNC "%.4g" "Nm/kmh" COEFFS 0 1 0 0 0 0.01 /end COMPU_METHOD
/begin COMPU_METHOD CM_0073 "X*0.1" RAT_FUNC "%.4g" "Nm/s" COEFFS 0 1 0 0 0 0.1 /end COMPU_METHOD
/begin COMPU_METHOD CM_0074 "X*0.01" RAT_FUNC "%.4g" "Nm" COEFFS 0 1 0 0 0 0.01 /end COMPU_METHOD
/begin COMPU_METHOD CM_0075 "X*20.0" RAT_FUNC "%.4g" "?/sec" COEFFS 0 1 0 0 0 20 /end COMPU_METHOD
/begin COMPU_METHOD CM_0076 "X*12.5" RAT_FUNC "%.4g" "Upm/s" COEFFS 0 1 0 0 0 12.5 /end COMPU_METHOD
/begin COMPU_METHOD CM_0077 "X*(-1.0)" RAT_FUNC "%.4g" "Nm" COEFFS 0 1 0 0 0 -1 /end COMPU_METHOD
/begin COMPU_METHOD CM_0078 "X" RAT_FUNC "%.4g" "Nm" COEFFS 0 1 0 0 0 1 /end COMPU_METHOD
/end MODULE
/end PROJECT
