ASAP2_VERSION 1 60
/begin PROJECT MSS60_V762_INJ "MSS60 (S65) V762 INJ CPU - generated 04.11.2026 from the reverse-engineered XDF"
/begin HEADER "Calibration description (characteristics from the XDF; measurements = V530 RAM names transferred to V762 addresses, confidence in each long identifier). Status tag in every long identifier: verified (checked against the code) / A2L-ref (placed from the V530 A2L) / EST (estimated) / unassigned (UNK placeholder)." VERSION "V762-RE-04112026" /end HEADER
/begin MODULE INJ "MSS60 V762 INJ"
/begin MOD_COMMON "" BYTE_ORDER MSB_FIRST ALIGNMENT_BYTE 1 ALIGNMENT_WORD 2 ALIGNMENT_LONG 4 /end MOD_COMMON
/begin MEASUREMENT spgr_freq "spgr_freq [RAM name from V530, voted 1]" UBYTE M_FORMULA_1120 0 0 -1e+12 1e+12 ECU_ADDRESS 0x3FE35B /end MEASUREMENT
/begin MEASUREMENT spim_errorcounter "Fehlerzaehler der Spi [RAM name from V530, voted 7]" UBYTE M_FORMULA_0003 0 0 0 255 ECU_ADDRESS 0x3FE35C /end MEASUREMENT
/begin MEASUREMENT spim_reqcounter "Anzahl der Auftraege in der Queue [RAM name from V530, voted 9]" UBYTE M_FORMULA_0003 0 0 0 255 ECU_ADDRESS 0x3FE35D /end MEASUREMENT
/begin MEASUREMENT spim_status "Statusvariable der SPI [RAM name from V530, voted 8]" UBYTE NO_COMPU_METHOD 0 0 0 255 ECU_ADDRESS 0x3FE35E FORMAT "%.4g" /end MEASUREMENT
/begin MEASUREMENT spim_errorcode "Statusvariable der SPI [RAM name from V530, voted 8]" UBYTE NO_COMPU_METHOD 0 0 0 255 ECU_ADDRESS 0x3FE35F FORMAT "%.4g" /end MEASUREMENT
/begin MEASUREMENT sys_last_reset_st "Letzter Resetstatus [RAM name from V530, voted 1]" UBYTE NO_COMPU_METHOD 0 0 0 255 ECU_ADDRESS 0x3FE490 FORMAT "%.4g" /end MEASUREMENT
/begin MEASUREMENT te_freq "TE-Ansteuerfrequenz [RAM name from V530, voted 7]" UWORD M_FORMULA_1076 0 0 0 6553.5 ECU_ADDRESS 0x3FE4DA /end MEASUREMENT
/begin MEASUREMENT te_ml_min_b1 "min. angesaugte Gesamtluft / Anzahl TEV [RAM name from V530, voted 1]" UWORD M_FORMULA_0103 0 0 0 6553.5 ECU_ADDRESS 0x3FE502 /end MEASUREMENT
/begin MEASUREMENT te_ml_nue "Wichte - Luft [RAM name from V530, voted 1]" UWORD M_FORMULA_1130 0 0 0 65.535 ECU_ADDRESS 0x3FE506 /end MEASUREMENT
/begin MEASUREMENT te_ml_soll_b1 "SOLL-Massenstrom je TEV auf Luft normiert [RAM name from V530, voted 1]" UWORD M_FORMULA_0563 0 0 0 65.535 ECU_ADDRESS 0x3FE508 /end MEASUREMENT
/begin MEASUREMENT te_ml_soll_mg_b1 "SOLL-Massenstrom je Zyl auf Luft normiert [RAM name from V530, voted 3]" UWORD M_FORMULA_0111 0 0 0 1023.984375 ECU_ADDRESS 0x3FE50C /end MEASUREMENT
/begin MEASUREMENT te_mks_yps_quad "(te_mks_yps)2 - MKS [RAM name from V530, voted 1]" UWORD M_FORMULA_1131 0 0 0 589815 ECU_ADDRESS 0x3FE518 /end MEASUREMENT
/begin MEASUREMENT te_mks_yps "Stroemungsgeschwindigkeit - MKS [RAM name from V530, voted 1]" UWORD M_FORMULA_1132 0 0 0 65535 ECU_ADDRESS 0x3FE51E /end MEASUREMENT
/begin MEASUREMENT te_ml_yps "Stroemungsgeschwindigkeit - Luft [RAM name from V530, voted 1]" UWORD M_FORMULA_1132 0 0 0 65535 ECU_ADDRESS 0x3FE524 /end MEASUREMENT
/begin MEASUREMENT te_mzyl_ohne_b1 "adaptierter angesaugter Luftmassenstrom ohne TE [RAM name from V530, voted 1]" UWORD M_FORMULA_0111 0 0 0 1023.984375 ECU_ADDRESS 0x3FE526 /end MEASUREMENT
/begin MEASUREMENT te_ml_zyl_real_b1 "mzyl aus TI berechnet [RAM name from V530, voted 1]" UWORD M_FORMULA_0111 0 0 0 1023.984375 ECU_ADDRESS 0x3FE52A /end MEASUREMENT
/begin MEASUREMENT te_mzyl_diff_b1 "Differenz te_mzyl_ohne - te_ml_zyl_real [RAM name from V530, voted 1]" UWORD M_FORMULA_0111 0 0 0 1023.984375 ECU_ADDRESS 0x3FE52E /end MEASUREMENT
/begin MEASUREMENT te_mks_f_ist_b1 "Aenderungsbegr. Faktor auf Kraftstoffmasse aus TE [RAM name from V530, voted 2]" UWORD M_FORMULA_0024 0 0 0 1.999969482 ECU_ADDRESS 0x3FE536 /end MEASUREMENT
/begin MEASUREMENT te_mks_f_ist_b2 "Aenderungsbegr. Faktor auf Kraftstoffmasse aus TE [RAM name from V530, voted 1]" UWORD M_FORMULA_0024 0 0 0 1.999969482 ECU_ADDRESS 0x3FE538 /end MEASUREMENT
/begin MEASUREMENT te_mks_ist_b1 "aktuelle MKS aus TE [RAM name from V530, voted 3]" UWORD M_FORMULA_0111 0 0 0 1023.984375 ECU_ADDRESS 0x3FE510 /end MEASUREMENT
/begin MEASUREMENT B_TE_ABBR "Abbruch SPUELEN [RAM name from V530, voted 12]" UWORD NO_COMPU_METHOD 0 0 0 65535 ECU_ADDRESS 0x3FE54C FORMAT "%.4g" /end MEASUREMENT
/begin MEASUREMENT B_TE_C_AKF_ADAPT_B1 "C-AKF einadaptiert - Bank1 [RAM name from V530, voted 12]" UWORD NO_COMPU_METHOD 0 0 0 65535 ECU_ADDRESS 0x3FE54C FORMAT "%.4g" /end MEASUREMENT
/begin MEASUREMENT B_TE_C_AKF_ADAPT_B2 "C-AKF einadaptiert - Bank2 [RAM name from V530, voted 12]" UWORD NO_COMPU_METHOD 0 0 0 65535 ECU_ADDRESS 0x3FE54C FORMAT "%.4g" /end MEASUREMENT
/begin MEASUREMENT B_TE_DIAG_SH_TO_UB_B1 "TEV wegen KS_TO_UB sperren [RAM name from V530, voted 12]" UWORD NO_COMPU_METHOD 0 0 0 65535 ECU_ADDRESS 0x3FE54C FORMAT "%.4g" /end MEASUREMENT
/begin MEASUREMENT B_TE_DIAG_SH_TO_UB_B2 "TEV wegen KS_TO_UB sperren [RAM name from V530, voted 12]" UWORD NO_COMPU_METHOD 0 0 0 65535 ECU_ADDRESS 0x3FE54C FORMAT "%.4g" /end MEASUREMENT
/begin MEASUREMENT B_TE_LANG "Bedingungen fuer Lang Spuelen [RAM name from V530, voted 12]" UWORD NO_COMPU_METHOD 0 0 0 65535 ECU_ADDRESS 0x3FE54C FORMAT "%.4g" /end MEASUREMENT
/begin MEASUREMENT B_TE_N_STAT_B1 "n-Stationaer Bank1 [RAM name from V530, voted 12]" UWORD NO_COMPU_METHOD 0 0 0 65535 ECU_ADDRESS 0x3FE54C FORMAT "%.4g" /end MEASUREMENT
/begin MEASUREMENT B_TE_N_STAT_B2 "n-Stationaer Bank2 [RAM name from V530, voted 12]" UWORD NO_COMPU_METHOD 0 0 0 65535 ECU_ADDRESS 0x3FE54C FORMAT "%.4g" /end MEASUREMENT
/begin MEASUREMENT B_TE_NOTSPUELEN_B1 "NOTLAUF-SPUELEN Bank1 [RAM name from V530, voted 12]" UWORD NO_COMPU_METHOD 0 0 0 65535 ECU_ADDRESS 0x3FE54C FORMAT "%.4g" /end MEASUREMENT
/begin MEASUREMENT B_TE_NOTSPUELEN_B2 "NOTLAUF-SPUELEN Bank2 [RAM name from V530, voted 12]" UWORD NO_COMPU_METHOD 0 0 0 65535 ECU_ADDRESS 0x3FE54C FORMAT "%.4g" /end MEASUREMENT
/begin MEASUREMENT B_TE_RF_STAT_B1 "rf-Stationaer Bank1 [RAM name from V530, voted 12]" UWORD NO_COMPU_METHOD 0 0 0 65535 ECU_ADDRESS 0x3FE54C FORMAT "%.4g" /end MEASUREMENT
/begin MEASUREMENT B_TE_RF_STAT_B2 "rf-Stationaer Bank2 [RAM name from V530, voted 12]" UWORD NO_COMPU_METHOD 0 0 0 65535 ECU_ADDRESS 0x3FE54C FORMAT "%.4g" /end MEASUREMENT
/begin MEASUREMENT B_TE_STAT "Alles stationaer fuer TE_C_AKF_LERN [RAM name from V530, voted 12]" UWORD NO_COMPU_METHOD 0 0 0 65535 ECU_ADDRESS 0x3FE54C FORMAT "%.4g" /end MEASUREMENT
/begin MEASUREMENT B_TE_STOP "STOP-SPUELEN [RAM name from V530, voted 12]" UWORD NO_COMPU_METHOD 0 0 0 65535 ECU_ADDRESS 0x3FE54C FORMAT "%.4g" /end MEASUREMENT
/begin MEASUREMENT B_TE_VAN_STAT_B1 "VAN-Stationaer Bank1 [RAM name from V530, voted 12]" UWORD NO_COMPU_METHOD 0 0 0 65535 ECU_ADDRESS 0x3FE54C FORMAT "%.4g" /end MEASUREMENT
/begin MEASUREMENT B_TE_VAN_STAT_B2 "VAN-Stationaer Bank2 [RAM name from V530, voted 12]" UWORD NO_COMPU_METHOD 0 0 0 65535 ECU_ADDRESS 0x3FE54C FORMAT "%.4g" /end MEASUREMENT
/begin MEASUREMENT B_TE_ZUL "TE zulaessig [RAM name from V530, voted 12]" UWORD NO_COMPU_METHOD 0 0 0 65535 ECU_ADDRESS 0x3FE54C FORMAT "%.4g" /end MEASUREMENT
/begin MEASUREMENT te_st "allgemeiner TE-Status [RAM name from V530, voted 12]" UWORD M_FORMULA_0080 0 0 0 65535 ECU_ADDRESS 0x3FE54C /end MEASUREMENT
/begin MEASUREMENT te_t_begin_min "Min. Motorlaufzeit TE-Beginn [RAM name from V530, voted 2]" UWORD M_FORMULA_0021 0 0 0 655.35 ECU_ADDRESS 0x3FE54E /end MEASUREMENT
/begin MEASUREMENT te_t_spuel "SPUEL-Zeit [RAM name from V530, voted 7]" UWORD M_FORMULA_0071 0 0 0 6553.5 ECU_ADDRESS 0x3FE552 /end MEASUREMENT
/begin MEASUREMENT te_t_laa_ini "TE-LAA-INI-Zeit - ununterbrechbar [RAM name from V530, voted 3]" UWORD M_FORMULA_0071 0 0 0 6553.5 ECU_ADDRESS 0x3FE554 /end MEASUREMENT
/begin MEASUREMENT te_t_laa "TE-LAA-Zeit [RAM name from V530, voted 5]" UWORD M_FORMULA_0071 0 0 0 6553.5 ECU_ADDRESS 0x3FE556 /end MEASUREMENT
/begin MEASUREMENT te_ventil_exd_timeout "Tester Ansteuerzeit [RAM name from V530, voted 4]" UBYTE M_FORMULA_0461 0 0 0 25.5 ECU_ADDRESS 0x3FE572 /end MEASUREMENT
/begin MEASUREMENT te_vol_sum "Summe Volumenstrom AKF in Motorlauf [RAM name from V530, voted 5]" ULONG M_FORMULA_1152 0 0 0 14316.55765 ECU_ADDRESS 0x3FE57C /end MEASUREMENT
/begin MEASUREMENT te_x_mks_betrieb_b1 "MKS-Anteil auf Luft-Anteil norm, mit ti_min-Begr. [RAM name from V530, voted 1]" UWORD M_FORMULA_0024 0 0 0 1.999969482 ECU_ADDRESS 0x3FE584 /end MEASUREMENT
/begin MEASUREMENT te_x_ml_max_b1 "max. zulaessiger Spuelluftanteil [RAM name from V530, voted 1]" UWORD M_FORMULA_0024 0 0 0 1.999969482 ECU_ADDRESS 0x3FE594 /end MEASUREMENT
/begin MEASUREMENT te_x_ml_ziel_b1 "gewuenschter Spuelluftanteil [RAM name from V530, voted 1]" UWORD M_FORMULA_0024 0 0 0 1.999969482 ECU_ADDRESS 0x3FE5A4 /end MEASUREMENT
/begin MEASUREMENT te_obd_auss_delta_b1 "Auss-Integral Reaktion [RAM name from V530, voted 2]" SWORD M_FORMULA_0706 0 0 -327.68 327.67 ECU_ADDRESS 0x3FE5AA /end MEASUREMENT
/begin MEASUREMENT te_obd_auss_filt_b1 "gefilt. Auss-Integral-Leitwert [RAM name from V530, voted 3]" SWORD M_FORMULA_1161 0 0 -19.98848 19.98787 ECU_ADDRESS 0x3FE5AE /end MEASUREMENT
/begin MEASUREMENT te_obd_auss_start_b1 "gefilt. Auss-Integral bei Messbeginn [RAM name from V530, voted 3]" SWORD M_FORMULA_1161 0 0 -19.98848 19.98787 ECU_ADDRESS 0x3FE5B4 /end MEASUREMENT
/begin MEASUREMENT te_obd_kkos_md_start "Md-Aufnahme Klimakompressor [RAM name from V530, voted 2]" SWORD M_FORMULA_0120 0 0 -16384 16383.5 ECU_ADDRESS 0x3FE5B8 /end MEASUREMENT
/begin MEASUREMENT te_obd_lam_min_b1 "Minimalwert Lambda bei Messung [RAM name from V530, voted 2]" UWORD M_FORMULA_0025 0 0 0 3.999938965 ECU_ADDRESS 0x3FE5BA /end MEASUREMENT
/begin MEASUREMENT te_obd_lam_max_b2 "Maximalwert Lambda bei Messung [RAM name from V530, voted 1]" UWORD M_FORMULA_0025 0 0 0 3.999938965 ECU_ADDRESS 0x3FE5C0 /end MEASUREMENT
/begin MEASUREMENT te_obd_ll_cnt "Anzahl der LL Durchlaeufe [RAM name from V530, voted 5]" UBYTE M_FORMULA_0003 0 0 0 255 ECU_ADDRESS 0x3FE5C4 /end MEASUREMENT
/begin MEASUREMENT te_obd_ll_delta "ml/n-Reaktion auf TEV-Aktion [RAM name from V530, voted 4]" SWORD M_FORMULA_0022 0 0 -327.68 327.67 ECU_ADDRESS 0x3FE5CC /end MEASUREMENT
/begin MEASUREMENT te_obd_ll_ok "Anzahl der ml/n OK-Erkennungen [RAM name from V530, voted 7]" UBYTE M_FORMULA_0003 0 0 0 255 ECU_ADDRESS 0x3FE5CE /end MEASUREMENT
/begin MEASUREMENT te_obd_lrw_start "CAN: Lenkradwinkel [RAM name from V530, voted 2]" SWORD M_FORMULA_0132 0 0 -1440.1536 1440.10965 ECU_ADDRESS 0x3FE5D0 /end MEASUREMENT
/begin MEASUREMENT te_obd_md_gen_start "Generatormoment bei Messbeginn [RAM name from V530, voted 2]" SWORD M_FORMULA_0113 0 0 -3276.8 3276.7 ECU_ADDRESS 0x3FE5D2 /end MEASUREMENT
/begin MEASUREMENT te_obd_ml_alt "Wert vor te_tv-Veraenderung [RAM name from V530, voted 1]" SWORD M_FORMULA_0103 0 0 -3276.8 3276.7 ECU_ADDRESS 0x3FE5D4 /end MEASUREMENT
/begin MEASUREMENT te_obd_ml_filt "gefilterte hfm_ml_roh [RAM name from V530, voted 1]" SWORD M_FORMULA_1162 0 0 -51.2 51.1984375 ECU_ADDRESS 0x3FE5D6 /end MEASUREMENT
/begin MEASUREMENT te_obd_n_alt "Wert vor te_tv-Veraenderung [RAM name from V530, voted 1]" SWORD M_FORMULA_0006 0 0 -32768 32767 ECU_ADDRESS 0x3FE5D8 /end MEASUREMENT
/begin MEASUREMENT te_obd_result_b1 "Ergebnis TEV Funktions-Check [RAM name from V530, voted 3]" UBYTE NO_COMPU_METHOD 0 0 0 255 ECU_ADDRESS 0x3FE5DC FORMAT "%.4g" /end MEASUREMENT
/begin MEASUREMENT te_obd_st "Zustand TEV OBD Funktions-Check [RAM name from V530, voted 14]" UBYTE NO_COMPU_METHOD 0 0 0 255 ECU_ADDRESS 0x3FE5DE FORMAT "%.4g" /end MEASUREMENT
/begin MEASUREMENT te_obd_t_dly "Restzeit im LL bis Messbeginn [RAM name from V530, voted 4]" UBYTE M_FORMULA_0461 0 0 0 25.5 ECU_ADDRESS 0x3FE5DF /end MEASUREMENT
/begin MEASUREMENT te_obd_t_lam_reg_off "verbleibende Lam-Reg Sperrzeit [RAM name from V530, voted 4]" UBYTE M_FORMULA_0461 0 0 0 25.5 ECU_ADDRESS 0x3FE5E0 /end MEASUREMENT
/begin MEASUREMENT te_obd_t_mess "Rest-Messzeit bei te_tv Endwert [RAM name from V530, voted 9]" UBYTE M_FORMULA_0461 0 0 0 25.5 ECU_ADDRESS 0x3FE5E1 /end MEASUREMENT
/begin MEASUREMENT te_obd_tv_b1 "Tastverhaeltnis vom Funktions-Check [RAM name from V530, voted 8]" UWORD M_FORMULA_0107 0 0 0 6399.902344 ECU_ADDRESS 0x3FE5E4 /end MEASUREMENT
/begin MEASUREMENT te_obd_tz_start "Mittl. Zuendwinkel bei Mess-Beginn [RAM name from V530, voted 2]" SWORD M_FORMULA_0102 0 0 -3276.8 3276.7 ECU_ADDRESS 0x3FE5E8 /end MEASUREMENT
/begin MEASUREMENT te_obd_ub_start "Ub bei Mess-Beginn [RAM name from V530, voted 2]" SWORD M_FORMULA_0008 0 0 -3276.8 3276.7 ECU_ADDRESS 0x3FE5EA /end MEASUREMENT
/begin MEASUREMENT tgetr_filter "Gefilterter Messwert der Getriebetemperatur [RAM name from V530, voted 3]" SWORD M_FORMULA_0114 0 0 -32768 32767 ECU_ADDRESS 0x3FE5EE /end MEASUREMENT
/begin MEASUREMENT tgetr_ipol "Ungefilterter Messwert der Getriebetemperatur [RAM name from V530, voted 4]" SWORD M_FORMULA_1167 0 0 -1092.35 546.025 ECU_ADDRESS 0x3FE5F0 /end MEASUREMENT
/begin MEASUREMENT tgetr_sta "Status Uebertemperaturanzeige [RAM name from V530, voted 6]" UBYTE NO_COMPU_METHOD 0 0 0 255 ECU_ADDRESS 0x3FE5F2 FORMAT "%.4g" /end MEASUREMENT
/begin MEASUREMENT ti_b1.pdiff "Differenz pks-psau [RAM name from V530, voted 9]" SWORD M_FORMULA_0110 0 0 -32.768 32.767 ECU_ADDRESS 0x3FE5F4 /end MEASUREMENT
/begin MEASUREMENT ti_b1.ub_offs "UB-abhaengiger TI-Offset [RAM name from V530, voted 1]" UWORD M_FORMULA_0786 0 0 0 65.535 ECU_ADDRESS 0x3FE5FA /end MEASUREMENT
/begin MEASUREMENT ti_b1.min "min. TI-Zeit [RAM name from V530, voted 2]" UWORD M_FORMULA_0786 0 0 0 65.535 ECU_ADDRESS 0x3FE600 /end MEASUREMENT
/begin MEASUREMENT ti_b1.mks_grund "Grundeinspritzmasse mit WL [RAM name from V530, voted 1]" UWORD M_FORMULA_0111 0 0 0 1023.984375 ECU_ADDRESS 0x3FE608 /end MEASUREMENT
/begin MEASUREMENT ti_b1.phi_ende_min "min. Einspritzendewinkel [RAM name from V530, voted 2]" SWORD M_FORMULA_0102 0 0 -3276.8 3276.7 ECU_ADDRESS 0x3FE618 /end MEASUREMENT
/begin MEASUREMENT ti_b1.ml_max "max. ML aus ti_mks_max [RAM name from V530, voted 1]" UWORD M_FORMULA_0090 0 0 0 6553.5 ECU_ADDRESS 0x3FE61C /end MEASUREMENT
/begin MEASUREMENT ti_b2.pdiff "Differenz pks-psau [RAM name from V530, voted 7]" SWORD M_FORMULA_0110 0 0 -32.768 32.767 ECU_ADDRESS 0x3FE620 /end MEASUREMENT
/begin MEASUREMENT ti_b2.min "min. TI-Zeit [RAM name from V530, voted 1]" UWORD M_FORMULA_0786 0 0 0 65.535 ECU_ADDRESS 0x3FE62C /end MEASUREMENT
/begin MEASUREMENT ti_b2.mks_grund "Grundeinspritzmasse mit WL [RAM name from V530, voted 1]" UWORD M_FORMULA_0111 0 0 0 1023.984375 ECU_ADDRESS 0x3FE634 /end MEASUREMENT
/begin MEASUREMENT ti_b2.phi_ende_min "min. Einspritzendewinkel [RAM name from V530, voted 1]" SWORD M_FORMULA_0102 0 0 -3276.8 3276.7 ECU_ADDRESS 0x3FE644 /end MEASUREMENT
/begin MEASUREMENT ti_b2.ml_max "max. ML aus ti_mks_max [RAM name from V530, voted 1]" UWORD M_FORMULA_0090 0 0 0 6553.5 ECU_ADDRESS 0x3FE648 /end MEASUREMENT
/begin MEASUREMENT ti_max_lim "ti_max f. Ermittlung von B_TIM_MAX u. Druckerhoehung [RAM name from V530, voted 2]" ULONG M_FORMULA_0363 0 0 0 4294967.295 ECU_ADDRESS 0x3FE64C /end MEASUREMENT
/begin MEASUREMENT ti_tpu_start "TI-TPU-Start-Status [RAM name from V530, voted 5]" UWORD M_FORMULA_0010 0 0 0 65535 ECU_ADDRESS 0x3FE650 /end MEASUREMENT
/begin MEASUREMENT ti_segm_cnt "TI Segmentzaehler [RAM name from V530, voted 2]" UWORD M_FORMULA_0010 0 0 0 65535 ECU_ADDRESS 0x3FE654 /end MEASUREMENT
/begin MEASUREMENT ti_lin_offs_zyl1 "Kompensationsoffset [RAM name from V530, voted 3]" SWORD M_FORMULA_0786 0 0 -32.768 32.767 ECU_ADDRESS 0x3FE656 /end MEASUREMENT
/begin MEASUREMENT ti_mks_start "START-Grundeinspritzmasse [RAM name from V530, voted 1]" UWORD M_FORMULA_0111 0 0 0 1023.984375 ECU_ADDRESS 0x3FE66E /end MEASUREMENT
/begin MEASUREMENT ti_start_f "Abregelfaktor im START [RAM name from V530, voted 1]" UWORD M_FORMULA_0073 0 0 0 63.99902344 ECU_ADDRESS 0x3FE672 /end MEASUREMENT
/begin MEASUREMENT ti_mks_soll_zyl1 "SOLL-Einspritzmasse [RAM name from V530, voted 4]" UWORD M_FORMULA_0111 0 0 0 1023.984375 ECU_ADDRESS 0x3FE674 /end MEASUREMENT
/begin MEASUREMENT ti_out_zyl1 "Ausgegebene Einspritzzeit im letzten Arbeitsspiel. [RAM name from V530, voted 2]" ULONG M_FORMULA_0363 0 0 0 4294967.295 ECU_ADDRESS 0x3FE740 /end MEASUREMENT
/begin MEASUREMENT ti_asp_cnt_zyl1 "Arbeitsspielzaehler der Einspritzkanaele. [RAM name from V530, voted 3]" UBYTE M_FORMULA_0003 0 0 0 255 ECU_ADDRESS 0x3FE768 /end MEASUREMENT
/begin MEASUREMENT ti_status "TI-Status [RAM name from V530, voted 20]" UWORD M_FORMULA_0080 0 0 0 65535 ECU_ADDRESS 0x3FE772 /end MEASUREMENT
/begin MEASUREMENT ti_status_aus_auss "TI-Ausblendung - Aussetzer [RAM name from V530, voted 20]" UWORD NO_COMPU_METHOD 0 0 0 65535 ECU_ADDRESS 0x3FE772 FORMAT "%.4g" /end MEASUREMENT
/begin MEASUREMENT ti_status_aus_egas "TI-Ausblendung - EGAS [RAM name from V530, voted 20]" UWORD NO_COMPU_METHOD 0 0 0 65535 ECU_ADDRESS 0x3FE772 FORMAT "%.4g" /end MEASUREMENT
/begin MEASUREMENT ti_status_aus_md "TI-Ausblendung - Teilfeuerung [RAM name from V530, voted 20]" UWORD NO_COMPU_METHOD 0 0 0 65535 ECU_ADDRESS 0x3FE772 FORMAT "%.4g" /end MEASUREMENT
/begin MEASUREMENT ti_status_aus_sk "TI-Ausblendung - Sicherheitsmanager [RAM name from V530, voted 20]" UWORD NO_COMPU_METHOD 0 0 0 65535 ECU_ADDRESS 0x3FE772 FORMAT "%.4g" /end MEASUREMENT
/begin MEASUREMENT ti_status_aus_ti "reine TI-Komplettausblendung [RAM name from V530, voted 20]" UWORD NO_COMPU_METHOD 0 0 0 65535 ECU_ADDRESS 0x3FE772 FORMAT "%.4g" /end MEASUREMENT
/begin MEASUREMENT ti_status_aus_ti_tz "TI/TZ-Komplettausblendung [RAM name from V530, voted 20]" UWORD NO_COMPU_METHOD 0 0 0 65535 ECU_ADDRESS 0x3FE772 FORMAT "%.4g" /end MEASUREMENT
/begin MEASUREMENT ti_status_aus_treiber "TI-Ausblendung - Treiberdiagnose [RAM name from V530, voted 20]" UWORD NO_COMPU_METHOD 0 0 0 65535 ECU_ADDRESS 0x3FE772 FORMAT "%.4g" /end MEASUREMENT
/begin MEASUREMENT ti_status_off_cfg "TI-Ausblendung - ueber CFG [RAM name from V530, voted 20]" UWORD NO_COMPU_METHOD 0 0 0 65535 ECU_ADDRESS 0x3FE772 FORMAT "%.4g" /end MEASUREMENT
/begin MEASUREMENT ti_status_off_exd "TI-Ausblendung - externe Anforderung [RAM name from V530, voted 20]" UWORD NO_COMPU_METHOD 0 0 0 65535 ECU_ADDRESS 0x3FE772 FORMAT "%.4g" /end MEASUREMENT
/begin MEASUREMENT ti_wl_f_kh_b1 "Warmlauffaktor auf TI waehrend KH [RAM name from V530, voted 1]" UWORD M_FORMULA_0073 0 0 0 63.99902344 ECU_ADDRESS 0x3FE778 /end MEASUREMENT
/begin MEASUREMENT ti_off_exd "TI-OFF-Status - externe Anforderung [RAM name from V530, voted 2]" UWORD M_FORMULA_0010 0 0 0 65535 ECU_ADDRESS 0x3FE784 /end MEASUREMENT
/begin MEASUREMENT ti_off_exd_timeout "KWP-Ansteuerzeit [RAM name from V530, voted 3]" UWORD M_FORMULA_1022 0 0 0 65.535 ECU_ADDRESS 0x3FE786 /end MEASUREMENT
/begin MEASUREMENT ti_rf_max_dly "Verzoegerungszeit ueber Anzahl Segmente [RAM name from V530, voted 2]" UWORD M_FORMULA_1175 0 0 0 65535 ECU_ADDRESS 0x3FE788 /end MEASUREMENT
/begin MEASUREMENT ti_tu_f_n_sst10 "SST [RAM name from V530, voted 12]" ULONG M_FORMULA_0000 0 0 0 4294967295 ECU_ADDRESS 0x3FE78C /end MEASUREMENT
/begin MEASUREMENT tksm_mr_tumg_delta "Temperaturdifferenz Motorraum zu Umgebung [RAM name from V530, voted 1]" SWORD M_FORMULA_0023 0 0 -3550 3003.5 ECU_ADDRESS 0x3FE7B2 /end MEASUREMENT
/begin MEASUREMENT tksm_raw "Kraftstofftemperatur Modell ungefiltert [RAM name from V530, voted 2]" SWORD M_FORMULA_0023 0 0 -3550 3003.5 ECU_ADDRESS 0x3FE7B4 /end MEASUREMENT
/begin MEASUREMENT tksm_loc "Lokale Kraftstofftemperatur Modell gefiltert [RAM name from V530, voted 2]" SWORD M_FORMULA_0023 0 0 -3550 3003.5 ECU_ADDRESS 0x3FE7B6 /end MEASUREMENT
/begin MEASUREMENT tpu_code_status "TPU MicroCode Status. [RAM name from V530, voted 2]" UWORD M_FORMULA_0010 0 0 0 65535 ECU_ADDRESS 0x3FE7BC /end MEASUREMENT
/begin MEASUREMENT tpu_st_a "Status TPU Synchronisation [RAM name from V530, voted 24]" UBYTE NO_COMPU_METHOD 0 0 0 255 ECU_ADDRESS 0x3FE7BE FORMAT "%.4g" /end MEASUREMENT
/begin MEASUREMENT tpu_st_b "Status TPU Synchronisation [RAM name from V530, voted 11]" UBYTE NO_COMPU_METHOD 0 0 0 255 ECU_ADDRESS 0x3FE7BF FORMAT "%.4g" /end MEASUREMENT
/begin MEASUREMENT tpu_zyl "aktueller Zylinder [RAM name from V530, voted 7]" UBYTE M_FORMULA_0408 0 0 1 256 ECU_ADDRESS 0x3FE7C0 /end MEASUREMENT
/begin MEASUREMENT tpu_zyl_p2 "zwei Zylinder in der Zukunft [RAM name from V530, voted 5]" UBYTE M_FORMULA_0408 0 0 1 256 ECU_ADDRESS 0x3FE7C1 /end MEASUREMENT
/begin MEASUREMENT tpu_bank "aktuelle Bank [RAM name from V530, voted 10]" UBYTE M_FORMULA_0408 0 0 1 256 ECU_ADDRESS 0x3FE7C2 /end MEASUREMENT
/begin MEASUREMENT tpu_zyl_bank "aktueller Zylinder der Bank [RAM name from V530, voted 9]" UBYTE M_FORMULA_0408 0 0 1 256 ECU_ADDRESS 0x3FE7C3 /end MEASUREMENT
/begin MEASUREMENT tpu_index "Segmentindex fuer den Gesamtmotor [RAM name from V530, voted 10]" UBYTE M_FORMULA_0003 0 0 0 255 ECU_ADDRESS 0x3FE7C4 /end MEASUREMENT
/begin MEASUREMENT tpu_kw_rot "Rotation. [RAM name from V530, voted 3]" UBYTE M_FORMULA_0003 0 0 0 255 ECU_ADDRESS 0x3FE7C5 /end MEASUREMENT
/begin MEASUREMENT tpu_idx_a "Segmentindex auf TPU [RAM name from V530, voted 4]" UBYTE M_FORMULA_0003 0 0 0 255 ECU_ADDRESS 0x3FE7C6 /end MEASUREMENT
/begin MEASUREMENT tpu_idx_b "Segmentindex auf TPU [RAM name from V530, voted 2]" UBYTE M_FORMULA_0003 0 0 0 255 ECU_ADDRESS 0x3FE7C7 /end MEASUREMENT
/begin MEASUREMENT tpu_kw_nw_sync_cnt_a "Umsynchronisationszaehler [RAM name from V530, voted 5]" UBYTE M_FORMULA_0003 0 0 0 255 ECU_ADDRESS 0x3FE7C8 /end MEASUREMENT
/begin MEASUREMENT tpu_kw_nw_sync_cnt_b "Umsynchronisationszaehler [RAM name from V530, voted 2]" UBYTE M_FORMULA_0003 0 0 0 255 ECU_ADDRESS 0x3FE7C9 /end MEASUREMENT
/begin MEASUREMENT tpu_kw_irq_a "Letzte KW Interruptart. [RAM name from V530, voted 5]" UBYTE NO_COMPU_METHOD 0 0 0 255 ECU_ADDRESS 0x3FE7CA FORMAT "%.4g" /end MEASUREMENT
/begin MEASUREMENT tpu_kw_irq_error_a "Fehlerinterrupt. [RAM name from V530, voted 5]" UBYTE NO_COMPU_METHOD 0 0 0 255 ECU_ADDRESS 0x3FE7CA FORMAT "%.4g" /end MEASUREMENT
/begin MEASUREMENT tpu_kw_irq_info_a "Infointerrupt (+/- ein Zahn). [RAM name from V530, voted 5]" UBYTE NO_COMPU_METHOD 0 0 0 255 ECU_ADDRESS 0x3FE7CA FORMAT "%.4g" /end MEASUREMENT
/begin MEASUREMENT tpu_kw_irq_mess_a "Messfensterinterrupt (LU). [RAM name from V530, voted 5]" UBYTE NO_COMPU_METHOD 0 0 0 255 ECU_ADDRESS 0x3FE7CA FORMAT "%.4g" /end MEASUREMENT
/begin MEASUREMENT tpu_kw_irq_n_min_a "Unterdrehzahlinterrupt. [RAM name from V530, voted 5]" UBYTE NO_COMPU_METHOD 0 0 0 255 ECU_ADDRESS 0x3FE7CA FORMAT "%.4g" /end MEASUREMENT
/begin MEASUREMENT tpu_kw_irq_pre_sync_a "Pre-Sync-Interrupt (Start Lueckensuche). [RAM name from V530, voted 5]" UBYTE NO_COMPU_METHOD 0 0 0 255 ECU_ADDRESS 0x3FE7CA FORMAT "%.4g" /end MEASUREMENT
/begin MEASUREMENT tpu_kw_irq_segm_a "Segmentinterrupt. [RAM name from V530, voted 5]" UBYTE NO_COMPU_METHOD 0 0 0 255 ECU_ADDRESS 0x3FE7CA FORMAT "%.4g" /end MEASUREMENT
/begin MEASUREMENT tpu_kw_irq_sync_a "Sync-Interrupt (Luecke gefunden). [RAM name from V530, voted 5]" UBYTE NO_COMPU_METHOD 0 0 0 255 ECU_ADDRESS 0x3FE7CA FORMAT "%.4g" /end MEASUREMENT
/begin MEASUREMENT tpu_kw_irq_tooth_a "Zahninterrupt. [RAM name from V530, voted 5]" UBYTE NO_COMPU_METHOD 0 0 0 255 ECU_ADDRESS 0x3FE7CA FORMAT "%.4g" /end MEASUREMENT
/begin MEASUREMENT tpu_kw_irq_b "Letzte KW Interruptart. [RAM name from V530, voted 3]" UBYTE NO_COMPU_METHOD 0 0 0 255 ECU_ADDRESS 0x3FE7CB FORMAT "%.4g" /end MEASUREMENT
/begin MEASUREMENT tpu_kw_irq_error_b "Fehlerinterrupt. [RAM name from V530, voted 3]" UBYTE NO_COMPU_METHOD 0 0 0 255 ECU_ADDRESS 0x3FE7CB FORMAT "%.4g" /end MEASUREMENT
/begin MEASUREMENT tpu_kw_irq_info_b "Infointerrupt (+/- ein Zahn). [RAM name from V530, voted 3]" UBYTE NO_COMPU_METHOD 0 0 0 255 ECU_ADDRESS 0x3FE7CB FORMAT "%.4g" /end MEASUREMENT
/begin MEASUREMENT tpu_kw_irq_mess_b "Messfensterinterrupt (LU). [RAM name from V530, voted 3]" UBYTE NO_COMPU_METHOD 0 0 0 255 ECU_ADDRESS 0x3FE7CB FORMAT "%.4g" /end MEASUREMENT
/begin MEASUREMENT tpu_kw_irq_n_min_b "Unterdrehzahlinterrupt. [RAM name from V530, voted 3]" UBYTE NO_COMPU_METHOD 0 0 0 255 ECU_ADDRESS 0x3FE7CB FORMAT "%.4g" /end MEASUREMENT
/begin MEASUREMENT tpu_kw_irq_pre_sync_b "Pre-Sync-Interrupt (Start Lueckensuche). [RAM name from V530, voted 3]" UBYTE NO_COMPU_METHOD 0 0 0 255 ECU_ADDRESS 0x3FE7CB FORMAT "%.4g" /end MEASUREMENT
/begin MEASUREMENT tpu_kw_irq_segm_b "Segmentinterrupt. [RAM name from V530, voted 3]" UBYTE NO_COMPU_METHOD 0 0 0 255 ECU_ADDRESS 0x3FE7CB FORMAT "%.4g" /end MEASUREMENT
/begin MEASUREMENT tpu_kw_irq_sync_b "Sync-Interrupt (Luecke gefunden). [RAM name from V530, voted 3]" UBYTE NO_COMPU_METHOD 0 0 0 255 ECU_ADDRESS 0x3FE7CB FORMAT "%.4g" /end MEASUREMENT
/begin MEASUREMENT tpu_kw_irq_tooth_b "Zahninterrupt. [RAM name from V530, voted 3]" UBYTE NO_COMPU_METHOD 0 0 0 255 ECU_ADDRESS 0x3FE7CB FORMAT "%.4g" /end MEASUREMENT
/begin MEASUREMENT tpu_kw_irq_zahn_a "Zahnnummer TPU bei Eintritt in ISR. [RAM name from V530, voted 3]" UBYTE M_FORMULA_0003 0 0 0 255 ECU_ADDRESS 0x3FE7CC /end MEASUREMENT
/begin MEASUREMENT tpu_kw_irq_zahn_b "Zahnnummer TPU bei Eintritt in ISR. [RAM name from V530, voted 3]" UBYTE M_FORMULA_0003 0 0 0 255 ECU_ADDRESS 0x3FE7CD /end MEASUREMENT
/begin MEASUREMENT tpu_kw_irq_cnt_a "TPU Interruptzaehler. [RAM name from V530, voted 3]" UBYTE M_FORMULA_0003 0 0 0 255 ECU_ADDRESS 0x3FE7CE /end MEASUREMENT
/begin MEASUREMENT tpu_kw_irq_cnt_b "TPU Interruptzaehler. [RAM name from V530, voted 2]" UBYTE M_FORMULA_0003 0 0 0 255 ECU_ADDRESS 0x3FE7CF /end MEASUREMENT
/begin MEASUREMENT tpu_kw_irq_segm_cnt_a "Anzahl Segmentinterrupts. [RAM name from V530, voted 4]" UBYTE M_FORMULA_0003 0 0 0 255 ECU_ADDRESS 0x3FE7D0 /end MEASUREMENT
/begin MEASUREMENT tpu_kw_irq_segm_cnt_b "Anzahl Segmentinterrupts. [RAM name from V530, voted 2]" UBYTE M_FORMULA_0003 0 0 0 255 ECU_ADDRESS 0x3FE7D1 /end MEASUREMENT
/begin MEASUREMENT tpu_kw_irq_tooth_cnt_a "Zahninterruptzaehler. [RAM name from V530, voted 4]" UBYTE M_FORMULA_0003 0 0 0 255 ECU_ADDRESS 0x3FE7D2 /end MEASUREMENT
/begin MEASUREMENT tpu_kw_irq_tooth_cnt_b "Zahninterruptzaehler. [RAM name from V530, voted 1]" UBYTE M_FORMULA_0003 0 0 0 255 ECU_ADDRESS 0x3FE7D3 /end MEASUREMENT
/begin MEASUREMENT T_batt "Batterietemperatur [RAM name from V530, voted 8]" SWORD M_FORMULA_0431 0 0 -3276.8 3276.7 ECU_ADDRESS 0x3FD182 /end MEASUREMENT
/begin MEASUREMENT van_dsv_exd_st "Status externe Ansteuerung [RAM name from V530, voted 2]" UBYTE NO_COMPU_METHOD 0 0 0 255 ECU_ADDRESS 0x3FE7D4 FORMAT "%.4g" /end MEASUREMENT
/begin MEASUREMENT van_dsv_exd_timeout "Timeout externe Ansteuerung [RAM name from V530, voted 5]" UBYTE M_FORMULA_0461 0 0 0 25.5 ECU_ADDRESS 0x3FE7D5 /end MEASUREMENT
/begin MEASUREMENT van_dsv_peak_time "Zeit der Peak-Phase DSV [RAM name from V530, voted 8]" UBYTE M_FORMULA_0461 0 0 0 25.5 ECU_ADDRESS 0x3FE7D6 /end MEASUREMENT
/begin MEASUREMENT van_dsv_st "Status Vanos Druckspeicherventil [RAM name from V530, voted 5]" UBYTE NO_COMPU_METHOD 0 0 0 255 ECU_ADDRESS 0x3FE7D7 FORMAT "%.4g" /end MEASUREMENT
/begin MEASUREMENT van_dsv_timer "Zeitzaehler DSV [RAM name from V530, voted 7]" UBYTE M_FORMULA_0461 0 0 0 25.5 ECU_ADDRESS 0x3FE7D8 /end MEASUREMENT
/begin MEASUREMENT van_dsv_tv "Druckspeicherventil Tastverhaeltnis [RAM name from V530, voted 5]" SWORD M_FORMULA_1235 0 0 -400 399.987793 ECU_ADDRESS 0x3FE7DA /end MEASUREMENT
/begin MEASUREMENT van_druck_time "Motorlaufzeit ohne Druck [RAM name from V530, voted 3]" UWORD M_FORMULA_0071 0 0 0 6553.5 ECU_ADDRESS 0x3FE7E2 /end MEASUREMENT
/begin MEASUREMENT van_exd_anschl_max_E1 "Pr???flauf Max-Anschlag [RAM name from V530, voted 2]" SWORD M_FORMULA_0102 0 0 -3276.8 3276.7 ECU_ADDRESS 0x3FE7E6 /end MEASUREMENT
/begin MEASUREMENT van_exd_anschl_min_E1 "Pr???flauf Min-Anschlag [RAM name from V530, voted 3]" SWORD M_FORMULA_0102 0 0 -3276.8 3276.7 ECU_ADDRESS 0x3FE7EE /end MEASUREMENT
/begin MEASUREMENT van_exd_frequ_E1 "PWM-Frequenz vom Tester [RAM name from V530, voted 2]" UWORD M_FORMULA_1202 0 0 -1e+12 1e+12 ECU_ADDRESS 0x3FE7F6 /end MEASUREMENT
/begin MEASUREMENT van_exd_soll_E1 "Sollwert vom Tester [RAM name from V530, voted 4]" SWORD M_FORMULA_0102 0 0 -3276.8 3276.7 ECU_ADDRESS 0x3FE7FE /end MEASUREMENT
/begin MEASUREMENT van_exd_pruef "Pr???flauf Status [RAM name from V530, voted 11]" UBYTE NO_COMPU_METHOD 0 0 0 255 ECU_ADDRESS 0x3FE820 FORMAT "%.4g" /end MEASUREMENT
/begin MEASUREMENT van_exd_t "Timer Prueflauf [RAM name from V530, voted 8]" UWORD M_FORMULA_0021 0 0 0 655.35 ECU_ADDRESS 0x3FE80E /end MEASUREMENT
/begin MEASUREMENT van_exd_tv_E1 "Ventil Tastverhaeltnis vom Tester [RAM name from V530, voted 2]" SWORD M_FORMULA_0107 0 0 -3200 3199.902344 ECU_ADDRESS 0x3FE810 /end MEASUREMENT
/begin MEASUREMENT van_exd_tv_timeout_E1 "Tastverhaeltnis vom Tester [RAM name from V530, voted 5]" UBYTE M_FORMULA_0461 0 0 0 25.5 ECU_ADDRESS 0x3FE818 /end MEASUREMENT
/begin MEASUREMENT van_exd_soll_timeout_E1 "Sollwert vom Tester Timeout [RAM name from V530, voted 5]" UBYTE M_FORMULA_0461 0 0 0 25.5 ECU_ADDRESS 0x3FE81C /end MEASUREMENT
/begin MEASUREMENT B_VAN_DRUCK "Druck erkannt [RAM name from V530, voted 3]" UBYTE NO_COMPU_METHOD 0 0 0 255 ECU_ADDRESS 0x3FE821 FORMAT "%.4g" /end MEASUREMENT
/begin MEASUREMENT B_VAN_GUETE "Guetemessung aktiv [RAM name from V530, voted 3]" UBYTE NO_COMPU_METHOD 0 0 0 255 ECU_ADDRESS 0x3FE821 FORMAT "%.4g" /end MEASUREMENT
/begin MEASUREMENT van_flags "Steuerflags [RAM name from V530, voted 3]" UBYTE M_FORMULA_0037 0 0 0 255 ECU_ADDRESS 0x3FE821 /end MEASUREMENT
/begin MEASUREMENT van_ist_schl_E1 "Ventil Schliessen vor ZOT [RAM name from V530, voted 3]" SWORD M_FORMULA_0102 0 0 -3276.8 3276.7 ECU_ADDRESS 0x3FE8B2 /end MEASUREMENT
/begin MEASUREMENT van_r "Spulenwiderstand Ventil [RAM name from V530, voted 1]" SWORD M_FORMULA_1212 0 0 -32.768 32.767 ECU_ADDRESS 0x3FE8D6 /end MEASUREMENT
/begin MEASUREMENT van_smg_st "Sollwert SMG-Schaltung [RAM name from V530, voted 6]" UBYTE NO_COMPU_METHOD 0 0 0 255 ECU_ADDRESS 0x3FE8D8 FORMAT "%.4g" /end MEASUREMENT
/begin MEASUREMENT van_smg_dauer "SMG Eingriffsdauer [RAM name from V530, voted 2]" UBYTE M_FORMULA_0306 0 0 0 2.55 ECU_ADDRESS 0x3FE8D9 /end MEASUREMENT
/begin MEASUREMENT B_VAN_ANSCHL_ANF_E1 "Anschlag anfahren [RAM name from V530, voted 6]" UBYTE NO_COMPU_METHOD 0 0 0 255 ECU_ADDRESS 0x3FE902 FORMAT "%.4g" /end MEASUREMENT
/begin MEASUREMENT B_VAN_ANSCHL_DC_E1 "Anschlag im DrivingCycle gelernt [RAM name from V530, voted 6]" UBYTE NO_COMPU_METHOD 0 0 0 255 ECU_ADDRESS 0x3FE902 FORMAT "%.4g" /end MEASUREMENT
/begin MEASUREMENT B_VAN_DRUCK_SPAET_E1 "Druckerkennung Sollwert spaet [RAM name from V530, voted 6]" UBYTE NO_COMPU_METHOD 0 0 0 255 ECU_ADDRESS 0x3FE902 FORMAT "%.4g" /end MEASUREMENT
/begin MEASUREMENT B_VAN_EXD_PRUEF_I_E1 "Stromvorgabe ueber Diagnose [RAM name from V530, voted 6]" UBYTE NO_COMPU_METHOD 0 0 0 255 ECU_ADDRESS 0x3FE902 FORMAT "%.4g" /end MEASUREMENT
/begin MEASUREMENT B_VAN_FILTR_E1 "Filtration erkannt [RAM name from V530, voted 6]" UBYTE NO_COMPU_METHOD 0 0 0 255 ECU_ADDRESS 0x3FE902 FORMAT "%.4g" /end MEASUREMENT
/begin MEASUREMENT B_VAN_KS_AUS_E1 "Ventil Kurzschlussabschaltung [RAM name from V530, voted 6]" UBYTE NO_COMPU_METHOD 0 0 0 255 ECU_ADDRESS 0x3FE902 FORMAT "%.4g" /end MEASUREMENT
/begin MEASUREMENT B_VAN_REG_FREI_E1 "Lageregler Freigabe [RAM name from V530, voted 6]" UBYTE NO_COMPU_METHOD 0 0 0 255 ECU_ADDRESS 0x3FE902 FORMAT "%.4g" /end MEASUREMENT
/begin MEASUREMENT van_st_E1 "Status Vanos [RAM name from V530, voted 6]" UBYTE M_FORMULA_0003 0 0 0 255 ECU_ADDRESS 0x3FE902 /end MEASUREMENT
/begin MEASUREMENT B_VAN_EINGER_A1 "Vanos eingeregelt [RAM name from V530, voted 2]" UBYTE NO_COMPU_METHOD 0 0 0 255 ECU_ADDRESS 0x3FE906 FORMAT "%.4g" /end MEASUREMENT
/begin MEASUREMENT B_VAN_EINGER_A2 "Vanos eingeregelt [RAM name from V530, voted 2]" UBYTE NO_COMPU_METHOD 0 0 0 255 ECU_ADDRESS 0x3FE906 FORMAT "%.4g" /end MEASUREMENT
/begin MEASUREMENT B_VAN_EINGER_BANK1 "Vanos eingeregelt [RAM name from V530, voted 2]" UBYTE NO_COMPU_METHOD 0 0 0 255 ECU_ADDRESS 0x3FE906 FORMAT "%.4g" /end MEASUREMENT
/begin MEASUREMENT B_VAN_EINGER_BANK2 "Vanos eingeregelt [RAM name from V530, voted 2]" UBYTE NO_COMPU_METHOD 0 0 0 255 ECU_ADDRESS 0x3FE906 FORMAT "%.4g" /end MEASUREMENT
/begin MEASUREMENT B_VAN_EINGER_E1 "Vanos eingeregelt [RAM name from V530, voted 2]" UBYTE NO_COMPU_METHOD 0 0 0 255 ECU_ADDRESS 0x3FE906 FORMAT "%.4g" /end MEASUREMENT
/begin MEASUREMENT B_VAN_EINGER_E2 "Vanos eingeregelt [RAM name from V530, voted 2]" UBYTE NO_COMPU_METHOD 0 0 0 255 ECU_ADDRESS 0x3FE906 FORMAT "%.4g" /end MEASUREMENT
/begin MEASUREMENT van_st_eingeregelt "Vanos eingeregelt [RAM name from V530, voted 2]" UBYTE M_FORMULA_0003 0 0 0 255 ECU_ADDRESS 0x3FE906 /end MEASUREMENT
/begin MEASUREMENT van_zahn_cnt_b1 "Zahnzaehler fuer n-Messung [RAM name from V530, voted 1]" SBYTE M_FORMULA_0003 0 0 -128 127 ECU_ADDRESS 0x3FE98E /end MEASUREMENT
/begin MEASUREMENT van_zahn_ctr5ms_b1 "5ms-Ctr fuer n-Messung [RAM name from V530, voted 1]" SWORD M_FORMULA_0010 0 0 -32768 32767 ECU_ADDRESS 0x3FE990 /end MEASUREMENT
/begin MEASUREMENT n_van_b1 "Einlass Nockenwellen-Drehzahl [RAM name from V530, voted 5]" SWORD M_FORMULA_0006 0 0 -32768 32767 ECU_ADDRESS 0x3FE994 /end MEASUREMENT
/begin MEASUREMENT n_van_b2 "Einlass Nockenwellen-Drehzahl [RAM name from V530, voted 2]" SWORD M_FORMULA_0006 0 0 -32768 32767 ECU_ADDRESS 0x3FE996 /end MEASUREMENT
/begin MEASUREMENT vers_prog "Programmversion [RAM name from V530, voted 1]" UWORD M_FORMULA_0010 0 0 0 65535 ECU_ADDRESS 0x3FE9B6 /end MEASUREMENT
/begin MEASUREMENT v_max_schw_sk "Maximalgeschwindigkeit bei SK-Fehler [RAM name from V530, voted 2]" SWORD M_FORMULA_0076 0 0 -2048 2047.9375 ECU_ADDRESS 0x3FE9BC /end MEASUREMENT
/begin MEASUREMENT v_rad_tol_vl "gefilt. RadToleranz VL [RAM name from V530, voted 3]" SBYTE M_FORMULA_0623 0 0 -12.8 12.7 ECU_ADDRESS 0x3FE9BE /end MEASUREMENT
/begin MEASUREMENT v_rad_tol_vr "gefilt. RadToleranz VR [RAM name from V530, voted 3]" SBYTE M_FORMULA_0623 0 0 -12.8 12.7 ECU_ADDRESS 0x3FE9BF /end MEASUREMENT
/begin MEASUREMENT v_rad_tol_hl "gefilt. RadToleranz HL [RAM name from V530, voted 3]" SBYTE M_FORMULA_0623 0 0 -12.8 12.7 ECU_ADDRESS 0x3FE9C0 /end MEASUREMENT
/begin MEASUREMENT v_rad_tol_hr "gefilt. RadToleranz HR [RAM name from V530, voted 2]" SBYTE M_FORMULA_0623 0 0 -12.8 12.7 ECU_ADDRESS 0x3FE9C1 /end MEASUREMENT
/begin MEASUREMENT wf_start_st "Status-simultan/sequentieller WF-START [RAM name from V530, voted 5]" UWORD M_FORMULA_0080 0 0 0 65535 ECU_ADDRESS 0x3FEA12 /end MEASUREMENT
/begin MEASUREMENT wf_mks_st "WF-Aktiv-Status [RAM name from V530, voted 3]" UWORD M_FORMULA_0080 0 0 0 65535 ECU_ADDRESS 0x3FEA14 /end MEASUREMENT
/begin MEASUREMENT wf_dmks_t1 "wf_dmks_t1_ms/dt [RAM name from V530, voted 1]" UWORD M_FORMULA_0754 0 0 0 255.9960938 ECU_ADDRESS 0x3FEA16 /end MEASUREMENT
/begin MEASUREMENT wf_mks_tau "Filterkonstante [RAM name from V530, voted 2]" UWORD M_FORMULA_0762 0 0 0 7.99987793 ECU_ADDRESS 0x3FEA18 /end MEASUREMENT
/begin MEASUREMENT wf_mks_begr_zyl1 "begr. wf_mks_roh [RAM name from V530, voted 2]" SWORD M_FORMULA_0534 0 0 -1024 1023.96875 ECU_ADDRESS 0x3FEA6C /end MEASUREMENT
/begin MEASUREMENT wf_start_seq_cnt "Segmentcounter f. sequentiellen WF-START [RAM name from V530, voted 3]" UWORD M_FORMULA_1239 0 0 0 65535 ECU_ADDRESS 0x3FEA94 /end MEASUREMENT
/begin MEASUREMENT wf_asp_cnt "ASP-Counter f. WF-Auf-/Abbau [RAM name from V530, voted 1]" UWORD M_FORMULA_1240 0 0 0 65535 ECU_ADDRESS 0x3FEA96 /end MEASUREMENT
/begin MEASUREMENT wf_lam_soll_offs_b1 "OFFSET-lam_soll abhaengig vom wf [RAM name from V530, voted 4]" SWORD M_FORMULA_0025 0 0 -2 1.999938965 ECU_ADDRESS 0x3FEA98 /end MEASUREMENT
/begin MEASUREMENT wf_mks_begr_neg_b1 "min. Schwelle fuer Wandfilmbegrenzung [RAM name from V530, voted 1]" SWORD M_FORMULA_0534 0 0 -1024 1023.96875 ECU_ADDRESS 0x3FEAA0 /end MEASUREMENT
/begin MEASUREMENT wf_zyl_aktiv_st "WF-Ausgabe-Status [RAM name from V530, voted 11]" UWORD M_FORMULA_0010 0 0 0 65535 ECU_ADDRESS 0x3FEAA4 /end MEASUREMENT
/begin MEASUREMENT wf_mks_start_max "max. benoetigte MKS im START [RAM name from V530, voted 2]" UWORD M_FORMULA_0534 0 0 0 2047.96875 ECU_ADDRESS 0x3FEAA6 /end MEASUREMENT
/begin MEASUREMENT wf_soll_f_pumg "WF-Korrekturfaktor Hoehe/Umgebungsdruck [RAM name from V530, voted 1]" UWORD M_FORMULA_0073 0 0 0 63.99902344 ECU_ADDRESS 0x3FEAA8 /end MEASUREMENT
/begin MEASUREMENT zust_exd_st "Zustandsstatus fuer externe Ansteuerung Diagnose [RAM name from V530, voted 4]" UBYTE NO_COMPU_METHOD 0 0 0 255 ECU_ADDRESS 0x3FEAAC FORMAT "%.4g" /end MEASUREMENT
/begin MEASUREMENT sk_e2_byte "Counter Byte-Komplement [RAM name from V530, voted 4]" UBYTE M_FORMULA_0003 0 0 0 255 ECU_ADDRESS 0x3FEC32 /end MEASUREMENT
/begin MEASUREMENT sk_e2_word "Counter Word-Komplement [RAM name from V530, voted 4]" UBYTE M_FORMULA_0003 0 0 0 255 ECU_ADDRESS 0x3FEC33 /end MEASUREMENT
/begin MEASUREMENT sk_e2_long "Counter Long-Komplement [RAM name from V530, voted 4]" UBYTE M_FORMULA_0003 0 0 0 255 ECU_ADDRESS 0x3FEC34 /end MEASUREMENT
/begin MEASUREMENT sk_e2_byte_err "Fehler Byte-Komplement [RAM name from V530, voted 1]" UBYTE M_FORMULA_0003 0 0 0 255 ECU_ADDRESS 0x3FA218 /end MEASUREMENT
/begin MEASUREMENT sk_e2_word_err "Fehler Word-Komplement [RAM name from V530, voted 1]" UBYTE M_FORMULA_0003 0 0 0 255 ECU_ADDRESS 0x3FA219 /end MEASUREMENT
/begin MEASUREMENT sk_e2_long_err "Fehler Long-Komplement [RAM name from V530, voted 1]" UBYTE M_FORMULA_0003 0 0 0 255 ECU_ADDRESS 0x3FA21A /end MEASUREMENT
/begin MEASUREMENT sk_e2_komp_err "Anzahl der Komplement-Fehler [RAM name from V530, voted 11]" UBYTE M_FORMULA_0003 0 0 0 255 ECU_ADDRESS 0x3FEC35 /end MEASUREMENT
/begin MEASUREMENT sk_ursache "Urache fuer SK-Eingriff [RAM name from V530, voted 4]" UWORD NO_COMPU_METHOD 0 0 0 65535 ECU_ADDRESS 0x3FEFB2 FORMAT "%.4g" /end MEASUREMENT
/begin MEASUREMENT sk_reset_cnt "Resetzaehler seit Kl15 ein [RAM name from V530, voted 4]" UBYTE M_FORMULA_0003 0 0 0 255 ECU_ADDRESS 0x3FEFB4 /end MEASUREMENT
/begin MEASUREMENT sk_egas_off_ni "SK-Egasstufe - no Init [RAM name from V530, voted 1]" UBYTE NO_COMPU_METHOD 0 0 0 255 ECU_ADDRESS 0x3FEFB6 FORMAT "%.4g" /end MEASUREMENT
/begin MEASUREMENT sk_e2_fehler "aktueller Ebene2-Fehler [RAM name from V530, voted 1]" UWORD NO_COMPU_METHOD 0 0 0 65535 ECU_ADDRESS 0x3FEFB8 FORMAT "%.4g" /end MEASUREMENT
/begin MEASUREMENT sys_rsr "Reset Status Register [RAM name from V530, voted 3]" UWORD M_FORMULA_0010 0 0 0 65535 ECU_ADDRESS 0x3FEFBC /end MEASUREMENT
/begin MEASUREMENT sys_rsr_csrs "Checkstop reset [RAM name from V530, voted 3]" UWORD NO_COMPU_METHOD 0 0 0 65535 ECU_ADDRESS 0x3FEFBC FORMAT "%.4g" /end MEASUREMENT
/begin MEASUREMENT sys_rsr_dbhrs "Debug port hard reset [RAM name from V530, voted 3]" UWORD NO_COMPU_METHOD 0 0 0 65535 ECU_ADDRESS 0x3FEFBC FORMAT "%.4g" /end MEASUREMENT
/begin MEASUREMENT sys_rsr_dbsrs "Debug port soft reset [RAM name from V530, voted 3]" UWORD NO_COMPU_METHOD 0 0 0 65535 ECU_ADDRESS 0x3FEFBC FORMAT "%.4g" /end MEASUREMENT
/begin MEASUREMENT sys_rsr_ehrs "External Hreset [RAM name from V530, voted 3]" UWORD NO_COMPU_METHOD 0 0 0 65535 ECU_ADDRESS 0x3FEFBC FORMAT "%.4g" /end MEASUREMENT
/begin MEASUREMENT sys_rsr_ersr "External Soft reset [RAM name from V530, voted 3]" UWORD NO_COMPU_METHOD 0 0 0 65535 ECU_ADDRESS 0x3FEFBC FORMAT "%.4g" /end MEASUREMENT
/begin MEASUREMENT sys_rsr_ghrst "Glitch detected on HRESET PIN [RAM name from V530, voted 3]" UWORD NO_COMPU_METHOD 0 0 0 65535 ECU_ADDRESS 0x3FEFBC FORMAT "%.4g" /end MEASUREMENT
/begin MEASUREMENT sys_rsr_gpor "Glitch detected on powern on reset [RAM name from V530, voted 3]" UWORD NO_COMPU_METHOD 0 0 0 65535 ECU_ADDRESS 0x3FEFBC FORMAT "%.4g" /end MEASUREMENT
/begin MEASUREMENT sys_rsr_gsrst "Glitch detected on SRESET PIN [RAM name from V530, voted 3]" UWORD NO_COMPU_METHOD 0 0 0 65535 ECU_ADDRESS 0x3FEFBC FORMAT "%.4g" /end MEASUREMENT
/begin MEASUREMENT sys_rsr_ilbc "Illegal bit change reset [RAM name from V530, voted 3]" UWORD NO_COMPU_METHOD 0 0 0 65535 ECU_ADDRESS 0x3FEFBC FORMAT "%.4g" /end MEASUREMENT
/begin MEASUREMENT sys_rsr_jtrs "Jtag reset [RAM name from V530, voted 3]" UWORD NO_COMPU_METHOD 0 0 0 65535 ECU_ADDRESS 0x3FEFBC FORMAT "%.4g" /end MEASUREMENT
/begin MEASUREMENT sys_rsr_llrs "Los of lock reset [RAM name from V530, voted 3]" UWORD NO_COMPU_METHOD 0 0 0 65535 ECU_ADDRESS 0x3FEFBC FORMAT "%.4g" /end MEASUREMENT
/begin MEASUREMENT sys_rsr_occs "On chip clock reset [RAM name from V530, voted 3]" UWORD NO_COMPU_METHOD 0 0 0 65535 ECU_ADDRESS 0x3FEFBC FORMAT "%.4g" /end MEASUREMENT
/begin MEASUREMENT sys_rsr_swrs "Software watchdog reset [RAM name from V530, voted 3]" UWORD NO_COMPU_METHOD 0 0 0 65535 ECU_ADDRESS 0x3FEFBC FORMAT "%.4g" /end MEASUREMENT
/begin MEASUREMENT sys_rsr_cnt_sum "Reset-Summenzaehler [RAM name from V530, voted 3]" UWORD M_FORMULA_0010 0 0 0 65535 ECU_ADDRESS 0x3FEFBE /end MEASUREMENT
/begin MEASUREMENT sys_zust_cpu_last "CPU Last [RAM name from V530, voted 1]" UWORD M_FORMULA_0001 0 0 0 6553.5 ECU_ADDRESS 0x3FEFC0 /end MEASUREMENT
/begin MEASUREMENT sys_zust_bgnd_cnt "Aufruf Bgnd Task pro 100ms [RAM name from V530, voted 6]" UWORD M_FORMULA_0010 0 0 0 65535 ECU_ADDRESS 0x3FEFC2 /end MEASUREMENT
/begin MEASUREMENT sys_zust_bgnd_net_min "Background Netto time min [RAM name from V530, voted 3]" UWORD M_FORMULA_0404 0 0 0 65.535 ECU_ADDRESS 0x3FEFC4 /end MEASUREMENT
/begin MEASUREMENT sys_exc_vec "Exception-Vector [RAM name from V530, voted 3]" UWORD NO_COMPU_METHOD 0 0 0 65535 ECU_ADDRESS 0x3FEFC6 FORMAT "%.4g" /end MEASUREMENT
/begin MEASUREMENT sys_exc_addr "Exception-Adresse [RAM name from V530, voted 2]" ULONG M_FORMULA_0000 0 0 0 4294967295 ECU_ADDRESS 0x3FEFC8 /end MEASUREMENT
/begin MEASUREMENT sys_sg_fehler "SG internere Fehlernummer [RAM name from V530, voted 18]" UBYTE NO_COMPU_METHOD 0 0 0 255 ECU_ADDRESS 0x3FEFCC FORMAT "%.4g" /end MEASUREMENT
/begin MEASUREMENT sys_reset_st "Resetursache [RAM name from V530, voted 5]" UBYTE NO_COMPU_METHOD 0 0 0 255 ECU_ADDRESS 0x3FEFCD FORMAT "%.4g" /end MEASUREMENT
/begin MEASUREMENT sys_exc_km_ni "Kilometerstand bei Exception [RAM name from V530, voted 2]" ULONG M_FORMULA_0027 0 0 0 4294967295 ECU_ADDRESS 0x3FEFD0 /end MEASUREMENT
/begin MEASUREMENT sys_exc_n_ni "Drehzahl bei Exception [RAM name from V530, voted 2]" SWORD M_FORMULA_0006 0 0 -32768 32767 ECU_ADDRESS 0x3FEFD4 /end MEASUREMENT
/begin MEASUREMENT sys_sync_init_t "Hochlauf Zeitmarken [RAM name from V530, voted 1]" UWORD M_FORMULA_0406 0 0 0 16711.425 ECU_ADDRESS 0x3FEFD6 /end MEASUREMENT
/begin MEASUREMENT vers_boot_index "Booterversionsindex [RAM name from V530, interpolated]" UWORD M_FORMULA_0010 0 0 0 65535 ECU_ADDRESS 0x3F8016 /end MEASUREMENT
/begin MEASUREMENT llr_state "LLR-Zustand [RAM name from V530, interpolated]" UBYTE NO_COMPU_METHOD 0 0 0 255 ECU_ADDRESS 0x3F8BC0 FORMAT "%.4g" /end MEASUREMENT
/begin MEASUREMENT pwg_kd_st "Kickdown-Status [RAM name from V530, interpolated]" UBYTE M_FORMULA_0003 0 0 0 255 ECU_ADDRESS 0x3F8BD0 /end MEASUREMENT
/begin MEASUREMENT pwg_kd_st_kickdown "Kickdown-Status [RAM name from V530, interpolated]" UBYTE NO_COMPU_METHOD 0 0 0 255 ECU_ADDRESS 0x3F8BD0 FORMAT "%.4g" /end MEASUREMENT
/begin MEASUREMENT md_kupp_wunsch_tz "Wunschmoment fuer den Zuendwinkelpfad [RAM name from V530, interpolated]" SWORD M_FORMULA_0009 0 0 -3276.8 3276.7 ECU_ADDRESS 0x3F8BE4 /end MEASUREMENT
/begin MEASUREMENT md_can_begr_st "MD-Begrenzungen [RAM name from V530, interpolated]" UBYTE NO_COMPU_METHOD 0 0 0 255 ECU_ADDRESS 0x3F8BEC FORMAT "%.4g" /end MEASUREMENT
/begin MEASUREMENT md_can_kkos_max "max. Moment fuer KKOS [RAM name from V530, interpolated]" SWORD M_FORMULA_0009 0 0 -3276.8 3276.7 ECU_ADDRESS 0x3F8BEE /end MEASUREMENT
/begin MEASUREMENT md_dsc_sperr_st "Sperre DSC-Eingriff [RAM name from V530, interpolated]" UBYTE NO_COMPU_METHOD 0 0 0 255 ECU_ADDRESS 0x3F8BED FORMAT "%.4g" /end MEASUREMENT
/begin MEASUREMENT md_nbegr_t "Zeit im Begrenzer [RAM name from V530, interpolated]" UWORD M_FORMULA_0109 0 0 0 327.675 ECU_ADDRESS 0x3F8BEA /end MEASUREMENT
/begin MEASUREMENT aq_rf_b2 "Fuellung aus inv. Ipol gefiltert mit alle korrekturen [RAM name from V530, interpolated]" SWORD M_FORMULA_0007 0 0 -3.2768 3.2767 ECU_ADDRESS 0x3F8C18 /end MEASUREMENT
/begin MEASUREMENT aq_rel "relative Oeffnungsquerschnitt [RAM name from V530, interpolated]" UWORD M_FORMULA_0106 0 0 0 399.9938965 ECU_ADDRESS 0x3F8C20 /end MEASUREMENT
/begin MEASUREMENT aq_rf_roh_b1 "Fuellung aus Inv. Ipol nicht gefiltert und rg korregiert [RAM name from V530, interpolated]" SWORD M_FORMULA_0007 0 0 -3.2768 3.2767 ECU_ADDRESS 0x3F8C24 /end MEASUREMENT
/begin MEASUREMENT aq_rf_roh_b2 "Fuellung aus Inv. Ipol nicht gefiltert und rg korregiert [RAM name from V530, interpolated]" SWORD M_FORMULA_0007 0 0 -3.2768 3.2767 ECU_ADDRESS 0x3F8C26 /end MEASUREMENT
/begin MEASUREMENT dr_rel_b1 "relative Drosselung [RAM name from V530, interpolated]" SWORD M_FORMULA_0106 0 0 -200 199.9938965 ECU_ADDRESS 0x3F8C1C /end MEASUREMENT
/begin MEASUREMENT dr_rel_b2 "relative Drosselung [RAM name from V530, interpolated]" SWORD M_FORMULA_0106 0 0 -200 199.9938965 ECU_ADDRESS 0x3F8C1E /end MEASUREMENT
/begin MEASUREMENT smg_can_n_getr_ein "Getriebeeingangsdrehzahl [RAM name from V530, interpolated]" SWORD M_FORMULA_0006 0 0 -32768 32767 ECU_ADDRESS 0x3F8C3A /end MEASUREMENT
/begin MEASUREMENT smg_can_prog_info "Programminfo [RAM name from V530, interpolated]" UBYTE M_FORMULA_0263 0 0 0 255 ECU_ADDRESS 0x3F8C3C /end MEASUREMENT
/begin MEASUREMENT egas_ist_wdk_b1 "Istwert (analog) [RAM name from V530, interpolated]" SWORD M_FORMULA_0001 0 0 -3276.8 3276.7 ECU_ADDRESS 0x3F8C3E /end MEASUREMENT
/begin MEASUREMENT egas_ist_wdk_b2 "Istwert (analog) [RAM name from V530, interpolated]" SWORD M_FORMULA_0001 0 0 -3276.8 3276.7 ECU_ADDRESS 0x3F8C40 /end MEASUREMENT
/begin MEASUREMENT egas_wdk_adapt_b2 "Adaptionsstatus [RAM name from V530, interpolated]" UBYTE NO_COMPU_METHOD 0 0 0 255 ECU_ADDRESS 0x3F8C43 FORMAT "%.4g" /end MEASUREMENT
/begin MEASUREMENT aq_eingeregelt_st "Status AQ eingeregelt [RAM name from V530, interpolated]" UBYTE M_FORMULA_0003 0 0 0 255 ECU_ADDRESS 0x3F8C46 /end MEASUREMENT
/begin MEASUREMENT egas_aq_soll_b1 "AQ-Soll mit Fuellungsadaption und sek. Einfluessen [RAM name from V530, interpolated]" UWORD M_FORMULA_0143 0 0 0 6553.5 ECU_ADDRESS 0x3F8C4C /end MEASUREMENT
/begin MEASUREMENT egas_aq_soll_b2 "AQ-Soll mit Fuellungsadaption und sek. Einfluessen [RAM name from V530, interpolated]" UWORD M_FORMULA_0143 0 0 0 6553.5 ECU_ADDRESS 0x3F8C4E /end MEASUREMENT
/begin MEASUREMENT egas_aq_soll_grad_b2 "Gradient AQ-Soll [RAM name from V530, interpolated]" SWORD M_FORMULA_0020 0 0 -655360 655340 ECU_ADDRESS 0x3F8C4A /end MEASUREMENT
/begin MEASUREMENT md_rad_schlepp_ist "min. Radschleppmoment [RAM name from V530, interpolated]" SLONG M_FORMULA_0272 0 0 -214748364.8 214748364.7 ECU_ADDRESS 0x3F8C54 /end MEASUREMENT
/begin MEASUREMENT md_ind_ml_st "Status Sollmoment-Luft [RAM name from V530, interpolated]" UBYTE NO_COMPU_METHOD 0 0 0 255 ECU_ADDRESS 0x3F8C66 FORMAT "%.4g" /end MEASUREMENT
/begin MEASUREMENT md_ind_tz_st "Status Sollmoment-TZ [RAM name from V530, interpolated]" UBYTE NO_COMPU_METHOD 0 0 0 255 ECU_ADDRESS 0x3F8C65 FORMAT "%.4g" /end MEASUREMENT
/begin MEASUREMENT at_sa_sperre "Anti-Trampeln Schubabschaltungssperre [RAM name from V530, interpolated]" UBYTE NO_COMPU_METHOD 0 0 0 255 ECU_ADDRESS 0x3F8C6C FORMAT "%.4g" /end MEASUREMENT
/begin MEASUREMENT n_getr_abtrieb "Getriebeabtriebsdrehzahl [RAM name from V530, interpolated]" SWORD M_FORMULA_0006 0 0 -32768 32767 ECU_ADDRESS 0x3F8C70 /end MEASUREMENT
/begin MEASUREMENT smg_n_getr_anschluss "gerechnete Ziel-Drehzahl am Getriebeeingang im naechsten Gang [RAM name from V530, interpolated]" SWORD M_FORMULA_0006 0 0 -32768 32767 ECU_ADDRESS 0x3F8CC0 /end MEASUREMENT
/begin MEASUREMENT smg_schaltart "Schaltart [RAM name from V530, interpolated]" UWORD M_FORMULA_0010 0 0 0 65535 ECU_ADDRESS 0x3F8CBE /end MEASUREMENT
/begin MEASUREMENT smg_schaltart_aks "Schaltart (AKS) [RAM name from V530, interpolated]" UWORD NO_COMPU_METHOD 0 0 0 65535 ECU_ADDRESS 0x3F8CBE FORMAT "%.4g" /end MEASUREMENT
/begin MEASUREMENT smg_schaltart_automat "Schaltart (Automat) [RAM name from V530, interpolated]" UWORD NO_COMPU_METHOD 0 0 0 65535 ECU_ADDRESS 0x3F8CBE FORMAT "%.4g" /end MEASUREMENT
/begin MEASUREMENT smg_schaltart_eingr "Schaltart (Eingriff) [RAM name from V530, interpolated]" UWORD NO_COMPU_METHOD 0 0 0 65535 ECU_ADDRESS 0x3F8CBE FORMAT "%.4g" /end MEASUREMENT
/begin MEASUREMENT smg_schaltart_hr "Schaltart (Zug-Schub-Hoch) [RAM name from V530, interpolated]" UWORD NO_COMPU_METHOD 0 0 0 65535 ECU_ADDRESS 0x3F8CBE FORMAT "%.4g" /end MEASUREMENT
/begin MEASUREMENT smg_schaltart_lw "Schaltart (Lastwechsel) [RAM name from V530, interpolated]" UWORD NO_COMPU_METHOD 0 0 0 65535 ECU_ADDRESS 0x3F8CBE FORMAT "%.4g" /end MEASUREMENT
/begin MEASUREMENT smg_schaltart_rs "Schaltart (Rennstart) [RAM name from V530, interpolated]" UWORD NO_COMPU_METHOD 0 0 0 65535 ECU_ADDRESS 0x3F8CBE FORMAT "%.4g" /end MEASUREMENT
/begin MEASUREMENT smg_schaltart_zs "Schaltart (Zug-Schub-Hoch) [RAM name from V530, interpolated]" UWORD NO_COMPU_METHOD 0 0 0 65535 ECU_ADDRESS 0x3F8CBE FORMAT "%.4g" /end MEASUREMENT
/begin MEASUREMENT smg_st_dme "DME-Status [RAM name from V530, interpolated]" UBYTE NO_COMPU_METHOD 0 0 0 255 ECU_ADDRESS 0x3F8CBC FORMAT "%.4g" /end MEASUREMENT
/begin MEASUREMENT smg_t_abregel "Abregelzeit [RAM name from V530, interpolated]" UBYTE M_FORMULA_0306 0 0 0 2.55 ECU_ADDRESS 0x3F8CC2 /end MEASUREMENT
/begin MEASUREMENT smg_sk_mode "SK-Mode SMG [RAM name from V530, interpolated]" UBYTE NO_COMPU_METHOD 0 0 0 255 ECU_ADDRESS 0x3F8CC4 FORMAT "%.4g" /end MEASUREMENT
/begin MEASUREMENT gang_berech "berechneter Gang inkl. R und N [RAM name from V530, interpolated]" SBYTE M_FORMULA_0135 0 0 -128 127 ECU_ADDRESS 0x3F8CC8 /end MEASUREMENT
/begin MEASUREMENT gang_can "Gang CAN Botschaftswert fuer Kombi [RAM name from V530, interpolated]" SBYTE M_FORMULA_0135 0 0 -128 127 ECU_ADDRESS 0x3F8CD2 /end MEASUREMENT
/begin MEASUREMENT sk_egas_off_ign "SK-Egasstufe [RAM name from V530, interpolated]" UBYTE NO_COMPU_METHOD 0 0 0 255 ECU_ADDRESS 0x3F8CD4 FORMAT "%.4g" /end MEASUREMENT
/begin MEASUREMENT fgr_anzeige_kombi "FGR Anzeige im Kombi ein-/ausschalten [RAM name from V530, interpolated]" UBYTE NO_COMPU_METHOD 0 0 0 255 ECU_ADDRESS 0x3F8CDD FORMAT "%.4g" /end MEASUREMENT
/begin MEASUREMENT tabg_vkat_b2 "Abgastemperatur vorm Kat [RAM name from V530, interpolated]" SWORD M_FORMULA_0023 0 0 -3550 3003.5 ECU_ADDRESS 0x3F8D1C /end MEASUREMENT
/begin MEASUREMENT tabg_kat_b1 "Abgastemperatur im Kat [RAM name from V530, interpolated]" SWORD M_FORMULA_0023 0 0 -3550 3003.5 ECU_ADDRESS 0x3F8D22 /end MEASUREMENT
/begin MEASUREMENT tabg_kat_b2 "Abgastemperatur im Kat [RAM name from V530, interpolated]" SWORD M_FORMULA_0023 0 0 -3550 3003.5 ECU_ADDRESS 0x3F8D24 /end MEASUREMENT
/begin MEASUREMENT tsgrw_b1 "Saugrohrwandtemperatur [RAM name from V530, interpolated]" SWORD M_FORMULA_0023 0 0 -3550 3003.5 ECU_ADDRESS 0x3F8D4A /end MEASUREMENT
/begin MEASUREMENT tsgrw_b2 "Saugrohrwandtemperatur [RAM name from V530, interpolated]" SWORD M_FORMULA_0023 0 0 -3550 3003.5 ECU_ADDRESS 0x3F8D4C /end MEASUREMENT
/begin MEASUREMENT hdw_ign "hdw_ign [RAM name from V530, interpolated]" ULONG M_FORMULA_0000 0 0 0 4294967295 ECU_ADDRESS 0x3F8D54 /end MEASUREMENT
/begin MEASUREMENT hdw_ign_st "hdw_ign_st [RAM name from V530, interpolated]" UBYTE M_FORMULA_0003 0 0 0 255 ECU_ADDRESS 0x3F8D52 /end MEASUREMENT
/begin MEASUREMENT tabg_nkat_modell_b1 "Abgastemperaturmodell nach dem Kat [RAM name from V530, interpolated]" SWORD M_FORMULA_0023 0 0 -3550 3003.5 ECU_ADDRESS 0x3F8D58 /end MEASUREMENT
/begin MEASUREMENT tabg_nkat_modell_b2 "Abgastemperaturmodell nach dem Kat [RAM name from V530, interpolated]" SWORD M_FORMULA_0023 0 0 -3550 3003.5 ECU_ADDRESS 0x3F8D5A /end MEASUREMENT
/begin MEASUREMENT md_rf_soll_pt_roh "Soll-rf mit pt-Korr [RAM name from V530, interpolated]" SWORD M_FORMULA_0007 0 0 -3.2768 3.2767 ECU_ADDRESS 0x3F8D82 /end MEASUREMENT
/begin MEASUREMENT kwp_fp_st_ign "Status KWP-FP [RAM name from V530, interpolated]" UBYTE M_FORMULA_0003 0 0 0 255 ECU_ADDRESS 0x3F8D87 /end MEASUREMENT
/begin MEASUREMENT lam_ist_ers_b2 "LAM-IST - Ersatz [RAM name from V530, interpolated]" UWORD M_FORMULA_0025 0 0 0 3.999938965 ECU_ADDRESS 0x3F8E46 /end MEASUREMENT
/begin MEASUREMENT lam_soll_ms_kat_b2 "gespeicherte Sauerstoffmasse im KAT [RAM name from V530, interpolated]" SWORD M_FORMULA_0090 0 0 -3276.8 3276.7 ECU_ADDRESS 0x3F8E4C /end MEASUREMENT
/begin MEASUREMENT van_ist_A1 "Istposition [RAM name from V530, interpolated]" SWORD M_FORMULA_0102 0 0 -3276.8 3276.7 ECU_ADDRESS 0x3F8E60 /end MEASUREMENT
/begin MEASUREMENT van_ist_A2 "Istposition [RAM name from V530, interpolated]" SWORD M_FORMULA_0102 0 0 -3276.8 3276.7 ECU_ADDRESS 0x3F8E64 /end MEASUREMENT
/begin MEASUREMENT van_ist_E2 "Istposition [RAM name from V530, interpolated]" SWORD M_FORMULA_0102 0 0 -3276.8 3276.7 ECU_ADDRESS 0x3F8E62 /end MEASUREMENT
/begin MEASUREMENT rps_auss_st "Status Aussetzer-RPS [RAM name from V530, interpolated]" UWORD M_FORMULA_0010 0 0 0 65535 ECU_ADDRESS 0x3F8E7E /end MEASUREMENT
/begin MEASUREMENT sa_aktive_time "SA aktive Zeit [RAM name from V530, interpolated]" UWORD M_FORMULA_0109 0 0 0 327.675 ECU_ADDRESS 0x3F8EFA /end MEASUREMENT
/begin MEASUREMENT can_st_torqdsc "Empfangsstatus TorqDSC [RAM name from V530, interpolated]" UWORD NO_COMPU_METHOD 0 0 0 65535 ECU_ADDRESS 0x3F8F22 FORMAT "%.4g" /end MEASUREMENT
/begin MEASUREMENT can_dkg_eingr "DKG-Eingriff [RAM name from V530, interpolated]" UBYTE NO_COMPU_METHOD 0 0 0 255 ECU_ADDRESS 0x3F8F5F FORMAT "%.4g" /end MEASUREMENT
/begin MEASUREMENT can_dkg_istgang "DKG-Istgang [RAM name from V530, interpolated]" SBYTE M_FORMULA_0135 0 0 -128 127 ECU_ADDRESS 0x3F8F5E /end MEASUREMENT
/begin MEASUREMENT can_dkg_md_soll "DKG-Sollmoment [RAM name from V530, interpolated]" SWORD M_FORMULA_0120 0 0 -16384 16383.5 ECU_ADDRESS 0x3F8F62 /end MEASUREMENT
/begin MEASUREMENT can_dkg_md_soll_pos "DKG-Sollmoment positiv [RAM name from V530, interpolated]" SWORD M_FORMULA_0120 0 0 -16384 16383.5 ECU_ADDRESS 0x3F8F60 /end MEASUREMENT
/begin MEASUREMENT can_no_key "Schluesselnummer [RAM name from V530, interpolated]" UBYTE M_FORMULA_0003 0 0 0 255 ECU_ADDRESS 0x3F8F5D /end MEASUREMENT
/begin MEASUREMENT mvac_aq_bre "AQ-Offset LL-Steller Bank 2 [RAM name from V530, interpolated]" UWORD M_FORMULA_0143 0 0 0 6553.5 ECU_ADDRESS 0x3F8F80 /end MEASUREMENT
/begin MEASUREMENT sl_zwd_tv "Tastverh. LLS fuer SL [RAM name from V530, interpolated]" SWORD M_FORMULA_0142 0 0 -1965.686863 1965.626875 ECU_ADDRESS 0x3F8F7E /end MEASUREMENT
/begin MEASUREMENT mvac_rf_sr_b_b2 "Fuellung MVAC bankspezifisch [RAM name from V530, interpolated]" SWORD M_FORMULA_0007 0 0 -3.2768 3.2767 ECU_ADDRESS 0x3F8F88 /end MEASUREMENT
/begin MEASUREMENT rf_fil_b2 "PT1 gefiltertes rf. [RAM name from V530, interpolated]" SWORD M_FORMULA_0007 0 0 -3.2768 3.2767 ECU_ADDRESS 0x3F9082 /end MEASUREMENT
/begin MEASUREMENT rf_grad_b2 "Rf Gradient. [RAM name from V530, interpolated]" SWORD M_FORMULA_0187 0 0 -327.68 327.67 ECU_ADDRESS 0x3F9086 /end MEASUREMENT
/begin MEASUREMENT slv_st "SLV Status [RAM name from V530, interpolated]" UBYTE NO_COMPU_METHOD 0 0 0 255 ECU_ADDRESS 0x3F90A6 FORMAT "%.4g" /end MEASUREMENT
/begin MEASUREMENT pksr_exd_md_fw_st "100Proz FW-Anforderungsstatus von PKSR [RAM name from V530, interpolated]" UWORD M_FORMULA_0010 0 0 0 65535 ECU_ADDRESS 0x3F90CC /end MEASUREMENT
/begin MEASUREMENT sk_tr_req "Angefragte Testrechnung vom INJ [RAM name from V530, interpolated]" UBYTE M_FORMULA_0003 0 0 0 255 ECU_ADDRESS 0x3F90CE /end MEASUREMENT
/begin MEASUREMENT ti_zyl_tz "Zylinder selektive Abschaltung von TI und TZ [RAM name from V530, interpolated]" UWORD M_FORMULA_0080 0 0 0 65535 ECU_ADDRESS 0x3F90FA /end MEASUREMENT
/begin MEASUREMENT v_max_anh_st "Status v_max-Anhebung durch CAS bzw. BMW-Nachruestung [RAM name from V530, interpolated]" UBYTE NO_COMPU_METHOD 0 0 0 255 ECU_ADDRESS 0x3F910E FORMAT "%.4g" /end MEASUREMENT
/begin MEASUREMENT v_max_ff_v_max_st "Status Maximalgeschwindigkeit [RAM name from V530, interpolated]" UBYTE M_FORMULA_0003 0 0 0 255 ECU_ADDRESS 0x3F9CC3 /end MEASUREMENT
/begin MEASUREMENT n_max_ff_n_getriebe "Getriebeeingangsdrehzahl [RAM name from V530, interpolated]" SWORD M_FORMULA_0006 0 0 -32768 32767 ECU_ADDRESS 0x3F9CCC /end MEASUREMENT
/begin MEASUREMENT n_max_ff_n_grad "Gradient [RAM name from V530, interpolated]" SWORD M_FORMULA_0105 0 0 -32768 32767 ECU_ADDRESS 0x3F9CC8 /end MEASUREMENT
/begin MEASUREMENT n_max_ff_n_vanos "Referenzdrehzahl aus Vanos [RAM name from V530, interpolated]" SWORD M_FORMULA_0006 0 0 -32768 32767 ECU_ADDRESS 0x3F9CCA /end MEASUREMENT
/begin MEASUREMENT n_max_ff_nbegr_egas "Begrenzerdrehzahl fuer Md-Eingrif [RAM name from V530, interpolated]" SWORD M_FORMULA_0006 0 0 -32768 32767 ECU_ADDRESS 0x3F9CCE /end MEASUREMENT
/begin MEASUREMENT n_max_ff_nbegr_ti "Begrenzerdrehzahl fuer Ti-Eingrif [RAM name from V530, interpolated]" SWORD M_FORMULA_0006 0 0 -32768 32767 ECU_ADDRESS 0x3F9CD0 /end MEASUREMENT
/begin MEASUREMENT n_max_ff_tsum_egas "Summenzeit oberhalb nbegr_egas [RAM name from V530, interpolated]" UWORD M_FORMULA_0021 0 0 0 655.35 ECU_ADDRESS 0x3F9CD2 /end MEASUREMENT
/begin MEASUREMENT n_max_ff_tsum_ti "Summenzeit oberhalb nbegr_ti [RAM name from V530, interpolated]" UWORD M_FORMULA_0021 0 0 0 655.35 ECU_ADDRESS 0x3F9CD4 /end MEASUREMENT
/begin MEASUREMENT n_max_ff_km_stand "Kilometerstand [RAM name from V530, interpolated]" ULONG M_FORMULA_0027 0 0 0 4294967295 ECU_ADDRESS 0x3F9CDC /end MEASUREMENT
/begin MEASUREMENT n_max_ff_md_fahrer "Fahrerwunschmoment [RAM name from V530, interpolated]" SWORD M_FORMULA_0009 0 0 -3276.8 3276.7 ECU_ADDRESS 0x3F9CE2 /end MEASUREMENT
/begin MEASUREMENT n_max_ff_md_ist "Kupplungs-Istmoment [RAM name from V530, interpolated]" SWORD M_FORMULA_0009 0 0 -3276.8 3276.7 ECU_ADDRESS 0x3F9CE6 /end MEASUREMENT
/begin MEASUREMENT n_max_ff_md_wunsch "resultierendes Kupplungs-Wunschmoment [RAM name from V530, interpolated]" SWORD M_FORMULA_0009 0 0 -3276.8 3276.7 ECU_ADDRESS 0x3F9CE4 /end MEASUREMENT
/begin MEASUREMENT n_max_ff_ml "Luftmasse [RAM name from V530, interpolated]" SWORD M_FORMULA_0103 0 0 -3276.8 3276.7 ECU_ADDRESS 0x3F9CE0 /end MEASUREMENT
/begin MEASUREMENT n_max_ff_pwg "Fahrpedalstellung [RAM name from V530, interpolated]" SWORD M_FORMULA_0001 0 0 -3276.8 3276.7 ECU_ADDRESS 0x3F9CDA /end MEASUREMENT
/begin MEASUREMENT n_max_ff_schalter_inj "Schalterstatus Inj [RAM name from V530, interpolated]" UWORD M_FORMULA_0010 0 0 0 65535 ECU_ADDRESS 0x3F9CEC /end MEASUREMENT
/begin MEASUREMENT n_max_ff_tmot "Kuehlwassertemperatur [RAM name from V530, interpolated]" SWORD M_FORMULA_0023 0 0 -3550 3003.5 ECU_ADDRESS 0x3F9CE8 /end MEASUREMENT
/begin MEASUREMENT n_max_ff_toel "Oeltemperatur [RAM name from V530, interpolated]" SWORD M_FORMULA_0023 0 0 -3550 3003.5 ECU_ADDRESS 0x3F9CEA /end MEASUREMENT
/begin MEASUREMENT n_max_ff_v_hinten "mittlere Geschwindigkeit hinten [RAM name from V530, interpolated]" SWORD M_FORMULA_0076 0 0 -2048 2047.9375 ECU_ADDRESS 0x3F9CD8 /end MEASUREMENT
/begin MEASUREMENT n_max_ff_zustand_motor "Betriebszustand [RAM name from V530, interpolated]" UWORD NO_COMPU_METHOD 0 0 0 65535 ECU_ADDRESS 0x3F9CEE FORMAT "%.4g" /end MEASUREMENT
/begin MEASUREMENT n_max_ff_smg_st "DME-Status [RAM name from V530, interpolated]" UBYTE NO_COMPU_METHOD 0 0 0 255 ECU_ADDRESS 0x3F9CF1 FORMAT "%.4g" /end MEASUREMENT
/begin MEASUREMENT stat_data_toel_nv "toel-Statistik ueber Motorlaufzeit [RAM name from V530, interpolated]" ULONG M_FORMULA_0542 0 0 0 4294967295 ECU_ADDRESS 0x3F9D34 /end MEASUREMENT
/begin MEASUREMENT mdrv_st_dsc_key1 "MDRV-Status DSC (CAN) [RAM name from V530, interpolated]" UBYTE NO_COMPU_METHOD 0 0 0 255 ECU_ADDRESS 0x3F9D55 FORMAT "%.4g" /end MEASUREMENT
/begin MEASUREMENT mdrv_st_dsc_key2 "MDRV-Status DSC (CAN) [RAM name from V530, interpolated]" UBYTE NO_COMPU_METHOD 0 0 0 255 ECU_ADDRESS 0x3F9D56 FORMAT "%.4g" /end MEASUREMENT
/begin MEASUREMENT mdrv_st_dsc_key4 "MDRV-Status DSC (CAN) [RAM name from V530, interpolated]" UBYTE NO_COMPU_METHOD 0 0 0 255 ECU_ADDRESS 0x3F9D58 FORMAT "%.4g" /end MEASUREMENT
/begin MEASUREMENT mdrv_st_dsc_key5 "MDRV-Status DSC (CAN) [RAM name from V530, interpolated]" UBYTE NO_COMPU_METHOD 0 0 0 255 ECU_ADDRESS 0x3F9D59 FORMAT "%.4g" /end MEASUREMENT
/begin MEASUREMENT mdrv_st_dsc_key6 "MDRV-Status DSC (CAN) [RAM name from V530, interpolated]" UBYTE NO_COMPU_METHOD 0 0 0 255 ECU_ADDRESS 0x3F9D5A FORMAT "%.4g" /end MEASUREMENT
/begin MEASUREMENT mdrv_st_dsc_key7 "MDRV-Status DSC (CAN) [RAM name from V530, interpolated]" UBYTE NO_COMPU_METHOD 0 0 0 255 ECU_ADDRESS 0x3F9D5B FORMAT "%.4g" /end MEASUREMENT
/begin MEASUREMENT mdrv_st_dsc_key8 "MDRV-Status DSC (CAN) [RAM name from V530, interpolated]" UBYTE NO_COMPU_METHOD 0 0 0 255 ECU_ADDRESS 0x3F9D5C FORMAT "%.4g" /end MEASUREMENT
/begin MEASUREMENT mdrv_st_dsc_key9 "MDRV-Status DSC (CAN) [RAM name from V530, interpolated]" UBYTE NO_COMPU_METHOD 0 0 0 255 ECU_ADDRESS 0x3F9D5D FORMAT "%.4g" /end MEASUREMENT
/begin MEASUREMENT mdrv_st_mod_smg_key1 "MDRV-Status SMG (CAN) [RAM name from V530, interpolated]" UBYTE NO_COMPU_METHOD 0 0 0 255 ECU_ADDRESS 0x3F9D5F FORMAT "%.4g" /end MEASUREMENT
/begin MEASUREMENT mdrv_st_mod_smg_key2 "MDRV-Status SMG (CAN) [RAM name from V530, interpolated]" UBYTE NO_COMPU_METHOD 0 0 0 255 ECU_ADDRESS 0x3F9D60 FORMAT "%.4g" /end MEASUREMENT
/begin MEASUREMENT mdrv_st_mod_smg_key3 "MDRV-Status SMG (CAN) [RAM name from V530, interpolated]" UBYTE NO_COMPU_METHOD 0 0 0 255 ECU_ADDRESS 0x3F9D61 FORMAT "%.4g" /end MEASUREMENT
/begin MEASUREMENT mdrv_st_mod_smg_key4 "MDRV-Status SMG (CAN) [RAM name from V530, interpolated]" UBYTE NO_COMPU_METHOD 0 0 0 255 ECU_ADDRESS 0x3F9D62 FORMAT "%.4g" /end MEASUREMENT
/begin MEASUREMENT mdrv_st_mod_smg_key5 "MDRV-Status SMG (CAN) [RAM name from V530, interpolated]" UBYTE NO_COMPU_METHOD 0 0 0 255 ECU_ADDRESS 0x3F9D63 FORMAT "%.4g" /end MEASUREMENT
/begin MEASUREMENT mdrv_st_mod_smg_key6 "MDRV-Status SMG (CAN) [RAM name from V530, interpolated]" UBYTE NO_COMPU_METHOD 0 0 0 255 ECU_ADDRESS 0x3F9D64 FORMAT "%.4g" /end MEASUREMENT
/begin MEASUREMENT mdrv_st_mod_smg_key7 "MDRV-Status SMG (CAN) [RAM name from V530, interpolated]" UBYTE NO_COMPU_METHOD 0 0 0 255 ECU_ADDRESS 0x3F9D65 FORMAT "%.4g" /end MEASUREMENT
/begin MEASUREMENT mdrv_st_mod_smg_key8 "MDRV-Status SMG (CAN) [RAM name from V530, interpolated]" UBYTE NO_COMPU_METHOD 0 0 0 255 ECU_ADDRESS 0x3F9D66 FORMAT "%.4g" /end MEASUREMENT
/begin MEASUREMENT mdrv_st_mod_smg_key9 "MDRV-Status SMG (CAN) [RAM name from V530, interpolated]" UBYTE NO_COMPU_METHOD 0 0 0 255 ECU_ADDRESS 0x3F9D67 FORMAT "%.4g" /end MEASUREMENT
/begin MEASUREMENT mdrv_st_stg_smg_key1 "MDRV-Status Drivelogic (CAN) [RAM name from V530, interpolated]" UBYTE NO_COMPU_METHOD 0 0 0 255 ECU_ADDRESS 0x3F9D69 FORMAT "%.4g" /end MEASUREMENT
/begin MEASUREMENT mdrv_st_stg_smg_key2 "MDRV-Status Drivelogic (CAN) [RAM name from V530, interpolated]" UBYTE NO_COMPU_METHOD 0 0 0 255 ECU_ADDRESS 0x3F9D6A FORMAT "%.4g" /end MEASUREMENT
/begin MEASUREMENT mdrv_st_stg_smg_key3 "MDRV-Status Drivelogic (CAN) [RAM name from V530, interpolated]" UBYTE NO_COMPU_METHOD 0 0 0 255 ECU_ADDRESS 0x3F9D6B FORMAT "%.4g" /end MEASUREMENT
/begin MEASUREMENT mdrv_st_stg_smg_key4 "MDRV-Status Drivelogic (CAN) [RAM name from V530, interpolated]" UBYTE NO_COMPU_METHOD 0 0 0 255 ECU_ADDRESS 0x3F9D6C FORMAT "%.4g" /end MEASUREMENT
/begin MEASUREMENT mdrv_st_stg_smg_key5 "MDRV-Status Drivelogic (CAN) [RAM name from V530, interpolated]" UBYTE NO_COMPU_METHOD 0 0 0 255 ECU_ADDRESS 0x3F9D6D FORMAT "%.4g" /end MEASUREMENT
/begin MEASUREMENT mdrv_st_stg_smg_key6 "MDRV-Status Drivelogic (CAN) [RAM name from V530, interpolated]" UBYTE NO_COMPU_METHOD 0 0 0 255 ECU_ADDRESS 0x3F9D6E FORMAT "%.4g" /end MEASUREMENT
/begin MEASUREMENT mdrv_st_stg_smg_key7 "MDRV-Status Drivelogic (CAN) [RAM name from V530, interpolated]" UBYTE NO_COMPU_METHOD 0 0 0 255 ECU_ADDRESS 0x3F9D6F FORMAT "%.4g" /end MEASUREMENT
/begin MEASUREMENT mdrv_st_stg_smg_key8 "MDRV-Status Drivelogic (CAN) [RAM name from V530, interpolated]" UBYTE NO_COMPU_METHOD 0 0 0 255 ECU_ADDRESS 0x3F9D70 FORMAT "%.4g" /end MEASUREMENT
/begin MEASUREMENT mdrv_st_stg_smg_key9 "MDRV-Status Drivelogic (CAN) [RAM name from V530, interpolated]" UBYTE NO_COMPU_METHOD 0 0 0 255 ECU_ADDRESS 0x3F9D71 FORMAT "%.4g" /end MEASUREMENT
/begin MEASUREMENT mdrv_st_mod_eng_key1 "MDRV-Status Motor (CAN) [RAM name from V530, interpolated]" UBYTE NO_COMPU_METHOD 0 0 0 255 ECU_ADDRESS 0x3F9D73 FORMAT "%.4g" /end MEASUREMENT
/begin MEASUREMENT mdrv_st_mod_eng_key2 "MDRV-Status Motor (CAN) [RAM name from V530, interpolated]" UBYTE NO_COMPU_METHOD 0 0 0 255 ECU_ADDRESS 0x3F9D74 FORMAT "%.4g" /end MEASUREMENT
/begin MEASUREMENT mdrv_st_mod_eng_key3 "MDRV-Status Motor (CAN) [RAM name from V530, interpolated]" UBYTE NO_COMPU_METHOD 0 0 0 255 ECU_ADDRESS 0x3F9D75 FORMAT "%.4g" /end MEASUREMENT
/begin MEASUREMENT mdrv_st_mod_eng_key4 "MDRV-Status Motor (CAN) [RAM name from V530, interpolated]" UBYTE NO_COMPU_METHOD 0 0 0 255 ECU_ADDRESS 0x3F9D76 FORMAT "%.4g" /end MEASUREMENT
/begin MEASUREMENT mdrv_st_mod_eng_key5 "MDRV-Status Motor (CAN) [RAM name from V530, interpolated]" UBYTE NO_COMPU_METHOD 0 0 0 255 ECU_ADDRESS 0x3F9D77 FORMAT "%.4g" /end MEASUREMENT
/begin MEASUREMENT mdrv_st_mod_eng_key6 "MDRV-Status Motor (CAN) [RAM name from V530, interpolated]" UBYTE NO_COMPU_METHOD 0 0 0 255 ECU_ADDRESS 0x3F9D78 FORMAT "%.4g" /end MEASUREMENT
/begin MEASUREMENT mdrv_st_mod_eng_key7 "MDRV-Status Motor (CAN) [RAM name from V530, interpolated]" UBYTE NO_COMPU_METHOD 0 0 0 255 ECU_ADDRESS 0x3F9D79 FORMAT "%.4g" /end MEASUREMENT
/begin MEASUREMENT mdrv_st_mod_eng_key8 "MDRV-Status Motor (CAN) [RAM name from V530, interpolated]" UBYTE NO_COMPU_METHOD 0 0 0 255 ECU_ADDRESS 0x3F9D7A FORMAT "%.4g" /end MEASUREMENT
/begin MEASUREMENT mdrv_st_mod_eng_key9 "MDRV-Status Motor (CAN) [RAM name from V530, interpolated]" UBYTE NO_COMPU_METHOD 0 0 0 255 ECU_ADDRESS 0x3F9D7B FORMAT "%.4g" /end MEASUREMENT
/begin MEASUREMENT mdrv_st_mod_edck_key1 "MDRV-Status EDCK (CAN) [RAM name from V530, interpolated]" UBYTE NO_COMPU_METHOD 0 0 0 255 ECU_ADDRESS 0x3F9D7D FORMAT "%.4g" /end MEASUREMENT
/begin MEASUREMENT mdrv_st_mod_edck_key2 "MDRV-Status EDCK (CAN) [RAM name from V530, interpolated]" UBYTE NO_COMPU_METHOD 0 0 0 255 ECU_ADDRESS 0x3F9D7E FORMAT "%.4g" /end MEASUREMENT
/begin MEASUREMENT mdrv_st_mod_edck_key3 "MDRV-Status EDCK (CAN) [RAM name from V530, interpolated]" UBYTE NO_COMPU_METHOD 0 0 0 255 ECU_ADDRESS 0x3F9D7F FORMAT "%.4g" /end MEASUREMENT
/begin MEASUREMENT mdrv_st_mod_edck_key4 "MDRV-Status EDCK (CAN) [RAM name from V530, interpolated]" UBYTE NO_COMPU_METHOD 0 0 0 255 ECU_ADDRESS 0x3F9D80 FORMAT "%.4g" /end MEASUREMENT
/begin MEASUREMENT mdrv_st_mod_edck_key5 "MDRV-Status EDCK (CAN) [RAM name from V530, interpolated]" UBYTE NO_COMPU_METHOD 0 0 0 255 ECU_ADDRESS 0x3F9D81 FORMAT "%.4g" /end MEASUREMENT
/begin MEASUREMENT mdrv_st_mod_edck_key6 "MDRV-Status EDCK (CAN) [RAM name from V530, interpolated]" UBYTE NO_COMPU_METHOD 0 0 0 255 ECU_ADDRESS 0x3F9D82 FORMAT "%.4g" /end MEASUREMENT
/begin MEASUREMENT mdrv_st_mod_edck_key7 "MDRV-Status EDCK (CAN) [RAM name from V530, interpolated]" UBYTE NO_COMPU_METHOD 0 0 0 255 ECU_ADDRESS 0x3F9D83 FORMAT "%.4g" /end MEASUREMENT
/begin MEASUREMENT mdrv_st_mod_edck_key8 "MDRV-Status EDCK (CAN) [RAM name from V530, interpolated]" UBYTE NO_COMPU_METHOD 0 0 0 255 ECU_ADDRESS 0x3F9D84 FORMAT "%.4g" /end MEASUREMENT
/begin MEASUREMENT mdrv_st_mod_edck_key9 "MDRV-Status EDCK (CAN) [RAM name from V530, interpolated]" UBYTE NO_COMPU_METHOD 0 0 0 255 ECU_ADDRESS 0x3F9D85 FORMAT "%.4g" /end MEASUREMENT
/begin MEASUREMENT mdrv_st_mod_albv_key1 "MDRV-Status aLBV (CAN) [RAM name from V530, interpolated]" UBYTE NO_COMPU_METHOD 0 0 0 255 ECU_ADDRESS 0x3F9D87 FORMAT "%.4g" /end MEASUREMENT
/begin MEASUREMENT mdrv_st_mod_albv_key2 "MDRV-Status aLBV (CAN) [RAM name from V530, interpolated]" UBYTE NO_COMPU_METHOD 0 0 0 255 ECU_ADDRESS 0x3F9D88 FORMAT "%.4g" /end MEASUREMENT
/begin MEASUREMENT mdrv_st_mod_albv_key3 "MDRV-Status aLBV (CAN) [RAM name from V530, interpolated]" UBYTE NO_COMPU_METHOD 0 0 0 255 ECU_ADDRESS 0x3F9D89 FORMAT "%.4g" /end MEASUREMENT
/begin MEASUREMENT mdrv_st_mod_albv_key4 "MDRV-Status aLBV (CAN) [RAM name from V530, interpolated]" UBYTE NO_COMPU_METHOD 0 0 0 255 ECU_ADDRESS 0x3F9D8A FORMAT "%.4g" /end MEASUREMENT
/begin MEASUREMENT mdrv_st_mod_albv_key5 "MDRV-Status aLBV (CAN) [RAM name from V530, interpolated]" UBYTE NO_COMPU_METHOD 0 0 0 255 ECU_ADDRESS 0x3F9D8B FORMAT "%.4g" /end MEASUREMENT
/begin MEASUREMENT mdrv_st_mod_albv_key6 "MDRV-Status aLBV (CAN) [RAM name from V530, interpolated]" UBYTE NO_COMPU_METHOD 0 0 0 255 ECU_ADDRESS 0x3F9D8C FORMAT "%.4g" /end MEASUREMENT
/begin MEASUREMENT mdrv_st_mod_albv_key7 "MDRV-Status aLBV (CAN) [RAM name from V530, interpolated]" UBYTE NO_COMPU_METHOD 0 0 0 255 ECU_ADDRESS 0x3F9D8D FORMAT "%.4g" /end MEASUREMENT
/begin MEASUREMENT mdrv_st_mod_albv_key8 "MDRV-Status aLBV (CAN) [RAM name from V530, interpolated]" UBYTE NO_COMPU_METHOD 0 0 0 255 ECU_ADDRESS 0x3F9D8E FORMAT "%.4g" /end MEASUREMENT
/begin MEASUREMENT mdrv_st_mod_albv_key9 "MDRV-Status aLBV (CAN) [RAM name from V530, interpolated]" UBYTE NO_COMPU_METHOD 0 0 0 255 ECU_ADDRESS 0x3F9D8F FORMAT "%.4g" /end MEASUREMENT
/begin MEASUREMENT mdrv_st_mod_hud_key1 "MDRV-Status HUD (CAN) [RAM name from V530, interpolated]" UBYTE NO_COMPU_METHOD 0 0 0 255 ECU_ADDRESS 0x3F9D91 FORMAT "%.4g" /end MEASUREMENT
/begin MEASUREMENT mdrv_st_mod_hud_key2 "MDRV-Status HUD (CAN) [RAM name from V530, interpolated]" UBYTE NO_COMPU_METHOD 0 0 0 255 ECU_ADDRESS 0x3F9D92 FORMAT "%.4g" /end MEASUREMENT
/begin MEASUREMENT mdrv_st_mod_hud_key3 "MDRV-Status HUD (CAN) [RAM name from V530, interpolated]" UBYTE NO_COMPU_METHOD 0 0 0 255 ECU_ADDRESS 0x3F9D93 FORMAT "%.4g" /end MEASUREMENT
/begin MEASUREMENT mdrv_st_mod_hud_key4 "MDRV-Status HUD (CAN) [RAM name from V530, interpolated]" UBYTE NO_COMPU_METHOD 0 0 0 255 ECU_ADDRESS 0x3F9D94 FORMAT "%.4g" /end MEASUREMENT
/begin MEASUREMENT mdrv_st_mod_hud_key5 "MDRV-Status HUD (CAN) [RAM name from V530, interpolated]" UBYTE NO_COMPU_METHOD 0 0 0 255 ECU_ADDRESS 0x3F9D95 FORMAT "%.4g" /end MEASUREMENT
/begin MEASUREMENT mdrv_st_mod_hud_key6 "MDRV-Status HUD (CAN) [RAM name from V530, interpolated]" UBYTE NO_COMPU_METHOD 0 0 0 255 ECU_ADDRESS 0x3F9D96 FORMAT "%.4g" /end MEASUREMENT
/begin MEASUREMENT mdrv_st_mod_hud_key7 "MDRV-Status HUD (CAN) [RAM name from V530, interpolated]" UBYTE NO_COMPU_METHOD 0 0 0 255 ECU_ADDRESS 0x3F9D97 FORMAT "%.4g" /end MEASUREMENT
/begin MEASUREMENT mdrv_st_mod_hud_key8 "MDRV-Status HUD (CAN) [RAM name from V530, interpolated]" UBYTE NO_COMPU_METHOD 0 0 0 255 ECU_ADDRESS 0x3F9D98 FORMAT "%.4g" /end MEASUREMENT
/begin MEASUREMENT mdrv_st_mod_hud_key9 "MDRV-Status HUD (CAN) [RAM name from V530, interpolated]" UBYTE NO_COMPU_METHOD 0 0 0 255 ECU_ADDRESS 0x3F9D99 FORMAT "%.4g" /end MEASUREMENT
/begin MEASUREMENT ccp_retry_cnt_nv "Download Retryzaehler [RAM name from V530, interpolated]" UWORD M_FORMULA_0010 0 0 0 65535 ECU_ADDRESS 0x3FA192 /end MEASUREMENT
/begin MEASUREMENT sys_rsr_cnt_nv.csrs "ChkstopReset [RAM name from V530, interpolated]" UBYTE M_FORMULA_0003 0 0 0 255 ECU_ADDRESS 0x3FA188 /end MEASUREMENT
/begin MEASUREMENT sys_rsr_cnt_nv.dbhrs "DebugHardReset [RAM name from V530, interpolated]" UBYTE M_FORMULA_0003 0 0 0 255 ECU_ADDRESS 0x3FA189 /end MEASUREMENT
/begin MEASUREMENT sys_rsr_cnt_nv.dbsrs "DebugSoftReset [RAM name from V530, interpolated]" UBYTE M_FORMULA_0003 0 0 0 255 ECU_ADDRESS 0x3FA18A /end MEASUREMENT
/begin MEASUREMENT sys_rsr_cnt_nv.ghrst "GlitchHPinReset [RAM name from V530, interpolated]" UBYTE M_FORMULA_0003 0 0 0 255 ECU_ADDRESS 0x3FA18F /end MEASUREMENT
/begin MEASUREMENT sys_rsr_cnt_nv.gpor "GlitchPowerOnReset [RAM name from V530, interpolated]" UBYTE M_FORMULA_0003 0 0 0 255 ECU_ADDRESS 0x3FA18E /end MEASUREMENT
/begin MEASUREMENT sys_rsr_cnt_nv.gsrst "GlitchSPinReset [RAM name from V530, interpolated]" UBYTE M_FORMULA_0003 0 0 0 255 ECU_ADDRESS 0x3FA190 /end MEASUREMENT
/begin MEASUREMENT sys_rsr_cnt_nv.ilbc "IllegalBitChangeReset [RAM name from V530, interpolated]" UBYTE M_FORMULA_0003 0 0 0 255 ECU_ADDRESS 0x3FA18D /end MEASUREMENT
/begin MEASUREMENT sys_rsr_cnt_nv.jtrs "JTAGReset [RAM name from V530, interpolated]" UBYTE M_FORMULA_0003 0 0 0 255 ECU_ADDRESS 0x3FA18B /end MEASUREMENT
/begin MEASUREMENT sys_rsr_cnt_nv.llrs "LossOfClockReset [RAM name from V530, interpolated]" UBYTE M_FORMULA_0003 0 0 0 255 ECU_ADDRESS 0x3FA186 /end MEASUREMENT
/begin MEASUREMENT sys_rsr_cnt_nv.ocrs "OnChipReset [RAM name from V530, interpolated]" UBYTE M_FORMULA_0003 0 0 0 255 ECU_ADDRESS 0x3FA18C /end MEASUREMENT
/begin MEASUREMENT sys_rsr_cnt_nv.swrs "WatchdogReset [RAM name from V530, interpolated]" UBYTE M_FORMULA_0003 0 0 0 255 ECU_ADDRESS 0x3FA187 /end MEASUREMENT
/begin MEASUREMENT ed_fil_sk_tr_inj.zyklus_filter_nv "Vorwaertsfilter zur Fehlerzustandsbestaetigung [RAM name from V530, interpolated]" UBYTE M_FORMULA_0003 0 0 0 255 ECU_ADDRESS 0x3FA349 /end MEASUREMENT
/begin MEASUREMENT ed_fil_pumg.filter_nv "Filterwert vor und nach Eintrag [RAM name from V530, interpolated]" UBYTE M_FORMULA_0003 0 0 0 255 ECU_ADDRESS 0x3FA34E /end MEASUREMENT
/begin MEASUREMENT ed_fil_pumg.zyklus_filter_nv "Vorwaertsfilter zur Fehlerzustandsbestaetigung [RAM name from V530, interpolated]" UBYTE M_FORMULA_0003 0 0 0 255 ECU_ADDRESS 0x3FA34F /end MEASUREMENT
/begin MEASUREMENT ed_fil_sk_tr_inj.fehler_aufrufe_nv "Gesamtzahl der Fehleraufrufe [RAM name from V530, interpolated]" UBYTE M_FORMULA_0003 0 0 0 255 ECU_ADDRESS 0x3FA34D /end MEASUREMENT
/begin MEASUREMENT ed_fil_sk_tr_inj.filter_max_nv "Maximaler Fehlerfilterwert [RAM name from V530, interpolated]" UBYTE M_FORMULA_0003 0 0 0 255 ECU_ADDRESS 0x3FA34C /end MEASUREMENT
/begin MEASUREMENT ed_fil_hfm1.art_aktuell_nv "Fehlerart und Statusbits [RAM name from V530, interpolated]" UWORD NO_COMPU_METHOD 0 0 0 65535 ECU_ADDRESS 0x3FA356 FORMAT "%.4g" /end MEASUREMENT
/begin MEASUREMENT ed_fil_hfm1.fehler_aufrufe_nv "Gesamtzahl der Fehleraufrufe [RAM name from V530, interpolated]" UBYTE M_FORMULA_0003 0 0 0 255 ECU_ADDRESS 0x3FA359 /end MEASUREMENT
/begin MEASUREMENT ed_fil_hfm1.filter_max_nv "Maximaler Fehlerfilterwert [RAM name from V530, interpolated]" UBYTE M_FORMULA_0003 0 0 0 255 ECU_ADDRESS 0x3FA358 /end MEASUREMENT
/begin MEASUREMENT ed_fil_hfm1.filter_nv "Filterwert vor und nach Eintrag [RAM name from V530, interpolated]" UBYTE M_FORMULA_0003 0 0 0 255 ECU_ADDRESS 0x3FA354 /end MEASUREMENT
/begin MEASUREMENT ed_fil_hfm1.zyklus_filter_nv "Vorwaertsfilter zur Fehlerzustandsbestaetigung [RAM name from V530, interpolated]" UBYTE M_FORMULA_0003 0 0 0 255 ECU_ADDRESS 0x3FA355 /end MEASUREMENT
/begin MEASUREMENT ed_fil_hfm2.art_aktuell_nv "Fehlerart und Statusbits [RAM name from V530, interpolated]" UWORD NO_COMPU_METHOD 0 0 0 65535 ECU_ADDRESS 0x3FA35C FORMAT "%.4g" /end MEASUREMENT
/begin MEASUREMENT ed_fil_hfm2.fehler_aufrufe_nv "Gesamtzahl der Fehleraufrufe [RAM name from V530, interpolated]" UBYTE M_FORMULA_0003 0 0 0 255 ECU_ADDRESS 0x3FA35F /end MEASUREMENT
/begin MEASUREMENT ed_fil_hfm2.filter_max_nv "Maximaler Fehlerfilterwert [RAM name from V530, interpolated]" UBYTE M_FORMULA_0003 0 0 0 255 ECU_ADDRESS 0x3FA35E /end MEASUREMENT
/begin MEASUREMENT ed_fil_hfm2.filter_nv "Filterwert vor und nach Eintrag [RAM name from V530, interpolated]" UBYTE M_FORMULA_0003 0 0 0 255 ECU_ADDRESS 0x3FA35A /end MEASUREMENT
/begin MEASUREMENT ed_fil_hfm2.zyklus_filter_nv "Vorwaertsfilter zur Fehlerzustandsbestaetigung [RAM name from V530, interpolated]" UBYTE M_FORMULA_0003 0 0 0 255 ECU_ADDRESS 0x3FA35B /end MEASUREMENT
/begin MEASUREMENT ed_fil_psau1.art_aktuell_nv "Fehlerart und Statusbits [RAM name from V530, interpolated]" UWORD NO_COMPU_METHOD 0 0 0 65535 ECU_ADDRESS 0x3FA362 FORMAT "%.4g" /end MEASUREMENT
/begin MEASUREMENT ed_fil_psau1.fehler_aufrufe_nv "Gesamtzahl der Fehleraufrufe [RAM name from V530, interpolated]" UBYTE M_FORMULA_0003 0 0 0 255 ECU_ADDRESS 0x3FA365 /end MEASUREMENT
/begin MEASUREMENT ed_fil_psau1.filter_max_nv "Maximaler Fehlerfilterwert [RAM name from V530, interpolated]" UBYTE M_FORMULA_0003 0 0 0 255 ECU_ADDRESS 0x3FA364 /end MEASUREMENT
/begin MEASUREMENT ed_fil_psau1.filter_nv "Filterwert vor und nach Eintrag [RAM name from V530, interpolated]" UBYTE M_FORMULA_0003 0 0 0 255 ECU_ADDRESS 0x3FA360 /end MEASUREMENT
/begin MEASUREMENT ed_fil_psau1.zyklus_filter_nv "Vorwaertsfilter zur Fehlerzustandsbestaetigung [RAM name from V530, interpolated]" UBYTE M_FORMULA_0003 0 0 0 255 ECU_ADDRESS 0x3FA361 /end MEASUREMENT
/begin MEASUREMENT ed_fil_psau2.art_aktuell_nv "Fehlerart und Statusbits [RAM name from V530, interpolated]" UWORD NO_COMPU_METHOD 0 0 0 65535 ECU_ADDRESS 0x3FA368 FORMAT "%.4g" /end MEASUREMENT
/begin MEASUREMENT ed_fil_psau2.fehler_aufrufe_nv "Gesamtzahl der Fehleraufrufe [RAM name from V530, interpolated]" UBYTE M_FORMULA_0003 0 0 0 255 ECU_ADDRESS 0x3FA36B /end MEASUREMENT
/begin MEASUREMENT ed_fil_psau2.filter_max_nv "Maximaler Fehlerfilterwert [RAM name from V530, interpolated]" UBYTE M_FORMULA_0003 0 0 0 255 ECU_ADDRESS 0x3FA36A /end MEASUREMENT
/begin MEASUREMENT ed_fil_psau2.filter_nv "Filterwert vor und nach Eintrag [RAM name from V530, interpolated]" UBYTE M_FORMULA_0003 0 0 0 255 ECU_ADDRESS 0x3FA366 /end MEASUREMENT
/begin MEASUREMENT ed_fil_psau2.zyklus_filter_nv "Vorwaertsfilter zur Fehlerzustandsbestaetigung [RAM name from V530, interpolated]" UBYTE M_FORMULA_0003 0 0 0 255 ECU_ADDRESS 0x3FA367 /end MEASUREMENT
/begin MEASUREMENT ed_fil_pumg.fehler_aufrufe_nv "Gesamtzahl der Fehleraufrufe [RAM name from V530, interpolated]" UBYTE M_FORMULA_0003 0 0 0 255 ECU_ADDRESS 0x3FA353 /end MEASUREMENT
/begin MEASUREMENT ed_fil_pumg.filter_max_nv "Maximaler Fehlerfilterwert [RAM name from V530, interpolated]" UBYTE M_FORMULA_0003 0 0 0 255 ECU_ADDRESS 0x3FA352 /end MEASUREMENT
/begin MEASUREMENT ed_fil_van_hall_e1.filter_nv "Filterwert vor und nach Eintrag [RAM name from V530, interpolated]" UBYTE M_FORMULA_0003 0 0 0 255 ECU_ADDRESS 0x3FA36C /end MEASUREMENT
/begin MEASUREMENT ed_fil_van_hall_e1.zyklus_filter_nv "Vorwaertsfilter zur Fehlerzustandsbestaetigung [RAM name from V530, interpolated]" UBYTE M_FORMULA_0003 0 0 0 255 ECU_ADDRESS 0x3FA36D /end MEASUREMENT
/begin MEASUREMENT ed_fil_van_hall_a1.filter_nv "Filterwert vor und nach Eintrag [RAM name from V530, interpolated]" UBYTE M_FORMULA_0003 0 0 0 255 ECU_ADDRESS 0x3FA372 /end MEASUREMENT
/begin MEASUREMENT ed_fil_van_hall_a1.zyklus_filter_nv "Vorwaertsfilter zur Fehlerzustandsbestaetigung [RAM name from V530, interpolated]" UBYTE M_FORMULA_0003 0 0 0 255 ECU_ADDRESS 0x3FA373 /end MEASUREMENT
/begin MEASUREMENT ed_fil_van_hall_e1.fehler_aufrufe_nv "Gesamtzahl der Fehleraufrufe [RAM name from V530, interpolated]" UBYTE M_FORMULA_0003 0 0 0 255 ECU_ADDRESS 0x3FA371 /end MEASUREMENT
/begin MEASUREMENT ed_fil_van_hall_e1.filter_max_nv "Maximaler Fehlerfilterwert [RAM name from V530, interpolated]" UBYTE M_FORMULA_0003 0 0 0 255 ECU_ADDRESS 0x3FA370 /end MEASUREMENT
/begin MEASUREMENT ed_fil_van_hall_a1.fehler_aufrufe_nv "Gesamtzahl der Fehleraufrufe [RAM name from V530, interpolated]" UBYTE M_FORMULA_0003 0 0 0 255 ECU_ADDRESS 0x3FA377 /end MEASUREMENT
/begin MEASUREMENT ed_fil_van_hall_a1.filter_max_nv "Maximaler Fehlerfilterwert [RAM name from V530, interpolated]" UBYTE M_FORMULA_0003 0 0 0 255 ECU_ADDRESS 0x3FA376 /end MEASUREMENT
/begin MEASUREMENT ed_fil_van_hall_e2.filter_nv "Filterwert vor und nach Eintrag [RAM name from V530, interpolated]" UBYTE M_FORMULA_0003 0 0 0 255 ECU_ADDRESS 0x3FA378 /end MEASUREMENT
/begin MEASUREMENT ed_fil_van_hall_e2.zyklus_filter_nv "Vorwaertsfilter zur Fehlerzustandsbestaetigung [RAM name from V530, interpolated]" UBYTE M_FORMULA_0003 0 0 0 255 ECU_ADDRESS 0x3FA379 /end MEASUREMENT
/begin MEASUREMENT ed_fil_van_hall_a2.filter_nv "Filterwert vor und nach Eintrag [RAM name from V530, interpolated]" UBYTE M_FORMULA_0003 0 0 0 255 ECU_ADDRESS 0x3FA37E /end MEASUREMENT
/begin MEASUREMENT ed_fil_van_hall_a2.zyklus_filter_nv "Vorwaertsfilter zur Fehlerzustandsbestaetigung [RAM name from V530, interpolated]" UBYTE M_FORMULA_0003 0 0 0 255 ECU_ADDRESS 0x3FA37F /end MEASUREMENT
/begin MEASUREMENT ed_fil_van_hall_e2.fehler_aufrufe_nv "Gesamtzahl der Fehleraufrufe [RAM name from V530, interpolated]" UBYTE M_FORMULA_0003 0 0 0 255 ECU_ADDRESS 0x3FA37D /end MEASUREMENT
/begin MEASUREMENT ed_fil_van_hall_e2.filter_max_nv "Maximaler Fehlerfilterwert [RAM name from V530, interpolated]" UBYTE M_FORMULA_0003 0 0 0 255 ECU_ADDRESS 0x3FA37C /end MEASUREMENT
/begin MEASUREMENT ed_fil_van_hall_a2.fehler_aufrufe_nv "Gesamtzahl der Fehleraufrufe [RAM name from V530, interpolated]" UBYTE M_FORMULA_0003 0 0 0 255 ECU_ADDRESS 0x3FA383 /end MEASUREMENT
/begin MEASUREMENT ed_fil_van_hall_a2.filter_max_nv "Maximaler Fehlerfilterwert [RAM name from V530, interpolated]" UBYTE M_FORMULA_0003 0 0 0 255 ECU_ADDRESS 0x3FA382 /end MEASUREMENT
/begin MEASUREMENT ed_fil_van_regl_e1.filter_nv "Filterwert vor und nach Eintrag [RAM name from V530, interpolated]" UBYTE M_FORMULA_0003 0 0 0 255 ECU_ADDRESS 0x3FA384 /end MEASUREMENT
/begin MEASUREMENT ed_fil_van_regl_e1.zyklus_filter_nv "Vorwaertsfilter zur Fehlerzustandsbestaetigung [RAM name from V530, interpolated]" UBYTE M_FORMULA_0003 0 0 0 255 ECU_ADDRESS 0x3FA385 /end MEASUREMENT
/begin MEASUREMENT ed_fil_van_regl_a1.filter_nv "Filterwert vor und nach Eintrag [RAM name from V530, interpolated]" UBYTE M_FORMULA_0003 0 0 0 255 ECU_ADDRESS 0x3FA38A /end MEASUREMENT
/begin MEASUREMENT ed_fil_van_regl_a1.zyklus_filter_nv "Vorwaertsfilter zur Fehlerzustandsbestaetigung [RAM name from V530, interpolated]" UBYTE M_FORMULA_0003 0 0 0 255 ECU_ADDRESS 0x3FA38B /end MEASUREMENT
/begin MEASUREMENT ed_fil_van_regl_e1.fehler_aufrufe_nv "Gesamtzahl der Fehleraufrufe [RAM name from V530, interpolated]" UBYTE M_FORMULA_0003 0 0 0 255 ECU_ADDRESS 0x3FA389 /end MEASUREMENT
/begin MEASUREMENT ed_fil_van_regl_e1.filter_max_nv "Maximaler Fehlerfilterwert [RAM name from V530, interpolated]" UBYTE M_FORMULA_0003 0 0 0 255 ECU_ADDRESS 0x3FA388 /end MEASUREMENT
/begin MEASUREMENT ed_fil_van_regl_a1.fehler_aufrufe_nv "Gesamtzahl der Fehleraufrufe [RAM name from V530, interpolated]" UBYTE M_FORMULA_0003 0 0 0 255 ECU_ADDRESS 0x3FA38F /end MEASUREMENT
/begin MEASUREMENT ed_fil_van_regl_a1.filter_max_nv "Maximaler Fehlerfilterwert [RAM name from V530, interpolated]" UBYTE M_FORMULA_0003 0 0 0 255 ECU_ADDRESS 0x3FA38E /end MEASUREMENT
/begin MEASUREMENT ed_fil_van_regl_e2.filter_nv "Filterwert vor und nach Eintrag [RAM name from V530, interpolated]" UBYTE M_FORMULA_0003 0 0 0 255 ECU_ADDRESS 0x3FA390 /end MEASUREMENT
/begin MEASUREMENT ed_fil_van_regl_e2.zyklus_filter_nv "Vorwaertsfilter zur Fehlerzustandsbestaetigung [RAM name from V530, interpolated]" UBYTE M_FORMULA_0003 0 0 0 255 ECU_ADDRESS 0x3FA391 /end MEASUREMENT
/begin MEASUREMENT ed_fil_van_regl_a2.filter_nv "Filterwert vor und nach Eintrag [RAM name from V530, interpolated]" UBYTE M_FORMULA_0003 0 0 0 255 ECU_ADDRESS 0x3FA396 /end MEASUREMENT
/begin MEASUREMENT ed_fil_van_regl_a2.zyklus_filter_nv "Vorwaertsfilter zur Fehlerzustandsbestaetigung [RAM name from V530, interpolated]" UBYTE M_FORMULA_0003 0 0 0 255 ECU_ADDRESS 0x3FA397 /end MEASUREMENT
/begin MEASUREMENT ed_fil_van_regl_e2.fehler_aufrufe_nv "Gesamtzahl der Fehleraufrufe [RAM name from V530, interpolated]" UBYTE M_FORMULA_0003 0 0 0 255 ECU_ADDRESS 0x3FA395 /end MEASUREMENT
/begin MEASUREMENT ed_fil_van_regl_e2.filter_max_nv "Maximaler Fehlerfilterwert [RAM name from V530, interpolated]" UBYTE M_FORMULA_0003 0 0 0 255 ECU_ADDRESS 0x3FA394 /end MEASUREMENT
/begin MEASUREMENT ed_fil_index_15_inj.art_aktuell_nv "Fehlerart und Statusbits [RAM name from V530, interpolated]" UWORD NO_COMPU_METHOD 0 0 0 65535 ECU_ADDRESS 0x3FA3A4 FORMAT "%.4g" /end MEASUREMENT
/begin MEASUREMENT ed_fil_index_15_inj.fehler_aufrufe_nv "Gesamtzahl der Fehleraufrufe [RAM name from V530, interpolated]" UBYTE M_FORMULA_0003 0 0 0 255 ECU_ADDRESS 0x3FA3A7 /end MEASUREMENT
/begin MEASUREMENT ed_fil_index_15_inj.filter_max_nv "Maximaler Fehlerfilterwert [RAM name from V530, interpolated]" UBYTE M_FORMULA_0003 0 0 0 255 ECU_ADDRESS 0x3FA3A6 /end MEASUREMENT
/begin MEASUREMENT ed_fil_index_15_inj.filter_nv "Filterwert vor und nach Eintrag [RAM name from V530, interpolated]" UBYTE M_FORMULA_0003 0 0 0 255 ECU_ADDRESS 0x3FA3A2 /end MEASUREMENT
/begin MEASUREMENT ed_fil_index_15_inj.zyklus_filter_nv "Vorwaertsfilter zur Fehlerzustandsbestaetigung [RAM name from V530, interpolated]" UBYTE M_FORMULA_0003 0 0 0 255 ECU_ADDRESS 0x3FA3A3 /end MEASUREMENT
/begin MEASUREMENT ed_fil_nw_sync.art_aktuell_nv "Fehlerart und Statusbits [RAM name from V530, interpolated]" UWORD NO_COMPU_METHOD 0 0 0 65535 ECU_ADDRESS 0x3FA39E FORMAT "%.4g" /end MEASUREMENT
/begin MEASUREMENT ed_fil_nw_sync.fehler_aufrufe_nv "Gesamtzahl der Fehleraufrufe [RAM name from V530, interpolated]" UBYTE M_FORMULA_0003 0 0 0 255 ECU_ADDRESS 0x3FA3A1 /end MEASUREMENT
/begin MEASUREMENT ed_fil_nw_sync.filter_max_nv "Maximaler Fehlerfilterwert [RAM name from V530, interpolated]" UBYTE M_FORMULA_0003 0 0 0 255 ECU_ADDRESS 0x3FA3A0 /end MEASUREMENT
/begin MEASUREMENT ed_fil_nw_sync.filter_nv "Filterwert vor und nach Eintrag [RAM name from V530, interpolated]" UBYTE M_FORMULA_0003 0 0 0 255 ECU_ADDRESS 0x3FA39C /end MEASUREMENT
/begin MEASUREMENT ed_fil_nw_sync.zyklus_filter_nv "Vorwaertsfilter zur Fehlerzustandsbestaetigung [RAM name from V530, interpolated]" UBYTE M_FORMULA_0003 0 0 0 255 ECU_ADDRESS 0x3FA39D /end MEASUREMENT
/begin MEASUREMENT ed_fil_pctrl_inj.filter_nv "Filterwert vor und nach Eintrag [RAM name from V530, interpolated]" UBYTE M_FORMULA_0003 0 0 0 255 ECU_ADDRESS 0x3FA3A8 /end MEASUREMENT
/begin MEASUREMENT ed_fil_pctrl_inj.zyklus_filter_nv "Vorwaertsfilter zur Fehlerzustandsbestaetigung [RAM name from V530, interpolated]" UBYTE M_FORMULA_0003 0 0 0 255 ECU_ADDRESS 0x3FA3A9 /end MEASUREMENT
/begin MEASUREMENT ed_fil_van_regl_a2.fehler_aufrufe_nv "Gesamtzahl der Fehleraufrufe [RAM name from V530, interpolated]" UBYTE M_FORMULA_0003 0 0 0 255 ECU_ADDRESS 0x3FA39B /end MEASUREMENT
/begin MEASUREMENT ed_fil_van_regl_a2.filter_max_nv "Maximaler Fehlerfilterwert [RAM name from V530, interpolated]" UBYTE M_FORMULA_0003 0 0 0 255 ECU_ADDRESS 0x3FA39A /end MEASUREMENT
/begin MEASUREMENT ed_fil_pctrl_inj.fehler_aufrufe_nv "Gesamtzahl der Fehleraufrufe [RAM name from V530, interpolated]" UBYTE M_FORMULA_0003 0 0 0 255 ECU_ADDRESS 0x3FA3AD /end MEASUREMENT
/begin MEASUREMENT ed_fil_pctrl_inj.filter_max_nv "Maximaler Fehlerfilterwert [RAM name from V530, interpolated]" UBYTE M_FORMULA_0003 0 0 0 255 ECU_ADDRESS 0x3FA3AC /end MEASUREMENT
/begin MEASUREMENT ed_fil_pks.filter_nv "Filterwert vor und nach Eintrag [RAM name from V530, interpolated]" UBYTE M_FORMULA_0003 0 0 0 255 ECU_ADDRESS 0x3FA3B4 /end MEASUREMENT
/begin MEASUREMENT ed_fil_pks.zyklus_filter_nv "Vorwaertsfilter zur Fehlerzustandsbestaetigung [RAM name from V530, interpolated]" UBYTE M_FORMULA_0003 0 0 0 255 ECU_ADDRESS 0x3FA3B5 /end MEASUREMENT
/begin MEASUREMENT ed_fil_pt_statdkg.art_aktuell_nv "Fehlerart und Statusbits [RAM name from V530, interpolated]" UWORD NO_COMPU_METHOD 0 0 0 65535 ECU_ADDRESS 0x3FA3B0 FORMAT "%.4g" /end MEASUREMENT
/begin MEASUREMENT ed_fil_pt_statdkg.fehler_aufrufe_nv "Gesamtzahl der Fehleraufrufe [RAM name from V530, interpolated]" UBYTE M_FORMULA_0003 0 0 0 255 ECU_ADDRESS 0x3FA3B3 /end MEASUREMENT
/begin MEASUREMENT ed_fil_pt_statdkg.filter_max_nv "Maximaler Fehlerfilterwert [RAM name from V530, interpolated]" UBYTE M_FORMULA_0003 0 0 0 255 ECU_ADDRESS 0x3FA3B2 /end MEASUREMENT
/begin MEASUREMENT ed_fil_pt_statdkg.filter_nv "Filterwert vor und nach Eintrag [RAM name from V530, interpolated]" UBYTE M_FORMULA_0003 0 0 0 255 ECU_ADDRESS 0x3FA3AE /end MEASUREMENT
/begin MEASUREMENT ed_fil_pt_statdkg.zyklus_filter_nv "Vorwaertsfilter zur Fehlerzustandsbestaetigung [RAM name from V530, interpolated]" UBYTE M_FORMULA_0003 0 0 0 255 ECU_ADDRESS 0x3FA3AF /end MEASUREMENT
/begin MEASUREMENT ed_fil_lavk1.filter_nv "Filterwert vor und nach Eintrag [RAM name from V530, interpolated]" UBYTE M_FORMULA_0003 0 0 0 255 ECU_ADDRESS 0x3FA3C0 /end MEASUREMENT
/begin MEASUREMENT ed_fil_lavk1.zyklus_filter_nv "Vorwaertsfilter zur Fehlerzustandsbestaetigung [RAM name from V530, interpolated]" UBYTE M_FORMULA_0003 0 0 0 255 ECU_ADDRESS 0x3FA3C1 /end MEASUREMENT
/begin MEASUREMENT ed_fil_pks.fehler_aufrufe_nv "Gesamtzahl der Fehleraufrufe [RAM name from V530, interpolated]" UBYTE M_FORMULA_0003 0 0 0 255 ECU_ADDRESS 0x3FA3B9 /end MEASUREMENT
/begin MEASUREMENT ed_fil_pks.filter_max_nv "Maximaler Fehlerfilterwert [RAM name from V530, interpolated]" UBYTE M_FORMULA_0003 0 0 0 255 ECU_ADDRESS 0x3FA3B8 /end MEASUREMENT
/begin MEASUREMENT ed_fil_pt_statr.art_aktuell_nv "Fehlerart und Statusbits [RAM name from V530, interpolated]" UWORD NO_COMPU_METHOD 0 0 0 65535 ECU_ADDRESS 0x3FA3BC FORMAT "%.4g" /end MEASUREMENT
/begin MEASUREMENT ed_fil_pt_statr.fehler_aufrufe_nv "Gesamtzahl der Fehleraufrufe [RAM name from V530, interpolated]" UBYTE M_FORMULA_0003 0 0 0 255 ECU_ADDRESS 0x3FA3BF /end MEASUREMENT
/begin MEASUREMENT ed_fil_pt_statr.filter_max_nv "Maximaler Fehlerfilterwert [RAM name from V530, interpolated]" UBYTE M_FORMULA_0003 0 0 0 255 ECU_ADDRESS 0x3FA3BE /end MEASUREMENT
/begin MEASUREMENT ed_fil_pt_statr.filter_nv "Filterwert vor und nach Eintrag [RAM name from V530, interpolated]" UBYTE M_FORMULA_0003 0 0 0 255 ECU_ADDRESS 0x3FA3BA /end MEASUREMENT
/begin MEASUREMENT ed_fil_pt_statr.zyklus_filter_nv "Vorwaertsfilter zur Fehlerzustandsbestaetigung [RAM name from V530, interpolated]" UBYTE M_FORMULA_0003 0 0 0 255 ECU_ADDRESS 0x3FA3BB /end MEASUREMENT
/begin MEASUREMENT ed_fil_lank1.art_aktuell_nv "Fehlerart und Statusbits [RAM name from V530, interpolated]" UWORD NO_COMPU_METHOD 0 0 0 65535 ECU_ADDRESS 0x3FA3E6 FORMAT "%.4g" /end MEASUREMENT
/begin MEASUREMENT ed_fil_lank1.fehler_aufrufe_nv "Gesamtzahl der Fehleraufrufe [RAM name from V530, interpolated]" UBYTE M_FORMULA_0003 0 0 0 255 ECU_ADDRESS 0x3FA3E9 /end MEASUREMENT
/begin MEASUREMENT ed_fil_lank1.filter_max_nv "Maximaler Fehlerfilterwert [RAM name from V530, interpolated]" UBYTE M_FORMULA_0003 0 0 0 255 ECU_ADDRESS 0x3FA3E8 /end MEASUREMENT
/begin MEASUREMENT ed_fil_lank1.filter_nv "Filterwert vor und nach Eintrag [RAM name from V530, interpolated]" UBYTE M_FORMULA_0003 0 0 0 255 ECU_ADDRESS 0x3FA3E4 /end MEASUREMENT
/begin MEASUREMENT ed_fil_lank1.zyklus_filter_nv "Vorwaertsfilter zur Fehlerzustandsbestaetigung [RAM name from V530, interpolated]" UBYTE M_FORMULA_0003 0 0 0 255 ECU_ADDRESS 0x3FA3E5 /end MEASUREMENT
/begin MEASUREMENT ed_fil_lank2.art_aktuell_nv "Fehlerart und Statusbits [RAM name from V530, interpolated]" UWORD NO_COMPU_METHOD 0 0 0 65535 ECU_ADDRESS 0x3FA3EC FORMAT "%.4g" /end MEASUREMENT
/begin MEASUREMENT ed_fil_lank2.fehler_aufrufe_nv "Gesamtzahl der Fehleraufrufe [RAM name from V530, interpolated]" UBYTE M_FORMULA_0003 0 0 0 255 ECU_ADDRESS 0x3FA3EF /end MEASUREMENT
/begin MEASUREMENT ed_fil_lank2.filter_max_nv "Maximaler Fehlerfilterwert [RAM name from V530, interpolated]" UBYTE M_FORMULA_0003 0 0 0 255 ECU_ADDRESS 0x3FA3EE /end MEASUREMENT
/begin MEASUREMENT ed_fil_lank2.filter_nv "Filterwert vor und nach Eintrag [RAM name from V530, interpolated]" UBYTE M_FORMULA_0003 0 0 0 255 ECU_ADDRESS 0x3FA3EA /end MEASUREMENT
/begin MEASUREMENT ed_fil_lank2.zyklus_filter_nv "Vorwaertsfilter zur Fehlerzustandsbestaetigung [RAM name from V530, interpolated]" UBYTE M_FORMULA_0003 0 0 0 255 ECU_ADDRESS 0x3FA3EB /end MEASUREMENT
/begin MEASUREMENT ed_fil_lavk1.fehler_aufrufe_nv "Gesamtzahl der Fehleraufrufe [RAM name from V530, interpolated]" UBYTE M_FORMULA_0003 0 0 0 255 ECU_ADDRESS 0x3FA3C5 /end MEASUREMENT
/begin MEASUREMENT ed_fil_lavk1.filter_max_nv "Maximaler Fehlerfilterwert [RAM name from V530, interpolated]" UBYTE M_FORMULA_0003 0 0 0 255 ECU_ADDRESS 0x3FA3C4 /end MEASUREMENT
/begin MEASUREMENT ed_fil_lavk1_obd_plau.art_aktuell_nv "Fehlerart und Statusbits [RAM name from V530, interpolated]" UWORD NO_COMPU_METHOD 0 0 0 65535 ECU_ADDRESS 0x3FA3CE FORMAT "%.4g" /end MEASUREMENT
/begin MEASUREMENT ed_fil_lavk1_obd_plau.fehler_aufrufe_nv "Gesamtzahl der Fehleraufrufe [RAM name from V530, interpolated]" UBYTE M_FORMULA_0003 0 0 0 255 ECU_ADDRESS 0x3FA3D1 /end MEASUREMENT
/begin MEASUREMENT ed_fil_lavk1_obd_plau.filter_max_nv "Maximaler Fehlerfilterwert [RAM name from V530, interpolated]" UBYTE M_FORMULA_0003 0 0 0 255 ECU_ADDRESS 0x3FA3D0 /end MEASUREMENT
/begin MEASUREMENT ed_fil_lavk1_obd_plau.filter_nv "Filterwert vor und nach Eintrag [RAM name from V530, interpolated]" UBYTE M_FORMULA_0003 0 0 0 255 ECU_ADDRESS 0x3FA3CC /end MEASUREMENT
/begin MEASUREMENT ed_fil_lavk1_obd_plau.zyklus_filter_nv "Vorwaertsfilter zur Fehlerzustandsbestaetigung [RAM name from V530, interpolated]" UBYTE M_FORMULA_0003 0 0 0 255 ECU_ADDRESS 0x3FA3CD /end MEASUREMENT
/begin MEASUREMENT ed_fil_lavk1_obd_sa.art_aktuell_nv "Fehlerart und Statusbits [RAM name from V530, interpolated]" UWORD NO_COMPU_METHOD 0 0 0 65535 ECU_ADDRESS 0x3FA3DA FORMAT "%.4g" /end MEASUREMENT
/begin MEASUREMENT ed_fil_lavk1_obd_sa.fehler_aufrufe_nv "Gesamtzahl der Fehleraufrufe [RAM name from V530, interpolated]" UBYTE M_FORMULA_0003 0 0 0 255 ECU_ADDRESS 0x3FA3DD /end MEASUREMENT
/begin MEASUREMENT ed_fil_lavk1_obd_sa.filter_max_nv "Maximaler Fehlerfilterwert [RAM name from V530, interpolated]" UBYTE M_FORMULA_0003 0 0 0 255 ECU_ADDRESS 0x3FA3DC /end MEASUREMENT
/begin MEASUREMENT ed_fil_lavk1_obd_sa.filter_nv "Filterwert vor und nach Eintrag [RAM name from V530, interpolated]" UBYTE M_FORMULA_0003 0 0 0 255 ECU_ADDRESS 0x3FA3D8 /end MEASUREMENT
/begin MEASUREMENT ed_fil_lavk1_obd_sa.zyklus_filter_nv "Vorwaertsfilter zur Fehlerzustandsbestaetigung [RAM name from V530, interpolated]" UBYTE M_FORMULA_0003 0 0 0 255 ECU_ADDRESS 0x3FA3D9 /end MEASUREMENT
/begin MEASUREMENT ed_fil_lavk2.art_aktuell_nv "Fehlerart und Statusbits [RAM name from V530, interpolated]" UWORD NO_COMPU_METHOD 0 0 0 65535 ECU_ADDRESS 0x3FA3C8 FORMAT "%.4g" /end MEASUREMENT
/begin MEASUREMENT ed_fil_lavk2.fehler_aufrufe_nv "Gesamtzahl der Fehleraufrufe [RAM name from V530, interpolated]" UBYTE M_FORMULA_0003 0 0 0 255 ECU_ADDRESS 0x3FA3CB /end MEASUREMENT
/begin MEASUREMENT ed_fil_lavk2.filter_max_nv "Maximaler Fehlerfilterwert [RAM name from V530, interpolated]" UBYTE M_FORMULA_0003 0 0 0 255 ECU_ADDRESS 0x3FA3CA /end MEASUREMENT
/begin MEASUREMENT ed_fil_lavk2.filter_nv "Filterwert vor und nach Eintrag [RAM name from V530, interpolated]" UBYTE M_FORMULA_0003 0 0 0 255 ECU_ADDRESS 0x3FA3C6 /end MEASUREMENT
/begin MEASUREMENT ed_fil_lavk2.zyklus_filter_nv "Vorwaertsfilter zur Fehlerzustandsbestaetigung [RAM name from V530, interpolated]" UBYTE M_FORMULA_0003 0 0 0 255 ECU_ADDRESS 0x3FA3C7 /end MEASUREMENT
/begin MEASUREMENT ed_fil_lavk2_obd_plau.art_aktuell_nv "Fehlerart und Statusbits [RAM name from V530, interpolated]" UWORD NO_COMPU_METHOD 0 0 0 65535 ECU_ADDRESS 0x3FA3D4 FORMAT "%.4g" /end MEASUREMENT
/begin MEASUREMENT ed_fil_lavk2_obd_plau.fehler_aufrufe_nv "Gesamtzahl der Fehleraufrufe [RAM name from V530, interpolated]" UBYTE M_FORMULA_0003 0 0 0 255 ECU_ADDRESS 0x3FA3D7 /end MEASUREMENT
/begin MEASUREMENT ed_fil_lavk2_obd_plau.filter_max_nv "Maximaler Fehlerfilterwert [RAM name from V530, interpolated]" UBYTE M_FORMULA_0003 0 0 0 255 ECU_ADDRESS 0x3FA3D6 /end MEASUREMENT
/begin MEASUREMENT ed_fil_lavk2_obd_plau.filter_nv "Filterwert vor und nach Eintrag [RAM name from V530, interpolated]" UBYTE M_FORMULA_0003 0 0 0 255 ECU_ADDRESS 0x3FA3D2 /end MEASUREMENT
/begin MEASUREMENT ed_fil_lavk2_obd_plau.zyklus_filter_nv "Vorwaertsfilter zur Fehlerzustandsbestaetigung [RAM name from V530, interpolated]" UBYTE M_FORMULA_0003 0 0 0 255 ECU_ADDRESS 0x3FA3D3 /end MEASUREMENT
/begin MEASUREMENT ed_fil_lavk2_obd_sa.art_aktuell_nv "Fehlerart und Statusbits [RAM name from V530, interpolated]" UWORD NO_COMPU_METHOD 0 0 0 65535 ECU_ADDRESS 0x3FA3E0 FORMAT "%.4g" /end MEASUREMENT
/begin MEASUREMENT ed_fil_lavk2_obd_sa.fehler_aufrufe_nv "Gesamtzahl der Fehleraufrufe [RAM name from V530, interpolated]" UBYTE M_FORMULA_0003 0 0 0 255 ECU_ADDRESS 0x3FA3E3 /end MEASUREMENT
/begin MEASUREMENT ed_fil_lavk2_obd_sa.filter_max_nv "Maximaler Fehlerfilterwert [RAM name from V530, interpolated]" UBYTE M_FORMULA_0003 0 0 0 255 ECU_ADDRESS 0x3FA3E2 /end MEASUREMENT
/begin MEASUREMENT ed_fil_lavk2_obd_sa.filter_nv "Filterwert vor und nach Eintrag [RAM name from V530, interpolated]" UBYTE M_FORMULA_0003 0 0 0 255 ECU_ADDRESS 0x3FA3DE /end MEASUREMENT
/begin MEASUREMENT ed_fil_lavk2_obd_sa.zyklus_filter_nv "Vorwaertsfilter zur Fehlerzustandsbestaetigung [RAM name from V530, interpolated]" UBYTE M_FORMULA_0003 0 0 0 255 ECU_ADDRESS 0x3FA3DF /end MEASUREMENT
/begin MEASUREMENT ed_fil_lshnk1.filter_nv "Filterwert vor und nach Eintrag [RAM name from V530, interpolated]" UBYTE M_FORMULA_0003 0 0 0 255 ECU_ADDRESS 0x3FA3F0 /end MEASUREMENT
/begin MEASUREMENT ed_fil_lshnk1.zyklus_filter_nv "Vorwaertsfilter zur Fehlerzustandsbestaetigung [RAM name from V530, interpolated]" UBYTE M_FORMULA_0003 0 0 0 255 ECU_ADDRESS 0x3FA3F1 /end MEASUREMENT
/begin MEASUREMENT ed_fil_lshnk1.fehler_aufrufe_nv "Gesamtzahl der Fehleraufrufe [RAM name from V530, interpolated]" UBYTE M_FORMULA_0003 0 0 0 255 ECU_ADDRESS 0x3FA3F5 /end MEASUREMENT
/begin MEASUREMENT ed_fil_lshnk1.filter_max_nv "Maximaler Fehlerfilterwert [RAM name from V530, interpolated]" UBYTE M_FORMULA_0003 0 0 0 255 ECU_ADDRESS 0x3FA3F4 /end MEASUREMENT
/begin MEASUREMENT ed_fil_lshnk2.filter_nv "Filterwert vor und nach Eintrag [RAM name from V530, interpolated]" UBYTE M_FORMULA_0003 0 0 0 255 ECU_ADDRESS 0x3FA3F6 /end MEASUREMENT
/begin MEASUREMENT ed_fil_lshnk2.zyklus_filter_nv "Vorwaertsfilter zur Fehlerzustandsbestaetigung [RAM name from V530, interpolated]" UBYTE M_FORMULA_0003 0 0 0 255 ECU_ADDRESS 0x3FA3F7 /end MEASUREMENT
/begin MEASUREMENT ed_fil_lshnk2.fehler_aufrufe_nv "Gesamtzahl der Fehleraufrufe [RAM name from V530, interpolated]" UBYTE M_FORMULA_0003 0 0 0 255 ECU_ADDRESS 0x3FA3FB /end MEASUREMENT
/begin MEASUREMENT ed_fil_lshnk2.filter_max_nv "Maximaler Fehlerfilterwert [RAM name from V530, interpolated]" UBYTE M_FORMULA_0003 0 0 0 255 ECU_ADDRESS 0x3FA3FA /end MEASUREMENT
/begin MEASUREMENT ed_fil_pt_busoff.filter_nv "Filterwert vor und nach Eintrag [RAM name from V530, interpolated]" UBYTE M_FORMULA_0003 0 0 0 255 ECU_ADDRESS 0x3FA3FC /end MEASUREMENT
/begin MEASUREMENT ed_fil_pt_busoff.zyklus_filter_nv "Vorwaertsfilter zur Fehlerzustandsbestaetigung [RAM name from V530, interpolated]" UBYTE M_FORMULA_0003 0 0 0 255 ECU_ADDRESS 0x3FA3FD /end MEASUREMENT
/begin MEASUREMENT ed_fil_pt_atemp.art_aktuell_nv "Fehlerart und Statusbits [RAM name from V530, interpolated]" UWORD NO_COMPU_METHOD 0 0 0 65535 ECU_ADDRESS 0x3FA41C FORMAT "%.4g" /end MEASUREMENT
/begin MEASUREMENT ed_fil_pt_atemp.fehler_aufrufe_nv "Gesamtzahl der Fehleraufrufe [RAM name from V530, interpolated]" UBYTE M_FORMULA_0003 0 0 0 255 ECU_ADDRESS 0x3FA41F /end MEASUREMENT
/begin MEASUREMENT ed_fil_pt_atemp.filter_max_nv "Maximaler Fehlerfilterwert [RAM name from V530, interpolated]" UBYTE M_FORMULA_0003 0 0 0 255 ECU_ADDRESS 0x3FA41E /end MEASUREMENT
/begin MEASUREMENT ed_fil_pt_atemp.filter_nv "Filterwert vor und nach Eintrag [RAM name from V530, interpolated]" UBYTE M_FORMULA_0003 0 0 0 255 ECU_ADDRESS 0x3FA41A /end MEASUREMENT
/begin MEASUREMENT ed_fil_pt_atemp.zyklus_filter_nv "Vorwaertsfilter zur Fehlerzustandsbestaetigung [RAM name from V530, interpolated]" UBYTE M_FORMULA_0003 0 0 0 255 ECU_ADDRESS 0x3FA41B /end MEASUREMENT
/begin MEASUREMENT ed_fil_pt_busoff.fehler_aufrufe_nv "Gesamtzahl der Fehleraufrufe [RAM name from V530, interpolated]" UBYTE M_FORMULA_0003 0 0 0 255 ECU_ADDRESS 0x3FA401 /end MEASUREMENT
/begin MEASUREMENT ed_fil_pt_busoff.filter_max_nv "Maximaler Fehlerfilterwert [RAM name from V530, interpolated]" UBYTE M_FORMULA_0003 0 0 0 255 ECU_ADDRESS 0x3FA400 /end MEASUREMENT
/begin MEASUREMENT ed_fil_pt_klst.filter_nv "Filterwert vor und nach Eintrag [RAM name from V530, interpolated]" UBYTE M_FORMULA_0003 0 0 0 255 ECU_ADDRESS 0x3FA420 /end MEASUREMENT
/begin MEASUREMENT ed_fil_pt_klst.zyklus_filter_nv "Vorwaertsfilter zur Fehlerzustandsbestaetigung [RAM name from V530, interpolated]" UBYTE M_FORMULA_0003 0 0 0 255 ECU_ADDRESS 0x3FA421 /end MEASUREMENT
/begin MEASUREMENT ed_fil_pt_stdsc.art_aktuell_nv "Fehlerart und Statusbits [RAM name from V530, interpolated]" UWORD NO_COMPU_METHOD 0 0 0 65535 ECU_ADDRESS 0x3FA40A FORMAT "%.4g" /end MEASUREMENT
/begin MEASUREMENT ed_fil_pt_stdsc.fehler_aufrufe_nv "Gesamtzahl der Fehleraufrufe [RAM name from V530, interpolated]" UBYTE M_FORMULA_0003 0 0 0 255 ECU_ADDRESS 0x3FA40D /end MEASUREMENT
/begin MEASUREMENT ed_fil_pt_stdsc.filter_max_nv "Maximaler Fehlerfilterwert [RAM name from V530, interpolated]" UBYTE M_FORMULA_0003 0 0 0 255 ECU_ADDRESS 0x3FA40C /end MEASUREMENT
/begin MEASUREMENT ed_fil_pt_stdsc.filter_nv "Filterwert vor und nach Eintrag [RAM name from V530, interpolated]" UBYTE M_FORMULA_0003 0 0 0 255 ECU_ADDRESS 0x3FA408 /end MEASUREMENT
/begin MEASUREMENT ed_fil_pt_stdsc.zyklus_filter_nv "Vorwaertsfilter zur Fehlerzustandsbestaetigung [RAM name from V530, interpolated]" UBYTE M_FORMULA_0003 0 0 0 255 ECU_ADDRESS 0x3FA409 /end MEASUREMENT
/begin MEASUREMENT ed_fil_pt_torqdsc.art_aktuell_nv "Fehlerart und Statusbits [RAM name from V530, interpolated]" UWORD NO_COMPU_METHOD 0 0 0 65535 ECU_ADDRESS 0x3FA404 FORMAT "%.4g" /end MEASUREMENT
/begin MEASUREMENT ed_fil_pt_torqdsc.fehler_aufrufe_nv "Gesamtzahl der Fehleraufrufe [RAM name from V530, interpolated]" UBYTE M_FORMULA_0003 0 0 0 255 ECU_ADDRESS 0x3FA407 /end MEASUREMENT
/begin MEASUREMENT ed_fil_pt_torqdsc.filter_max_nv "Maximaler Fehlerfilterwert [RAM name from V530, interpolated]" UBYTE M_FORMULA_0003 0 0 0 255 ECU_ADDRESS 0x3FA406 /end MEASUREMENT
/begin MEASUREMENT ed_fil_pt_torqdsc.filter_nv "Filterwert vor und nach Eintrag [RAM name from V530, interpolated]" UBYTE M_FORMULA_0003 0 0 0 255 ECU_ADDRESS 0x3FA402 /end MEASUREMENT
/begin MEASUREMENT ed_fil_pt_torqdsc.zyklus_filter_nv "Vorwaertsfilter zur Fehlerzustandsbestaetigung [RAM name from V530, interpolated]" UBYTE M_FORMULA_0003 0 0 0 255 ECU_ADDRESS 0x3FA403 /end MEASUREMENT
/begin MEASUREMENT ed_fil_pt_vfzg.art_aktuell_nv "Fehlerart und Statusbits [RAM name from V530, interpolated]" UWORD NO_COMPU_METHOD 0 0 0 65535 ECU_ADDRESS 0x3FA416 FORMAT "%.4g" /end MEASUREMENT
/begin MEASUREMENT ed_fil_pt_vfzg.fehler_aufrufe_nv "Gesamtzahl der Fehleraufrufe [RAM name from V530, interpolated]" UBYTE M_FORMULA_0003 0 0 0 255 ECU_ADDRESS 0x3FA419 /end MEASUREMENT
/begin MEASUREMENT ed_fil_pt_vfzg.filter_max_nv "Maximaler Fehlerfilterwert [RAM name from V530, interpolated]" UBYTE M_FORMULA_0003 0 0 0 255 ECU_ADDRESS 0x3FA418 /end MEASUREMENT
/begin MEASUREMENT ed_fil_pt_vfzg.filter_nv "Filterwert vor und nach Eintrag [RAM name from V530, interpolated]" UBYTE M_FORMULA_0003 0 0 0 255 ECU_ADDRESS 0x3FA414 /end MEASUREMENT
/begin MEASUREMENT ed_fil_pt_vfzg.zyklus_filter_nv "Vorwaertsfilter zur Fehlerzustandsbestaetigung [RAM name from V530, interpolated]" UBYTE M_FORMULA_0003 0 0 0 255 ECU_ADDRESS 0x3FA415 /end MEASUREMENT
/begin MEASUREMENT ed_fil_pt_vrad.art_aktuell_nv "Fehlerart und Statusbits [RAM name from V530, interpolated]" UWORD NO_COMPU_METHOD 0 0 0 65535 ECU_ADDRESS 0x3FA410 FORMAT "%.4g" /end MEASUREMENT
/begin MEASUREMENT ed_fil_pt_vrad.fehler_aufrufe_nv "Gesamtzahl der Fehleraufrufe [RAM name from V530, interpolated]" UBYTE M_FORMULA_0003 0 0 0 255 ECU_ADDRESS 0x3FA413 /end MEASUREMENT
/begin MEASUREMENT ed_fil_pt_vrad.filter_max_nv "Maximaler Fehlerfilterwert [RAM name from V530, interpolated]" UBYTE M_FORMULA_0003 0 0 0 255 ECU_ADDRESS 0x3FA412 /end MEASUREMENT
/begin MEASUREMENT ed_fil_pt_vrad.filter_nv "Filterwert vor und nach Eintrag [RAM name from V530, interpolated]" UBYTE M_FORMULA_0003 0 0 0 255 ECU_ADDRESS 0x3FA40E /end MEASUREMENT
/begin MEASUREMENT ed_fil_pt_vrad.zyklus_filter_nv "Vorwaertsfilter zur Fehlerzustandsbestaetigung [RAM name from V530, interpolated]" UBYTE M_FORMULA_0003 0 0 0 255 ECU_ADDRESS 0x3FA40F /end MEASUREMENT
/begin MEASUREMENT ed_fil_fplau1.filter_nv "Filterwert vor und nach Eintrag [RAM name from V530, interpolated]" UBYTE M_FORMULA_0003 0 0 0 255 ECU_ADDRESS 0x3FA432 /end MEASUREMENT
/begin MEASUREMENT ed_fil_fplau1.zyklus_filter_nv "Vorwaertsfilter zur Fehlerzustandsbestaetigung [RAM name from V530, interpolated]" UBYTE M_FORMULA_0003 0 0 0 255 ECU_ADDRESS 0x3FA433 /end MEASUREMENT
/begin MEASUREMENT ed_fil_pt_kkos.art_aktuell_nv "Fehlerart und Statusbits [RAM name from V530, interpolated]" UWORD NO_COMPU_METHOD 0 0 0 65535 ECU_ADDRESS 0x3FA428 FORMAT "%.4g" /end MEASUREMENT
/begin MEASUREMENT ed_fil_pt_kkos.fehler_aufrufe_nv "Gesamtzahl der Fehleraufrufe [RAM name from V530, interpolated]" UBYTE M_FORMULA_0003 0 0 0 255 ECU_ADDRESS 0x3FA42B /end MEASUREMENT
/begin MEASUREMENT ed_fil_pt_kkos.filter_max_nv "Maximaler Fehlerfilterwert [RAM name from V530, interpolated]" UBYTE M_FORMULA_0003 0 0 0 255 ECU_ADDRESS 0x3FA42A /end MEASUREMENT
/begin MEASUREMENT ed_fil_pt_kkos.filter_nv "Filterwert vor und nach Eintrag [RAM name from V530, interpolated]" UBYTE M_FORMULA_0003 0 0 0 255 ECU_ADDRESS 0x3FA426 /end MEASUREMENT
/begin MEASUREMENT ed_fil_pt_kkos.zyklus_filter_nv "Vorwaertsfilter zur Fehlerzustandsbestaetigung [RAM name from V530, interpolated]" UBYTE M_FORMULA_0003 0 0 0 255 ECU_ADDRESS 0x3FA427 /end MEASUREMENT
/begin MEASUREMENT ed_fil_pt_klst.fehler_aufrufe_nv "Gesamtzahl der Fehleraufrufe [RAM name from V530, interpolated]" UBYTE M_FORMULA_0003 0 0 0 255 ECU_ADDRESS 0x3FA425 /end MEASUREMENT
/begin MEASUREMENT ed_fil_pt_klst.filter_max_nv "Maximaler Fehlerfilterwert [RAM name from V530, interpolated]" UBYTE M_FORMULA_0003 0 0 0 255 ECU_ADDRESS 0x3FA424 /end MEASUREMENT
/begin MEASUREMENT ed_fil_pt_lrw.art_aktuell_nv "Fehlerart und Statusbits [RAM name from V530, interpolated]" UWORD NO_COMPU_METHOD 0 0 0 65535 ECU_ADDRESS 0x3FA42E FORMAT "%.4g" /end MEASUREMENT
/begin MEASUREMENT ed_fil_pt_lrw.fehler_aufrufe_nv "Gesamtzahl der Fehleraufrufe [RAM name from V530, interpolated]" UBYTE M_FORMULA_0003 0 0 0 255 ECU_ADDRESS 0x3FA431 /end MEASUREMENT
/begin MEASUREMENT ed_fil_pt_lrw.filter_max_nv "Maximaler Fehlerfilterwert [RAM name from V530, interpolated]" UBYTE M_FORMULA_0003 0 0 0 255 ECU_ADDRESS 0x3FA430 /end MEASUREMENT
/begin MEASUREMENT ed_fil_pt_lrw.filter_nv "Filterwert vor und nach Eintrag [RAM name from V530, interpolated]" UBYTE M_FORMULA_0003 0 0 0 255 ECU_ADDRESS 0x3FA42C /end MEASUREMENT
/begin MEASUREMENT ed_fil_pt_lrw.zyklus_filter_nv "Vorwaertsfilter zur Fehlerzustandsbestaetigung [RAM name from V530, interpolated]" UBYTE M_FORMULA_0003 0 0 0 255 ECU_ADDRESS 0x3FA42D /end MEASUREMENT
/begin MEASUREMENT ed_fil_fplau1.fehler_aufrufe_nv "Gesamtzahl der Fehleraufrufe [RAM name from V530, interpolated]" UBYTE M_FORMULA_0003 0 0 0 255 ECU_ADDRESS 0x3FA437 /end MEASUREMENT
/begin MEASUREMENT ed_fil_fplau1.filter_max_nv "Maximaler Fehlerfilterwert [RAM name from V530, interpolated]" UBYTE M_FORMULA_0003 0 0 0 255 ECU_ADDRESS 0x3FA436 /end MEASUREMENT
/begin MEASUREMENT ed_fil_fplau2.filter_nv "Filterwert vor und nach Eintrag [RAM name from V530, interpolated]" UBYTE M_FORMULA_0003 0 0 0 255 ECU_ADDRESS 0x3FA438 /end MEASUREMENT
/begin MEASUREMENT ed_fil_fplau2.zyklus_filter_nv "Vorwaertsfilter zur Fehlerzustandsbestaetigung [RAM name from V530, interpolated]" UBYTE M_FORMULA_0003 0 0 0 255 ECU_ADDRESS 0x3FA439 /end MEASUREMENT
/begin MEASUREMENT ed_fil_fplau2.fehler_aufrufe_nv "Gesamtzahl der Fehleraufrufe [RAM name from V530, interpolated]" UBYTE M_FORMULA_0003 0 0 0 255 ECU_ADDRESS 0x3FA43D /end MEASUREMENT
/begin MEASUREMENT ed_fil_fplau2.filter_max_nv "Maximaler Fehlerfilterwert [RAM name from V530, interpolated]" UBYTE M_FORMULA_0003 0 0 0 255 ECU_ADDRESS 0x3FA43C /end MEASUREMENT
/begin MEASUREMENT ed_fil_sl_ml_hfm.filter_nv "Filterwert vor und nach Eintrag [RAM name from V530, interpolated]" UBYTE M_FORMULA_0003 0 0 0 255 ECU_ADDRESS 0x3FA43E /end MEASUREMENT
/begin MEASUREMENT ed_fil_sl_ml_hfm.zyklus_filter_nv "Vorwaertsfilter zur Fehlerzustandsbestaetigung [RAM name from V530, interpolated]" UBYTE M_FORMULA_0003 0 0 0 255 ECU_ADDRESS 0x3FA43F /end MEASUREMENT
/begin MEASUREMENT ed_fil_lank1_obd_s.art_aktuell_nv "Fehlerart und Statusbits [RAM name from V530, interpolated]" UWORD NO_COMPU_METHOD 0 0 0 65535 ECU_ADDRESS 0x3FA446 FORMAT "%.4g" /end MEASUREMENT
/begin MEASUREMENT ed_fil_lank1_obd_s.fehler_aufrufe_nv "Gesamtzahl der Fehleraufrufe [RAM name from V530, interpolated]" UBYTE M_FORMULA_0003 0 0 0 255 ECU_ADDRESS 0x3FA449 /end MEASUREMENT
/begin MEASUREMENT ed_fil_lank1_obd_s.filter_max_nv "Maximaler Fehlerfilterwert [RAM name from V530, interpolated]" UBYTE M_FORMULA_0003 0 0 0 255 ECU_ADDRESS 0x3FA448 /end MEASUREMENT
/begin MEASUREMENT ed_fil_lank1_obd_s.filter_nv "Filterwert vor und nach Eintrag [RAM name from V530, interpolated]" UBYTE M_FORMULA_0003 0 0 0 255 ECU_ADDRESS 0x3FA444 /end MEASUREMENT
/begin MEASUREMENT ed_fil_lank1_obd_s.zyklus_filter_nv "Vorwaertsfilter zur Fehlerzustandsbestaetigung [RAM name from V530, interpolated]" UBYTE M_FORMULA_0003 0 0 0 255 ECU_ADDRESS 0x3FA445 /end MEASUREMENT
/begin MEASUREMENT ed_fil_lank2_obd_s.art_aktuell_nv "Fehlerart und Statusbits [RAM name from V530, interpolated]" UWORD NO_COMPU_METHOD 0 0 0 65535 ECU_ADDRESS 0x3FA44C FORMAT "%.4g" /end MEASUREMENT
/begin MEASUREMENT ed_fil_lank2_obd_s.fehler_aufrufe_nv "Gesamtzahl der Fehleraufrufe [RAM name from V530, interpolated]" UBYTE M_FORMULA_0003 0 0 0 255 ECU_ADDRESS 0x3FA44F /end MEASUREMENT
/begin MEASUREMENT ed_fil_lank2_obd_s.filter_max_nv "Maximaler Fehlerfilterwert [RAM name from V530, interpolated]" UBYTE M_FORMULA_0003 0 0 0 255 ECU_ADDRESS 0x3FA44E /end MEASUREMENT
/begin MEASUREMENT ed_fil_lank2_obd_s.filter_nv "Filterwert vor und nach Eintrag [RAM name from V530, interpolated]" UBYTE M_FORMULA_0003 0 0 0 255 ECU_ADDRESS 0x3FA44A /end MEASUREMENT
/begin MEASUREMENT ed_fil_lank2_obd_s.zyklus_filter_nv "Vorwaertsfilter zur Fehlerzustandsbestaetigung [RAM name from V530, interpolated]" UBYTE M_FORMULA_0003 0 0 0 255 ECU_ADDRESS 0x3FA44B /end MEASUREMENT
/begin MEASUREMENT ed_fil_lavk1_obd_tl.art_aktuell_nv "Fehlerart und Statusbits [RAM name from V530, interpolated]" UWORD NO_COMPU_METHOD 0 0 0 65535 ECU_ADDRESS 0x3FA452 FORMAT "%.4g" /end MEASUREMENT
/begin MEASUREMENT ed_fil_lavk1_obd_tl.fehler_aufrufe_nv "Gesamtzahl der Fehleraufrufe [RAM name from V530, interpolated]" UBYTE M_FORMULA_0003 0 0 0 255 ECU_ADDRESS 0x3FA455 /end MEASUREMENT
/begin MEASUREMENT ed_fil_lavk1_obd_tl.filter_max_nv "Maximaler Fehlerfilterwert [RAM name from V530, interpolated]" UBYTE M_FORMULA_0003 0 0 0 255 ECU_ADDRESS 0x3FA454 /end MEASUREMENT
/begin MEASUREMENT ed_fil_lavk1_obd_tl.filter_nv "Filterwert vor und nach Eintrag [RAM name from V530, interpolated]" UBYTE M_FORMULA_0003 0 0 0 255 ECU_ADDRESS 0x3FA450 /end MEASUREMENT
/begin MEASUREMENT ed_fil_lavk1_obd_tl.zyklus_filter_nv "Vorwaertsfilter zur Fehlerzustandsbestaetigung [RAM name from V530, interpolated]" UBYTE M_FORMULA_0003 0 0 0 255 ECU_ADDRESS 0x3FA451 /end MEASUREMENT
/begin MEASUREMENT ed_fil_lavk2_obd_tl.art_aktuell_nv "Fehlerart und Statusbits [RAM name from V530, interpolated]" UWORD NO_COMPU_METHOD 0 0 0 65535 ECU_ADDRESS 0x3FA458 FORMAT "%.4g" /end MEASUREMENT
/begin MEASUREMENT ed_fil_lavk2_obd_tl.fehler_aufrufe_nv "Gesamtzahl der Fehleraufrufe [RAM name from V530, interpolated]" UBYTE M_FORMULA_0003 0 0 0 255 ECU_ADDRESS 0x3FA45B /end MEASUREMENT
/begin MEASUREMENT ed_fil_lavk2_obd_tl.filter_max_nv "Maximaler Fehlerfilterwert [RAM name from V530, interpolated]" UBYTE M_FORMULA_0003 0 0 0 255 ECU_ADDRESS 0x3FA45A /end MEASUREMENT
/begin MEASUREMENT ed_fil_lavk2_obd_tl.filter_nv "Filterwert vor und nach Eintrag [RAM name from V530, interpolated]" UBYTE M_FORMULA_0003 0 0 0 255 ECU_ADDRESS 0x3FA456 /end MEASUREMENT
/begin MEASUREMENT ed_fil_lavk2_obd_tl.zyklus_filter_nv "Vorwaertsfilter zur Fehlerzustandsbestaetigung [RAM name from V530, interpolated]" UBYTE M_FORMULA_0003 0 0 0 255 ECU_ADDRESS 0x3FA457 /end MEASUREMENT
/begin MEASUREMENT ed_fil_lshvk1.filter_nv "Filterwert vor und nach Eintrag [RAM name from V530, interpolated]" UBYTE M_FORMULA_0003 0 0 0 255 ECU_ADDRESS 0x3FA45C /end MEASUREMENT
/begin MEASUREMENT ed_fil_lshvk1.zyklus_filter_nv "Vorwaertsfilter zur Fehlerzustandsbestaetigung [RAM name from V530, interpolated]" UBYTE M_FORMULA_0003 0 0 0 255 ECU_ADDRESS 0x3FA45D /end MEASUREMENT
/begin MEASUREMENT ed_fil_sl_ml_hfm.fehler_aufrufe_nv "Gesamtzahl der Fehleraufrufe [RAM name from V530, interpolated]" UBYTE M_FORMULA_0003 0 0 0 255 ECU_ADDRESS 0x3FA443 /end MEASUREMENT
/begin MEASUREMENT ed_fil_sl_ml_hfm.filter_max_nv "Maximaler Fehlerfilterwert [RAM name from V530, interpolated]" UBYTE M_FORMULA_0003 0 0 0 255 ECU_ADDRESS 0x3FA442 /end MEASUREMENT
/begin MEASUREMENT ed_fil_lshvk1.fehler_aufrufe_nv "Gesamtzahl der Fehleraufrufe [RAM name from V530, interpolated]" UBYTE M_FORMULA_0003 0 0 0 255 ECU_ADDRESS 0x3FA461 /end MEASUREMENT
/begin MEASUREMENT ed_fil_lshvk1.filter_max_nv "Maximaler Fehlerfilterwert [RAM name from V530, interpolated]" UBYTE M_FORMULA_0003 0 0 0 255 ECU_ADDRESS 0x3FA460 /end MEASUREMENT
/begin MEASUREMENT ed_fil_lshvk2.filter_nv "Filterwert vor und nach Eintrag [RAM name from V530, interpolated]" UBYTE M_FORMULA_0003 0 0 0 255 ECU_ADDRESS 0x3FA462 /end MEASUREMENT
/begin MEASUREMENT ed_fil_lshvk2.zyklus_filter_nv "Vorwaertsfilter zur Fehlerzustandsbestaetigung [RAM name from V530, interpolated]" UBYTE M_FORMULA_0003 0 0 0 255 ECU_ADDRESS 0x3FA463 /end MEASUREMENT
/begin MEASUREMENT ed_fil_lavk1_diag.art_aktuell_nv "Fehlerart und Statusbits [RAM name from V530, interpolated]" UWORD NO_COMPU_METHOD 0 0 0 65535 ECU_ADDRESS 0x3FA4A6 FORMAT "%.4g" /end MEASUREMENT
/begin MEASUREMENT ed_fil_lavk1_diag.fehler_aufrufe_nv "Gesamtzahl der Fehleraufrufe [RAM name from V530, interpolated]" UBYTE M_FORMULA_0003 0 0 0 255 ECU_ADDRESS 0x3FA4A9 /end MEASUREMENT
/begin MEASUREMENT ed_fil_lavk1_diag.filter_max_nv "Maximaler Fehlerfilterwert [RAM name from V530, interpolated]" UBYTE M_FORMULA_0003 0 0 0 255 ECU_ADDRESS 0x3FA4A8 /end MEASUREMENT
/begin MEASUREMENT ed_fil_lavk1_diag.filter_nv "Filterwert vor und nach Eintrag [RAM name from V530, interpolated]" UBYTE M_FORMULA_0003 0 0 0 255 ECU_ADDRESS 0x3FA4A4 /end MEASUREMENT
/begin MEASUREMENT ed_fil_lavk1_diag.zyklus_filter_nv "Vorwaertsfilter zur Fehlerzustandsbestaetigung [RAM name from V530, interpolated]" UBYTE M_FORMULA_0003 0 0 0 255 ECU_ADDRESS 0x3FA4A5 /end MEASUREMENT
/begin MEASUREMENT ed_fil_lavk1_ia_openload.art_aktuell_nv "Fehlerart und Statusbits [RAM name from V530, interpolated]" UWORD NO_COMPU_METHOD 0 0 0 65535 ECU_ADDRESS 0x3FA4B2 FORMAT "%.4g" /end MEASUREMENT
/begin MEASUREMENT ed_fil_lavk1_ia_openload.fehler_aufrufe_nv "Gesamtzahl der Fehleraufrufe [RAM name from V530, interpolated]" UBYTE M_FORMULA_0003 0 0 0 255 ECU_ADDRESS 0x3FA4B5 /end MEASUREMENT
/begin MEASUREMENT ed_fil_lavk1_ia_openload.filter_max_nv "Maximaler Fehlerfilterwert [RAM name from V530, interpolated]" UBYTE M_FORMULA_0003 0 0 0 255 ECU_ADDRESS 0x3FA4B4 /end MEASUREMENT
/begin MEASUREMENT ed_fil_lavk1_ia_openload.filter_nv "Filterwert vor und nach Eintrag [RAM name from V530, interpolated]" UBYTE M_FORMULA_0003 0 0 0 255 ECU_ADDRESS 0x3FA4B0 /end MEASUREMENT
/begin MEASUREMENT ed_fil_lavk1_ia_openload.zyklus_filter_nv "Vorwaertsfilter zur Fehlerzustandsbestaetigung [RAM name from V530, interpolated]" UBYTE M_FORMULA_0003 0 0 0 255 ECU_ADDRESS 0x3FA4B1 /end MEASUREMENT
/begin MEASUREMENT ed_fil_lavk1_un_openload.art_aktuell_nv "Fehlerart und Statusbits [RAM name from V530, interpolated]" UWORD NO_COMPU_METHOD 0 0 0 65535 ECU_ADDRESS 0x3FA4CA FORMAT "%.4g" /end MEASUREMENT
/begin MEASUREMENT ed_fil_lavk1_un_openload.fehler_aufrufe_nv "Gesamtzahl der Fehleraufrufe [RAM name from V530, interpolated]" UBYTE M_FORMULA_0003 0 0 0 255 ECU_ADDRESS 0x3FA4CD /end MEASUREMENT
/begin MEASUREMENT ed_fil_lavk1_un_openload.filter_max_nv "Maximaler Fehlerfilterwert [RAM name from V530, interpolated]" UBYTE M_FORMULA_0003 0 0 0 255 ECU_ADDRESS 0x3FA4CC /end MEASUREMENT
/begin MEASUREMENT ed_fil_lavk1_un_openload.filter_nv "Filterwert vor und nach Eintrag [RAM name from V530, interpolated]" UBYTE M_FORMULA_0003 0 0 0 255 ECU_ADDRESS 0x3FA4C8 /end MEASUREMENT
/begin MEASUREMENT ed_fil_lavk1_un_openload.zyklus_filter_nv "Vorwaertsfilter zur Fehlerzustandsbestaetigung [RAM name from V530, interpolated]" UBYTE M_FORMULA_0003 0 0 0 255 ECU_ADDRESS 0x3FA4C9 /end MEASUREMENT
/begin MEASUREMENT ed_fil_lavk2_diag.art_aktuell_nv "Fehlerart und Statusbits [RAM name from V530, interpolated]" UWORD NO_COMPU_METHOD 0 0 0 65535 ECU_ADDRESS 0x3FA4AC FORMAT "%.4g" /end MEASUREMENT
/begin MEASUREMENT ed_fil_lavk2_diag.fehler_aufrufe_nv "Gesamtzahl der Fehleraufrufe [RAM name from V530, interpolated]" UBYTE M_FORMULA_0003 0 0 0 255 ECU_ADDRESS 0x3FA4AF /end MEASUREMENT
/begin MEASUREMENT ed_fil_lavk2_diag.filter_max_nv "Maximaler Fehlerfilterwert [RAM name from V530, interpolated]" UBYTE M_FORMULA_0003 0 0 0 255 ECU_ADDRESS 0x3FA4AE /end MEASUREMENT
/begin MEASUREMENT ed_fil_lavk2_diag.filter_nv "Filterwert vor und nach Eintrag [RAM name from V530, interpolated]" UBYTE M_FORMULA_0003 0 0 0 255 ECU_ADDRESS 0x3FA4AA /end MEASUREMENT
/begin MEASUREMENT ed_fil_lavk2_diag.zyklus_filter_nv "Vorwaertsfilter zur Fehlerzustandsbestaetigung [RAM name from V530, interpolated]" UBYTE M_FORMULA_0003 0 0 0 255 ECU_ADDRESS 0x3FA4AB /end MEASUREMENT
/begin MEASUREMENT ed_fil_lavk2_ia_openload.art_aktuell_nv "Fehlerart und Statusbits [RAM name from V530, interpolated]" UWORD NO_COMPU_METHOD 0 0 0 65535 ECU_ADDRESS 0x3FA4B8 FORMAT "%.4g" /end MEASUREMENT
/begin MEASUREMENT ed_fil_lavk2_ia_openload.fehler_aufrufe_nv "Gesamtzahl der Fehleraufrufe [RAM name from V530, interpolated]" UBYTE M_FORMULA_0003 0 0 0 255 ECU_ADDRESS 0x3FA4BB /end MEASUREMENT
/begin MEASUREMENT ed_fil_lavk2_ia_openload.filter_max_nv "Maximaler Fehlerfilterwert [RAM name from V530, interpolated]" UBYTE M_FORMULA_0003 0 0 0 255 ECU_ADDRESS 0x3FA4BA /end MEASUREMENT
/begin MEASUREMENT ed_fil_lavk2_ia_openload.filter_nv "Filterwert vor und nach Eintrag [RAM name from V530, interpolated]" UBYTE M_FORMULA_0003 0 0 0 255 ECU_ADDRESS 0x3FA4B6 /end MEASUREMENT
/begin MEASUREMENT ed_fil_lavk2_ia_openload.zyklus_filter_nv "Vorwaertsfilter zur Fehlerzustandsbestaetigung [RAM name from V530, interpolated]" UBYTE M_FORMULA_0003 0 0 0 255 ECU_ADDRESS 0x3FA4B7 /end MEASUREMENT
/begin MEASUREMENT ed_fil_lavk2_un_openload.filter_nv "Filterwert vor und nach Eintrag [RAM name from V530, interpolated]" UBYTE M_FORMULA_0003 0 0 0 255 ECU_ADDRESS 0x3FA4CE /end MEASUREMENT
/begin MEASUREMENT ed_fil_lavk2_un_openload.zyklus_filter_nv "Vorwaertsfilter zur Fehlerzustandsbestaetigung [RAM name from V530, interpolated]" UBYTE M_FORMULA_0003 0 0 0 255 ECU_ADDRESS 0x3FA4CF /end MEASUREMENT
/begin MEASUREMENT ed_fil_lsrvk2_obd_ref.fehler_aufrufe_nv "Gesamtzahl der Fehleraufrufe [RAM name from V530, interpolated]" UBYTE M_FORMULA_0003 0 0 0 255 ECU_ADDRESS 0x3FA4A3 /end MEASUREMENT
/begin MEASUREMENT ed_fil_lsrvk2_obd_ref.filter_max_nv "Maximaler Fehlerfilterwert [RAM name from V530, interpolated]" UBYTE M_FORMULA_0003 0 0 0 255 ECU_ADDRESS 0x3FA4A2 /end MEASUREMENT
/begin MEASUREMENT ed_fil_pt_grb.art_aktuell_nv "Fehlerart und Statusbits [RAM name from V530, interpolated]" UWORD NO_COMPU_METHOD 0 0 0 65535 ECU_ADDRESS 0x3FA4BE FORMAT "%.4g" /end MEASUREMENT
/begin MEASUREMENT ed_fil_pt_grb.fehler_aufrufe_nv "Gesamtzahl der Fehleraufrufe [RAM name from V530, interpolated]" UBYTE M_FORMULA_0003 0 0 0 255 ECU_ADDRESS 0x3FA4C1 /end MEASUREMENT
/begin MEASUREMENT ed_fil_pt_grb.filter_max_nv "Maximaler Fehlerfilterwert [RAM name from V530, interpolated]" UBYTE M_FORMULA_0003 0 0 0 255 ECU_ADDRESS 0x3FA4C0 /end MEASUREMENT
/begin MEASUREMENT ed_fil_pt_grb.filter_nv "Filterwert vor und nach Eintrag [RAM name from V530, interpolated]" UBYTE M_FORMULA_0003 0 0 0 255 ECU_ADDRESS 0x3FA4BC /end MEASUREMENT
/begin MEASUREMENT ed_fil_pt_grb.zyklus_filter_nv "Vorwaertsfilter zur Fehlerzustandsbestaetigung [RAM name from V530, interpolated]" UBYTE M_FORMULA_0003 0 0 0 255 ECU_ADDRESS 0x3FA4BD /end MEASUREMENT
/begin MEASUREMENT ed_fil_pt_grb2.art_aktuell_nv "Fehlerart und Statusbits [RAM name from V530, interpolated]" UWORD NO_COMPU_METHOD 0 0 0 65535 ECU_ADDRESS 0x3FA4C4 FORMAT "%.4g" /end MEASUREMENT
/begin MEASUREMENT ed_fil_pt_grb2.fehler_aufrufe_nv "Gesamtzahl der Fehleraufrufe [RAM name from V530, interpolated]" UBYTE M_FORMULA_0003 0 0 0 255 ECU_ADDRESS 0x3FA4C7 /end MEASUREMENT
/begin MEASUREMENT ed_fil_pt_grb2.filter_max_nv "Maximaler Fehlerfilterwert [RAM name from V530, interpolated]" UBYTE M_FORMULA_0003 0 0 0 255 ECU_ADDRESS 0x3FA4C6 /end MEASUREMENT
/begin MEASUREMENT ed_fil_pt_grb2.filter_nv "Filterwert vor und nach Eintrag [RAM name from V530, interpolated]" UBYTE M_FORMULA_0003 0 0 0 255 ECU_ADDRESS 0x3FA4C2 /end MEASUREMENT
/begin MEASUREMENT ed_fil_pt_grb2.zyklus_filter_nv "Vorwaertsfilter zur Fehlerzustandsbestaetigung [RAM name from V530, interpolated]" UBYTE M_FORMULA_0003 0 0 0 255 ECU_ADDRESS 0x3FA4C3 /end MEASUREMENT
/begin MEASUREMENT ed_fil_lam1_reg.fehler_aufrufe_nv "Gesamtzahl der Fehleraufrufe [RAM name from V530, interpolated]" UBYTE M_FORMULA_0003 0 0 0 255 ECU_ADDRESS 0x3FA51B /end MEASUREMENT
/begin MEASUREMENT ed_fil_lam1_reg.filter_max_nv "Maximaler Fehlerfilterwert [RAM name from V530, interpolated]" UBYTE M_FORMULA_0003 0 0 0 255 ECU_ADDRESS 0x3FA51A /end MEASUREMENT
/begin MEASUREMENT ed_fil_lam2_reg.filter_nv "Filterwert vor und nach Eintrag [RAM name from V530, interpolated]" UBYTE M_FORMULA_0003 0 0 0 255 ECU_ADDRESS 0x3FA51C /end MEASUREMENT
/begin MEASUREMENT ed_fil_lam2_reg.zyklus_filter_nv "Vorwaertsfilter zur Fehlerzustandsbestaetigung [RAM name from V530, interpolated]" UBYTE M_FORMULA_0003 0 0 0 255 ECU_ADDRESS 0x3FA51D /end MEASUREMENT
/begin MEASUREMENT ed_fil_lam2_reg.fehler_aufrufe_nv "Gesamtzahl der Fehleraufrufe [RAM name from V530, interpolated]" UBYTE M_FORMULA_0003 0 0 0 255 ECU_ADDRESS 0x3FA521 /end MEASUREMENT
/begin MEASUREMENT ed_fil_lam2_reg.filter_max_nv "Maximaler Fehlerfilterwert [RAM name from V530, interpolated]" UBYTE M_FORMULA_0003 0 0 0 255 ECU_ADDRESS 0x3FA520 /end MEASUREMENT
/begin MEASUREMENT ed_fil_van_anschl_e1.filter_nv "Filterwert vor und nach Eintrag [RAM name from V530, interpolated]" UBYTE M_FORMULA_0003 0 0 0 255 ECU_ADDRESS 0x3FA522 /end MEASUREMENT
/begin MEASUREMENT ed_fil_van_anschl_e1.zyklus_filter_nv "Vorwaertsfilter zur Fehlerzustandsbestaetigung [RAM name from V530, interpolated]" UBYTE M_FORMULA_0003 0 0 0 255 ECU_ADDRESS 0x3FA523 /end MEASUREMENT
/begin MEASUREMENT ed_fil_van_anschl_a1.filter_nv "Filterwert vor und nach Eintrag [RAM name from V530, interpolated]" UBYTE M_FORMULA_0003 0 0 0 255 ECU_ADDRESS 0x3FA528 /end MEASUREMENT
/begin MEASUREMENT ed_fil_van_anschl_a1.zyklus_filter_nv "Vorwaertsfilter zur Fehlerzustandsbestaetigung [RAM name from V530, interpolated]" UBYTE M_FORMULA_0003 0 0 0 255 ECU_ADDRESS 0x3FA529 /end MEASUREMENT
/begin MEASUREMENT ed_fil_van_anschl_e1.fehler_aufrufe_nv "Gesamtzahl der Fehleraufrufe [RAM name from V530, interpolated]" UBYTE M_FORMULA_0003 0 0 0 255 ECU_ADDRESS 0x3FA527 /end MEASUREMENT
/begin MEASUREMENT ed_fil_van_anschl_e1.filter_max_nv "Maximaler Fehlerfilterwert [RAM name from V530, interpolated]" UBYTE M_FORMULA_0003 0 0 0 255 ECU_ADDRESS 0x3FA526 /end MEASUREMENT
/begin MEASUREMENT ed_fil_van_anschl_a1.fehler_aufrufe_nv "Gesamtzahl der Fehleraufrufe [RAM name from V530, interpolated]" UBYTE M_FORMULA_0003 0 0 0 255 ECU_ADDRESS 0x3FA52D /end MEASUREMENT
/begin MEASUREMENT ed_fil_van_anschl_a1.filter_max_nv "Maximaler Fehlerfilterwert [RAM name from V530, interpolated]" UBYTE M_FORMULA_0003 0 0 0 255 ECU_ADDRESS 0x3FA52C /end MEASUREMENT
/begin MEASUREMENT ed_fil_van_anschl_e2.filter_nv "Filterwert vor und nach Eintrag [RAM name from V530, interpolated]" UBYTE M_FORMULA_0003 0 0 0 255 ECU_ADDRESS 0x3FA52E /end MEASUREMENT
/begin MEASUREMENT ed_fil_van_anschl_e2.zyklus_filter_nv "Vorwaertsfilter zur Fehlerzustandsbestaetigung [RAM name from V530, interpolated]" UBYTE M_FORMULA_0003 0 0 0 255 ECU_ADDRESS 0x3FA52F /end MEASUREMENT
/begin MEASUREMENT ed_fil_van_anschl_a2.filter_nv "Filterwert vor und nach Eintrag [RAM name from V530, interpolated]" UBYTE M_FORMULA_0003 0 0 0 255 ECU_ADDRESS 0x3FA534 /end MEASUREMENT
/begin MEASUREMENT ed_fil_van_anschl_a2.zyklus_filter_nv "Vorwaertsfilter zur Fehlerzustandsbestaetigung [RAM name from V530, interpolated]" UBYTE M_FORMULA_0003 0 0 0 255 ECU_ADDRESS 0x3FA535 /end MEASUREMENT
/begin MEASUREMENT ed_fil_van_anschl_e2.fehler_aufrufe_nv "Gesamtzahl der Fehleraufrufe [RAM name from V530, interpolated]" UBYTE M_FORMULA_0003 0 0 0 255 ECU_ADDRESS 0x3FA533 /end MEASUREMENT
/begin MEASUREMENT ed_fil_van_anschl_e2.filter_max_nv "Maximaler Fehlerfilterwert [RAM name from V530, interpolated]" UBYTE M_FORMULA_0003 0 0 0 255 ECU_ADDRESS 0x3FA532 /end MEASUREMENT
/begin MEASUREMENT ed_fil_van_anschl_a2.fehler_aufrufe_nv "Gesamtzahl der Fehleraufrufe [RAM name from V530, interpolated]" UBYTE M_FORMULA_0003 0 0 0 255 ECU_ADDRESS 0x3FA539 /end MEASUREMENT
/begin MEASUREMENT ed_fil_van_anschl_a2.filter_max_nv "Maximaler Fehlerfilterwert [RAM name from V530, interpolated]" UBYTE M_FORMULA_0003 0 0 0 255 ECU_ADDRESS 0x3FA538 /end MEASUREMENT
/begin MEASUREMENT ed_fil_van_vent_e1.filter_nv "Filterwert vor und nach Eintrag [RAM name from V530, interpolated]" UBYTE M_FORMULA_0003 0 0 0 255 ECU_ADDRESS 0x3FA53A /end MEASUREMENT
/begin MEASUREMENT ed_fil_van_vent_e1.zyklus_filter_nv "Vorwaertsfilter zur Fehlerzustandsbestaetigung [RAM name from V530, interpolated]" UBYTE M_FORMULA_0003 0 0 0 255 ECU_ADDRESS 0x3FA53B /end MEASUREMENT
/begin MEASUREMENT ed_fil_van_vent_a1.filter_nv "Filterwert vor und nach Eintrag [RAM name from V530, interpolated]" UBYTE M_FORMULA_0003 0 0 0 255 ECU_ADDRESS 0x3FA540 /end MEASUREMENT
/begin MEASUREMENT ed_fil_van_vent_a1.zyklus_filter_nv "Vorwaertsfilter zur Fehlerzustandsbestaetigung [RAM name from V530, interpolated]" UBYTE M_FORMULA_0003 0 0 0 255 ECU_ADDRESS 0x3FA541 /end MEASUREMENT
/begin MEASUREMENT ed_fil_van_vent_e1.fehler_aufrufe_nv "Gesamtzahl der Fehleraufrufe [RAM name from V530, interpolated]" UBYTE M_FORMULA_0003 0 0 0 255 ECU_ADDRESS 0x3FA53F /end MEASUREMENT
/begin MEASUREMENT ed_fil_van_vent_e1.filter_max_nv "Maximaler Fehlerfilterwert [RAM name from V530, interpolated]" UBYTE M_FORMULA_0003 0 0 0 255 ECU_ADDRESS 0x3FA53E /end MEASUREMENT
/begin MEASUREMENT ed_fil_van_vent_a1.fehler_aufrufe_nv "Gesamtzahl der Fehleraufrufe [RAM name from V530, interpolated]" UBYTE M_FORMULA_0003 0 0 0 255 ECU_ADDRESS 0x3FA545 /end MEASUREMENT
/begin MEASUREMENT ed_fil_van_vent_a1.filter_max_nv "Maximaler Fehlerfilterwert [RAM name from V530, interpolated]" UBYTE M_FORMULA_0003 0 0 0 255 ECU_ADDRESS 0x3FA544 /end MEASUREMENT
/begin MEASUREMENT ed_fil_van_vent_e2.filter_nv "Filterwert vor und nach Eintrag [RAM name from V530, interpolated]" UBYTE M_FORMULA_0003 0 0 0 255 ECU_ADDRESS 0x3FA546 /end MEASUREMENT
/begin MEASUREMENT ed_fil_van_vent_e2.zyklus_filter_nv "Vorwaertsfilter zur Fehlerzustandsbestaetigung [RAM name from V530, interpolated]" UBYTE M_FORMULA_0003 0 0 0 255 ECU_ADDRESS 0x3FA547 /end MEASUREMENT
/begin MEASUREMENT ed_fil_van_vent_a2.filter_nv "Filterwert vor und nach Eintrag [RAM name from V530, interpolated]" UBYTE M_FORMULA_0003 0 0 0 255 ECU_ADDRESS 0x3FA54C /end MEASUREMENT
/begin MEASUREMENT ed_fil_van_vent_a2.zyklus_filter_nv "Vorwaertsfilter zur Fehlerzustandsbestaetigung [RAM name from V530, interpolated]" UBYTE M_FORMULA_0003 0 0 0 255 ECU_ADDRESS 0x3FA54D /end MEASUREMENT
/begin MEASUREMENT ed_fil_van_vent_e2.fehler_aufrufe_nv "Gesamtzahl der Fehleraufrufe [RAM name from V530, interpolated]" UBYTE M_FORMULA_0003 0 0 0 255 ECU_ADDRESS 0x3FA54B /end MEASUREMENT
/begin MEASUREMENT ed_fil_van_vent_e2.filter_max_nv "Maximaler Fehlerfilterwert [RAM name from V530, interpolated]" UBYTE M_FORMULA_0003 0 0 0 255 ECU_ADDRESS 0x3FA54A /end MEASUREMENT
/begin MEASUREMENT ed_fil_ev1.filter_nv "Filterwert vor und nach Eintrag [RAM name from V530, interpolated]" UBYTE M_FORMULA_0003 0 0 0 255 ECU_ADDRESS 0x3FA552 /end MEASUREMENT
/begin MEASUREMENT ed_fil_ev1.zyklus_filter_nv "Vorwaertsfilter zur Fehlerzustandsbestaetigung [RAM name from V530, interpolated]" UBYTE M_FORMULA_0003 0 0 0 255 ECU_ADDRESS 0x3FA553 /end MEASUREMENT
/begin MEASUREMENT ed_fil_van_vent_a2.fehler_aufrufe_nv "Gesamtzahl der Fehleraufrufe [RAM name from V530, interpolated]" UBYTE M_FORMULA_0003 0 0 0 255 ECU_ADDRESS 0x3FA551 /end MEASUREMENT
/begin MEASUREMENT ed_fil_van_vent_a2.filter_max_nv "Maximaler Fehlerfilterwert [RAM name from V530, interpolated]" UBYTE M_FORMULA_0003 0 0 0 255 ECU_ADDRESS 0x3FA550 /end MEASUREMENT
/begin MEASUREMENT ed_fil_ev1.fehler_aufrufe_nv "Gesamtzahl der Fehleraufrufe [RAM name from V530, interpolated]" UBYTE M_FORMULA_0003 0 0 0 255 ECU_ADDRESS 0x3FA557 /end MEASUREMENT
/begin MEASUREMENT ed_fil_ev1.filter_max_nv "Maximaler Fehlerfilterwert [RAM name from V530, interpolated]" UBYTE M_FORMULA_0003 0 0 0 255 ECU_ADDRESS 0x3FA556 /end MEASUREMENT
/begin MEASUREMENT ed_fil_ev2.filter_nv "Filterwert vor und nach Eintrag [RAM name from V530, interpolated]" UBYTE M_FORMULA_0003 0 0 0 255 ECU_ADDRESS 0x3FA558 /end MEASUREMENT
/begin MEASUREMENT ed_fil_ev2.zyklus_filter_nv "Vorwaertsfilter zur Fehlerzustandsbestaetigung [RAM name from V530, interpolated]" UBYTE M_FORMULA_0003 0 0 0 255 ECU_ADDRESS 0x3FA559 /end MEASUREMENT
/begin MEASUREMENT ed_fil_ev2.fehler_aufrufe_nv "Gesamtzahl der Fehleraufrufe [RAM name from V530, interpolated]" UBYTE M_FORMULA_0003 0 0 0 255 ECU_ADDRESS 0x3FA55D /end MEASUREMENT
/begin MEASUREMENT ed_fil_ev2.filter_max_nv "Maximaler Fehlerfilterwert [RAM name from V530, interpolated]" UBYTE M_FORMULA_0003 0 0 0 255 ECU_ADDRESS 0x3FA55C /end MEASUREMENT
/begin MEASUREMENT ed_fil_ev3.filter_nv "Filterwert vor und nach Eintrag [RAM name from V530, interpolated]" UBYTE M_FORMULA_0003 0 0 0 255 ECU_ADDRESS 0x3FA55E /end MEASUREMENT
/begin MEASUREMENT ed_fil_ev3.zyklus_filter_nv "Vorwaertsfilter zur Fehlerzustandsbestaetigung [RAM name from V530, interpolated]" UBYTE M_FORMULA_0003 0 0 0 255 ECU_ADDRESS 0x3FA55F /end MEASUREMENT
/begin MEASUREMENT ed_fil_ev3.fehler_aufrufe_nv "Gesamtzahl der Fehleraufrufe [RAM name from V530, interpolated]" UBYTE M_FORMULA_0003 0 0 0 255 ECU_ADDRESS 0x3FA563 /end MEASUREMENT
/begin MEASUREMENT ed_fil_ev3.filter_max_nv "Maximaler Fehlerfilterwert [RAM name from V530, interpolated]" UBYTE M_FORMULA_0003 0 0 0 255 ECU_ADDRESS 0x3FA562 /end MEASUREMENT
/begin MEASUREMENT ed_fil_ev4.filter_nv "Filterwert vor und nach Eintrag [RAM name from V530, interpolated]" UBYTE M_FORMULA_0003 0 0 0 255 ECU_ADDRESS 0x3FA564 /end MEASUREMENT
/begin MEASUREMENT ed_fil_ev4.zyklus_filter_nv "Vorwaertsfilter zur Fehlerzustandsbestaetigung [RAM name from V530, interpolated]" UBYTE M_FORMULA_0003 0 0 0 255 ECU_ADDRESS 0x3FA565 /end MEASUREMENT
/begin MEASUREMENT ed_fil_ev4.fehler_aufrufe_nv "Gesamtzahl der Fehleraufrufe [RAM name from V530, interpolated]" UBYTE M_FORMULA_0003 0 0 0 255 ECU_ADDRESS 0x3FA569 /end MEASUREMENT
/begin MEASUREMENT ed_fil_ev4.filter_max_nv "Maximaler Fehlerfilterwert [RAM name from V530, interpolated]" UBYTE M_FORMULA_0003 0 0 0 255 ECU_ADDRESS 0x3FA568 /end MEASUREMENT
/begin MEASUREMENT ed_fil_ev5.filter_nv "Filterwert vor und nach Eintrag [RAM name from V530, interpolated]" UBYTE M_FORMULA_0003 0 0 0 255 ECU_ADDRESS 0x3FA56A /end MEASUREMENT
/begin MEASUREMENT ed_fil_ev5.zyklus_filter_nv "Vorwaertsfilter zur Fehlerzustandsbestaetigung [RAM name from V530, interpolated]" UBYTE M_FORMULA_0003 0 0 0 255 ECU_ADDRESS 0x3FA56B /end MEASUREMENT
/begin MEASUREMENT ed_fil_dmtl_p.fehler_aufrufe_nv "Gesamtzahl der Fehleraufrufe [RAM name from V530, interpolated]" UBYTE M_FORMULA_0003 0 0 0 255 ECU_ADDRESS 0x3FA5B1 /end MEASUREMENT
/begin MEASUREMENT ed_fil_dmtl_p.filter_max_nv "Maximaler Fehlerfilterwert [RAM name from V530, interpolated]" UBYTE M_FORMULA_0003 0 0 0 255 ECU_ADDRESS 0x3FA5B0 /end MEASUREMENT
/begin MEASUREMENT ed_fil_dmtl_v.filter_nv "Filterwert vor und nach Eintrag [RAM name from V530, interpolated]" UBYTE M_FORMULA_0003 0 0 0 255 ECU_ADDRESS 0x3FA5B2 /end MEASUREMENT
/begin MEASUREMENT ed_fil_dmtl_v.zyklus_filter_nv "Vorwaertsfilter zur Fehlerzustandsbestaetigung [RAM name from V530, interpolated]" UBYTE M_FORMULA_0003 0 0 0 255 ECU_ADDRESS 0x3FA5B3 /end MEASUREMENT
/begin MEASUREMENT ed_fil_dmtl_h.filter_nv "Filterwert vor und nach Eintrag [RAM name from V530, interpolated]" UBYTE M_FORMULA_0003 0 0 0 255 ECU_ADDRESS 0x3FA5B8 /end MEASUREMENT
/begin MEASUREMENT ed_fil_dmtl_h.zyklus_filter_nv "Vorwaertsfilter zur Fehlerzustandsbestaetigung [RAM name from V530, interpolated]" UBYTE M_FORMULA_0003 0 0 0 255 ECU_ADDRESS 0x3FA5B9 /end MEASUREMENT
/begin MEASUREMENT ed_fil_dmtl_v.fehler_aufrufe_nv "Gesamtzahl der Fehleraufrufe [RAM name from V530, interpolated]" UBYTE M_FORMULA_0003 0 0 0 255 ECU_ADDRESS 0x3FA5B7 /end MEASUREMENT
/begin MEASUREMENT ed_fil_dmtl_v.filter_max_nv "Maximaler Fehlerfilterwert [RAM name from V530, interpolated]" UBYTE M_FORMULA_0003 0 0 0 255 ECU_ADDRESS 0x3FA5B6 /end MEASUREMENT
/begin MEASUREMENT ed_fil_dmtl_grobleck.filter_nv "Filterwert vor und nach Eintrag [RAM name from V530, interpolated]" UBYTE M_FORMULA_0003 0 0 0 255 ECU_ADDRESS 0x3FA5BE /end MEASUREMENT
/begin MEASUREMENT ed_fil_dmtl_grobleck.zyklus_filter_nv "Vorwaertsfilter zur Fehlerzustandsbestaetigung [RAM name from V530, interpolated]" UBYTE M_FORMULA_0003 0 0 0 255 ECU_ADDRESS 0x3FA5BF /end MEASUREMENT
/begin MEASUREMENT ed_fil_dmtl_h.fehler_aufrufe_nv "Gesamtzahl der Fehleraufrufe [RAM name from V530, interpolated]" UBYTE M_FORMULA_0003 0 0 0 255 ECU_ADDRESS 0x3FA5BD /end MEASUREMENT
/begin MEASUREMENT ed_fil_dmtl_h.filter_max_nv "Maximaler Fehlerfilterwert [RAM name from V530, interpolated]" UBYTE M_FORMULA_0003 0 0 0 255 ECU_ADDRESS 0x3FA5BC /end MEASUREMENT
/begin MEASUREMENT ed_fil_dmtl_feucht.filter_nv "Filterwert vor und nach Eintrag [RAM name from V530, interpolated]" UBYTE M_FORMULA_0003 0 0 0 255 ECU_ADDRESS 0x3FA5C4 /end MEASUREMENT
/begin MEASUREMENT ed_fil_dmtl_feucht.zyklus_filter_nv "Vorwaertsfilter zur Fehlerzustandsbestaetigung [RAM name from V530, interpolated]" UBYTE M_FORMULA_0003 0 0 0 255 ECU_ADDRESS 0x3FA5C5 /end MEASUREMENT
/begin MEASUREMENT ed_fil_dmtl_grobleck.fehler_aufrufe_nv "Gesamtzahl der Fehleraufrufe [RAM name from V530, interpolated]" UBYTE M_FORMULA_0003 0 0 0 255 ECU_ADDRESS 0x3FA5C3 /end MEASUREMENT
/begin MEASUREMENT ed_fil_dmtl_grobleck.filter_max_nv "Maximaler Fehlerfilterwert [RAM name from V530, interpolated]" UBYTE M_FORMULA_0003 0 0 0 255 ECU_ADDRESS 0x3FA5C2 /end MEASUREMENT
/begin MEASUREMENT ed_fil_dmtl_deckel.filter_nv "Filterwert vor und nach Eintrag [RAM name from V530, interpolated]" UBYTE M_FORMULA_0003 0 0 0 255 ECU_ADDRESS 0x3FA5CA /end MEASUREMENT
/begin MEASUREMENT ed_fil_dmtl_deckel.zyklus_filter_nv "Vorwaertsfilter zur Fehlerzustandsbestaetigung [RAM name from V530, interpolated]" UBYTE M_FORMULA_0003 0 0 0 255 ECU_ADDRESS 0x3FA5CB /end MEASUREMENT
/begin MEASUREMENT ed_fil_dmtl_feucht.fehler_aufrufe_nv "Gesamtzahl der Fehleraufrufe [RAM name from V530, interpolated]" UBYTE M_FORMULA_0003 0 0 0 255 ECU_ADDRESS 0x3FA5C9 /end MEASUREMENT
/begin MEASUREMENT ed_fil_dmtl_feucht.filter_max_nv "Maximaler Fehlerfilterwert [RAM name from V530, interpolated]" UBYTE M_FORMULA_0003 0 0 0 255 ECU_ADDRESS 0x3FA5C8 /end MEASUREMENT
/begin MEASUREMENT ed_fil_dmtl_deckel.fehler_aufrufe_nv "Gesamtzahl der Fehleraufrufe [RAM name from V530, interpolated]" UBYTE M_FORMULA_0003 0 0 0 255 ECU_ADDRESS 0x3FA5CF /end MEASUREMENT
/begin MEASUREMENT ed_fil_dmtl_deckel.filter_max_nv "Maximaler Fehlerfilterwert [RAM name from V530, interpolated]" UBYTE M_FORMULA_0003 0 0 0 255 ECU_ADDRESS 0x3FA5CE /end MEASUREMENT
/begin MEASUREMENT ed_fil_ekp_pwm.filter_nv "Filterwert vor und nach Eintrag [RAM name from V530, interpolated]" UBYTE M_FORMULA_0003 0 0 0 255 ECU_ADDRESS 0x3FA5E2 /end MEASUREMENT
/begin MEASUREMENT ed_fil_ekp_pwm.zyklus_filter_nv "Vorwaertsfilter zur Fehlerzustandsbestaetigung [RAM name from V530, interpolated]" UBYTE M_FORMULA_0003 0 0 0 255 ECU_ADDRESS 0x3FA5E3 /end MEASUREMENT
/begin MEASUREMENT ed_fil_lavk1_trim.art_aktuell_nv "Fehlerart und Statusbits [RAM name from V530, interpolated]" UWORD NO_COMPU_METHOD 0 0 0 65535 ECU_ADDRESS 0x3FA5D2 FORMAT "%.4g" /end MEASUREMENT
/begin MEASUREMENT ed_fil_lavk1_trim.fehler_aufrufe_nv "Gesamtzahl der Fehleraufrufe [RAM name from V530, interpolated]" UBYTE M_FORMULA_0003 0 0 0 255 ECU_ADDRESS 0x3FA5D5 /end MEASUREMENT
/begin MEASUREMENT ed_fil_lavk1_trim.filter_max_nv "Maximaler Fehlerfilterwert [RAM name from V530, interpolated]" UBYTE M_FORMULA_0003 0 0 0 255 ECU_ADDRESS 0x3FA5D4 /end MEASUREMENT
/begin MEASUREMENT ed_fil_lavk1_trim.filter_nv "Filterwert vor und nach Eintrag [RAM name from V530, interpolated]" UBYTE M_FORMULA_0003 0 0 0 255 ECU_ADDRESS 0x3FA5D0 /end MEASUREMENT
/begin MEASUREMENT ed_fil_lavk1_trim.zyklus_filter_nv "Vorwaertsfilter zur Fehlerzustandsbestaetigung [RAM name from V530, interpolated]" UBYTE M_FORMULA_0003 0 0 0 255 ECU_ADDRESS 0x3FA5D1 /end MEASUREMENT
/begin MEASUREMENT ed_fil_lavk2_trim.art_aktuell_nv "Fehlerart und Statusbits [RAM name from V530, interpolated]" UWORD NO_COMPU_METHOD 0 0 0 65535 ECU_ADDRESS 0x3FA5D8 FORMAT "%.4g" /end MEASUREMENT
/begin MEASUREMENT ed_fil_lavk2_trim.fehler_aufrufe_nv "Gesamtzahl der Fehleraufrufe [RAM name from V530, interpolated]" UBYTE M_FORMULA_0003 0 0 0 255 ECU_ADDRESS 0x3FA5DB /end MEASUREMENT
/begin MEASUREMENT ed_fil_lavk2_trim.filter_max_nv "Maximaler Fehlerfilterwert [RAM name from V530, interpolated]" UBYTE M_FORMULA_0003 0 0 0 255 ECU_ADDRESS 0x3FA5DA /end MEASUREMENT
/begin MEASUREMENT ed_fil_lavk2_trim.filter_nv "Filterwert vor und nach Eintrag [RAM name from V530, interpolated]" UBYTE M_FORMULA_0003 0 0 0 255 ECU_ADDRESS 0x3FA5D6 /end MEASUREMENT
/begin MEASUREMENT ed_fil_lavk2_trim.zyklus_filter_nv "Vorwaertsfilter zur Fehlerzustandsbestaetigung [RAM name from V530, interpolated]" UBYTE M_FORMULA_0003 0 0 0 255 ECU_ADDRESS 0x3FA5D7 /end MEASUREMENT
/begin MEASUREMENT ed_fil_rlu87.art_aktuell_nv "Fehlerart und Statusbits [RAM name from V530, interpolated]" UWORD NO_COMPU_METHOD 0 0 0 65535 ECU_ADDRESS 0x3FA5DE FORMAT "%.4g" /end MEASUREMENT
/begin MEASUREMENT ed_fil_rlu87.fehler_aufrufe_nv "Gesamtzahl der Fehleraufrufe [RAM name from V530, interpolated]" UBYTE M_FORMULA_0003 0 0 0 255 ECU_ADDRESS 0x3FA5E1 /end MEASUREMENT
/begin MEASUREMENT ed_fil_rlu87.filter_max_nv "Maximaler Fehlerfilterwert [RAM name from V530, interpolated]" UBYTE M_FORMULA_0003 0 0 0 255 ECU_ADDRESS 0x3FA5E0 /end MEASUREMENT
/begin MEASUREMENT ed_fil_rlu87.filter_nv "Filterwert vor und nach Eintrag [RAM name from V530, interpolated]" UBYTE M_FORMULA_0003 0 0 0 255 ECU_ADDRESS 0x3FA5DC /end MEASUREMENT
/begin MEASUREMENT ed_fil_rlu87.zyklus_filter_nv "Vorwaertsfilter zur Fehlerzustandsbestaetigung [RAM name from V530, interpolated]" UBYTE M_FORMULA_0003 0 0 0 255 ECU_ADDRESS 0x3FA5DD /end MEASUREMENT
/begin MEASUREMENT ed_fil_codierung.filter_nv "Filterwert vor und nach Eintrag [RAM name from V530, interpolated]" UBYTE M_FORMULA_0003 0 0 0 255 ECU_ADDRESS 0x3FA5E8 /end MEASUREMENT
/begin MEASUREMENT ed_fil_codierung.zyklus_filter_nv "Vorwaertsfilter zur Fehlerzustandsbestaetigung [RAM name from V530, interpolated]" UBYTE M_FORMULA_0003 0 0 0 255 ECU_ADDRESS 0x3FA5E9 /end MEASUREMENT
/begin MEASUREMENT ed_fil_ekp_pwm.fehler_aufrufe_nv "Gesamtzahl der Fehleraufrufe [RAM name from V530, interpolated]" UBYTE M_FORMULA_0003 0 0 0 255 ECU_ADDRESS 0x3FA5E7 /end MEASUREMENT
/begin MEASUREMENT ed_fil_ekp_pwm.filter_max_nv "Maximaler Fehlerfilterwert [RAM name from V530, interpolated]" UBYTE M_FORMULA_0003 0 0 0 255 ECU_ADDRESS 0x3FA5E6 /end MEASUREMENT
/begin MEASUREMENT ed_fil_codierung.fehler_aufrufe_nv "Gesamtzahl der Fehleraufrufe [RAM name from V530, interpolated]" UBYTE M_FORMULA_0003 0 0 0 255 ECU_ADDRESS 0x3FA5ED /end MEASUREMENT
/begin MEASUREMENT ed_fil_codierung.filter_max_nv "Maximaler Fehlerfilterwert [RAM name from V530, interpolated]" UBYTE M_FORMULA_0003 0 0 0 255 ECU_ADDRESS 0x3FA5EC /end MEASUREMENT
/begin MEASUREMENT ed_fil_td.filter_nv "Filterwert vor und nach Eintrag [RAM name from V530, interpolated]" UBYTE M_FORMULA_0003 0 0 0 255 ECU_ADDRESS 0x3FA5EE /end MEASUREMENT
/begin MEASUREMENT ed_fil_td.zyklus_filter_nv "Vorwaertsfilter zur Fehlerzustandsbestaetigung [RAM name from V530, interpolated]" UBYTE M_FORMULA_0003 0 0 0 255 ECU_ADDRESS 0x3FA5EF /end MEASUREMENT
/begin MEASUREMENT ed_fil_rlslp.filter_nv "Filterwert vor und nach Eintrag [RAM name from V530, interpolated]" UBYTE M_FORMULA_0003 0 0 0 255 ECU_ADDRESS 0x3FA5F4 /end MEASUREMENT
/begin MEASUREMENT ed_fil_rlslp.zyklus_filter_nv "Vorwaertsfilter zur Fehlerzustandsbestaetigung [RAM name from V530, interpolated]" UBYTE M_FORMULA_0003 0 0 0 255 ECU_ADDRESS 0x3FA5F5 /end MEASUREMENT
/begin MEASUREMENT ed_fil_td.fehler_aufrufe_nv "Gesamtzahl der Fehleraufrufe [RAM name from V530, interpolated]" UBYTE M_FORMULA_0003 0 0 0 255 ECU_ADDRESS 0x3FA5F3 /end MEASUREMENT
/begin MEASUREMENT ed_fil_td.filter_max_nv "Maximaler Fehlerfilterwert [RAM name from V530, interpolated]" UBYTE M_FORMULA_0003 0 0 0 255 ECU_ADDRESS 0x3FA5F2 /end MEASUREMENT
/begin MEASUREMENT ed_fil_pks_ll.filter_nv "Filterwert vor und nach Eintrag [RAM name from V530, interpolated]" UBYTE M_FORMULA_0003 0 0 0 255 ECU_ADDRESS 0x3FA60C /end MEASUREMENT
/begin MEASUREMENT ed_fil_pks_ll.zyklus_filter_nv "Vorwaertsfilter zur Fehlerzustandsbestaetigung [RAM name from V530, interpolated]" UBYTE M_FORMULA_0003 0 0 0 255 ECU_ADDRESS 0x3FA60D /end MEASUREMENT
/begin MEASUREMENT ed_fil_pt_km.art_aktuell_nv "Fehlerart und Statusbits [RAM name from V530, interpolated]" UWORD NO_COMPU_METHOD 0 0 0 65535 ECU_ADDRESS 0x3FA602 FORMAT "%.4g" /end MEASUREMENT
/begin MEASUREMENT ed_fil_pt_km.fehler_aufrufe_nv "Gesamtzahl der Fehleraufrufe [RAM name from V530, interpolated]" UBYTE M_FORMULA_0003 0 0 0 255 ECU_ADDRESS 0x3FA605 /end MEASUREMENT
/begin MEASUREMENT ed_fil_pt_km.filter_max_nv "Maximaler Fehlerfilterwert [RAM name from V530, interpolated]" UBYTE M_FORMULA_0003 0 0 0 255 ECU_ADDRESS 0x3FA604 /end MEASUREMENT
/begin MEASUREMENT ed_fil_pt_km.filter_nv "Filterwert vor und nach Eintrag [RAM name from V530, interpolated]" UBYTE M_FORMULA_0003 0 0 0 255 ECU_ADDRESS 0x3FA600 /end MEASUREMENT
/begin MEASUREMENT ed_fil_pt_km.zyklus_filter_nv "Vorwaertsfilter zur Fehlerzustandsbestaetigung [RAM name from V530, interpolated]" UBYTE M_FORMULA_0003 0 0 0 255 ECU_ADDRESS 0x3FA601 /end MEASUREMENT
/begin MEASUREMENT ed_fil_pt_kombi.art_aktuell_nv "Fehlerart und Statusbits [RAM name from V530, interpolated]" UWORD NO_COMPU_METHOD 0 0 0 65535 ECU_ADDRESS 0x3FA608 FORMAT "%.4g" /end MEASUREMENT
/begin MEASUREMENT ed_fil_pt_kombi.fehler_aufrufe_nv "Gesamtzahl der Fehleraufrufe [RAM name from V530, interpolated]" UBYTE M_FORMULA_0003 0 0 0 255 ECU_ADDRESS 0x3FA60B /end MEASUREMENT
/begin MEASUREMENT ed_fil_pt_kombi.filter_max_nv "Maximaler Fehlerfilterwert [RAM name from V530, interpolated]" UBYTE M_FORMULA_0003 0 0 0 255 ECU_ADDRESS 0x3FA60A /end MEASUREMENT
/begin MEASUREMENT ed_fil_pt_kombi.filter_nv "Filterwert vor und nach Eintrag [RAM name from V530, interpolated]" UBYTE M_FORMULA_0003 0 0 0 255 ECU_ADDRESS 0x3FA606 /end MEASUREMENT
/begin MEASUREMENT ed_fil_pt_kombi.zyklus_filter_nv "Vorwaertsfilter zur Fehlerzustandsbestaetigung [RAM name from V530, interpolated]" UBYTE M_FORMULA_0003 0 0 0 255 ECU_ADDRESS 0x3FA607 /end MEASUREMENT
/begin MEASUREMENT ed_fil_rlslp.fehler_aufrufe_nv "Gesamtzahl der Fehleraufrufe [RAM name from V530, interpolated]" UBYTE M_FORMULA_0003 0 0 0 255 ECU_ADDRESS 0x3FA5F9 /end MEASUREMENT
/begin MEASUREMENT ed_fil_rlslp.filter_max_nv "Maximaler Fehlerfilterwert [RAM name from V530, interpolated]" UBYTE M_FORMULA_0003 0 0 0 255 ECU_ADDRESS 0x3FA5F8 /end MEASUREMENT
/begin MEASUREMENT ed_fil_slv.art_aktuell_nv "Fehlerart und Statusbits [RAM name from V530, interpolated]" UWORD NO_COMPU_METHOD 0 0 0 65535 ECU_ADDRESS 0x3FA5FC FORMAT "%.4g" /end MEASUREMENT
/begin MEASUREMENT ed_fil_slv.fehler_aufrufe_nv "Gesamtzahl der Fehleraufrufe [RAM name from V530, interpolated]" UBYTE M_FORMULA_0003 0 0 0 255 ECU_ADDRESS 0x3FA5FF /end MEASUREMENT
/begin MEASUREMENT ed_fil_slv.filter_max_nv "Maximaler Fehlerfilterwert [RAM name from V530, interpolated]" UBYTE M_FORMULA_0003 0 0 0 255 ECU_ADDRESS 0x3FA5FE /end MEASUREMENT
/begin MEASUREMENT ed_fil_slv.filter_nv "Filterwert vor und nach Eintrag [RAM name from V530, interpolated]" UBYTE M_FORMULA_0003 0 0 0 255 ECU_ADDRESS 0x3FA5FA /end MEASUREMENT
/begin MEASUREMENT ed_fil_slv.zyklus_filter_nv "Vorwaertsfilter zur Fehlerzustandsbestaetigung [RAM name from V530, interpolated]" UBYTE M_FORMULA_0003 0 0 0 255 ECU_ADDRESS 0x3FA5FB /end MEASUREMENT
/begin MEASUREMENT ed_fil_pks_ll.fehler_aufrufe_nv "Gesamtzahl der Fehleraufrufe [RAM name from V530, interpolated]" UBYTE M_FORMULA_0003 0 0 0 255 ECU_ADDRESS 0x3FA611 /end MEASUREMENT
/begin MEASUREMENT ed_fil_pks_ll.filter_max_nv "Maximaler Fehlerfilterwert [RAM name from V530, interpolated]" UBYTE M_FORMULA_0003 0 0 0 255 ECU_ADDRESS 0x3FA610 /end MEASUREMENT
/begin MEASUREMENT ed_fil_pks_tl.filter_nv "Filterwert vor und nach Eintrag [RAM name from V530, interpolated]" UBYTE M_FORMULA_0003 0 0 0 255 ECU_ADDRESS 0x3FA612 /end MEASUREMENT
/begin MEASUREMENT ed_fil_pks_tl.zyklus_filter_nv "Vorwaertsfilter zur Fehlerzustandsbestaetigung [RAM name from V530, interpolated]" UBYTE M_FORMULA_0003 0 0 0 255 ECU_ADDRESS 0x3FA613 /end MEASUREMENT
/begin MEASUREMENT ed_fil_pks_q.filter_nv "Filterwert vor und nach Eintrag [RAM name from V530, interpolated]" UBYTE M_FORMULA_0003 0 0 0 255 ECU_ADDRESS 0x3FA618 /end MEASUREMENT
/begin MEASUREMENT ed_fil_pks_q.zyklus_filter_nv "Vorwaertsfilter zur Fehlerzustandsbestaetigung [RAM name from V530, interpolated]" UBYTE M_FORMULA_0003 0 0 0 255 ECU_ADDRESS 0x3FA619 /end MEASUREMENT
/begin MEASUREMENT ed_fil_pks_tl.fehler_aufrufe_nv "Gesamtzahl der Fehleraufrufe [RAM name from V530, interpolated]" UBYTE M_FORMULA_0003 0 0 0 255 ECU_ADDRESS 0x3FA617 /end MEASUREMENT
/begin MEASUREMENT ed_fil_pks_tl.filter_max_nv "Maximaler Fehlerfilterwert [RAM name from V530, interpolated]" UBYTE M_FORMULA_0003 0 0 0 255 ECU_ADDRESS 0x3FA616 /end MEASUREMENT
/begin MEASUREMENT ed_fil_kat_obd1.filter_nv "Filterwert vor und nach Eintrag [RAM name from V530, interpolated]" UBYTE M_FORMULA_0003 0 0 0 255 ECU_ADDRESS 0x3FA61E /end MEASUREMENT
/begin MEASUREMENT ed_fil_kat_obd1.zyklus_filter_nv "Vorwaertsfilter zur Fehlerzustandsbestaetigung [RAM name from V530, interpolated]" UBYTE M_FORMULA_0003 0 0 0 255 ECU_ADDRESS 0x3FA61F /end MEASUREMENT
/begin MEASUREMENT ed_fil_pks_q.fehler_aufrufe_nv "Gesamtzahl der Fehleraufrufe [RAM name from V530, interpolated]" UBYTE M_FORMULA_0003 0 0 0 255 ECU_ADDRESS 0x3FA61D /end MEASUREMENT
/begin MEASUREMENT ed_fil_pks_q.filter_max_nv "Maximaler Fehlerfilterwert [RAM name from V530, interpolated]" UBYTE M_FORMULA_0003 0 0 0 255 ECU_ADDRESS 0x3FA61C /end MEASUREMENT
/begin MEASUREMENT ed_fil_kat_obd1.fehler_aufrufe_nv "Gesamtzahl der Fehleraufrufe [RAM name from V530, interpolated]" UBYTE M_FORMULA_0003 0 0 0 255 ECU_ADDRESS 0x3FA623 /end MEASUREMENT
/begin MEASUREMENT ed_fil_kat_obd1.filter_max_nv "Maximaler Fehlerfilterwert [RAM name from V530, interpolated]" UBYTE M_FORMULA_0003 0 0 0 255 ECU_ADDRESS 0x3FA622 /end MEASUREMENT
/begin MEASUREMENT ed_fil_kat_obd2.filter_nv "Filterwert vor und nach Eintrag [RAM name from V530, interpolated]" UBYTE M_FORMULA_0003 0 0 0 255 ECU_ADDRESS 0x3FA624 /end MEASUREMENT
/begin MEASUREMENT ed_fil_kat_obd2.zyklus_filter_nv "Vorwaertsfilter zur Fehlerzustandsbestaetigung [RAM name from V530, interpolated]" UBYTE M_FORMULA_0003 0 0 0 255 ECU_ADDRESS 0x3FA625 /end MEASUREMENT
/begin MEASUREMENT ed_fil_kat_obd2.fehler_aufrufe_nv "Gesamtzahl der Fehleraufrufe [RAM name from V530, interpolated]" UBYTE M_FORMULA_0003 0 0 0 255 ECU_ADDRESS 0x3FA629 /end MEASUREMENT
/begin MEASUREMENT ed_fil_kat_obd2.filter_max_nv "Maximaler Fehlerfilterwert [RAM name from V530, interpolated]" UBYTE M_FORMULA_0003 0 0 0 255 ECU_ADDRESS 0x3FA628 /end MEASUREMENT
/begin MEASUREMENT ed_fil_van_dsv.filter_nv "Filterwert vor und nach Eintrag [RAM name from V530, interpolated]" UBYTE M_FORMULA_0003 0 0 0 255 ECU_ADDRESS 0x3FA62A /end MEASUREMENT
/begin MEASUREMENT ed_fil_van_dsv.zyklus_filter_nv "Vorwaertsfilter zur Fehlerzustandsbestaetigung [RAM name from V530, interpolated]" UBYTE M_FORMULA_0003 0 0 0 255 ECU_ADDRESS 0x3FA62B /end MEASUREMENT
/begin MEASUREMENT ed_fil_fi_bsd.art_aktuell_nv "Fehlerart und Statusbits [RAM name from V530, interpolated]" UWORD NO_COMPU_METHOD 0 0 0 65535 ECU_ADDRESS 0x3FA638 FORMAT "%.4g" /end MEASUREMENT
/begin MEASUREMENT ed_fil_fi_bsd.fehler_aufrufe_nv "Gesamtzahl der Fehleraufrufe [RAM name from V530, interpolated]" UBYTE M_FORMULA_0003 0 0 0 255 ECU_ADDRESS 0x3FA63B /end MEASUREMENT
/begin MEASUREMENT ed_fil_fi_bsd.filter_max_nv "Maximaler Fehlerfilterwert [RAM name from V530, interpolated]" UBYTE M_FORMULA_0003 0 0 0 255 ECU_ADDRESS 0x3FA63A /end MEASUREMENT
/begin MEASUREMENT ed_fil_fi_bsd.filter_nv "Filterwert vor und nach Eintrag [RAM name from V530, interpolated]" UBYTE M_FORMULA_0003 0 0 0 255 ECU_ADDRESS 0x3FA636 /end MEASUREMENT
/begin MEASUREMENT ed_fil_fi_bsd.zyklus_filter_nv "Vorwaertsfilter zur Fehlerzustandsbestaetigung [RAM name from V530, interpolated]" UBYTE M_FORMULA_0003 0 0 0 255 ECU_ADDRESS 0x3FA637 /end MEASUREMENT
/begin MEASUREMENT ed_fil_fi_gen.art_aktuell_nv "Fehlerart und Statusbits [RAM name from V530, interpolated]" UWORD NO_COMPU_METHOD 0 0 0 65535 ECU_ADDRESS 0x3FA632 FORMAT "%.4g" /end MEASUREMENT
/begin MEASUREMENT ed_fil_fi_gen.fehler_aufrufe_nv "Gesamtzahl der Fehleraufrufe [RAM name from V530, interpolated]" UBYTE M_FORMULA_0003 0 0 0 255 ECU_ADDRESS 0x3FA635 /end MEASUREMENT
/begin MEASUREMENT ed_fil_fi_gen.filter_max_nv "Maximaler Fehlerfilterwert [RAM name from V530, interpolated]" UBYTE M_FORMULA_0003 0 0 0 255 ECU_ADDRESS 0x3FA634 /end MEASUREMENT
/begin MEASUREMENT ed_fil_fi_gen.filter_nv "Filterwert vor und nach Eintrag [RAM name from V530, interpolated]" UBYTE M_FORMULA_0003 0 0 0 255 ECU_ADDRESS 0x3FA630 /end MEASUREMENT
/begin MEASUREMENT ed_fil_fi_gen.zyklus_filter_nv "Vorwaertsfilter zur Fehlerzustandsbestaetigung [RAM name from V530, interpolated]" UBYTE M_FORMULA_0003 0 0 0 255 ECU_ADDRESS 0x3FA631 /end MEASUREMENT
/begin MEASUREMENT ed_fil_fi_ibs1.art_aktuell_nv "Fehlerart und Statusbits [RAM name from V530, interpolated]" UWORD NO_COMPU_METHOD 0 0 0 65535 ECU_ADDRESS 0x3FA644 FORMAT "%.4g" /end MEASUREMENT
/begin MEASUREMENT ed_fil_fi_ibs1.fehler_aufrufe_nv "Gesamtzahl der Fehleraufrufe [RAM name from V530, interpolated]" UBYTE M_FORMULA_0003 0 0 0 255 ECU_ADDRESS 0x3FA647 /end MEASUREMENT
/begin MEASUREMENT ed_fil_fi_ibs1.filter_max_nv "Maximaler Fehlerfilterwert [RAM name from V530, interpolated]" UBYTE M_FORMULA_0003 0 0 0 255 ECU_ADDRESS 0x3FA646 /end MEASUREMENT
/begin MEASUREMENT ed_fil_fi_ibs1.filter_nv "Filterwert vor und nach Eintrag [RAM name from V530, interpolated]" UBYTE M_FORMULA_0003 0 0 0 255 ECU_ADDRESS 0x3FA642 /end MEASUREMENT
/begin MEASUREMENT ed_fil_fi_ibs1.zyklus_filter_nv "Vorwaertsfilter zur Fehlerzustandsbestaetigung [RAM name from V530, interpolated]" UBYTE M_FORMULA_0003 0 0 0 255 ECU_ADDRESS 0x3FA643 /end MEASUREMENT
/begin MEASUREMENT ed_fil_fi_ibs2.art_aktuell_nv "Fehlerart und Statusbits [RAM name from V530, interpolated]" UWORD NO_COMPU_METHOD 0 0 0 65535 ECU_ADDRESS 0x3FA64A FORMAT "%.4g" /end MEASUREMENT
/begin MEASUREMENT ed_fil_fi_ibs2.fehler_aufrufe_nv "Gesamtzahl der Fehleraufrufe [RAM name from V530, interpolated]" UBYTE M_FORMULA_0003 0 0 0 255 ECU_ADDRESS 0x3FA64D /end MEASUREMENT
/begin MEASUREMENT ed_fil_fi_ibs2.filter_max_nv "Maximaler Fehlerfilterwert [RAM name from V530, interpolated]" UBYTE M_FORMULA_0003 0 0 0 255 ECU_ADDRESS 0x3FA64C /end MEASUREMENT
/begin MEASUREMENT ed_fil_fi_ibs2.filter_nv "Filterwert vor und nach Eintrag [RAM name from V530, interpolated]" UBYTE M_FORMULA_0003 0 0 0 255 ECU_ADDRESS 0x3FA648 /end MEASUREMENT
/begin MEASUREMENT ed_fil_fi_ibs2.zyklus_filter_nv "Vorwaertsfilter zur Fehlerzustandsbestaetigung [RAM name from V530, interpolated]" UBYTE M_FORMULA_0003 0 0 0 255 ECU_ADDRESS 0x3FA649 /end MEASUREMENT
/begin MEASUREMENT ed_fil_fi_ibs3.filter_nv "Filterwert vor und nach Eintrag [RAM name from V530, interpolated]" UBYTE M_FORMULA_0003 0 0 0 255 ECU_ADDRESS 0x3FA64E /end MEASUREMENT
/begin MEASUREMENT ed_fil_fi_ibs3.zyklus_filter_nv "Vorwaertsfilter zur Fehlerzustandsbestaetigung [RAM name from V530, interpolated]" UBYTE M_FORMULA_0003 0 0 0 255 ECU_ADDRESS 0x3FA64F /end MEASUREMENT
/begin MEASUREMENT ed_fil_fi_qlt.art_aktuell_nv "Fehlerart und Statusbits [RAM name from V530, interpolated]" UWORD NO_COMPU_METHOD 0 0 0 65535 ECU_ADDRESS 0x3FA63E FORMAT "%.4g" /end MEASUREMENT
/begin MEASUREMENT ed_fil_fi_qlt.fehler_aufrufe_nv "Gesamtzahl der Fehleraufrufe [RAM name from V530, interpolated]" UBYTE M_FORMULA_0003 0 0 0 255 ECU_ADDRESS 0x3FA641 /end MEASUREMENT
/begin MEASUREMENT ed_fil_fi_qlt.filter_max_nv "Maximaler Fehlerfilterwert [RAM name from V530, interpolated]" UBYTE M_FORMULA_0003 0 0 0 255 ECU_ADDRESS 0x3FA640 /end MEASUREMENT
/begin MEASUREMENT ed_fil_fi_qlt.filter_nv "Filterwert vor und nach Eintrag [RAM name from V530, interpolated]" UBYTE M_FORMULA_0003 0 0 0 255 ECU_ADDRESS 0x3FA63C /end MEASUREMENT
/begin MEASUREMENT ed_fil_fi_qlt.zyklus_filter_nv "Vorwaertsfilter zur Fehlerzustandsbestaetigung [RAM name from V530, interpolated]" UBYTE M_FORMULA_0003 0 0 0 255 ECU_ADDRESS 0x3FA63D /end MEASUREMENT
/begin MEASUREMENT ed_fil_van_dsv.fehler_aufrufe_nv "Gesamtzahl der Fehleraufrufe [RAM name from V530, interpolated]" UBYTE M_FORMULA_0003 0 0 0 255 ECU_ADDRESS 0x3FA62F /end MEASUREMENT
/begin MEASUREMENT ed_fil_van_dsv.filter_max_nv "Maximaler Fehlerfilterwert [RAM name from V530, interpolated]" UBYTE M_FORMULA_0003 0 0 0 255 ECU_ADDRESS 0x3FA62E /end MEASUREMENT
/begin MEASUREMENT ed_fil_ews_sci.filter_nv "Filterwert vor und nach Eintrag [RAM name from V530, interpolated]" UBYTE M_FORMULA_0003 0 0 0 255 ECU_ADDRESS 0x3FA678 /end MEASUREMENT
/begin MEASUREMENT ed_fil_ews_sci.zyklus_filter_nv "Vorwaertsfilter zur Fehlerzustandsbestaetigung [RAM name from V530, interpolated]" UBYTE M_FORMULA_0003 0 0 0 255 ECU_ADDRESS 0x3FA679 /end MEASUREMENT
/begin MEASUREMENT ed_fil_fi_ibs3.fehler_aufrufe_nv "Gesamtzahl der Fehleraufrufe [RAM name from V530, interpolated]" UBYTE M_FORMULA_0003 0 0 0 255 ECU_ADDRESS 0x3FA653 /end MEASUREMENT
/begin MEASUREMENT ed_fil_fi_ibs3.filter_max_nv "Maximaler Fehlerfilterwert [RAM name from V530, interpolated]" UBYTE M_FORMULA_0003 0 0 0 255 ECU_ADDRESS 0x3FA652 /end MEASUREMENT
/begin MEASUREMENT ed_fil_fi_pmbatt.art_aktuell_nv "Fehlerart und Statusbits [RAM name from V530, interpolated]" UWORD NO_COMPU_METHOD 0 0 0 65535 ECU_ADDRESS 0x3FA65C FORMAT "%.4g" /end MEASUREMENT
/begin MEASUREMENT ed_fil_fi_pmbatt.fehler_aufrufe_nv "Gesamtzahl der Fehleraufrufe [RAM name from V530, interpolated]" UBYTE M_FORMULA_0003 0 0 0 255 ECU_ADDRESS 0x3FA65F /end MEASUREMENT
/begin MEASUREMENT ed_fil_fi_pmbatt.filter_max_nv "Maximaler Fehlerfilterwert [RAM name from V530, interpolated]" UBYTE M_FORMULA_0003 0 0 0 255 ECU_ADDRESS 0x3FA65E /end MEASUREMENT
/begin MEASUREMENT ed_fil_fi_pmbatt.filter_nv "Filterwert vor und nach Eintrag [RAM name from V530, interpolated]" UBYTE M_FORMULA_0003 0 0 0 255 ECU_ADDRESS 0x3FA65A /end MEASUREMENT
/begin MEASUREMENT ed_fil_fi_pmbatt.zyklus_filter_nv "Vorwaertsfilter zur Fehlerzustandsbestaetigung [RAM name from V530, interpolated]" UBYTE M_FORMULA_0003 0 0 0 255 ECU_ADDRESS 0x3FA65B /end MEASUREMENT
/begin MEASUREMENT ed_fil_fi_pmbn.art_aktuell_nv "Fehlerart und Statusbits [RAM name from V530, interpolated]" UWORD NO_COMPU_METHOD 0 0 0 65535 ECU_ADDRESS 0x3FA656 FORMAT "%.4g" /end MEASUREMENT
/begin MEASUREMENT ed_fil_fi_pmbn.fehler_aufrufe_nv "Gesamtzahl der Fehleraufrufe [RAM name from V530, interpolated]" UBYTE M_FORMULA_0003 0 0 0 255 ECU_ADDRESS 0x3FA659 /end MEASUREMENT
/begin MEASUREMENT ed_fil_fi_pmbn.filter_max_nv "Maximaler Fehlerfilterwert [RAM name from V530, interpolated]" UBYTE M_FORMULA_0003 0 0 0 255 ECU_ADDRESS 0x3FA658 /end MEASUREMENT
/begin MEASUREMENT ed_fil_fi_pmbn.filter_nv "Filterwert vor und nach Eintrag [RAM name from V530, interpolated]" UBYTE M_FORMULA_0003 0 0 0 255 ECU_ADDRESS 0x3FA654 /end MEASUREMENT
/begin MEASUREMENT ed_fil_fi_pmbn.zyklus_filter_nv "Vorwaertsfilter zur Fehlerzustandsbestaetigung [RAM name from V530, interpolated]" UBYTE M_FORMULA_0003 0 0 0 255 ECU_ADDRESS 0x3FA655 /end MEASUREMENT
/begin MEASUREMENT ed_fil_index_135_inj.art_aktuell_nv "Fehlerart und Statusbits [RAM name from V530, interpolated]" UWORD NO_COMPU_METHOD 0 0 0 65535 ECU_ADDRESS 0x3FA674 FORMAT "%.4g" /end MEASUREMENT
/begin MEASUREMENT ed_fil_index_135_inj.fehler_aufrufe_nv "Gesamtzahl der Fehleraufrufe [RAM name from V530, interpolated]" UBYTE M_FORMULA_0003 0 0 0 255 ECU_ADDRESS 0x3FA677 /end MEASUREMENT
/begin MEASUREMENT ed_fil_index_135_inj.filter_max_nv "Maximaler Fehlerfilterwert [RAM name from V530, interpolated]" UBYTE M_FORMULA_0003 0 0 0 255 ECU_ADDRESS 0x3FA676 /end MEASUREMENT
/begin MEASUREMENT ed_fil_index_135_inj.filter_nv "Filterwert vor und nach Eintrag [RAM name from V530, interpolated]" UBYTE M_FORMULA_0003 0 0 0 255 ECU_ADDRESS 0x3FA672 /end MEASUREMENT
/begin MEASUREMENT ed_fil_index_135_inj.zyklus_filter_nv "Vorwaertsfilter zur Fehlerzustandsbestaetigung [RAM name from V530, interpolated]" UBYTE M_FORMULA_0003 0 0 0 255 ECU_ADDRESS 0x3FA673 /end MEASUREMENT
/begin MEASUREMENT ed_fil_mvac_drucksensor.art_aktuell_nv "Fehlerart und Statusbits [RAM name from V530, interpolated]" UWORD NO_COMPU_METHOD 0 0 0 65535 ECU_ADDRESS 0x3FA662 FORMAT "%.4g" /end MEASUREMENT
/begin MEASUREMENT ed_fil_mvac_drucksensor.fehler_aufrufe_nv "Gesamtzahl der Fehleraufrufe [RAM name from V530, interpolated]" UBYTE M_FORMULA_0003 0 0 0 255 ECU_ADDRESS 0x3FA665 /end MEASUREMENT
/begin MEASUREMENT ed_fil_mvac_drucksensor.filter_max_nv "Maximaler Fehlerfilterwert [RAM name from V530, interpolated]" UBYTE M_FORMULA_0003 0 0 0 255 ECU_ADDRESS 0x3FA664 /end MEASUREMENT
/begin MEASUREMENT ed_fil_mvac_drucksensor.filter_nv "Filterwert vor und nach Eintrag [RAM name from V530, interpolated]" UBYTE M_FORMULA_0003 0 0 0 255 ECU_ADDRESS 0x3FA660 /end MEASUREMENT
/begin MEASUREMENT ed_fil_mvac_drucksensor.zyklus_filter_nv "Vorwaertsfilter zur Fehlerzustandsbestaetigung [RAM name from V530, interpolated]" UBYTE M_FORMULA_0003 0 0 0 255 ECU_ADDRESS 0x3FA661 /end MEASUREMENT
/begin MEASUREMENT ed_fil_pt_bedat.art_aktuell_nv "Fehlerart und Statusbits [RAM name from V530, interpolated]" UWORD NO_COMPU_METHOD 0 0 0 65535 ECU_ADDRESS 0x3FA668 FORMAT "%.4g" /end MEASUREMENT
/begin MEASUREMENT ed_fil_pt_bedat.fehler_aufrufe_nv "Gesamtzahl der Fehleraufrufe [RAM name from V530, interpolated]" UBYTE M_FORMULA_0003 0 0 0 255 ECU_ADDRESS 0x3FA66B /end MEASUREMENT
/begin MEASUREMENT ed_fil_pt_bedat.filter_max_nv "Maximaler Fehlerfilterwert [RAM name from V530, interpolated]" UBYTE M_FORMULA_0003 0 0 0 255 ECU_ADDRESS 0x3FA66A /end MEASUREMENT
/begin MEASUREMENT ed_fil_pt_bedat.filter_nv "Filterwert vor und nach Eintrag [RAM name from V530, interpolated]" UBYTE M_FORMULA_0003 0 0 0 255 ECU_ADDRESS 0x3FA666 /end MEASUREMENT
/begin MEASUREMENT ed_fil_pt_bedat.zyklus_filter_nv "Vorwaertsfilter zur Fehlerzustandsbestaetigung [RAM name from V530, interpolated]" UBYTE M_FORMULA_0003 0 0 0 255 ECU_ADDRESS 0x3FA667 /end MEASUREMENT
/begin MEASUREMENT ed_fil_sk_manager_inj.art_aktuell_nv "Fehlerart und Statusbits [RAM name from V530, interpolated]" UWORD NO_COMPU_METHOD 0 0 0 65535 ECU_ADDRESS 0x3FA66E FORMAT "%.4g" /end MEASUREMENT
/begin MEASUREMENT ed_fil_sk_manager_inj.fehler_aufrufe_nv "Gesamtzahl der Fehleraufrufe [RAM name from V530, interpolated]" UBYTE M_FORMULA_0003 0 0 0 255 ECU_ADDRESS 0x3FA671 /end MEASUREMENT
/begin MEASUREMENT ed_fil_sk_manager_inj.filter_max_nv "Maximaler Fehlerfilterwert [RAM name from V530, interpolated]" UBYTE M_FORMULA_0003 0 0 0 255 ECU_ADDRESS 0x3FA670 /end MEASUREMENT
/begin MEASUREMENT ed_fil_sk_manager_inj.filter_nv "Filterwert vor und nach Eintrag [RAM name from V530, interpolated]" UBYTE M_FORMULA_0003 0 0 0 255 ECU_ADDRESS 0x3FA66C /end MEASUREMENT
/begin MEASUREMENT ed_fil_sk_manager_inj.zyklus_filter_nv "Vorwaertsfilter zur Fehlerzustandsbestaetigung [RAM name from V530, interpolated]" UBYTE M_FORMULA_0003 0 0 0 255 ECU_ADDRESS 0x3FA66D /end MEASUREMENT
/begin MEASUREMENT ed_fil_ews_man.art_aktuell_nv "Fehlerart und Statusbits [RAM name from V530, interpolated]" UWORD NO_COMPU_METHOD 0 0 0 65535 ECU_ADDRESS 0x3FA680 FORMAT "%.4g" /end MEASUREMENT
/begin MEASUREMENT ed_fil_ews_man.fehler_aufrufe_nv "Gesamtzahl der Fehleraufrufe [RAM name from V530, interpolated]" UBYTE M_FORMULA_0003 0 0 0 255 ECU_ADDRESS 0x3FA683 /end MEASUREMENT
/begin MEASUREMENT ed_fil_ews_man.filter_max_nv "Maximaler Fehlerfilterwert [RAM name from V530, interpolated]" UBYTE M_FORMULA_0003 0 0 0 255 ECU_ADDRESS 0x3FA682 /end MEASUREMENT
/begin MEASUREMENT ed_fil_ews_man.filter_nv "Filterwert vor und nach Eintrag [RAM name from V530, interpolated]" UBYTE M_FORMULA_0003 0 0 0 255 ECU_ADDRESS 0x3FA67E /end MEASUREMENT
/begin MEASUREMENT ed_fil_ews_man.zyklus_filter_nv "Vorwaertsfilter zur Fehlerzustandsbestaetigung [RAM name from V530, interpolated]" UBYTE M_FORMULA_0003 0 0 0 255 ECU_ADDRESS 0x3FA67F /end MEASUREMENT
/begin MEASUREMENT ed_fil_ews_sci.fehler_aufrufe_nv "Gesamtzahl der Fehleraufrufe [RAM name from V530, interpolated]" UBYTE M_FORMULA_0003 0 0 0 255 ECU_ADDRESS 0x3FA67D /end MEASUREMENT
/begin MEASUREMENT ed_fil_ews_sci.filter_max_nv "Maximaler Fehlerfilterwert [RAM name from V530, interpolated]" UBYTE M_FORMULA_0003 0 0 0 255 ECU_ADDRESS 0x3FA67C /end MEASUREMENT
/begin MEASUREMENT ed_fil_fi_bsd_0.art_aktuell_nv "Fehlerart und Statusbits [RAM name from V530, interpolated]" UWORD NO_COMPU_METHOD 0 0 0 65535 ECU_ADDRESS 0x3FA686 FORMAT "%.4g" /end MEASUREMENT
/begin MEASUREMENT ed_fil_fi_bsd_0.fehler_aufrufe_nv "Gesamtzahl der Fehleraufrufe [RAM name from V530, interpolated]" UBYTE M_FORMULA_0003 0 0 0 255 ECU_ADDRESS 0x3FA689 /end MEASUREMENT
/begin MEASUREMENT ed_fil_fi_bsd_0.filter_max_nv "Maximaler Fehlerfilterwert [RAM name from V530, interpolated]" UBYTE M_FORMULA_0003 0 0 0 255 ECU_ADDRESS 0x3FA688 /end MEASUREMENT
/begin MEASUREMENT ed_fil_fi_bsd_0.filter_nv "Filterwert vor und nach Eintrag [RAM name from V530, interpolated]" UBYTE M_FORMULA_0003 0 0 0 255 ECU_ADDRESS 0x3FA684 /end MEASUREMENT
/begin MEASUREMENT ed_fil_fi_bsd_0.zyklus_filter_nv "Vorwaertsfilter zur Fehlerzustandsbestaetigung [RAM name from V530, interpolated]" UBYTE M_FORMULA_0003 0 0 0 255 ECU_ADDRESS 0x3FA685 /end MEASUREMENT
/begin MEASUREMENT ed_fil_fi_bsd_6.art_aktuell_nv "Fehlerart und Statusbits [RAM name from V530, interpolated]" UWORD NO_COMPU_METHOD 0 0 0 65535 ECU_ADDRESS 0x3FA68C FORMAT "%.4g" /end MEASUREMENT
/begin MEASUREMENT ed_fil_fi_bsd_6.fehler_aufrufe_nv "Gesamtzahl der Fehleraufrufe [RAM name from V530, interpolated]" UBYTE M_FORMULA_0003 0 0 0 255 ECU_ADDRESS 0x3FA68F /end MEASUREMENT
/begin MEASUREMENT ed_fil_fi_bsd_6.filter_max_nv "Maximaler Fehlerfilterwert [RAM name from V530, interpolated]" UBYTE M_FORMULA_0003 0 0 0 255 ECU_ADDRESS 0x3FA68E /end MEASUREMENT
/begin MEASUREMENT ed_fil_fi_bsd_6.filter_nv "Filterwert vor und nach Eintrag [RAM name from V530, interpolated]" UBYTE M_FORMULA_0003 0 0 0 255 ECU_ADDRESS 0x3FA68A /end MEASUREMENT
/begin MEASUREMENT ed_fil_fi_bsd_6.zyklus_filter_nv "Vorwaertsfilter zur Fehlerzustandsbestaetigung [RAM name from V530, interpolated]" UBYTE M_FORMULA_0003 0 0 0 255 ECU_ADDRESS 0x3FA68B /end MEASUREMENT
/begin MEASUREMENT ed_fil_fi_bsdglob.art_aktuell_nv "Fehlerart und Statusbits [RAM name from V530, interpolated]" UWORD NO_COMPU_METHOD 0 0 0 65535 ECU_ADDRESS 0x3FA692 FORMAT "%.4g" /end MEASUREMENT
/begin MEASUREMENT ed_fil_fi_bsdglob.fehler_aufrufe_nv "Gesamtzahl der Fehleraufrufe [RAM name from V530, interpolated]" UBYTE M_FORMULA_0003 0 0 0 255 ECU_ADDRESS 0x3FA695 /end MEASUREMENT
/begin MEASUREMENT ed_fil_fi_bsdglob.filter_max_nv "Maximaler Fehlerfilterwert [RAM name from V530, interpolated]" UBYTE M_FORMULA_0003 0 0 0 255 ECU_ADDRESS 0x3FA694 /end MEASUREMENT
/begin MEASUREMENT ed_fil_fi_bsdglob.filter_nv "Filterwert vor und nach Eintrag [RAM name from V530, interpolated]" UBYTE M_FORMULA_0003 0 0 0 255 ECU_ADDRESS 0x3FA690 /end MEASUREMENT
/begin MEASUREMENT ed_fil_fi_bsdglob.zyklus_filter_nv "Vorwaertsfilter zur Fehlerzustandsbestaetigung [RAM name from V530, interpolated]" UBYTE M_FORMULA_0003 0 0 0 255 ECU_ADDRESS 0x3FA691 /end MEASUREMENT
/begin MEASUREMENT ed_fil_fi_pmruhverl.art_aktuell_nv "Fehlerart und Statusbits [RAM name from V530, interpolated]" UWORD NO_COMPU_METHOD 0 0 0 65535 ECU_ADDRESS 0x3FA698 FORMAT "%.4g" /end MEASUREMENT
/begin MEASUREMENT ed_fil_fi_pmruhverl.fehler_aufrufe_nv "Gesamtzahl der Fehleraufrufe [RAM name from V530, interpolated]" UBYTE M_FORMULA_0003 0 0 0 255 ECU_ADDRESS 0x3FA69B /end MEASUREMENT
/begin MEASUREMENT ed_fil_fi_pmruhverl.filter_max_nv "Maximaler Fehlerfilterwert [RAM name from V530, interpolated]" UBYTE M_FORMULA_0003 0 0 0 255 ECU_ADDRESS 0x3FA69A /end MEASUREMENT
/begin MEASUREMENT ed_fil_fi_pmruhverl.filter_nv "Filterwert vor und nach Eintrag [RAM name from V530, interpolated]" UBYTE M_FORMULA_0003 0 0 0 255 ECU_ADDRESS 0x3FA696 /end MEASUREMENT
/begin MEASUREMENT ed_fil_fi_pmruhverl.zyklus_filter_nv "Vorwaertsfilter zur Fehlerzustandsbestaetigung [RAM name from V530, interpolated]" UBYTE M_FORMULA_0003 0 0 0 255 ECU_ADDRESS 0x3FA697 /end MEASUREMENT
/begin MEASUREMENT ed_fil_fi_toens.filter_nv "Filterwert vor und nach Eintrag [RAM name from V530, interpolated]" UBYTE M_FORMULA_0003 0 0 0 255 ECU_ADDRESS 0x3FA69C /end MEASUREMENT
/begin MEASUREMENT ed_fil_fi_toens.zyklus_filter_nv "Vorwaertsfilter zur Fehlerzustandsbestaetigung [RAM name from V530, interpolated]" UBYTE M_FORMULA_0003 0 0 0 255 ECU_ADDRESS 0x3FA69D /end MEASUREMENT
/begin MEASUREMENT ed_fil_ebox_elu.filter_nv "Filterwert vor und nach Eintrag [RAM name from V530, interpolated]" UBYTE M_FORMULA_0003 0 0 0 255 ECU_ADDRESS 0x3FA6A2 /end MEASUREMENT
/begin MEASUREMENT ed_fil_ebox_elu.zyklus_filter_nv "Vorwaertsfilter zur Fehlerzustandsbestaetigung [RAM name from V530, interpolated]" UBYTE M_FORMULA_0003 0 0 0 255 ECU_ADDRESS 0x3FA6A3 /end MEASUREMENT
/begin MEASUREMENT ed_fil_fi_toens.fehler_aufrufe_nv "Gesamtzahl der Fehleraufrufe [RAM name from V530, interpolated]" UBYTE M_FORMULA_0003 0 0 0 255 ECU_ADDRESS 0x3FA6A1 /end MEASUREMENT
/begin MEASUREMENT ed_fil_fi_toens.filter_max_nv "Maximaler Fehlerfilterwert [RAM name from V530, interpolated]" UBYTE M_FORMULA_0003 0 0 0 255 ECU_ADDRESS 0x3FA6A0 /end MEASUREMENT
/begin MEASUREMENT ed_fil_dk1_enltg.art_aktuell_nv "Fehlerart und Statusbits [RAM name from V530, interpolated]" UWORD NO_COMPU_METHOD 0 0 0 65535 ECU_ADDRESS 0x3FA6B0 FORMAT "%.4g" /end MEASUREMENT
/begin MEASUREMENT ed_fil_dk1_enltg.fehler_aufrufe_nv "Gesamtzahl der Fehleraufrufe [RAM name from V530, interpolated]" UBYTE M_FORMULA_0003 0 0 0 255 ECU_ADDRESS 0x3FA6B3 /end MEASUREMENT
/begin MEASUREMENT ed_fil_dk1_enltg.filter_max_nv "Maximaler Fehlerfilterwert [RAM name from V530, interpolated]" UBYTE M_FORMULA_0003 0 0 0 255 ECU_ADDRESS 0x3FA6B2 /end MEASUREMENT
/begin MEASUREMENT ed_fil_dk1_enltg.filter_nv "Filterwert vor und nach Eintrag [RAM name from V530, interpolated]" UBYTE M_FORMULA_0003 0 0 0 255 ECU_ADDRESS 0x3FA6AE /end MEASUREMENT
/begin MEASUREMENT ed_fil_dk1_enltg.zyklus_filter_nv "Vorwaertsfilter zur Fehlerzustandsbestaetigung [RAM name from V530, interpolated]" UBYTE M_FORMULA_0003 0 0 0 255 ECU_ADDRESS 0x3FA6AF /end MEASUREMENT
/begin MEASUREMENT ed_fil_dk2_enltg.art_aktuell_nv "Fehlerart und Statusbits [RAM name from V530, interpolated]" UWORD NO_COMPU_METHOD 0 0 0 65535 ECU_ADDRESS 0x3FA6B6 FORMAT "%.4g" /end MEASUREMENT
/begin MEASUREMENT ed_fil_dk2_enltg.fehler_aufrufe_nv "Gesamtzahl der Fehleraufrufe [RAM name from V530, interpolated]" UBYTE M_FORMULA_0003 0 0 0 255 ECU_ADDRESS 0x3FA6B9 /end MEASUREMENT
/begin MEASUREMENT ed_fil_dk2_enltg.filter_max_nv "Maximaler Fehlerfilterwert [RAM name from V530, interpolated]" UBYTE M_FORMULA_0003 0 0 0 255 ECU_ADDRESS 0x3FA6B8 /end MEASUREMENT
/begin MEASUREMENT ed_fil_dk2_enltg.filter_nv "Filterwert vor und nach Eintrag [RAM name from V530, interpolated]" UBYTE M_FORMULA_0003 0 0 0 255 ECU_ADDRESS 0x3FA6B4 /end MEASUREMENT
/begin MEASUREMENT ed_fil_dk2_enltg.zyklus_filter_nv "Vorwaertsfilter zur Fehlerzustandsbestaetigung [RAM name from V530, interpolated]" UBYTE M_FORMULA_0003 0 0 0 255 ECU_ADDRESS 0x3FA6B5 /end MEASUREMENT
/begin MEASUREMENT ed_fil_ebox_elu.fehler_aufrufe_nv "Gesamtzahl der Fehleraufrufe [RAM name from V530, interpolated]" UBYTE M_FORMULA_0003 0 0 0 255 ECU_ADDRESS 0x3FA6A7 /end MEASUREMENT
/begin MEASUREMENT ed_fil_ebox_elu.filter_max_nv "Maximaler Fehlerfilterwert [RAM name from V530, interpolated]" UBYTE M_FORMULA_0003 0 0 0 255 ECU_ADDRESS 0x3FA6A6 /end MEASUREMENT
/begin MEASUREMENT ed_fil_s_poel_diag.filter_nv "Filterwert vor und nach Eintrag [RAM name from V530, interpolated]" UBYTE M_FORMULA_0003 0 0 0 255 ECU_ADDRESS 0x3FA6BA /end MEASUREMENT
/begin MEASUREMENT ed_fil_s_poel_diag.zyklus_filter_nv "Vorwaertsfilter zur Fehlerzustandsbestaetigung [RAM name from V530, interpolated]" UBYTE M_FORMULA_0003 0 0 0 255 ECU_ADDRESS 0x3FA6BB /end MEASUREMENT
/begin MEASUREMENT ed_fil_sg_inj.art_aktuell_nv "Fehlerart und Statusbits [RAM name from V530, interpolated]" UWORD NO_COMPU_METHOD 0 0 0 65535 ECU_ADDRESS 0x3FA6AA FORMAT "%.4g" /end MEASUREMENT
/begin MEASUREMENT ed_fil_sg_inj.fehler_aufrufe_nv "Gesamtzahl der Fehleraufrufe [RAM name from V530, interpolated]" UBYTE M_FORMULA_0003 0 0 0 255 ECU_ADDRESS 0x3FA6AD /end MEASUREMENT
/begin MEASUREMENT ed_fil_sg_inj.filter_max_nv "Maximaler Fehlerfilterwert [RAM name from V530, interpolated]" UBYTE M_FORMULA_0003 0 0 0 255 ECU_ADDRESS 0x3FA6AC /end MEASUREMENT
/begin MEASUREMENT ed_fil_sg_inj.filter_nv "Filterwert vor und nach Eintrag [RAM name from V530, interpolated]" UBYTE M_FORMULA_0003 0 0 0 255 ECU_ADDRESS 0x3FA6A8 /end MEASUREMENT
/begin MEASUREMENT ed_fil_sg_inj.zyklus_filter_nv "Vorwaertsfilter zur Fehlerzustandsbestaetigung [RAM name from V530, interpolated]" UBYTE M_FORMULA_0003 0 0 0 255 ECU_ADDRESS 0x3FA6A9 /end MEASUREMENT
/begin MEASUREMENT ed_fil_s_poel_diag.fehler_aufrufe_nv "Gesamtzahl der Fehleraufrufe [RAM name from V530, interpolated]" UBYTE M_FORMULA_0003 0 0 0 255 ECU_ADDRESS 0x3FA6BF /end MEASUREMENT
/begin MEASUREMENT ed_fil_s_poel_diag.filter_max_nv "Maximaler Fehlerfilterwert [RAM name from V530, interpolated]" UBYTE M_FORMULA_0003 0 0 0 255 ECU_ADDRESS 0x3FA6BE /end MEASUREMENT
/begin MEASUREMENT ed_fil_te_obd_1.filter_nv "Filterwert vor und nach Eintrag [RAM name from V530, interpolated]" UBYTE M_FORMULA_0003 0 0 0 255 ECU_ADDRESS 0x3FA6C0 /end MEASUREMENT
/begin MEASUREMENT ed_fil_te_obd_1.zyklus_filter_nv "Vorwaertsfilter zur Fehlerzustandsbestaetigung [RAM name from V530, interpolated]" UBYTE M_FORMULA_0003 0 0 0 255 ECU_ADDRESS 0x3FA6C1 /end MEASUREMENT
/begin COMPU_METHOD M_FORMULA_0000 "V530 FORMULA_0000" RAT_FUNC "%.4g" "-" COEFFS 0 1 0 0 0 1 /end COMPU_METHOD
/begin COMPU_METHOD M_FORMULA_0001 "V530 FORMULA_0001" RAT_FUNC "%.4g" "%" COEFFS 0 10 0 0 0 1 /end COMPU_METHOD
/begin COMPU_METHOD M_FORMULA_0003 "V530 FORMULA_0003" RAT_FUNC "%.4g" "-" COEFFS 0 1 0 0 0 1 /end COMPU_METHOD
/begin COMPU_METHOD M_FORMULA_0006 "V530 FORMULA_0006" RAT_FUNC "%.4g" "Upm" COEFFS 0 1 0 0 0 1 /end COMPU_METHOD
/begin COMPU_METHOD M_FORMULA_0007 "V530 FORMULA_0007" RAT_FUNC "%.4g" "-" COEFFS 0 10000 0 0 0 1 /end COMPU_METHOD
/begin COMPU_METHOD M_FORMULA_0008 "V530 FORMULA_0008" RAT_FUNC "%.4g" "V" COEFFS 0 10 0 0 0 1 /end COMPU_METHOD
/begin COMPU_METHOD M_FORMULA_0009 "V530 FORMULA_0009" RAT_FUNC "%.4g" "Nm" COEFFS 0 10 0 0 0 1 /end COMPU_METHOD
/begin COMPU_METHOD M_FORMULA_0010 "V530 FORMULA_0010" RAT_FUNC "%.4g" "-" COEFFS 0 1 0 0 0 1 /end COMPU_METHOD
/begin COMPU_METHOD M_FORMULA_0020 "V530 FORMULA_0020" RAT_FUNC "%.4g" "qmm/s" COEFFS 0 0.05 0 0 0 1 /end COMPU_METHOD
/begin COMPU_METHOD M_FORMULA_0021 "V530 FORMULA_0021" RAT_FUNC "%.4g" "s" COEFFS 0 100 0 0 0 1 /end COMPU_METHOD
/begin COMPU_METHOD M_FORMULA_0022 "V530 FORMULA_0022" RAT_FUNC "%.4g" "%" COEFFS 0 100 0 0 0 1 /end COMPU_METHOD
/begin COMPU_METHOD M_FORMULA_0023 "V530 FORMULA_0023" RAT_FUNC "%.4g" "???C" COEFFS 0 10 2732 0 0 1 /end COMPU_METHOD
/begin COMPU_METHOD M_FORMULA_0024 "V530 FORMULA_0024" RAT_FUNC "%.4g" "-" COEFFS 0 32768 0 0 0 1 /end COMPU_METHOD
/begin COMPU_METHOD M_FORMULA_0025 "V530 FORMULA_0025" RAT_FUNC "%.4g" "-" COEFFS 0 16384 0 0 0 1 /end COMPU_METHOD
/begin COMPU_METHOD M_FORMULA_0027 "V530 FORMULA_0027" RAT_FUNC "%.4g" "km" COEFFS 0 1 0 0 0 1 /end COMPU_METHOD
/begin COMPU_METHOD M_FORMULA_0037 "V530 FORMULA_0037" RAT_FUNC "%.4g" "-" COEFFS 0 1 0 0 0 1 /end COMPU_METHOD
/begin COMPU_METHOD M_FORMULA_0071 "V530 FORMULA_0071" RAT_FUNC "%.4g" "s" COEFFS 0 10 0 0 0 1 /end COMPU_METHOD
/begin COMPU_METHOD M_FORMULA_0073 "V530 FORMULA_0073" RAT_FUNC "%.4g" "-" COEFFS 0 1024 0 0 0 1 /end COMPU_METHOD
/begin COMPU_METHOD M_FORMULA_0076 "V530 FORMULA_0076" RAT_FUNC "%.4g" "km/h" COEFFS 0 16 0 0 0 1 /end COMPU_METHOD
/begin COMPU_METHOD M_FORMULA_0080 "V530 FORMULA_0080" RAT_FUNC "%.4g" "-" COEFFS 0 1 0 0 0 1 /end COMPU_METHOD
/begin COMPU_METHOD M_FORMULA_0090 "V530 FORMULA_0090" RAT_FUNC "%.4g" "mg" COEFFS 0 10 0 0 0 1 /end COMPU_METHOD
/begin COMPU_METHOD M_FORMULA_0102 "V530 FORMULA_0102" RAT_FUNC "%.4g" "???KW" COEFFS 0 10 0 0 0 1 /end COMPU_METHOD
/begin COMPU_METHOD M_FORMULA_0103 "V530 FORMULA_0103" RAT_FUNC "%.4g" "kg/h" COEFFS 0 10 0 0 0 1 /end COMPU_METHOD
/begin COMPU_METHOD M_FORMULA_0105 "V530 FORMULA_0105" RAT_FUNC "%.4g" "Upm/s" COEFFS 0 1 0 0 0 1 /end COMPU_METHOD
/begin COMPU_METHOD M_FORMULA_0106 "V530 FORMULA_0106" RAT_FUNC "%.4g" "%" COEFFS 0 163.84 0 0 0 1 /end COMPU_METHOD
/begin COMPU_METHOD M_FORMULA_0107 "V530 FORMULA_0107" RAT_FUNC "%.4g" "%" COEFFS 0 10.24 0 0 0 1 /end COMPU_METHOD
/begin COMPU_METHOD M_FORMULA_0109 "V530 FORMULA_0109" RAT_FUNC "%.4g" "s" COEFFS 0 200 0 0 0 1 /end COMPU_METHOD
/begin COMPU_METHOD M_FORMULA_0110 "V530 FORMULA_0110" RAT_FUNC "%.4g" "bar" COEFFS 0 1000 0 0 0 1 /end COMPU_METHOD
/begin COMPU_METHOD M_FORMULA_0111 "V530 FORMULA_0111" RAT_FUNC "%.4g" "mg" COEFFS 0 64 0 0 0 1 /end COMPU_METHOD
/begin COMPU_METHOD M_FORMULA_0113 "V530 FORMULA_0113" RAT_FUNC "%.4g" "Nm" COEFFS 0 10 0 0 0 1 /end COMPU_METHOD
/begin COMPU_METHOD M_FORMULA_0114 "V530 FORMULA_0114" RAT_FUNC "%.4g" "digit" COEFFS 0 1 0 0 0 1 /end COMPU_METHOD
/begin COMPU_METHOD M_FORMULA_0120 "V530 FORMULA_0120" RAT_FUNC "%.4g" "Nm" COEFFS 0 2 0 0 0 1 /end COMPU_METHOD
/begin COMPU_METHOD M_FORMULA_0132 "V530 FORMULA_0132" RAT_FUNC "%.4g" "Grad" COEFFS 0 22.75312856 0 0 0 1 /end COMPU_METHOD
/begin COMPU_METHOD M_FORMULA_0135 "V530 FORMULA_0135" RAT_FUNC "%.4g" ".Gang" COEFFS 0 1 0 0 0 1 /end COMPU_METHOD
/begin COMPU_METHOD M_FORMULA_0142 "V530 FORMULA_0142" RAT_FUNC "%.4g" "%" COEFFS 0 16.67 0 0 0 1 /end COMPU_METHOD
/begin COMPU_METHOD M_FORMULA_0143 "V530 FORMULA_0143" RAT_FUNC "%.4g" "qmm" COEFFS 0 10 0 0 0 1 /end COMPU_METHOD
/begin COMPU_METHOD M_FORMULA_0187 "V530 FORMULA_0187" RAT_FUNC "%.4g" "100/10ms" COEFFS 0 100 0 0 0 1 /end COMPU_METHOD
/begin COMPU_METHOD M_FORMULA_0263 "V530 FORMULA_0263" RAT_FUNC "%.4g" ".Prog" COEFFS 0 1 0 0 0 1 /end COMPU_METHOD
/begin COMPU_METHOD M_FORMULA_0272 "V530 FORMULA_0272" RAT_FUNC "%.4g" "Nm" COEFFS 0 10 0 0 0 1 /end COMPU_METHOD
/begin COMPU_METHOD M_FORMULA_0306 "V530 FORMULA_0306" RAT_FUNC "%.4g" "s" COEFFS 0 100 0 0 0 1 /end COMPU_METHOD
/begin COMPU_METHOD M_FORMULA_0363 "V530 FORMULA_0363" RAT_FUNC "%.4g" "ms" COEFFS 0 1000 0 0 0 1 /end COMPU_METHOD
/begin COMPU_METHOD M_FORMULA_0404 "V530 FORMULA_0404" RAT_FUNC "%.4g" "ms" COEFFS 0 1000 0 0 0 1 /end COMPU_METHOD
/begin COMPU_METHOD M_FORMULA_0406 "V530 FORMULA_0406" RAT_FUNC "%.4g" "ms" COEFFS 0 3.921568627 0 0 0 1 /end COMPU_METHOD
/begin COMPU_METHOD M_FORMULA_0408 "V530 FORMULA_0408" RAT_FUNC "%.4g" "-" COEFFS 0 1 -1 0 0 1 /end COMPU_METHOD
/begin COMPU_METHOD M_FORMULA_0431 "V530 FORMULA_0431" RAT_FUNC "%.4g" "???C" COEFFS 0 10 0 0 0 1 /end COMPU_METHOD
/begin COMPU_METHOD M_FORMULA_0461 "V530 FORMULA_0461" RAT_FUNC "%.4g" "s" COEFFS 0 10 0 0 0 1 /end COMPU_METHOD
/begin COMPU_METHOD M_FORMULA_0534 "V530 FORMULA_0534" RAT_FUNC "%.4g" "mg" COEFFS 0 32 0 0 0 1 /end COMPU_METHOD
/begin COMPU_METHOD M_FORMULA_0542 "V530 FORMULA_0542" RAT_FUNC "%.4g" "s" COEFFS 0 1 0 0 0 1 /end COMPU_METHOD
/begin COMPU_METHOD M_FORMULA_0563 "V530 FORMULA_0563" RAT_FUNC "%.4g" "kg/h" COEFFS 0 1000 0 0 0 1 /end COMPU_METHOD
/begin COMPU_METHOD M_FORMULA_0623 "V530 FORMULA_0623" RAT_FUNC "%.4g" "%" COEFFS 0 10 0 0 0 1 /end COMPU_METHOD
/begin COMPU_METHOD M_FORMULA_0706 "V530 FORMULA_0706" RAT_FUNC "%.4g" "%" COEFFS 0 100 0 0 0 1 /end COMPU_METHOD
/begin COMPU_METHOD M_FORMULA_0754 "V530 FORMULA_0754" RAT_FUNC "%.4g" "-" COEFFS 0 256 0 0 0 1 /end COMPU_METHOD
/begin COMPU_METHOD M_FORMULA_0762 "V530 FORMULA_0762" RAT_FUNC "%.4g" "-" COEFFS 0 8192 0 0 0 1 /end COMPU_METHOD
/begin COMPU_METHOD M_FORMULA_0786 "V530 FORMULA_0786" RAT_FUNC "%.4g" "ms" COEFFS 0 1000 0 0 0 1 /end COMPU_METHOD
/begin COMPU_METHOD M_FORMULA_1022 "V530 FORMULA_1022" RAT_FUNC "%.4g" "s" COEFFS 0 1000 0 0 0 1 /end COMPU_METHOD
/begin COMPU_METHOD M_FORMULA_1076 "V530 FORMULA_1076" RAT_FUNC "%.4g" "Hz" COEFFS 0 10 0 0 0 1 /end COMPU_METHOD
/begin COMPU_METHOD M_FORMULA_1120 "V530 FORMULA_1120" RAT_FUNC "%.4g" "kHz" COEFFS 0 0 10000000 0 714 0 /end COMPU_METHOD
/begin COMPU_METHOD M_FORMULA_1130 "V530 FORMULA_1130" RAT_FUNC "%.4g" "m3/kg" COEFFS 0 1000 0 0 0 1 /end COMPU_METHOD
/begin COMPU_METHOD M_FORMULA_1131 "V530 FORMULA_1131" RAT_FUNC "%.4g" "(kg/(m2*s))2" COEFFS 0 0.1111111111 0 0 0 1 /end COMPU_METHOD
/begin COMPU_METHOD M_FORMULA_1132 "V530 FORMULA_1132" RAT_FUNC "%.4g" "kg/(m2*s)" COEFFS 0 1 0 0 0 1 /end COMPU_METHOD
/begin COMPU_METHOD M_FORMULA_1152 "V530 FORMULA_1152" RAT_FUNC "%.4g" "l" COEFFS 0 300000 0 0 0 1 /end COMPU_METHOD
/begin COMPU_METHOD M_FORMULA_1161 "V530 FORMULA_1161" RAT_FUNC "%.4g" "nSs" COEFFS 0 1639.344262 0 0 0 1 /end COMPU_METHOD
/begin COMPU_METHOD M_FORMULA_1162 "V530 FORMULA_1162" RAT_FUNC "%.4g" "kg/h" COEFFS 0 640 0 0 0 1 /end COMPU_METHOD
/begin COMPU_METHOD M_FORMULA_1167 "V530 FORMULA_1167" RAT_FUNC "%.4g" "???C" COEFFS 0 40 10926 0 0 1 /end COMPU_METHOD
/begin COMPU_METHOD M_FORMULA_1175 "V530 FORMULA_1175" RAT_FUNC "%.4g" "Segmente" COEFFS 0 1 0 0 0 1 /end COMPU_METHOD
/begin COMPU_METHOD M_FORMULA_1202 "V530 FORMULA_1202" RAT_FUNC "%.4g" "Hz" COEFFS 0 0 1000000 0 1 0 /end COMPU_METHOD
/begin COMPU_METHOD M_FORMULA_1212 "V530 FORMULA_1212" RAT_FUNC "%.4g" "Ohm" COEFFS 0 1000 0 0 0 1 /end COMPU_METHOD
/begin COMPU_METHOD M_FORMULA_1235 "V530 FORMULA_1235" RAT_FUNC "%.4g" "%" COEFFS 0 81.92 0 0 0 1 /end COMPU_METHOD
/begin COMPU_METHOD M_FORMULA_1239 "V530 FORMULA_1239" RAT_FUNC "%.4g" "Segm" COEFFS 0 1 0 0 0 1 /end COMPU_METHOD
/begin COMPU_METHOD M_FORMULA_1240 "V530 FORMULA_1240" RAT_FUNC "%.4g" "ASP" COEFFS 0 1 0 0 0 1 /end COMPU_METHOD
/begin COMPU_METHOD CM_0285 "X" RAT_FUNC "%.4g" "Anzahl" COEFFS 0 1 0 0 0 1 /end COMPU_METHOD
/begin COMPU_METHOD CM_0287 "X/4000" RAT_FUNC "%.4g" "m/(s*s)" COEFFS 0 4000 0 0 0 1 /end COMPU_METHOD
/begin COMPU_METHOD CM_0289 "X/10" RAT_FUNC "%.4g" "%/s" COEFFS 0 10 0 0 0 1 /end COMPU_METHOD
/begin COMPU_METHOD CM_0290 "X" RAT_FUNC "%.4g" "kg" COEFFS 0 1 0 0 0 1 /end COMPU_METHOD
/begin COMPU_METHOD CM_0296 "X/10" RAT_FUNC "%.4g" "?/seg" COEFFS 0 10 0 0 0 1 /end COMPU_METHOD
/begin COMPU_METHOD CM_0298 "X*8/10000" RAT_FUNC "%.4g" "ms" COEFFS 0 1250 0 0 0 1 /end COMPU_METHOD
/begin COMPU_METHOD CM_0299 "X/1000" RAT_FUNC "%.4g" "A" COEFFS 0 1000 0 0 0 1 /end COMPU_METHOD
/begin COMPU_METHOD CM_0304 "X/40" RAT_FUNC "%.4g" "K/100ms" COEFFS 0 40 0 0 0 1 /end COMPU_METHOD
/begin COMPU_METHOD CM_0305 "X/4" RAT_FUNC "%.4g" "K/s" COEFFS 0 4 0 0 0 1 /end COMPU_METHOD
/begin COMPU_METHOD CM_0320 "X/1024" RAT_FUNC "%.4g" "m" COEFFS 0 1024 0 0 0 1 /end COMPU_METHOD
/begin COMPU_METHOD CM_0321 "(X*200)/32768" RAT_FUNC "%.4g" "1/s" COEFFS 0 4096 0 0 0 25 /end COMPU_METHOD
/begin COMPU_METHOD CM_0322 "X/10" RAT_FUNC "%.4g" "Nm" COEFFS 0 10 0 0 0 1 /end COMPU_METHOD
/begin COMPU_METHOD CM_0325 "X*0.04395" RAT_FUNC "%.4g" "-" COEFFS 0 1 0 0 0 0.04395 /end COMPU_METHOD
/begin COMPU_METHOD CM_0326 "X/100" RAT_FUNC "%.4g" "10E-4" COEFFS 0 100 0 0 0 1 /end COMPU_METHOD
/begin COMPU_METHOD CM_0327 "-X*10" RAT_FUNC "%.4g" "Nm/s" COEFFS 0 1 0 0 0 -10 /end COMPU_METHOD
/begin COMPU_METHOD CM_0328 "X*0.1" RAT_FUNC "%.4g" "kHz" COEFFS 0 1 0 0 0 0.1 /end COMPU_METHOD
/begin COMPU_METHOD CM_0329 "X/256" RAT_FUNC "%.4g" "-/segment" COEFFS 0 256 0 0 0 1 /end COMPU_METHOD
/begin COMPU_METHOD CM_0330 "0X0000" RAT_FUNC "%.4g" "nS" COEFFS 0 1 0 0 0 1 /end COMPU_METHOD
/begin COMPU_METHOD CM_0331 "X/100" RAT_FUNC "%.4g" "-" COEFFS 0 100 0 0 0 1 /end COMPU_METHOD
/begin COMPU_METHOD CM_0332 "0X0000" RAT_FUNC "%.4g" "?KW/Segm" COEFFS 0 1 0 0 0 1 /end COMPU_METHOD
/begin COMPU_METHOD CM_0334 "X/327.68" RAT_FUNC "%.4g" "1/s" COEFFS 0 1 0 0 0 0.003051757812 /end COMPU_METHOD
/begin COMPU_METHOD CM_0343 "X*0.89" RAT_FUNC "%.4g" "mA" COEFFS 0 1 0 0 0 0.89 /end COMPU_METHOD
/begin COMPU_METHOD CM_0344 "X" RAT_FUNC "%.4g" "mA/V*Tast" COEFFS 0 1 0 0 0 1 /end COMPU_METHOD
/begin COMPU_METHOD CM_0345 "X" RAT_FUNC "%.4g" "Dig/mA" COEFFS 0 1 0 0 0 1 /end COMPU_METHOD
/begin COMPU_METHOD CM_0346 "X*20" RAT_FUNC "%.4g" "ms/mA" COEFFS 0 1 0 0 0 20 /end COMPU_METHOD
/begin COMPU_METHOD CM_0347 "10240/X" RAT_FUNC "%.4g" "ms" COEFFS 0 0 -10240 0 -1 0 /end COMPU_METHOD
/begin COMPU_METHOD CM_0349 "X/1000" RAT_FUNC "%.4g" "kDoens" COEFFS 0 1000 0 0 0 1 /end COMPU_METHOD
/begin COMPU_METHOD CM_0371 "X*89" RAT_FUNC "%.4g" "mA/s" COEFFS 0 1 0 0 0 89 /end COMPU_METHOD
/begin COMPU_METHOD CM_0372 "X" RAT_FUNC "%.4g" "can_lrw[6]" COEFFS 0 1 0 0 0 1 /end COMPU_METHOD
/begin COMPU_METHOD CM_0373 "X*0.04395" RAT_FUNC "%.4g" "Grad/s" COEFFS 0 1 0 0 0 0.04395 /end COMPU_METHOD
/begin COMPU_METHOD CM_0374 "X/1000" RAT_FUNC "%.4g" "W/Km?" COEFFS 0 1000 0 0 0 1 /end COMPU_METHOD
/begin COMPU_METHOD CM_0375 "X/100" RAT_FUNC "%.4g" "Kelvin" COEFFS 0 100 0 0 0 1 /end COMPU_METHOD
/begin COMPU_METHOD CM_0376 "X*0.0625" RAT_FUNC "%.4g" "trmp" COEFFS 0 1 0 0 0 0.0625 /end COMPU_METHOD
/begin COMPU_METHOD CM_0377 "X*0.006103515625" RAT_FUNC "%.4g" "%" COEFFS 0 1 0 0 0 0.006103515625 /end COMPU_METHOD
/begin COMPU_METHOD CM_0378 "X*0.003921568627" RAT_FUNC "%.4g" "-" COEFFS 0 1 0 0 0 0.003921568627 /end COMPU_METHOD
/begin COMPU_METHOD CM_0379 "X*0.1" RAT_FUNC "%.4g" "%/s" COEFFS 0 1 0 0 0 0.1 /end COMPU_METHOD
/begin COMPU_METHOD CM_0381 "X*6.103515625e-05" RAT_FUNC "%.4g" "-/seg(144???KW)" COEFFS 0 1 0 0 0 6.103515625e-05 /end COMPU_METHOD
/begin COMPU_METHOD CM_0382 "X*200" RAT_FUNC "%.4g" "Upm/s" COEFFS 0 1 0 0 0 200 /end COMPU_METHOD
/begin COMPU_METHOD CM_0383 "X*0.0005" RAT_FUNC "%.4g" "Nm/s" COEFFS 0 1 0 0 0 0.0005 /end COMPU_METHOD
/begin COMPU_METHOD CM_0385 "X*0.01" RAT_FUNC "%.4g" "%/V" COEFFS 0 1 0 0 0 0.01 /end COMPU_METHOD
/begin COMPU_METHOD CM_0386 "X" RAT_FUNC "%.4g" "J/(kg*K)" COEFFS 0 1 0 0 0 1 /end COMPU_METHOD
/begin COMPU_METHOD CM_0387 "X" RAT_FUNC "%.4g" "J/Kelvin" COEFFS 0 1 0 0 0 1 /end COMPU_METHOD
/end MODULE
/end PROJECT
