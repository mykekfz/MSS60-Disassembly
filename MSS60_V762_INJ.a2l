ASAP2_VERSION 1 60
/begin PROJECT MSS60_V762_INJ "MSS60 (S65) V762 INJ CPU - generated 04.11.2026 from the reverse-engineered XDF"
/begin HEADER "Calibration description (characteristics from the XDF; measurements = V530 RAM names transferred to V762 addresses, confidence in each long identifier). Status tag in every long identifier: verified (checked against the code) / A2L-ref (placed from the V530 A2L) / EST (estimated) / unassigned (UNK placeholder)." VERSION "V762-RE-04112026" /end HEADER
/begin MODULE INJ "MSS60 V762 INJ"
/begin MOD_COMMON "" BYTE_ORDER MSB_FIRST ALIGNMENT_BYTE 1 ALIGNMENT_WORD 2 ALIGNMENT_LONG 4 /end MOD_COMMON
/begin CHARACTERISTIC K_ED_LAVK1_UN_OPENLOAD.OK_SCHWELLE "Fault code LAVK1_UN_OPENLOAD - debounce filter threshold for clearing (healing) the fault [verified]" VALUE 0x71119 RL_VAL_UB 0 CM_0000 0 255 /end CHARACTERISTIC
/begin CHARACTERISTIC K_ED_LAVK1_UN_OPENLOAD.P_CODE_OPENLOAD "Fault code LAVK1_UN_OPENLOAD - OBD P-code reported for open circuit [verified]" VALUE 0x71114 RL_VAL_UW 0 CM_0000 0 65535 /end CHARACTERISTIC
/begin CHARACTERISTIC K_ED_LAVK1_UN_OPENLOAD.P_CODE_SH_TO_GND "Fault code LAVK1_UN_OPENLOAD - OBD P-code reported for short to ground [verified]" VALUE 0x71112 RL_VAL_UW 0 CM_0000 0 65535 /end CHARACTERISTIC
/begin CHARACTERISTIC K_ED_LAVK1_UN_OPENLOAD.P_CODE_SH_TO_UB "Fault code LAVK1_UN_OPENLOAD - OBD P-code reported for short to battery voltage [verified]" VALUE 0x71110 RL_VAL_UW 0 CM_0000 0 65535 /end CHARACTERISTIC
/begin CHARACTERISTIC K_ED_LAVK1_UN_OPENLOAD.P_CODE_UNPLAUSIBEL "Fault code LAVK1_UN_OPENLOAD - OBD P-code reported for implausible signal [verified]" VALUE 0x71116 RL_VAL_UW 0 CM_0000 0 65535 /end CHARACTERISTIC
/begin CHARACTERISTIC K_ED_LAVK2.DEC_NACH_EINTRAG "Fault code LAVK2 - debounce filter decrement after fault-memory entry [verified]" VALUE 0x70CF3 RL_VAL_UB 0 CM_0000 0 255 /end CHARACTERISTIC
/begin CHARACTERISTIC K_ED_LAVK2.DEC_VOR_EINTRAG "Fault code LAVK2 - debounce filter decrement before fault-memory entry [verified]" VALUE 0x70CF1 RL_VAL_UB 0 CM_0000 0 255 /end CHARACTERISTIC
/begin CHARACTERISTIC K_ED_LAVK2.FEHLERSCHWELLE "Fault code LAVK2 - debounce filter threshold for setting the fault [verified]" VALUE 0x70CEE RL_VAL_UB 0 CM_0000 0 255 /end CHARACTERISTIC
/begin CHARACTERISTIC K_ED_LAVK2.INC_NACH_EINTRAG "Fault code LAVK2 - debounce filter increment after fault-memory entry [verified]" VALUE 0x70CF2 RL_VAL_UB 0 CM_0000 0 255 /end CHARACTERISTIC
/begin CHARACTERISTIC K_ED_LAVK2.INC_VOR_EINTRAG "Fault code LAVK2 - debounce filter increment before fault-memory entry [verified]" VALUE 0x70CF0 RL_VAL_UB 0 CM_0000 0 255 /end CHARACTERISTIC
/begin CHARACTERISTIC K_ED_LAVK2.KLASSENINDEX "Fault code LAVK2 - fault class selection (lamp / warning behaviour) [verified]" VALUE 0x70CF4 RL_VAL_UB 0 CM_0000 0 255 /end CHARACTERISTIC
/begin CHARACTERISTIC K_ED_LAVK2.OK_SCHWELLE "Fault code LAVK2 - debounce filter threshold for clearing (healing) the fault [verified]" VALUE 0x70CEF RL_VAL_UB 0 CM_0000 0 255 /end CHARACTERISTIC
/begin CHARACTERISTIC K_ED_LAVK2.P_CODE_OPENLOAD "Fault code LAVK2 - OBD P-code reported for open circuit [verified]" VALUE 0x70CEA RL_VAL_UW 0 CM_0000 0 65535 /end CHARACTERISTIC
/begin CHARACTERISTIC K_ED_LAVK2.P_CODE_SH_TO_GND "Fault code LAVK2 - OBD P-code reported for short to ground [verified]" VALUE 0x70CE8 RL_VAL_UW 0 CM_0000 0 65535 /end CHARACTERISTIC
/begin CHARACTERISTIC K_ED_LAVK2.P_CODE_SH_TO_UB "Fault code LAVK2 - OBD P-code reported for short to battery voltage [verified]" VALUE 0x70CE6 RL_VAL_UW 0 CM_0000 0 65535 /end CHARACTERISTIC
/begin CHARACTERISTIC K_ED_LAVK2.P_CODE_UNPLAUSIBEL "Fault code LAVK2 - OBD P-code reported for implausible signal [verified]" VALUE 0x70CEC RL_VAL_UW 0 CM_0000 0 65535 /end CHARACTERISTIC
/begin CHARACTERISTIC K_ED_LAVK2_DIAG.DEC_NACH_EINTRAG "Fault code LAVK2_DIAG - debounce filter decrement after fault-memory entry [verified]" VALUE 0x7109B RL_VAL_UB 0 CM_0000 0 255 /end CHARACTERISTIC
/begin CHARACTERISTIC K_ED_LAVK2_DIAG.DEC_VOR_EINTRAG "Fault code LAVK2_DIAG - debounce filter decrement before fault-memory entry [verified]" VALUE 0x71099 RL_VAL_UB 0 CM_0000 0 255 /end CHARACTERISTIC
/begin CHARACTERISTIC K_ED_LAVK2_DIAG.FEHLERSCHWELLE "Fault code LAVK2_DIAG - debounce filter threshold for setting the fault [verified]" VALUE 0x71096 RL_VAL_UB 0 CM_0000 0 255 /end CHARACTERISTIC
/begin CHARACTERISTIC K_ED_LAVK2_DIAG.INC_NACH_EINTRAG "Fault code LAVK2_DIAG - debounce filter increment after fault-memory entry [verified]" VALUE 0x7109A RL_VAL_UB 0 CM_0000 0 255 /end CHARACTERISTIC
/begin CHARACTERISTIC K_ED_LAVK2_DIAG.INC_VOR_EINTRAG "Fault code LAVK2_DIAG - debounce filter increment before fault-memory entry [verified]" VALUE 0x71098 RL_VAL_UB 0 CM_0000 0 255 /end CHARACTERISTIC
/begin CHARACTERISTIC K_ED_LAVK2_DIAG.KLASSENINDEX "Fault code LAVK2_DIAG - fault class selection (lamp / warning behaviour) [verified]" VALUE 0x7109C RL_VAL_UB 0 CM_0000 0 255 /end CHARACTERISTIC
/begin CHARACTERISTIC K_ED_LAVK2_DIAG.OK_SCHWELLE "Fault code LAVK2_DIAG - debounce filter threshold for clearing (healing) the fault [verified]" VALUE 0x71097 RL_VAL_UB 0 CM_0000 0 255 /end CHARACTERISTIC
/begin CHARACTERISTIC K_ED_LAVK2_DIAG.P_CODE_OPENLOAD "Fault code LAVK2_DIAG - OBD P-code reported for open circuit [verified]" VALUE 0x71092 RL_VAL_UW 0 CM_0000 0 65535 /end CHARACTERISTIC
/begin CHARACTERISTIC K_ED_LAVK2_DIAG.P_CODE_SH_TO_GND "Fault code LAVK2_DIAG - OBD P-code reported for short to ground [verified]" VALUE 0x71090 RL_VAL_UW 0 CM_0000 0 65535 /end CHARACTERISTIC
/begin CHARACTERISTIC K_ED_LAVK2_DIAG.P_CODE_SH_TO_UB "Fault code LAVK2_DIAG - OBD P-code reported for short to battery voltage [verified]" VALUE 0x7108E RL_VAL_UW 0 CM_0000 0 65535 /end CHARACTERISTIC
/begin CHARACTERISTIC K_ED_LAVK2_DIAG.P_CODE_UNPLAUSIBEL "Fault code LAVK2_DIAG - OBD P-code reported for implausible signal [verified]" VALUE 0x71094 RL_VAL_UW 0 CM_0000 0 65535 /end CHARACTERISTIC
/begin CHARACTERISTIC K_ED_LAVK2_IA_OPENLOAD.DEC_NACH_EINTRAG "Fault code LAVK2_IA_OPENLOAD - debounce filter decrement after fault-memory entry [verified]" VALUE 0x710CF RL_VAL_UB 0 CM_0000 0 255 /end CHARACTERISTIC
/begin CHARACTERISTIC K_ED_LAVK2_IA_OPENLOAD.DEC_VOR_EINTRAG "Fault code LAVK2_IA_OPENLOAD - debounce filter decrement before fault-memory entry [verified]" VALUE 0x710CD RL_VAL_UB 0 CM_0000 0 255 /end CHARACTERISTIC
/begin CHARACTERISTIC K_ED_LAVK2_IA_OPENLOAD.FEHLERSCHWELLE "Fault code LAVK2_IA_OPENLOAD - debounce filter threshold for setting the fault [verified]" VALUE 0x710CA RL_VAL_UB 0 CM_0000 0 255 /end CHARACTERISTIC
/begin CHARACTERISTIC K_ED_LAVK2_IA_OPENLOAD.INC_NACH_EINTRAG "Fault code LAVK2_IA_OPENLOAD - debounce filter increment after fault-memory entry [verified]" VALUE 0x710CE RL_VAL_UB 0 CM_0000 0 255 /end CHARACTERISTIC
/begin CHARACTERISTIC K_ED_LAVK2_IA_OPENLOAD.INC_VOR_EINTRAG "Fault code LAVK2_IA_OPENLOAD - debounce filter increment before fault-memory entry [verified]" VALUE 0x710CC RL_VAL_UB 0 CM_0000 0 255 /end CHARACTERISTIC
/begin CHARACTERISTIC K_ED_LAVK2_IA_OPENLOAD.KLASSENINDEX "Fault code LAVK2_IA_OPENLOAD - fault class selection (lamp / warning behaviour) [verified]" VALUE 0x710D0 RL_VAL_UB 0 CM_0000 0 255 /end CHARACTERISTIC
/begin CHARACTERISTIC K_ED_LAVK2_IA_OPENLOAD.OK_SCHWELLE "Fault code LAVK2_IA_OPENLOAD - debounce filter threshold for clearing (healing) the fault [verified]" VALUE 0x710CB RL_VAL_UB 0 CM_0000 0 255 /end CHARACTERISTIC
/begin CHARACTERISTIC K_ED_LAVK2_IA_OPENLOAD.P_CODE_OPENLOAD "Fault code LAVK2_IA_OPENLOAD - OBD P-code reported for open circuit [verified]" VALUE 0x710C6 RL_VAL_UW 0 CM_0000 0 65535 /end CHARACTERISTIC
/begin CHARACTERISTIC K_ED_LAVK2_IA_OPENLOAD.P_CODE_SH_TO_GND "Fault code LAVK2_IA_OPENLOAD - OBD P-code reported for short to ground [verified]" VALUE 0x710C4 RL_VAL_UW 0 CM_0000 0 65535 /end CHARACTERISTIC
/begin CHARACTERISTIC K_ED_LAVK2_IA_OPENLOAD.P_CODE_SH_TO_UB "Fault code LAVK2_IA_OPENLOAD - OBD P-code reported for short to battery voltage [verified]" VALUE 0x710C2 RL_VAL_UW 0 CM_0000 0 65535 /end CHARACTERISTIC
/begin CHARACTERISTIC K_ED_LAVK2_IA_OPENLOAD.P_CODE_UNPLAUSIBEL "Fault code LAVK2_IA_OPENLOAD - OBD P-code reported for implausible signal [verified]" VALUE 0x710C8 RL_VAL_UW 0 CM_0000 0 65535 /end CHARACTERISTIC
/begin CHARACTERISTIC K_ED_LAVK2_IP_OPENLOAD.DEC_NACH_EINTRAG "Fault code LAVK2_IP_OPENLOAD - debounce filter decrement after fault-memory entry [verified]" VALUE 0x7116B RL_VAL_UB 0 CM_0000 0 255 /end CHARACTERISTIC
/begin CHARACTERISTIC K_ED_LAVK2_IP_OPENLOAD.DEC_VOR_EINTRAG "Fault code LAVK2_IP_OPENLOAD - debounce filter decrement before fault-memory entry [verified]" VALUE 0x71169 RL_VAL_UB 0 CM_0000 0 255 /end CHARACTERISTIC
/begin CHARACTERISTIC K_ED_LAVK2_IP_OPENLOAD.FEHLERSCHWELLE "Fault code LAVK2_IP_OPENLOAD - debounce filter threshold for setting the fault [verified]" VALUE 0x71166 RL_VAL_UB 0 CM_0000 0 255 /end CHARACTERISTIC
/begin CHARACTERISTIC K_ED_LAVK2_IP_OPENLOAD.INC_NACH_EINTRAG "Fault code LAVK2_IP_OPENLOAD - debounce filter increment after fault-memory entry [verified]" VALUE 0x7116A RL_VAL_UB 0 CM_0000 0 255 /end CHARACTERISTIC
/begin CHARACTERISTIC K_ED_LAVK2_IP_OPENLOAD.INC_VOR_EINTRAG "Fault code LAVK2_IP_OPENLOAD - debounce filter increment before fault-memory entry [verified]" VALUE 0x71168 RL_VAL_UB 0 CM_0000 0 255 /end CHARACTERISTIC
/begin CHARACTERISTIC K_ED_LAVK2_IP_OPENLOAD.KLASSENINDEX "Fault code LAVK2_IP_OPENLOAD - fault class selection (lamp / warning behaviour) [verified]" VALUE 0x7116C RL_VAL_UB 0 CM_0000 0 255 /end CHARACTERISTIC
/begin CHARACTERISTIC K_ED_LAVK2_IP_OPENLOAD.OK_SCHWELLE "Fault code LAVK2_IP_OPENLOAD - debounce filter threshold for clearing (healing) the fault [verified]" VALUE 0x71167 RL_VAL_UB 0 CM_0000 0 255 /end CHARACTERISTIC
/begin CHARACTERISTIC K_ED_LAVK2_IP_OPENLOAD.P_CODE_OPENLOAD "Fault code LAVK2_IP_OPENLOAD - OBD P-code reported for open circuit [verified]" VALUE 0x71162 RL_VAL_UW 0 CM_0000 0 65535 /end CHARACTERISTIC
/begin CHARACTERISTIC K_ED_LAVK2_IP_OPENLOAD.P_CODE_SH_TO_GND "Fault code LAVK2_IP_OPENLOAD - OBD P-code reported for short to ground [verified]" VALUE 0x71160 RL_VAL_UW 0 CM_0000 0 65535 /end CHARACTERISTIC
/begin CHARACTERISTIC K_ED_LAVK2_IP_OPENLOAD.P_CODE_SH_TO_UB "Fault code LAVK2_IP_OPENLOAD - OBD P-code reported for short to battery voltage [verified]" VALUE 0x7115E RL_VAL_UW 0 CM_0000 0 65535 /end CHARACTERISTIC
/begin CHARACTERISTIC K_ED_LAVK2_IP_OPENLOAD.P_CODE_UNPLAUSIBEL "Fault code LAVK2_IP_OPENLOAD - OBD P-code reported for implausible signal [verified]" VALUE 0x71164 RL_VAL_UW 0 CM_0000 0 65535 /end CHARACTERISTIC
/begin CHARACTERISTIC K_ED_LAVK2_OBD_DYN.DEC_NACH_EINTRAG "Fault code LAVK2_OBD_DYN - debounce filter decrement after fault-memory entry [verified]" VALUE 0x714C5 RL_VAL_UB 0 CM_0000 0 255 /end CHARACTERISTIC
/begin CHARACTERISTIC K_ED_LAVK2_OBD_DYN.DEC_VOR_EINTRAG "Fault code LAVK2_OBD_DYN - debounce filter decrement before fault-memory entry [verified]" VALUE 0x714C3 RL_VAL_UB 0 CM_0000 0 255 /end CHARACTERISTIC
/begin CHARACTERISTIC K_ED_LAVK2_OBD_DYN.FEHLERSCHWELLE "Fault code LAVK2_OBD_DYN - debounce filter threshold for setting the fault [verified]" VALUE 0x714C0 RL_VAL_UB 0 CM_0000 0 255 /end CHARACTERISTIC
/begin CHARACTERISTIC K_ED_LAVK2_OBD_DYN.INC_NACH_EINTRAG "Fault code LAVK2_OBD_DYN - debounce filter increment after fault-memory entry [verified]" VALUE 0x714C4 RL_VAL_UB 0 CM_0000 0 255 /end CHARACTERISTIC
/begin CHARACTERISTIC K_ED_LAVK2_OBD_DYN.INC_VOR_EINTRAG "Fault code LAVK2_OBD_DYN - debounce filter increment before fault-memory entry [verified]" VALUE 0x714C2 RL_VAL_UB 0 CM_0000 0 255 /end CHARACTERISTIC
/begin CHARACTERISTIC K_ED_LAVK2_OBD_DYN.KLASSENINDEX "Fault code LAVK2_OBD_DYN - fault class selection (lamp / warning behaviour) [verified]" VALUE 0x714C6 RL_VAL_UB 0 CM_0000 0 255 /end CHARACTERISTIC
/begin CHARACTERISTIC K_ED_LAVK2_OBD_DYN.OK_SCHWELLE "Fault code LAVK2_OBD_DYN - debounce filter threshold for clearing (healing) the fault [verified]" VALUE 0x714C1 RL_VAL_UB 0 CM_0000 0 255 /end CHARACTERISTIC
/begin CHARACTERISTIC K_ED_LAVK2_OBD_DYN.P_CODE_OPENLOAD "Fault code LAVK2_OBD_DYN - OBD P-code reported for open circuit [verified]" VALUE 0x714BC RL_VAL_UW 0 CM_0000 0 65535 /end CHARACTERISTIC
/begin CHARACTERISTIC K_ED_LAVK2_OBD_DYN.P_CODE_SH_TO_GND "Fault code LAVK2_OBD_DYN - OBD P-code reported for short to ground [verified]" VALUE 0x714BA RL_VAL_UW 0 CM_0000 0 65535 /end CHARACTERISTIC
/begin CHARACTERISTIC K_ED_LAVK2_OBD_DYN.P_CODE_SH_TO_UB "Fault code LAVK2_OBD_DYN - OBD P-code reported for short to battery voltage [verified]" VALUE 0x714B8 RL_VAL_UW 0 CM_0000 0 65535 /end CHARACTERISTIC
/begin CHARACTERISTIC K_ED_LAVK2_OBD_DYN.P_CODE_UNPLAUSIBEL "Fault code LAVK2_OBD_DYN - OBD P-code reported for implausible signal [verified]" VALUE 0x714BE RL_VAL_UW 0 CM_0000 0 65535 /end CHARACTERISTIC
/begin CHARACTERISTIC K_ED_LAVK2_OBD_PLAU.DEC_NACH_EINTRAG "Fault code LAVK2_OBD_PLAU - debounce filter decrement after fault-memory entry [verified]" VALUE 0x70D27 RL_VAL_UB 0 CM_0000 0 255 /end CHARACTERISTIC
/begin CHARACTERISTIC K_ED_LAVK2_OBD_PLAU.DEC_VOR_EINTRAG "Fault code LAVK2_OBD_PLAU - debounce filter decrement before fault-memory entry [verified]" VALUE 0x70D25 RL_VAL_UB 0 CM_0000 0 255 /end CHARACTERISTIC
/begin CHARACTERISTIC K_ED_LAVK2_OBD_PLAU.FEHLERSCHWELLE "Fault code LAVK2_OBD_PLAU - debounce filter threshold for setting the fault [verified]" VALUE 0x70D22 RL_VAL_UB 0 CM_0000 0 255 /end CHARACTERISTIC
/begin CHARACTERISTIC K_ED_LAVK2_OBD_PLAU.INC_NACH_EINTRAG "Fault code LAVK2_OBD_PLAU - debounce filter increment after fault-memory entry [verified]" VALUE 0x70D26 RL_VAL_UB 0 CM_0000 0 255 /end CHARACTERISTIC
/begin CHARACTERISTIC K_ED_LAVK2_OBD_PLAU.INC_VOR_EINTRAG "Fault code LAVK2_OBD_PLAU - debounce filter increment before fault-memory entry [verified]" VALUE 0x70D24 RL_VAL_UB 0 CM_0000 0 255 /end CHARACTERISTIC
/begin CHARACTERISTIC K_ED_LAVK2_OBD_PLAU.KLASSENINDEX "Fault code LAVK2_OBD_PLAU - fault class selection (lamp / warning behaviour) [verified]" VALUE 0x70D28 RL_VAL_UB 0 CM_0000 0 255 /end CHARACTERISTIC
/begin CHARACTERISTIC K_ED_LAVK2_OBD_PLAU.OK_SCHWELLE "Fault code LAVK2_OBD_PLAU - debounce filter threshold for clearing (healing) the fault [verified]" VALUE 0x70D23 RL_VAL_UB 0 CM_0000 0 255 /end CHARACTERISTIC
/begin CHARACTERISTIC K_ED_LAVK2_OBD_PLAU.P_CODE_OPENLOAD "Fault code LAVK2_OBD_PLAU - OBD P-code reported for open circuit [verified]" VALUE 0x70D1E RL_VAL_UW 0 CM_0000 0 65535 /end CHARACTERISTIC
/begin CHARACTERISTIC K_ED_LAVK2_OBD_PLAU.P_CODE_SH_TO_GND "Fault code LAVK2_OBD_PLAU - OBD P-code reported for short to ground [verified]" VALUE 0x70D1C RL_VAL_UW 0 CM_0000 0 65535 /end CHARACTERISTIC
/begin CHARACTERISTIC K_ED_LAVK2_OBD_PLAU.P_CODE_SH_TO_UB "Fault code LAVK2_OBD_PLAU - OBD P-code reported for short to battery voltage [verified]" VALUE 0x70D1A RL_VAL_UW 0 CM_0000 0 65535 /end CHARACTERISTIC
/begin CHARACTERISTIC K_ED_LAVK2_OBD_PLAU.P_CODE_UNPLAUSIBEL "Fault code LAVK2_OBD_PLAU - OBD P-code reported for implausible signal [verified]" VALUE 0x70D20 RL_VAL_UW 0 CM_0000 0 65535 /end CHARACTERISTIC
/begin CHARACTERISTIC K_ED_LAVK2_OBD_SA.DEC_NACH_EINTRAG "Fault code LAVK2_OBD_SA - debounce filter decrement after fault-memory entry [verified]" VALUE 0x70D5B RL_VAL_UB 0 CM_0000 0 255 /end CHARACTERISTIC
/begin CHARACTERISTIC K_ED_LAVK2_OBD_SA.DEC_VOR_EINTRAG "Fault code LAVK2_OBD_SA - debounce filter decrement before fault-memory entry [verified]" VALUE 0x70D59 RL_VAL_UB 0 CM_0000 0 255 /end CHARACTERISTIC
/begin CHARACTERISTIC K_ED_LAVK2_OBD_SA.FEHLERSCHWELLE "Fault code LAVK2_OBD_SA - debounce filter threshold for setting the fault [verified]" VALUE 0x70D56 RL_VAL_UB 0 CM_0000 0 255 /end CHARACTERISTIC
/begin CHARACTERISTIC K_ED_LAVK2_OBD_SA.INC_NACH_EINTRAG "Fault code LAVK2_OBD_SA - debounce filter increment after fault-memory entry [verified]" VALUE 0x70D5A RL_VAL_UB 0 CM_0000 0 255 /end CHARACTERISTIC
/begin CHARACTERISTIC K_ED_LAVK2_OBD_SA.INC_VOR_EINTRAG "Fault code LAVK2_OBD_SA - debounce filter increment before fault-memory entry [verified]" VALUE 0x70D58 RL_VAL_UB 0 CM_0000 0 255 /end CHARACTERISTIC
/begin CHARACTERISTIC K_ED_LAVK2_OBD_SA.KLASSENINDEX "Fault code LAVK2_OBD_SA - fault class selection (lamp / warning behaviour) [verified]" VALUE 0x70D5C RL_VAL_UB 0 CM_0000 0 255 /end CHARACTERISTIC
/begin CHARACTERISTIC K_ED_LAVK2_OBD_SA.OK_SCHWELLE "Fault code LAVK2_OBD_SA - debounce filter threshold for clearing (healing) the fault [verified]" VALUE 0x70D57 RL_VAL_UB 0 CM_0000 0 255 /end CHARACTERISTIC
/begin CHARACTERISTIC K_ED_LAVK2_OBD_SA.P_CODE_OPENLOAD "Fault code LAVK2_OBD_SA - OBD P-code reported for open circuit [verified]" VALUE 0x70D52 RL_VAL_UW 0 CM_0000 0 65535 /end CHARACTERISTIC
/begin CHARACTERISTIC K_ED_LAVK2_OBD_SA.P_CODE_SH_TO_GND "Fault code LAVK2_OBD_SA - OBD P-code reported for short to ground [verified]" VALUE 0x70D50 RL_VAL_UW 0 CM_0000 0 65535 /end CHARACTERISTIC
/begin CHARACTERISTIC K_ED_LAVK2_OBD_SA.P_CODE_SH_TO_UB "Fault code LAVK2_OBD_SA - OBD P-code reported for short to battery voltage [verified]" VALUE 0x70D4E RL_VAL_UW 0 CM_0000 0 65535 /end CHARACTERISTIC
/begin CHARACTERISTIC K_ED_LAVK2_OBD_SA.P_CODE_UNPLAUSIBEL "Fault code LAVK2_OBD_SA - OBD P-code reported for implausible signal [verified]" VALUE 0x70D54 RL_VAL_UW 0 CM_0000 0 65535 /end CHARACTERISTIC
/begin CHARACTERISTIC K_ED_LAVK2_OBD_TL.DEC_NACH_EINTRAG "Fault code LAVK2_OBD_TL - debounce filter decrement after fault-memory entry [verified]" VALUE 0x70F63 RL_VAL_UB 0 CM_0000 0 255 /end CHARACTERISTIC
/begin CHARACTERISTIC K_ED_LAVK2_OBD_TL.DEC_VOR_EINTRAG "Fault code LAVK2_OBD_TL - debounce filter decrement before fault-memory entry [verified]" VALUE 0x70F61 RL_VAL_UB 0 CM_0000 0 255 /end CHARACTERISTIC
/begin CHARACTERISTIC K_ED_LAVK2_OBD_TL.FEHLERSCHWELLE "Fault code LAVK2_OBD_TL - debounce filter threshold for setting the fault [verified]" VALUE 0x70F5E RL_VAL_UB 0 CM_0000 0 255 /end CHARACTERISTIC
/begin CHARACTERISTIC K_ED_LAVK2_OBD_TL.INC_NACH_EINTRAG "Fault code LAVK2_OBD_TL - debounce filter increment after fault-memory entry [verified]" VALUE 0x70F62 RL_VAL_UB 0 CM_0000 0 255 /end CHARACTERISTIC
/begin CHARACTERISTIC K_ED_LAVK2_OBD_TL.INC_VOR_EINTRAG "Fault code LAVK2_OBD_TL - debounce filter increment before fault-memory entry [verified]" VALUE 0x70F60 RL_VAL_UB 0 CM_0000 0 255 /end CHARACTERISTIC
/begin CHARACTERISTIC K_ED_LAVK2_OBD_TL.KLASSENINDEX "Fault code LAVK2_OBD_TL - fault class selection (lamp / warning behaviour) [verified]" VALUE 0x70F64 RL_VAL_UB 0 CM_0000 0 255 /end CHARACTERISTIC
/begin CHARACTERISTIC K_ED_LAVK2_OBD_TL.OK_SCHWELLE "Fault code LAVK2_OBD_TL - debounce filter threshold for clearing (healing) the fault [verified]" VALUE 0x70F5F RL_VAL_UB 0 CM_0000 0 255 /end CHARACTERISTIC
/begin CHARACTERISTIC K_ED_LAVK2_OBD_TL.P_CODE_OPENLOAD "Fault code LAVK2_OBD_TL - OBD P-code reported for open circuit [verified]" VALUE 0x70F5A RL_VAL_UW 0 CM_0000 0 65535 /end CHARACTERISTIC
/begin CHARACTERISTIC K_ED_LAVK2_OBD_TL.P_CODE_SH_TO_GND "Fault code LAVK2_OBD_TL - OBD P-code reported for short to ground [verified]" VALUE 0x70F58 RL_VAL_UW 0 CM_0000 0 65535 /end CHARACTERISTIC
/begin CHARACTERISTIC K_ED_LAVK2_OBD_TL.P_CODE_SH_TO_UB "Fault code LAVK2_OBD_TL - OBD P-code reported for short to battery voltage [verified]" VALUE 0x70F56 RL_VAL_UW 0 CM_0000 0 65535 /end CHARACTERISTIC
/begin CHARACTERISTIC K_ED_LAVK2_OBD_TL.P_CODE_UNPLAUSIBEL "Fault code LAVK2_OBD_TL - OBD P-code reported for implausible signal [verified]" VALUE 0x70F5C RL_VAL_UW 0 CM_0000 0 65535 /end CHARACTERISTIC
/begin CHARACTERISTIC K_ED_LAVK2_TRIM.DEC_NACH_EINTRAG "Fault code LAVK2_TRIM - debounce filter decrement after fault-memory entry [verified]" VALUE 0x715E3 RL_VAL_UB 0 CM_0000 0 255 /end CHARACTERISTIC
/begin CHARACTERISTIC K_ED_LAVK2_TRIM.DEC_VOR_EINTRAG "Fault code LAVK2_TRIM - debounce filter decrement before fault-memory entry [verified]" VALUE 0x715E1 RL_VAL_UB 0 CM_0000 0 255 /end CHARACTERISTIC
/begin CHARACTERISTIC K_ED_LAVK2_TRIM.FEHLERSCHWELLE "Fault code LAVK2_TRIM - debounce filter threshold for setting the fault [verified]" VALUE 0x715DE RL_VAL_UB 0 CM_0000 0 255 /end CHARACTERISTIC
/begin CHARACTERISTIC K_ED_LAVK2_TRIM.INC_NACH_EINTRAG "Fault code LAVK2_TRIM - debounce filter increment after fault-memory entry [verified]" VALUE 0x715E2 RL_VAL_UB 0 CM_0000 0 255 /end CHARACTERISTIC
/begin CHARACTERISTIC K_ED_LAVK2_TRIM.INC_VOR_EINTRAG "Fault code LAVK2_TRIM - debounce filter increment before fault-memory entry [verified]" VALUE 0x715E0 RL_VAL_UB 0 CM_0000 0 255 /end CHARACTERISTIC
/begin CHARACTERISTIC K_ED_LAVK2_TRIM.KLASSENINDEX "Fault code LAVK2_TRIM - fault class selection (lamp / warning behaviour) [verified]" VALUE 0x715E4 RL_VAL_UB 0 CM_0000 0 255 /end CHARACTERISTIC
/begin CHARACTERISTIC K_ED_LAVK2_TRIM.OK_SCHWELLE "Fault code LAVK2_TRIM - debounce filter threshold for clearing (healing) the fault [verified]" VALUE 0x715DF RL_VAL_UB 0 CM_0000 0 255 /end CHARACTERISTIC
/begin CHARACTERISTIC K_ED_LAVK2_TRIM.P_CODE_OPENLOAD "Fault code LAVK2_TRIM - OBD P-code reported for open circuit [verified]" VALUE 0x715DA RL_VAL_UW 0 CM_0000 0 65535 /end CHARACTERISTIC
/begin CHARACTERISTIC K_ED_LAVK2_TRIM.P_CODE_SH_TO_GND "Fault code LAVK2_TRIM - OBD P-code reported for short to ground [verified]" VALUE 0x715D8 RL_VAL_UW 0 CM_0000 0 65535 /end CHARACTERISTIC
/begin CHARACTERISTIC K_ED_LAVK2_TRIM.P_CODE_SH_TO_UB "Fault code LAVK2_TRIM - OBD P-code reported for short to battery voltage [verified]" VALUE 0x715D6 RL_VAL_UW 0 CM_0000 0 65535 /end CHARACTERISTIC
/begin CHARACTERISTIC K_ED_LAVK2_TRIM.P_CODE_UNPLAUSIBEL "Fault code LAVK2_TRIM - OBD P-code reported for implausible signal [verified]" VALUE 0x715DC RL_VAL_UW 0 CM_0000 0 65535 /end CHARACTERISTIC
/begin CHARACTERISTIC K_ED_LAVK2_UN_OPENLOAD.DEC_NACH_EINTRAG "Fault code LAVK2_UN_OPENLOAD - debounce filter decrement after fault-memory entry [verified]" VALUE 0x71137 RL_VAL_UB 0 CM_0000 0 255 /end CHARACTERISTIC
/begin CHARACTERISTIC K_ED_LAVK2_UN_OPENLOAD.DEC_VOR_EINTRAG "Fault code LAVK2_UN_OPENLOAD - debounce filter decrement before fault-memory entry [verified]" VALUE 0x71135 RL_VAL_UB 0 CM_0000 0 255 /end CHARACTERISTIC
/begin CHARACTERISTIC K_ED_LAVK2_UN_OPENLOAD.FEHLERSCHWELLE "Fault code LAVK2_UN_OPENLOAD - debounce filter threshold for setting the fault [verified]" VALUE 0x71132 RL_VAL_UB 0 CM_0000 0 255 /end CHARACTERISTIC
/begin CHARACTERISTIC K_ED_LAVK2_UN_OPENLOAD.INC_NACH_EINTRAG "Fault code LAVK2_UN_OPENLOAD - debounce filter increment after fault-memory entry [verified]" VALUE 0x71136 RL_VAL_UB 0 CM_0000 0 255 /end CHARACTERISTIC
/begin CHARACTERISTIC K_ED_LAVK2_UN_OPENLOAD.INC_VOR_EINTRAG "Fault code LAVK2_UN_OPENLOAD - debounce filter increment before fault-memory entry [verified]" VALUE 0x71134 RL_VAL_UB 0 CM_0000 0 255 /end CHARACTERISTIC
/begin CHARACTERISTIC K_ED_LAVK2_UN_OPENLOAD.KLASSENINDEX "Fault code LAVK2_UN_OPENLOAD - fault class selection (lamp / warning behaviour) [verified]" VALUE 0x71138 RL_VAL_UB 0 CM_0000 0 255 /end CHARACTERISTIC
/begin CHARACTERISTIC K_ED_LAVK2_UN_OPENLOAD.OK_SCHWELLE "Fault code LAVK2_UN_OPENLOAD - debounce filter threshold for clearing (healing) the fault [verified]" VALUE 0x71133 RL_VAL_UB 0 CM_0000 0 255 /end CHARACTERISTIC
/begin CHARACTERISTIC K_ED_LAVK2_UN_OPENLOAD.P_CODE_OPENLOAD "Fault code LAVK2_UN_OPENLOAD - OBD P-code reported for open circuit [verified]" VALUE 0x7112E RL_VAL_UW 0 CM_0000 0 65535 /end CHARACTERISTIC
/begin CHARACTERISTIC K_ED_LAVK2_UN_OPENLOAD.P_CODE_SH_TO_GND "Fault code LAVK2_UN_OPENLOAD - OBD P-code reported for short to ground [verified]" VALUE 0x7112C RL_VAL_UW 0 CM_0000 0 65535 /end CHARACTERISTIC
/begin CHARACTERISTIC K_ED_LAVK2_UN_OPENLOAD.P_CODE_SH_TO_UB "Fault code LAVK2_UN_OPENLOAD - OBD P-code reported for short to battery voltage [verified]" VALUE 0x7112A RL_VAL_UW 0 CM_0000 0 65535 /end CHARACTERISTIC
/begin CHARACTERISTIC K_ED_LAVK2_UN_OPENLOAD.P_CODE_UNPLAUSIBEL "Fault code LAVK2_UN_OPENLOAD - OBD P-code reported for implausible signal [verified]" VALUE 0x71130 RL_VAL_UW 0 CM_0000 0 65535 /end CHARACTERISTIC
/begin CHARACTERISTIC K_ED_LAVK_ATIC42.DEC_NACH_EINTRAG "Fault code LAVK_ATIC42 - debounce filter decrement after fault-memory entry [verified]" VALUE 0x71E85 RL_VAL_UB 0 CM_0000 0 255 /end CHARACTERISTIC
/begin CHARACTERISTIC K_ED_LAVK_ATIC42.DEC_VOR_EINTRAG "Fault code LAVK_ATIC42 - debounce filter decrement before fault-memory entry [verified]" VALUE 0x71E83 RL_VAL_UB 0 CM_0000 0 255 /end CHARACTERISTIC
/begin CHARACTERISTIC K_ED_LAVK_ATIC42.FEHLERSCHWELLE "Fault code LAVK_ATIC42 - debounce filter threshold for setting the fault [verified]" VALUE 0x71E80 RL_VAL_UB 0 CM_0000 0 255 /end CHARACTERISTIC
/begin CHARACTERISTIC K_ED_LAVK_ATIC42.INC_NACH_EINTRAG "Fault code LAVK_ATIC42 - debounce filter increment after fault-memory entry [verified]" VALUE 0x71E84 RL_VAL_UB 0 CM_0000 0 255 /end CHARACTERISTIC
/begin CHARACTERISTIC K_ED_LAVK_ATIC42.INC_VOR_EINTRAG "Fault code LAVK_ATIC42 - debounce filter increment before fault-memory entry [verified]" VALUE 0x71E82 RL_VAL_UB 0 CM_0000 0 255 /end CHARACTERISTIC
/begin CHARACTERISTIC K_ED_LAVK_ATIC42.KLASSENINDEX "Fault code LAVK_ATIC42 - fault class selection (lamp / warning behaviour) [verified]" VALUE 0x71E86 RL_VAL_UB 0 CM_0000 0 255 /end CHARACTERISTIC
/begin CHARACTERISTIC K_ED_LAVK_ATIC42.OK_SCHWELLE "Fault code LAVK_ATIC42 - debounce filter threshold for clearing (healing) the fault [verified]" VALUE 0x71E81 RL_VAL_UB 0 CM_0000 0 255 /end CHARACTERISTIC
/begin CHARACTERISTIC K_ED_LAVK_ATIC42.P_CODE_OPENLOAD "Fault code LAVK_ATIC42 - OBD P-code reported for open circuit [verified]" VALUE 0x71E7C RL_VAL_UW 0 CM_0000 0 65535 /end CHARACTERISTIC
/begin CHARACTERISTIC K_ED_LAVK_ATIC42.P_CODE_SH_TO_GND "Fault code LAVK_ATIC42 - OBD P-code reported for short to ground [verified]" VALUE 0x71E7A RL_VAL_UW 0 CM_0000 0 65535 /end CHARACTERISTIC
/begin CHARACTERISTIC K_ED_LAVK_ATIC42.P_CODE_SH_TO_UB "Fault code LAVK_ATIC42 - OBD P-code reported for short to battery voltage [verified]" VALUE 0x71E78 RL_VAL_UW 0 CM_0000 0 65535 /end CHARACTERISTIC
/begin CHARACTERISTIC K_ED_LAVK_ATIC42.P_CODE_UNPLAUSIBEL "Fault code LAVK_ATIC42 - OBD P-code reported for implausible signal [verified]" VALUE 0x71E7E RL_VAL_UW 0 CM_0000 0 65535 /end CHARACTERISTIC
/begin CHARACTERISTIC K_ED_LSHNK1.DEC_NACH_EINTRAG "Fault code LSHNK1 - debounce filter decrement after fault-memory entry [verified]" VALUE 0x70DA9 RL_VAL_UB 0 CM_0000 0 255 /end CHARACTERISTIC
/begin CHARACTERISTIC K_ED_LSHNK1.DEC_VOR_EINTRAG "Fault code LSHNK1 - debounce filter decrement before fault-memory entry [verified]" VALUE 0x70DA7 RL_VAL_UB 0 CM_0000 0 255 /end CHARACTERISTIC
/begin CHARACTERISTIC K_ED_LSHNK1.FEHLERSCHWELLE "Fault code LSHNK1 - debounce filter threshold for setting the fault [verified]" VALUE 0x70DA4 RL_VAL_UB 0 CM_0000 0 255 /end CHARACTERISTIC
/begin CHARACTERISTIC K_ED_LSHNK1.INC_NACH_EINTRAG "Fault code LSHNK1 - debounce filter increment after fault-memory entry [verified]" VALUE 0x70DA8 RL_VAL_UB 0 CM_0000 0 255 /end CHARACTERISTIC
/begin CHARACTERISTIC K_ED_LSHNK1.INC_VOR_EINTRAG "Fault code LSHNK1 - debounce filter increment before fault-memory entry [verified]" VALUE 0x70DA6 RL_VAL_UB 0 CM_0000 0 255 /end CHARACTERISTIC
/begin CHARACTERISTIC K_ED_LSHNK1.KLASSENINDEX "Fault code LSHNK1 - fault class selection (lamp / warning behaviour) [verified]" VALUE 0x70DAA RL_VAL_UB 0 CM_0000 0 255 /end CHARACTERISTIC
/begin CHARACTERISTIC K_ED_LSHNK1.OK_SCHWELLE "Fault code LSHNK1 - debounce filter threshold for clearing (healing) the fault [verified]" VALUE 0x70DA5 RL_VAL_UB 0 CM_0000 0 255 /end CHARACTERISTIC
/begin CHARACTERISTIC K_ED_LSHNK1.P_CODE_OPENLOAD "Fault code LSHNK1 - OBD P-code reported for open circuit [verified]" VALUE 0x70DA0 RL_VAL_UW 0 CM_0000 0 65535 /end CHARACTERISTIC
/begin CHARACTERISTIC K_ED_LSHNK1.P_CODE_SH_TO_GND "Fault code LSHNK1 - OBD P-code reported for short to ground [verified]" VALUE 0x70D9E RL_VAL_UW 0 CM_0000 0 65535 /end CHARACTERISTIC
/begin CHARACTERISTIC K_ED_LSHNK1.P_CODE_SH_TO_UB "Fault code LSHNK1 - OBD P-code reported for short to battery voltage [verified]" VALUE 0x70D9C RL_VAL_UW 0 CM_0000 0 65535 /end CHARACTERISTIC
/begin CHARACTERISTIC K_ED_LSHNK1.P_CODE_UNPLAUSIBEL "Fault code LSHNK1 - OBD P-code reported for implausible signal [verified]" VALUE 0x70DA2 RL_VAL_UW 0 CM_0000 0 65535 /end CHARACTERISTIC
/begin CHARACTERISTIC K_ED_LSHNK1_R.DEC_NACH_EINTRAG "Fault code LSHNK1_R - debounce filter decrement after fault-memory entry [verified]" VALUE 0x71DE9 RL_VAL_UB 0 CM_0000 0 255 /end CHARACTERISTIC
/begin CHARACTERISTIC K_ED_LSHNK1_R.DEC_VOR_EINTRAG "Fault code LSHNK1_R - debounce filter decrement before fault-memory entry [verified]" VALUE 0x71DE7 RL_VAL_UB 0 CM_0000 0 255 /end CHARACTERISTIC
/begin CHARACTERISTIC K_ED_LSHNK1_R.FEHLERSCHWELLE "Fault code LSHNK1_R - debounce filter threshold for setting the fault [verified]" VALUE 0x71DE4 RL_VAL_UB 0 CM_0000 0 255 /end CHARACTERISTIC
/begin CHARACTERISTIC K_ED_LSHNK1_R.INC_NACH_EINTRAG "Fault code LSHNK1_R - debounce filter increment after fault-memory entry [verified]" VALUE 0x71DE8 RL_VAL_UB 0 CM_0000 0 255 /end CHARACTERISTIC
/begin CHARACTERISTIC K_ED_LSHNK1_R.INC_VOR_EINTRAG "Fault code LSHNK1_R - debounce filter increment before fault-memory entry [verified]" VALUE 0x71DE6 RL_VAL_UB 0 CM_0000 0 255 /end CHARACTERISTIC
/begin CHARACTERISTIC K_ED_LSHNK1_R.KLASSENINDEX "Fault code LSHNK1_R - fault class selection (lamp / warning behaviour) [verified]" VALUE 0x71DEA RL_VAL_UB 0 CM_0000 0 255 /end CHARACTERISTIC
/begin CHARACTERISTIC K_ED_LSHNK1_R.OK_SCHWELLE "Fault code LSHNK1_R - debounce filter threshold for clearing (healing) the fault [verified]" VALUE 0x71DE5 RL_VAL_UB 0 CM_0000 0 255 /end CHARACTERISTIC
/begin CHARACTERISTIC K_ED_LSHNK1_R.P_CODE_OPENLOAD "Fault code LSHNK1_R - OBD P-code reported for open circuit [verified]" VALUE 0x71DE0 RL_VAL_UW 0 CM_0000 0 65535 /end CHARACTERISTIC
/begin CHARACTERISTIC K_ED_LSHNK1_R.P_CODE_SH_TO_GND "Fault code LSHNK1_R - OBD P-code reported for short to ground [verified]" VALUE 0x71DDE RL_VAL_UW 0 CM_0000 0 65535 /end CHARACTERISTIC
/begin CHARACTERISTIC K_ED_LSHNK1_R.P_CODE_SH_TO_UB "Fault code LSHNK1_R - OBD P-code reported for short to battery voltage [verified]" VALUE 0x71DDC RL_VAL_UW 0 CM_0000 0 65535 /end CHARACTERISTIC
/begin CHARACTERISTIC K_ED_LSHNK1_R.P_CODE_UNPLAUSIBEL "Fault code LSHNK1_R - OBD P-code reported for implausible signal [verified]" VALUE 0x71DE2 RL_VAL_UW 0 CM_0000 0 65535 /end CHARACTERISTIC
/begin CHARACTERISTIC K_ED_LSHNK2.DEC_NACH_EINTRAG "Fault code LSHNK2 - debounce filter decrement after fault-memory entry [verified]" VALUE 0x70DC3 RL_VAL_UB 0 CM_0000 0 255 /end CHARACTERISTIC
/begin CHARACTERISTIC K_ED_LSHNK2.DEC_VOR_EINTRAG "Fault code LSHNK2 - debounce filter decrement before fault-memory entry [verified]" VALUE 0x70DC1 RL_VAL_UB 0 CM_0000 0 255 /end CHARACTERISTIC
/begin CHARACTERISTIC K_ED_LSHNK2.FEHLERSCHWELLE "Fault code LSHNK2 - debounce filter threshold for setting the fault [verified]" VALUE 0x70DBE RL_VAL_UB 0 CM_0000 0 255 /end CHARACTERISTIC
/begin CHARACTERISTIC K_ED_LSHNK2.INC_NACH_EINTRAG "Fault code LSHNK2 - debounce filter increment after fault-memory entry [verified]" VALUE 0x70DC2 RL_VAL_UB 0 CM_0000 0 255 /end CHARACTERISTIC
/begin CHARACTERISTIC K_ED_LSHNK2.INC_VOR_EINTRAG "Fault code LSHNK2 - debounce filter increment before fault-memory entry [verified]" VALUE 0x70DC0 RL_VAL_UB 0 CM_0000 0 255 /end CHARACTERISTIC
/begin CHARACTERISTIC K_ED_LSHNK2.KLASSENINDEX "Fault code LSHNK2 - fault class selection (lamp / warning behaviour) [verified]" VALUE 0x70DC4 RL_VAL_UB 0 CM_0000 0 255 /end CHARACTERISTIC
/begin CHARACTERISTIC K_ED_LSHNK2.OK_SCHWELLE "Fault code LSHNK2 - debounce filter threshold for clearing (healing) the fault [verified]" VALUE 0x70DBF RL_VAL_UB 0 CM_0000 0 255 /end CHARACTERISTIC
/begin CHARACTERISTIC K_ED_LSHNK2.P_CODE_OPENLOAD "Fault code LSHNK2 - OBD P-code reported for open circuit [verified]" VALUE 0x70DBA RL_VAL_UW 0 CM_0000 0 65535 /end CHARACTERISTIC
/begin CHARACTERISTIC K_ED_LSHNK2.P_CODE_SH_TO_GND "Fault code LSHNK2 - OBD P-code reported for short to ground [verified]" VALUE 0x70DB8 RL_VAL_UW 0 CM_0000 0 65535 /end CHARACTERISTIC
/begin CHARACTERISTIC K_ED_LSHNK2.P_CODE_SH_TO_UB "Fault code LSHNK2 - OBD P-code reported for short to battery voltage [verified]" VALUE 0x70DB6 RL_VAL_UW 0 CM_0000 0 65535 /end CHARACTERISTIC
/begin CHARACTERISTIC K_ED_LSHNK2.P_CODE_UNPLAUSIBEL "Fault code LSHNK2 - OBD P-code reported for implausible signal [verified]" VALUE 0x70DBC RL_VAL_UW 0 CM_0000 0 65535 /end CHARACTERISTIC
/begin CHARACTERISTIC K_ED_LSHNK2_R.DEC_NACH_EINTRAG "Fault code LSHNK2_R - debounce filter decrement after fault-memory entry [verified]" VALUE 0x71E03 RL_VAL_UB 0 CM_0000 0 255 /end CHARACTERISTIC
/begin CHARACTERISTIC K_ED_LSHNK2_R.DEC_VOR_EINTRAG "Fault code LSHNK2_R - debounce filter decrement before fault-memory entry [verified]" VALUE 0x71E01 RL_VAL_UB 0 CM_0000 0 255 /end CHARACTERISTIC
/begin CHARACTERISTIC K_ED_LSHNK2_R.FEHLERSCHWELLE "Fault code LSHNK2_R - debounce filter threshold for setting the fault [verified]" VALUE 0x71DFE RL_VAL_UB 0 CM_0000 0 255 /end CHARACTERISTIC
/begin CHARACTERISTIC K_ED_LSHNK2_R.INC_NACH_EINTRAG "Fault code LSHNK2_R - debounce filter increment after fault-memory entry [verified]" VALUE 0x71E02 RL_VAL_UB 0 CM_0000 0 255 /end CHARACTERISTIC
/begin CHARACTERISTIC K_ED_LSHNK2_R.INC_VOR_EINTRAG "Fault code LSHNK2_R - debounce filter increment before fault-memory entry [verified]" VALUE 0x71E00 RL_VAL_UB 0 CM_0000 0 255 /end CHARACTERISTIC
/begin CHARACTERISTIC K_ED_LSHNK2_R.KLASSENINDEX "Fault code LSHNK2_R - fault class selection (lamp / warning behaviour) [verified]" VALUE 0x71E04 RL_VAL_UB 0 CM_0000 0 255 /end CHARACTERISTIC
/begin CHARACTERISTIC K_ED_LSHNK2_R.OK_SCHWELLE "Fault code LSHNK2_R - debounce filter threshold for clearing (healing) the fault [verified]" VALUE 0x71DFF RL_VAL_UB 0 CM_0000 0 255 /end CHARACTERISTIC
/begin CHARACTERISTIC K_ED_LSHNK2_R.P_CODE_OPENLOAD "Fault code LSHNK2_R - OBD P-code reported for open circuit [verified]" VALUE 0x71DFA RL_VAL_UW 0 CM_0000 0 65535 /end CHARACTERISTIC
/begin CHARACTERISTIC K_ED_LSHNK2_R.P_CODE_SH_TO_GND "Fault code LSHNK2_R - OBD P-code reported for short to ground [verified]" VALUE 0x71DF8 RL_VAL_UW 0 CM_0000 0 65535 /end CHARACTERISTIC
/begin CHARACTERISTIC K_ED_LSHNK2_R.P_CODE_SH_TO_UB "Fault code LSHNK2_R - OBD P-code reported for short to battery voltage [verified]" VALUE 0x71DF6 RL_VAL_UW 0 CM_0000 0 65535 /end CHARACTERISTIC
/begin CHARACTERISTIC K_ED_LSHNK2_R.P_CODE_UNPLAUSIBEL "Fault code LSHNK2_R - OBD P-code reported for implausible signal [verified]" VALUE 0x71DFC RL_VAL_UW 0 CM_0000 0 65535 /end CHARACTERISTIC
/begin CHARACTERISTIC K_ED_LSHVK1.DEC_NACH_EINTRAG "Fault code LSHVK1 - debounce filter decrement after fault-memory entry [verified]" VALUE 0x70F7D RL_VAL_UB 0 CM_0000 0 255 /end CHARACTERISTIC
/begin CHARACTERISTIC K_ED_LSHVK1.DEC_VOR_EINTRAG "Fault code LSHVK1 - debounce filter decrement before fault-memory entry [verified]" VALUE 0x70F7B RL_VAL_UB 0 CM_0000 0 255 /end CHARACTERISTIC
/begin CHARACTERISTIC K_ED_LSHVK1.FEHLERSCHWELLE "Fault code LSHVK1 - debounce filter threshold for setting the fault [verified]" VALUE 0x70F78 RL_VAL_UB 0 CM_0000 0 255 /end CHARACTERISTIC
/begin CHARACTERISTIC K_ED_LSHVK1.INC_NACH_EINTRAG "Fault code LSHVK1 - debounce filter increment after fault-memory entry [verified]" VALUE 0x70F7C RL_VAL_UB 0 CM_0000 0 255 /end CHARACTERISTIC
/begin CHARACTERISTIC K_ED_LSHVK1.INC_VOR_EINTRAG "Fault code LSHVK1 - debounce filter increment before fault-memory entry [verified]" VALUE 0x70F7A RL_VAL_UB 0 CM_0000 0 255 /end CHARACTERISTIC
/begin CHARACTERISTIC K_ED_LSHVK1.KLASSENINDEX "Fault code LSHVK1 - fault class selection (lamp / warning behaviour) [verified]" VALUE 0x70F7E RL_VAL_UB 0 CM_0000 0 255 /end CHARACTERISTIC
/begin CHARACTERISTIC K_ED_LSHVK1.OK_SCHWELLE "Fault code LSHVK1 - debounce filter threshold for clearing (healing) the fault [verified]" VALUE 0x70F79 RL_VAL_UB 0 CM_0000 0 255 /end CHARACTERISTIC
/begin CHARACTERISTIC K_ED_LSHVK1.P_CODE_OPENLOAD "Fault code LSHVK1 - OBD P-code reported for open circuit [verified]" VALUE 0x70F74 RL_VAL_UW 0 CM_0000 0 65535 /end CHARACTERISTIC
/begin CHARACTERISTIC K_ED_LSHVK1.P_CODE_SH_TO_GND "Fault code LSHVK1 - OBD P-code reported for short to ground [verified]" VALUE 0x70F72 RL_VAL_UW 0 CM_0000 0 65535 /end CHARACTERISTIC
/begin CHARACTERISTIC K_ED_LSHVK1.P_CODE_SH_TO_UB "Fault code LSHVK1 - OBD P-code reported for short to battery voltage [verified]" VALUE 0x70F70 RL_VAL_UW 0 CM_0000 0 65535 /end CHARACTERISTIC
/begin CHARACTERISTIC K_ED_LSHVK1.P_CODE_UNPLAUSIBEL "Fault code LSHVK1 - OBD P-code reported for implausible signal [verified]" VALUE 0x70F76 RL_VAL_UW 0 CM_0000 0 65535 /end CHARACTERISTIC
/begin CHARACTERISTIC K_ED_LSHVK1_R.DEC_NACH_EINTRAG "Fault code LSHVK1_R - debounce filter decrement after fault-memory entry [verified]" VALUE 0x70FE5 RL_VAL_UB 0 CM_0000 0 255 /end CHARACTERISTIC
/begin CHARACTERISTIC K_ED_LSHVK1_R.DEC_VOR_EINTRAG "Fault code LSHVK1_R - debounce filter decrement before fault-memory entry [verified]" VALUE 0x70FE3 RL_VAL_UB 0 CM_0000 0 255 /end CHARACTERISTIC
/begin CHARACTERISTIC K_ED_LSHVK1_R.FEHLERSCHWELLE "Fault code LSHVK1_R - debounce filter threshold for setting the fault [verified]" VALUE 0x70FE0 RL_VAL_UB 0 CM_0000 0 255 /end CHARACTERISTIC
/begin CHARACTERISTIC K_ED_LSHVK1_R.INC_NACH_EINTRAG "Fault code LSHVK1_R - debounce filter increment after fault-memory entry [verified]" VALUE 0x70FE4 RL_VAL_UB 0 CM_0000 0 255 /end CHARACTERISTIC
/begin CHARACTERISTIC K_ED_LSHVK1_R.INC_VOR_EINTRAG "Fault code LSHVK1_R - debounce filter increment before fault-memory entry [verified]" VALUE 0x70FE2 RL_VAL_UB 0 CM_0000 0 255 /end CHARACTERISTIC
/begin CHARACTERISTIC K_ED_LSHVK1_R.KLASSENINDEX "Fault code LSHVK1_R - fault class selection (lamp / warning behaviour) [verified]" VALUE 0x70FE6 RL_VAL_UB 0 CM_0000 0 255 /end CHARACTERISTIC
/begin CHARACTERISTIC K_ED_LSHVK1_R.OK_SCHWELLE "Fault code LSHVK1_R - debounce filter threshold for clearing (healing) the fault [verified]" VALUE 0x70FE1 RL_VAL_UB 0 CM_0000 0 255 /end CHARACTERISTIC
/begin CHARACTERISTIC K_ED_LSHVK1_R.P_CODE_OPENLOAD "Fault code LSHVK1_R - OBD P-code reported for open circuit [verified]" VALUE 0x70FDC RL_VAL_UW 0 CM_0000 0 65535 /end CHARACTERISTIC
/begin CHARACTERISTIC K_ED_LSHVK1_R.P_CODE_SH_TO_GND "Fault code LSHVK1_R - OBD P-code reported for short to ground [verified]" VALUE 0x70FDA RL_VAL_UW 0 CM_0000 0 65535 /end CHARACTERISTIC
/begin CHARACTERISTIC K_ED_LSHVK1_R.P_CODE_SH_TO_UB "Fault code LSHVK1_R - OBD P-code reported for short to battery voltage [verified]" VALUE 0x70FD8 RL_VAL_UW 0 CM_0000 0 65535 /end CHARACTERISTIC
/begin CHARACTERISTIC K_ED_LSHVK1_R.P_CODE_UNPLAUSIBEL "Fault code LSHVK1_R - OBD P-code reported for implausible signal [verified]" VALUE 0x70FDE RL_VAL_UW 0 CM_0000 0 65535 /end CHARACTERISTIC
/begin CHARACTERISTIC K_ED_LSHVK2.DEC_NACH_EINTRAG "Fault code LSHVK2 - debounce filter decrement after fault-memory entry [verified]" VALUE 0x70F97 RL_VAL_UB 0 CM_0000 0 255 /end CHARACTERISTIC
/begin CHARACTERISTIC K_ED_LSHVK2.DEC_VOR_EINTRAG "Fault code LSHVK2 - debounce filter decrement before fault-memory entry [verified]" VALUE 0x70F95 RL_VAL_UB 0 CM_0000 0 255 /end CHARACTERISTIC
/begin CHARACTERISTIC K_ED_LSHVK2.FEHLERSCHWELLE "Fault code LSHVK2 - debounce filter threshold for setting the fault [verified]" VALUE 0x70F92 RL_VAL_UB 0 CM_0000 0 255 /end CHARACTERISTIC
/begin CHARACTERISTIC K_ED_LSHVK2.INC_NACH_EINTRAG "Fault code LSHVK2 - debounce filter increment after fault-memory entry [verified]" VALUE 0x70F96 RL_VAL_UB 0 CM_0000 0 255 /end CHARACTERISTIC
/begin CHARACTERISTIC K_ED_LSHVK2.INC_VOR_EINTRAG "Fault code LSHVK2 - debounce filter increment before fault-memory entry [verified]" VALUE 0x70F94 RL_VAL_UB 0 CM_0000 0 255 /end CHARACTERISTIC
/begin CHARACTERISTIC K_ED_LSHVK2.KLASSENINDEX "Fault code LSHVK2 - fault class selection (lamp / warning behaviour) [verified]" VALUE 0x70F98 RL_VAL_UB 0 CM_0000 0 255 /end CHARACTERISTIC
/begin CHARACTERISTIC K_ED_LSHVK2.OK_SCHWELLE "Fault code LSHVK2 - debounce filter threshold for clearing (healing) the fault [verified]" VALUE 0x70F93 RL_VAL_UB 0 CM_0000 0 255 /end CHARACTERISTIC
/begin CHARACTERISTIC K_ED_LSHVK2.P_CODE_OPENLOAD "Fault code LSHVK2 - OBD P-code reported for open circuit [verified]" VALUE 0x70F8E RL_VAL_UW 0 CM_0000 0 65535 /end CHARACTERISTIC
/begin CHARACTERISTIC K_ED_LSHVK2.P_CODE_SH_TO_GND "Fault code LSHVK2 - OBD P-code reported for short to ground [verified]" VALUE 0x70F8C RL_VAL_UW 0 CM_0000 0 65535 /end CHARACTERISTIC
/begin CHARACTERISTIC K_ED_LSHVK2.P_CODE_SH_TO_UB "Fault code LSHVK2 - OBD P-code reported for short to battery voltage [verified]" VALUE 0x70F8A RL_VAL_UW 0 CM_0000 0 65535 /end CHARACTERISTIC
/begin CHARACTERISTIC K_ED_LSHVK2.P_CODE_UNPLAUSIBEL "Fault code LSHVK2 - OBD P-code reported for implausible signal [verified]" VALUE 0x70F90 RL_VAL_UW 0 CM_0000 0 65535 /end CHARACTERISTIC
/begin CHARACTERISTIC K_ED_LSHVK2_R.DEC_NACH_EINTRAG "Fault code LSHVK2_R - debounce filter decrement after fault-memory entry [verified]" VALUE 0x70FFF RL_VAL_UB 0 CM_0000 0 255 /end CHARACTERISTIC
/begin CHARACTERISTIC K_ED_LSHVK2_R.DEC_VOR_EINTRAG "Fault code LSHVK2_R - debounce filter decrement before fault-memory entry [verified]" VALUE 0x70FFD RL_VAL_UB 0 CM_0000 0 255 /end CHARACTERISTIC
/begin CHARACTERISTIC K_ED_LSHVK2_R.FEHLERSCHWELLE "Fault code LSHVK2_R - debounce filter threshold for setting the fault [verified]" VALUE 0x70FFA RL_VAL_UB 0 CM_0000 0 255 /end CHARACTERISTIC
/begin CHARACTERISTIC K_ED_LSHVK2_R.INC_NACH_EINTRAG "Fault code LSHVK2_R - debounce filter increment after fault-memory entry [verified]" VALUE 0x70FFE RL_VAL_UB 0 CM_0000 0 255 /end CHARACTERISTIC
/begin CHARACTERISTIC K_ED_LSHVK2_R.INC_VOR_EINTRAG "Fault code LSHVK2_R - debounce filter increment before fault-memory entry [verified]" VALUE 0x70FFC RL_VAL_UB 0 CM_0000 0 255 /end CHARACTERISTIC
/begin CHARACTERISTIC K_ED_LSHVK2_R.KLASSENINDEX "Fault code LSHVK2_R - fault class selection (lamp / warning behaviour) [verified]" VALUE 0x71000 RL_VAL_UB 0 CM_0000 0 255 /end CHARACTERISTIC
/begin CHARACTERISTIC K_ED_LSHVK2_R.OK_SCHWELLE "Fault code LSHVK2_R - debounce filter threshold for clearing (healing) the fault [verified]" VALUE 0x70FFB RL_VAL_UB 0 CM_0000 0 255 /end CHARACTERISTIC
/begin CHARACTERISTIC K_ED_LSHVK2_R.P_CODE_OPENLOAD "Fault code LSHVK2_R - OBD P-code reported for open circuit [verified]" VALUE 0x70FF6 RL_VAL_UW 0 CM_0000 0 65535 /end CHARACTERISTIC
/begin CHARACTERISTIC K_ED_LSHVK2_R.P_CODE_SH_TO_GND "Fault code LSHVK2_R - OBD P-code reported for short to ground [verified]" VALUE 0x70FF4 RL_VAL_UW 0 CM_0000 0 65535 /end CHARACTERISTIC
/begin CHARACTERISTIC K_ED_LSHVK2_R.P_CODE_SH_TO_UB "Fault code LSHVK2_R - OBD P-code reported for short to battery voltage [verified]" VALUE 0x70FF2 RL_VAL_UW 0 CM_0000 0 65535 /end CHARACTERISTIC
/begin CHARACTERISTIC K_ED_LSHVK2_R.P_CODE_UNPLAUSIBEL "Fault code LSHVK2_R - OBD P-code reported for implausible signal [verified]" VALUE 0x70FF8 RL_VAL_UW 0 CM_0000 0 65535 /end CHARACTERISTIC
/begin CHARACTERISTIC K_ED_LSRVK1_OBD_REF.DEC_NACH_EINTRAG "Fault code LSRVK1_OBD_REF - debounce filter decrement after fault-memory entry [verified]" VALUE 0x7104D RL_VAL_UB 0 CM_0000 0 255 /end CHARACTERISTIC
/begin CHARACTERISTIC K_ED_LSRVK1_OBD_REF.DEC_VOR_EINTRAG "Fault code LSRVK1_OBD_REF - debounce filter decrement before fault-memory entry [verified]" VALUE 0x7104B RL_VAL_UB 0 CM_0000 0 255 /end CHARACTERISTIC
/begin CHARACTERISTIC K_ED_LSRVK1_OBD_REF.FEHLERSCHWELLE "Fault code LSRVK1_OBD_REF - debounce filter threshold for setting the fault [verified]" VALUE 0x71048 RL_VAL_UB 0 CM_0000 0 255 /end CHARACTERISTIC
/begin CHARACTERISTIC K_ED_LSRVK1_OBD_REF.INC_NACH_EINTRAG "Fault code LSRVK1_OBD_REF - debounce filter increment after fault-memory entry [verified]" VALUE 0x7104C RL_VAL_UB 0 CM_0000 0 255 /end CHARACTERISTIC
/begin CHARACTERISTIC K_ED_LSRVK1_OBD_REF.INC_VOR_EINTRAG "Fault code LSRVK1_OBD_REF - debounce filter increment before fault-memory entry [verified]" VALUE 0x7104A RL_VAL_UB 0 CM_0000 0 255 /end CHARACTERISTIC
/begin CHARACTERISTIC K_ED_LSRVK1_OBD_REF.KLASSENINDEX "Fault code LSRVK1_OBD_REF - fault class selection (lamp / warning behaviour) [verified]" VALUE 0x7104E RL_VAL_UB 0 CM_0000 0 255 /end CHARACTERISTIC
/begin CHARACTERISTIC K_ED_LSRVK1_OBD_REF.OK_SCHWELLE "Fault code LSRVK1_OBD_REF - debounce filter threshold for clearing (healing) the fault [verified]" VALUE 0x71049 RL_VAL_UB 0 CM_0000 0 255 /end CHARACTERISTIC
/begin CHARACTERISTIC K_ED_LSRVK1_OBD_REF.P_CODE_OPENLOAD "Fault code LSRVK1_OBD_REF - OBD P-code reported for open circuit [verified]" VALUE 0x71044 RL_VAL_UW 0 CM_0000 0 65535 /end CHARACTERISTIC
/begin CHARACTERISTIC K_ED_LSRVK1_OBD_REF.P_CODE_SH_TO_GND "Fault code LSRVK1_OBD_REF - OBD P-code reported for short to ground [verified]" VALUE 0x71042 RL_VAL_UW 0 CM_0000 0 65535 /end CHARACTERISTIC
/begin CHARACTERISTIC K_ED_LSRVK1_OBD_REF.P_CODE_SH_TO_UB "Fault code LSRVK1_OBD_REF - OBD P-code reported for short to battery voltage [verified]" VALUE 0x71040 RL_VAL_UW 0 CM_0000 0 65535 /end CHARACTERISTIC
/begin CHARACTERISTIC K_ED_LSRVK1_OBD_REF.P_CODE_UNPLAUSIBEL "Fault code LSRVK1_OBD_REF - OBD P-code reported for implausible signal [verified]" VALUE 0x71046 RL_VAL_UW 0 CM_0000 0 65535 /end CHARACTERISTIC
/begin CHARACTERISTIC K_ED_LSRVK1_OBD_REG.DEC_NACH_EINTRAG "Fault code LSRVK1_OBD_REG - debounce filter decrement after fault-memory entry [verified]" VALUE 0x70FB1 RL_VAL_UB 0 CM_0000 0 255 /end CHARACTERISTIC
/begin CHARACTERISTIC K_ED_LSRVK1_OBD_REG.DEC_VOR_EINTRAG "Fault code LSRVK1_OBD_REG - debounce filter decrement before fault-memory entry [verified]" VALUE 0x70FAF RL_VAL_UB 0 CM_0000 0 255 /end CHARACTERISTIC
/begin CHARACTERISTIC K_ED_LSRVK1_OBD_REG.FEHLERSCHWELLE "Fault code LSRVK1_OBD_REG - debounce filter threshold for setting the fault [verified]" VALUE 0x70FAC RL_VAL_UB 0 CM_0000 0 255 /end CHARACTERISTIC
/begin CHARACTERISTIC K_ED_LSRVK1_OBD_REG.INC_NACH_EINTRAG "Fault code LSRVK1_OBD_REG - debounce filter increment after fault-memory entry [verified]" VALUE 0x70FB0 RL_VAL_UB 0 CM_0000 0 255 /end CHARACTERISTIC
/begin CHARACTERISTIC K_ED_LSRVK1_OBD_REG.INC_VOR_EINTRAG "Fault code LSRVK1_OBD_REG - debounce filter increment before fault-memory entry [verified]" VALUE 0x70FAE RL_VAL_UB 0 CM_0000 0 255 /end CHARACTERISTIC
/begin CHARACTERISTIC K_ED_LSRVK1_OBD_REG.KLASSENINDEX "Fault code LSRVK1_OBD_REG - fault class selection (lamp / warning behaviour) [verified]" VALUE 0x70FB2 RL_VAL_UB 0 CM_0000 0 255 /end CHARACTERISTIC
/begin CHARACTERISTIC K_ED_LSRVK1_OBD_REG.OK_SCHWELLE "Fault code LSRVK1_OBD_REG - debounce filter threshold for clearing (healing) the fault [verified]" VALUE 0x70FAD RL_VAL_UB 0 CM_0000 0 255 /end CHARACTERISTIC
/begin CHARACTERISTIC K_ED_LSRVK1_OBD_REG.P_CODE_OPENLOAD "Fault code LSRVK1_OBD_REG - OBD P-code reported for open circuit [verified]" VALUE 0x70FA8 RL_VAL_UW 0 CM_0000 0 65535 /end CHARACTERISTIC
/begin CHARACTERISTIC K_ED_LSRVK1_OBD_REG.P_CODE_SH_TO_GND "Fault code LSRVK1_OBD_REG - OBD P-code reported for short to ground [verified]" VALUE 0x70FA6 RL_VAL_UW 0 CM_0000 0 65535 /end CHARACTERISTIC
/begin CHARACTERISTIC K_ED_LSRVK1_OBD_REG.P_CODE_SH_TO_UB "Fault code LSRVK1_OBD_REG - OBD P-code reported for short to battery voltage [verified]" VALUE 0x70FA4 RL_VAL_UW 0 CM_0000 0 65535 /end CHARACTERISTIC
/begin CHARACTERISTIC K_ED_LSRVK1_OBD_REG.P_CODE_UNPLAUSIBEL "Fault code LSRVK1_OBD_REG - OBD P-code reported for implausible signal [verified]" VALUE 0x70FAA RL_VAL_UW 0 CM_0000 0 65535 /end CHARACTERISTIC
/begin CHARACTERISTIC K_ED_LSRVK1_OBD_START.DEC_NACH_EINTRAG "Fault code LSRVK1_OBD_START - debounce filter decrement after fault-memory entry [verified]" VALUE 0x71019 RL_VAL_UB 0 CM_0000 0 255 /end CHARACTERISTIC
/begin CHARACTERISTIC K_ED_LSRVK1_OBD_START.DEC_VOR_EINTRAG "Fault code LSRVK1_OBD_START - debounce filter decrement before fault-memory entry [verified]" VALUE 0x71017 RL_VAL_UB 0 CM_0000 0 255 /end CHARACTERISTIC
/begin CHARACTERISTIC K_ED_LSRVK1_OBD_START.FEHLERSCHWELLE "Fault code LSRVK1_OBD_START - debounce filter threshold for setting the fault [verified]" VALUE 0x71014 RL_VAL_UB 0 CM_0000 0 255 /end CHARACTERISTIC
/begin CHARACTERISTIC K_ED_LSRVK1_OBD_START.INC_NACH_EINTRAG "Fault code LSRVK1_OBD_START - debounce filter increment after fault-memory entry [verified]" VALUE 0x71018 RL_VAL_UB 0 CM_0000 0 255 /end CHARACTERISTIC
/begin CHARACTERISTIC K_ED_LSRVK1_OBD_START.INC_VOR_EINTRAG "Fault code LSRVK1_OBD_START - debounce filter increment before fault-memory entry [verified]" VALUE 0x71016 RL_VAL_UB 0 CM_0000 0 255 /end CHARACTERISTIC
/begin CHARACTERISTIC K_ED_LSRVK1_OBD_START.KLASSENINDEX "Fault code LSRVK1_OBD_START - fault class selection (lamp / warning behaviour) [verified]" VALUE 0x7101A RL_VAL_UB 0 CM_0000 0 255 /end CHARACTERISTIC
/begin CHARACTERISTIC K_ED_LSRVK1_OBD_START.OK_SCHWELLE "Fault code LSRVK1_OBD_START - debounce filter threshold for clearing (healing) the fault [verified]" VALUE 0x71015 RL_VAL_UB 0 CM_0000 0 255 /end CHARACTERISTIC
/begin CHARACTERISTIC K_ED_LSRVK1_OBD_START.P_CODE_OPENLOAD "Fault code LSRVK1_OBD_START - OBD P-code reported for open circuit [verified]" VALUE 0x71010 RL_VAL_UW 0 CM_0000 0 65535 /end CHARACTERISTIC
/begin CHARACTERISTIC K_ED_LSRVK1_OBD_START.P_CODE_SH_TO_GND "Fault code LSRVK1_OBD_START - OBD P-code reported for short to ground [verified]" VALUE 0x7100E RL_VAL_UW 0 CM_0000 0 65535 /end CHARACTERISTIC
/begin CHARACTERISTIC K_ED_LSRVK1_OBD_START.P_CODE_SH_TO_UB "Fault code LSRVK1_OBD_START - OBD P-code reported for short to battery voltage [verified]" VALUE 0x7100C RL_VAL_UW 0 CM_0000 0 65535 /end CHARACTERISTIC
/begin CHARACTERISTIC K_ED_LSRVK1_OBD_START.P_CODE_UNPLAUSIBEL "Fault code LSRVK1_OBD_START - OBD P-code reported for implausible signal [verified]" VALUE 0x71012 RL_VAL_UW 0 CM_0000 0 65535 /end CHARACTERISTIC
/begin CHARACTERISTIC K_ED_LSRVK2_OBD_REF.DEC_NACH_EINTRAG "Fault code LSRVK2_OBD_REF - debounce filter decrement after fault-memory entry [verified]" VALUE 0x71067 RL_VAL_UB 0 CM_0000 0 255 /end CHARACTERISTIC
/begin CHARACTERISTIC K_ED_LSRVK2_OBD_REF.DEC_VOR_EINTRAG "Fault code LSRVK2_OBD_REF - debounce filter decrement before fault-memory entry [verified]" VALUE 0x71065 RL_VAL_UB 0 CM_0000 0 255 /end CHARACTERISTIC
/begin CHARACTERISTIC K_ED_LSRVK2_OBD_REF.FEHLERSCHWELLE "Fault code LSRVK2_OBD_REF - debounce filter threshold for setting the fault [verified]" VALUE 0x71062 RL_VAL_UB 0 CM_0000 0 255 /end CHARACTERISTIC
/begin CHARACTERISTIC K_ED_LSRVK2_OBD_REF.INC_NACH_EINTRAG "Fault code LSRVK2_OBD_REF - debounce filter increment after fault-memory entry [verified]" VALUE 0x71066 RL_VAL_UB 0 CM_0000 0 255 /end CHARACTERISTIC
/begin CHARACTERISTIC K_ED_LSRVK2_OBD_REF.INC_VOR_EINTRAG "Fault code LSRVK2_OBD_REF - debounce filter increment before fault-memory entry [verified]" VALUE 0x71064 RL_VAL_UB 0 CM_0000 0 255 /end CHARACTERISTIC
/begin CHARACTERISTIC K_ED_LSRVK2_OBD_REF.KLASSENINDEX "Fault code LSRVK2_OBD_REF - fault class selection (lamp / warning behaviour) [verified]" VALUE 0x71068 RL_VAL_UB 0 CM_0000 0 255 /end CHARACTERISTIC
/begin CHARACTERISTIC K_ED_LSRVK2_OBD_REF.OK_SCHWELLE "Fault code LSRVK2_OBD_REF - debounce filter threshold for clearing (healing) the fault [verified]" VALUE 0x71063 RL_VAL_UB 0 CM_0000 0 255 /end CHARACTERISTIC
/begin CHARACTERISTIC K_ED_LSRVK2_OBD_REF.P_CODE_OPENLOAD "Fault code LSRVK2_OBD_REF - OBD P-code reported for open circuit [verified]" VALUE 0x7105E RL_VAL_UW 0 CM_0000 0 65535 /end CHARACTERISTIC
/begin CHARACTERISTIC K_ED_LSRVK2_OBD_REF.P_CODE_SH_TO_GND "Fault code LSRVK2_OBD_REF - OBD P-code reported for short to ground [verified]" VALUE 0x7105C RL_VAL_UW 0 CM_0000 0 65535 /end CHARACTERISTIC
/begin CHARACTERISTIC K_ED_LSRVK2_OBD_REF.P_CODE_SH_TO_UB "Fault code LSRVK2_OBD_REF - OBD P-code reported for short to battery voltage [verified]" VALUE 0x7105A RL_VAL_UW 0 CM_0000 0 65535 /end CHARACTERISTIC
/begin CHARACTERISTIC K_ED_LSRVK2_OBD_REF.P_CODE_UNPLAUSIBEL "Fault code LSRVK2_OBD_REF - OBD P-code reported for implausible signal [verified]" VALUE 0x71060 RL_VAL_UW 0 CM_0000 0 65535 /end CHARACTERISTIC
/begin CHARACTERISTIC K_ED_LSRVK2_OBD_REG.DEC_NACH_EINTRAG "Fault code LSRVK2_OBD_REG - debounce filter decrement after fault-memory entry [verified]" VALUE 0x70FCB RL_VAL_UB 0 CM_0000 0 255 /end CHARACTERISTIC
/begin CHARACTERISTIC K_ED_LSRVK2_OBD_REG.DEC_VOR_EINTRAG "Fault code LSRVK2_OBD_REG - debounce filter decrement before fault-memory entry [verified]" VALUE 0x70FC9 RL_VAL_UB 0 CM_0000 0 255 /end CHARACTERISTIC
/begin CHARACTERISTIC K_ED_LSRVK2_OBD_REG.FEHLERSCHWELLE "Fault code LSRVK2_OBD_REG - debounce filter threshold for setting the fault [verified]" VALUE 0x70FC6 RL_VAL_UB 0 CM_0000 0 255 /end CHARACTERISTIC
/begin CHARACTERISTIC K_ED_LSRVK2_OBD_REG.INC_NACH_EINTRAG "Fault code LSRVK2_OBD_REG - debounce filter increment after fault-memory entry [verified]" VALUE 0x70FCA RL_VAL_UB 0 CM_0000 0 255 /end CHARACTERISTIC
/begin CHARACTERISTIC K_ED_LSRVK2_OBD_REG.INC_VOR_EINTRAG "Fault code LSRVK2_OBD_REG - debounce filter increment before fault-memory entry [verified]" VALUE 0x70FC8 RL_VAL_UB 0 CM_0000 0 255 /end CHARACTERISTIC
/begin CHARACTERISTIC K_ED_LSRVK2_OBD_REG.KLASSENINDEX "Fault code LSRVK2_OBD_REG - fault class selection (lamp / warning behaviour) [verified]" VALUE 0x70FCC RL_VAL_UB 0 CM_0000 0 255 /end CHARACTERISTIC
/begin CHARACTERISTIC K_ED_LSRVK2_OBD_REG.OK_SCHWELLE "Fault code LSRVK2_OBD_REG - debounce filter threshold for clearing (healing) the fault [verified]" VALUE 0x70FC7 RL_VAL_UB 0 CM_0000 0 255 /end CHARACTERISTIC
/begin CHARACTERISTIC K_ED_LSRVK2_OBD_REG.P_CODE_OPENLOAD "Fault code LSRVK2_OBD_REG - OBD P-code reported for open circuit [verified]" VALUE 0x70FC2 RL_VAL_UW 0 CM_0000 0 65535 /end CHARACTERISTIC
/begin CHARACTERISTIC K_ED_LSRVK2_OBD_REG.P_CODE_SH_TO_GND "Fault code LSRVK2_OBD_REG - OBD P-code reported for short to ground [verified]" VALUE 0x70FC0 RL_VAL_UW 0 CM_0000 0 65535 /end CHARACTERISTIC
/begin CHARACTERISTIC K_ED_LSRVK2_OBD_REG.P_CODE_SH_TO_UB "Fault code LSRVK2_OBD_REG - OBD P-code reported for short to battery voltage [verified]" VALUE 0x70FBE RL_VAL_UW 0 CM_0000 0 65535 /end CHARACTERISTIC
/begin CHARACTERISTIC K_ED_LSRVK2_OBD_REG.P_CODE_UNPLAUSIBEL "Fault code LSRVK2_OBD_REG - OBD P-code reported for implausible signal [verified]" VALUE 0x70FC4 RL_VAL_UW 0 CM_0000 0 65535 /end CHARACTERISTIC
/begin CHARACTERISTIC K_ED_LSRVK2_OBD_START.DEC_NACH_EINTRAG "Fault code LSRVK2_OBD_START - debounce filter decrement after fault-memory entry [verified]" VALUE 0x71033 RL_VAL_UB 0 CM_0000 0 255 /end CHARACTERISTIC
/begin CHARACTERISTIC K_ED_LSRVK2_OBD_START.DEC_VOR_EINTRAG "Fault code LSRVK2_OBD_START - debounce filter decrement before fault-memory entry [verified]" VALUE 0x71031 RL_VAL_UB 0 CM_0000 0 255 /end CHARACTERISTIC
/begin CHARACTERISTIC K_ED_LSRVK2_OBD_START.FEHLERSCHWELLE "Fault code LSRVK2_OBD_START - debounce filter threshold for setting the fault [verified]" VALUE 0x7102E RL_VAL_UB 0 CM_0000 0 255 /end CHARACTERISTIC
/begin CHARACTERISTIC K_ED_LSRVK2_OBD_START.INC_NACH_EINTRAG "Fault code LSRVK2_OBD_START - debounce filter increment after fault-memory entry [verified]" VALUE 0x71032 RL_VAL_UB 0 CM_0000 0 255 /end CHARACTERISTIC
/begin CHARACTERISTIC K_ED_LSRVK2_OBD_START.INC_VOR_EINTRAG "Fault code LSRVK2_OBD_START - debounce filter increment before fault-memory entry [verified]" VALUE 0x71030 RL_VAL_UB 0 CM_0000 0 255 /end CHARACTERISTIC
/begin CHARACTERISTIC K_ED_LSRVK2_OBD_START.KLASSENINDEX "Fault code LSRVK2_OBD_START - fault class selection (lamp / warning behaviour) [verified]" VALUE 0x71034 RL_VAL_UB 0 CM_0000 0 255 /end CHARACTERISTIC
/begin CHARACTERISTIC K_ED_LSRVK2_OBD_START.OK_SCHWELLE "Fault code LSRVK2_OBD_START - debounce filter threshold for clearing (healing) the fault [verified]" VALUE 0x7102F RL_VAL_UB 0 CM_0000 0 255 /end CHARACTERISTIC
/begin CHARACTERISTIC K_ED_LSRVK2_OBD_START.P_CODE_OPENLOAD "Fault code LSRVK2_OBD_START - OBD P-code reported for open circuit [verified]" VALUE 0x7102A RL_VAL_UW 0 CM_0000 0 65535 /end CHARACTERISTIC
/begin CHARACTERISTIC K_ED_LSRVK2_OBD_START.P_CODE_SH_TO_GND "Fault code LSRVK2_OBD_START - OBD P-code reported for short to ground [verified]" VALUE 0x71028 RL_VAL_UW 0 CM_0000 0 65535 /end CHARACTERISTIC
/begin CHARACTERISTIC K_ED_LSRVK2_OBD_START.P_CODE_SH_TO_UB "Fault code LSRVK2_OBD_START - OBD P-code reported for short to battery voltage [verified]" VALUE 0x71026 RL_VAL_UW 0 CM_0000 0 65535 /end CHARACTERISTIC
/begin CHARACTERISTIC K_ED_LSRVK2_OBD_START.P_CODE_UNPLAUSIBEL "Fault code LSRVK2_OBD_START - OBD P-code reported for implausible signal [verified]" VALUE 0x7102C RL_VAL_UW 0 CM_0000 0 65535 /end CHARACTERISTIC
/begin CHARACTERISTIC K_ED_MVAC_DRUCKSENSOR.DEC_NACH_EINTRAG "Fault code MVAC_DRUCKSENSOR - debounce filter decrement after fault-memory entry [verified]" VALUE 0x71839 RL_VAL_UB 0 CM_0000 0 255 /end CHARACTERISTIC
/begin CHARACTERISTIC K_ED_MVAC_DRUCKSENSOR.DEC_VOR_EINTRAG "Fault code MVAC_DRUCKSENSOR - debounce filter decrement before fault-memory entry [verified]" VALUE 0x71837 RL_VAL_UB 0 CM_0000 0 255 /end CHARACTERISTIC
/begin CHARACTERISTIC K_ED_MVAC_DRUCKSENSOR.FEHLERSCHWELLE "Fault code MVAC_DRUCKSENSOR - debounce filter threshold for setting the fault [verified]" VALUE 0x71834 RL_VAL_UB 0 CM_0000 0 255 /end CHARACTERISTIC
/begin CHARACTERISTIC K_ED_MVAC_DRUCKSENSOR.INC_NACH_EINTRAG "Fault code MVAC_DRUCKSENSOR - debounce filter increment after fault-memory entry [verified]" VALUE 0x71838 RL_VAL_UB 0 CM_0000 0 255 /end CHARACTERISTIC
/begin CHARACTERISTIC K_ED_MVAC_DRUCKSENSOR.INC_VOR_EINTRAG "Fault code MVAC_DRUCKSENSOR - debounce filter increment before fault-memory entry [verified]" VALUE 0x71836 RL_VAL_UB 0 CM_0000 0 255 /end CHARACTERISTIC
/begin CHARACTERISTIC K_ED_MVAC_DRUCKSENSOR.KLASSENINDEX "Fault code MVAC_DRUCKSENSOR - fault class selection (lamp / warning behaviour) [verified]" VALUE 0x7183A RL_VAL_UB 0 CM_0000 0 255 /end CHARACTERISTIC
/begin CHARACTERISTIC K_ED_MVAC_DRUCKSENSOR.OK_SCHWELLE "Fault code MVAC_DRUCKSENSOR - debounce filter threshold for clearing (healing) the fault [verified]" VALUE 0x71835 RL_VAL_UB 0 CM_0000 0 255 /end CHARACTERISTIC
/begin CHARACTERISTIC K_ED_MVAC_DRUCKSENSOR.P_CODE_OPENLOAD "Fault code MVAC_DRUCKSENSOR - OBD P-code reported for open circuit [verified]" VALUE 0x71830 RL_VAL_UW 0 CM_0000 0 65535 /end CHARACTERISTIC
/begin CHARACTERISTIC K_ED_MVAC_DRUCKSENSOR.P_CODE_SH_TO_GND "Fault code MVAC_DRUCKSENSOR - OBD P-code reported for short to ground [verified]" VALUE 0x7182E RL_VAL_UW 0 CM_0000 0 65535 /end CHARACTERISTIC
/begin CHARACTERISTIC K_ED_MVAC_DRUCKSENSOR.P_CODE_SH_TO_UB "Fault code MVAC_DRUCKSENSOR - OBD P-code reported for short to battery voltage [verified]" VALUE 0x7182C RL_VAL_UW 0 CM_0000 0 65535 /end CHARACTERISTIC
/begin CHARACTERISTIC K_ED_MVAC_DRUCKSENSOR.P_CODE_UNPLAUSIBEL "Fault code MVAC_DRUCKSENSOR - OBD P-code reported for implausible signal [verified]" VALUE 0x71832 RL_VAL_UW 0 CM_0000 0 65535 /end CHARACTERISTIC
/begin CHARACTERISTIC K_ED_NW_SYNC.DEC_NACH_EINTRAG "Fault code NW_SYNC - debounce filter decrement after fault-memory entry [verified]" VALUE 0x70C3D RL_VAL_UB 0 CM_0000 0 255 /end CHARACTERISTIC
/begin CHARACTERISTIC K_ED_NW_SYNC.DEC_VOR_EINTRAG "Fault code NW_SYNC - debounce filter decrement before fault-memory entry [verified]" VALUE 0x70C3B RL_VAL_UB 0 CM_0000 0 255 /end CHARACTERISTIC
/begin CHARACTERISTIC K_ED_NW_SYNC.FEHLERSCHWELLE "Fault code NW_SYNC - debounce filter threshold for setting the fault [verified]" VALUE 0x70C38 RL_VAL_UB 0 CM_0000 0 255 /end CHARACTERISTIC
/begin CHARACTERISTIC K_ED_NW_SYNC.INC_NACH_EINTRAG "Fault code NW_SYNC - debounce filter increment after fault-memory entry [verified]" VALUE 0x70C3C RL_VAL_UB 0 CM_0000 0 255 /end CHARACTERISTIC
/begin CHARACTERISTIC K_ED_NW_SYNC.INC_VOR_EINTRAG "Fault code NW_SYNC - debounce filter increment before fault-memory entry [verified]" VALUE 0x70C3A RL_VAL_UB 0 CM_0000 0 255 /end CHARACTERISTIC
/begin CHARACTERISTIC K_ED_NW_SYNC.KLASSENINDEX "Fault code NW_SYNC - fault class selection (lamp / warning behaviour) [verified]" VALUE 0x70C3E RL_VAL_UB 0 CM_0000 0 255 /end CHARACTERISTIC
/begin CHARACTERISTIC K_ED_NW_SYNC.OK_SCHWELLE "Fault code NW_SYNC - debounce filter threshold for clearing (healing) the fault [verified]" VALUE 0x70C39 RL_VAL_UB 0 CM_0000 0 255 /end CHARACTERISTIC
/begin CHARACTERISTIC K_ED_NW_SYNC.P_CODE_OPENLOAD "Fault code NW_SYNC - OBD P-code reported for open circuit [verified]" VALUE 0x70C34 RL_VAL_UW 0 CM_0000 0 65535 /end CHARACTERISTIC
/begin CHARACTERISTIC K_ED_NW_SYNC.P_CODE_SH_TO_GND "Fault code NW_SYNC - OBD P-code reported for short to ground [verified]" VALUE 0x70C32 RL_VAL_UW 0 CM_0000 0 65535 /end CHARACTERISTIC
/begin CHARACTERISTIC K_ED_NW_SYNC.P_CODE_SH_TO_UB "Fault code NW_SYNC - OBD P-code reported for short to battery voltage [verified]" VALUE 0x70C30 RL_VAL_UW 0 CM_0000 0 65535 /end CHARACTERISTIC
/begin CHARACTERISTIC K_ED_NW_SYNC.P_CODE_UNPLAUSIBEL "Fault code NW_SYNC - OBD P-code reported for implausible signal [verified]" VALUE 0x70C36 RL_VAL_UW 0 CM_0000 0 65535 /end CHARACTERISTIC
/begin CHARACTERISTIC K_ED_PCTRL_INJ.DEC_NACH_EINTRAG "Fault code PCTRL_INJ - debounce filter decrement after fault-memory entry [verified]" VALUE 0x70C71 RL_VAL_UB 0 CM_0000 0 255 /end CHARACTERISTIC
/begin CHARACTERISTIC K_ED_PCTRL_INJ.DEC_VOR_EINTRAG "Fault code PCTRL_INJ - debounce filter decrement before fault-memory entry [verified]" VALUE 0x70C6F RL_VAL_UB 0 CM_0000 0 255 /end CHARACTERISTIC
/begin CHARACTERISTIC K_ED_PCTRL_INJ.FEHLERSCHWELLE "Fault code PCTRL_INJ - debounce filter threshold for setting the fault [verified]" VALUE 0x70C6C RL_VAL_UB 0 CM_0000 0 255 /end CHARACTERISTIC
/begin CHARACTERISTIC K_ED_PCTRL_INJ.INC_NACH_EINTRAG "Fault code PCTRL_INJ - debounce filter increment after fault-memory entry [verified]" VALUE 0x70C70 RL_VAL_UB 0 CM_0000 0 255 /end CHARACTERISTIC
/begin CHARACTERISTIC K_ED_PCTRL_INJ.INC_VOR_EINTRAG "Fault code PCTRL_INJ - debounce filter increment before fault-memory entry [verified]" VALUE 0x70C6E RL_VAL_UB 0 CM_0000 0 255 /end CHARACTERISTIC
/begin CHARACTERISTIC K_ED_PCTRL_INJ.KLASSENINDEX "Fault code PCTRL_INJ - fault class selection (lamp / warning behaviour) [verified]" VALUE 0x70C72 RL_VAL_UB 0 CM_0000 0 255 /end CHARACTERISTIC
/begin CHARACTERISTIC K_ED_PCTRL_INJ.OK_SCHWELLE "Fault code PCTRL_INJ - debounce filter threshold for clearing (healing) the fault [verified]" VALUE 0x70C6D RL_VAL_UB 0 CM_0000 0 255 /end CHARACTERISTIC
/begin CHARACTERISTIC K_ED_PCTRL_INJ.P_CODE_OPENLOAD "Fault code PCTRL_INJ - OBD P-code reported for open circuit [verified]" VALUE 0x70C68 RL_VAL_UW 0 CM_0000 0 65535 /end CHARACTERISTIC
/begin CHARACTERISTIC K_ED_PCTRL_INJ.P_CODE_SH_TO_GND "Fault code PCTRL_INJ - OBD P-code reported for short to ground [verified]" VALUE 0x70C66 RL_VAL_UW 0 CM_0000 0 65535 /end CHARACTERISTIC
/begin CHARACTERISTIC K_ED_PCTRL_INJ.P_CODE_SH_TO_UB "Fault code PCTRL_INJ - OBD P-code reported for short to battery voltage [verified]" VALUE 0x70C64 RL_VAL_UW 0 CM_0000 0 65535 /end CHARACTERISTIC
/begin CHARACTERISTIC K_ED_PCTRL_INJ.P_CODE_UNPLAUSIBEL "Fault code PCTRL_INJ - OBD P-code reported for implausible signal [verified]" VALUE 0x70C6A RL_VAL_UW 0 CM_0000 0 65535 /end CHARACTERISTIC
/begin CHARACTERISTIC K_ED_PKS.DEC_NACH_EINTRAG "Fault code PKS - debounce filter decrement after fault-memory entry [verified]" VALUE 0x70CA5 RL_VAL_UB 0 CM_0000 0 255 /end CHARACTERISTIC
/begin CHARACTERISTIC K_ED_PKS.DEC_VOR_EINTRAG "Fault code PKS - debounce filter decrement before fault-memory entry [verified]" VALUE 0x70CA3 RL_VAL_UB 0 CM_0000 0 255 /end CHARACTERISTIC
/begin CHARACTERISTIC K_ED_PKS.FEHLERSCHWELLE "Fault code PKS - debounce filter threshold for setting the fault [verified]" VALUE 0x70CA0 RL_VAL_UB 0 CM_0000 0 255 /end CHARACTERISTIC
/begin CHARACTERISTIC K_ED_PKS.INC_NACH_EINTRAG "Fault code PKS - debounce filter increment after fault-memory entry [verified]" VALUE 0x70CA4 RL_VAL_UB 0 CM_0000 0 255 /end CHARACTERISTIC
/begin CHARACTERISTIC K_ED_PKS.INC_VOR_EINTRAG "Fault code PKS - debounce filter increment before fault-memory entry [verified]" VALUE 0x70CA2 RL_VAL_UB 0 CM_0000 0 255 /end CHARACTERISTIC
/begin CHARACTERISTIC K_ED_PKS.KLASSENINDEX "Fault code PKS - fault class selection (lamp / warning behaviour) [verified]" VALUE 0x70CA6 RL_VAL_UB 0 CM_0000 0 255 /end CHARACTERISTIC
/begin CHARACTERISTIC K_ED_PKS.OK_SCHWELLE "Fault code PKS - debounce filter threshold for clearing (healing) the fault [verified]" VALUE 0x70CA1 RL_VAL_UB 0 CM_0000 0 255 /end CHARACTERISTIC
/begin CHARACTERISTIC K_ED_PKS.P_CODE_OPENLOAD "Fault code PKS - OBD P-code reported for open circuit [verified]" VALUE 0x70C9C RL_VAL_UW 0 CM_0000 0 65535 /end CHARACTERISTIC
/begin CHARACTERISTIC K_ED_PKS.P_CODE_SH_TO_GND "Fault code PKS - OBD P-code reported for short to ground [verified]" VALUE 0x70C9A RL_VAL_UW 0 CM_0000 0 65535 /end CHARACTERISTIC
/begin CHARACTERISTIC K_ED_PKS.P_CODE_SH_TO_UB "Fault code PKS - OBD P-code reported for short to battery voltage [verified]" VALUE 0x70C98 RL_VAL_UW 0 CM_0000 0 65535 /end CHARACTERISTIC
/begin CHARACTERISTIC K_ED_PKS.P_CODE_UNPLAUSIBEL "Fault code PKS - OBD P-code reported for implausible signal [verified]" VALUE 0x70C9E RL_VAL_UW 0 CM_0000 0 65535 /end CHARACTERISTIC
/begin CHARACTERISTIC K_ED_PKS_ADAPT_ANSCHL.DEC_NACH_EINTRAG "Fault code PKS_ADAPT_ANSCHL - debounce filter decrement after fault-memory entry [verified]" VALUE 0x71E51 RL_VAL_UB 0 CM_0000 0 255 /end CHARACTERISTIC
/begin CHARACTERISTIC K_ED_PKS_ADAPT_ANSCHL.DEC_VOR_EINTRAG "Fault code PKS_ADAPT_ANSCHL - debounce filter decrement before fault-memory entry [verified]" VALUE 0x71E4F RL_VAL_UB 0 CM_0000 0 255 /end CHARACTERISTIC
/begin CHARACTERISTIC K_ED_PKS_ADAPT_ANSCHL.FEHLERSCHWELLE "Fault code PKS_ADAPT_ANSCHL - debounce filter threshold for setting the fault [verified]" VALUE 0x71E4C RL_VAL_UB 0 CM_0000 0 255 /end CHARACTERISTIC
/begin CHARACTERISTIC K_ED_PKS_ADAPT_ANSCHL.INC_NACH_EINTRAG "Fault code PKS_ADAPT_ANSCHL - debounce filter increment after fault-memory entry [verified]" VALUE 0x71E50 RL_VAL_UB 0 CM_0000 0 255 /end CHARACTERISTIC
/begin CHARACTERISTIC K_ED_PKS_ADAPT_ANSCHL.INC_VOR_EINTRAG "Fault code PKS_ADAPT_ANSCHL - debounce filter increment before fault-memory entry [verified]" VALUE 0x71E4E RL_VAL_UB 0 CM_0000 0 255 /end CHARACTERISTIC
/begin CHARACTERISTIC K_ED_PKS_ADAPT_ANSCHL.KLASSENINDEX "Fault code PKS_ADAPT_ANSCHL - fault class selection (lamp / warning behaviour) [verified]" VALUE 0x71E52 RL_VAL_UB 0 CM_0000 0 255 /end CHARACTERISTIC
/begin CHARACTERISTIC K_ED_PKS_ADAPT_ANSCHL.OK_SCHWELLE "Fault code PKS_ADAPT_ANSCHL - debounce filter threshold for clearing (healing) the fault [verified]" VALUE 0x71E4D RL_VAL_UB 0 CM_0000 0 255 /end CHARACTERISTIC
/begin CHARACTERISTIC K_ED_PKS_ADAPT_ANSCHL.P_CODE_OPENLOAD "Fault code PKS_ADAPT_ANSCHL - OBD P-code reported for open circuit [verified]" VALUE 0x71E48 RL_VAL_UW 0 CM_0000 0 65535 /end CHARACTERISTIC
/begin CHARACTERISTIC K_ED_PKS_ADAPT_ANSCHL.P_CODE_SH_TO_GND "Fault code PKS_ADAPT_ANSCHL - OBD P-code reported for short to ground [verified]" VALUE 0x71E46 RL_VAL_UW 0 CM_0000 0 65535 /end CHARACTERISTIC
/begin CHARACTERISTIC K_ED_PKS_ADAPT_ANSCHL.P_CODE_SH_TO_UB "Fault code PKS_ADAPT_ANSCHL - OBD P-code reported for short to battery voltage [verified]" VALUE 0x71E44 RL_VAL_UW 0 CM_0000 0 65535 /end CHARACTERISTIC
/begin CHARACTERISTIC K_ED_PKS_ADAPT_ANSCHL.P_CODE_UNPLAUSIBEL "Fault code PKS_ADAPT_ANSCHL - OBD P-code reported for implausible signal [verified]" VALUE 0x71E4A RL_VAL_UW 0 CM_0000 0 65535 /end CHARACTERISTIC
/begin CHARACTERISTIC K_ED_PKS_LL.DEC_NACH_EINTRAG "Fault code PKS_LL - debounce filter decrement after fault-memory entry [verified]" VALUE 0x716CD RL_VAL_UB 0 CM_0000 0 255 /end CHARACTERISTIC
/begin CHARACTERISTIC K_ED_PKS_LL.DEC_VOR_EINTRAG "Fault code PKS_LL - debounce filter decrement before fault-memory entry [verified]" VALUE 0x716CB RL_VAL_UB 0 CM_0000 0 255 /end CHARACTERISTIC
/begin CHARACTERISTIC K_ED_PKS_LL.FEHLERSCHWELLE "Fault code PKS_LL - debounce filter threshold for setting the fault [verified]" VALUE 0x716C8 RL_VAL_UB 0 CM_0000 0 255 /end CHARACTERISTIC
/begin CHARACTERISTIC K_ED_PKS_LL.INC_NACH_EINTRAG "Fault code PKS_LL - debounce filter increment after fault-memory entry [verified]" VALUE 0x716CC RL_VAL_UB 0 CM_0000 0 255 /end CHARACTERISTIC
/begin CHARACTERISTIC K_ED_PKS_LL.INC_VOR_EINTRAG "Fault code PKS_LL - debounce filter increment before fault-memory entry [verified]" VALUE 0x716CA RL_VAL_UB 0 CM_0000 0 255 /end CHARACTERISTIC
/begin CHARACTERISTIC K_ED_PKS_LL.KLASSENINDEX "Fault code PKS_LL - fault class selection (lamp / warning behaviour) [verified]" VALUE 0x716CE RL_VAL_UB 0 CM_0000 0 255 /end CHARACTERISTIC
/begin CHARACTERISTIC K_ED_PKS_LL.OK_SCHWELLE "Fault code PKS_LL - debounce filter threshold for clearing (healing) the fault [verified]" VALUE 0x716C9 RL_VAL_UB 0 CM_0000 0 255 /end CHARACTERISTIC
/begin CHARACTERISTIC K_ED_PKS_LL.P_CODE_OPENLOAD "Fault code PKS_LL - OBD P-code reported for open circuit [verified]" VALUE 0x716C4 RL_VAL_UW 0 CM_0000 0 65535 /end CHARACTERISTIC
/begin CHARACTERISTIC K_ED_PKS_LL.P_CODE_SH_TO_GND "Fault code PKS_LL - OBD P-code reported for short to ground [verified]" VALUE 0x716C2 RL_VAL_UW 0 CM_0000 0 65535 /end CHARACTERISTIC
/begin CHARACTERISTIC K_ED_PKS_LL.P_CODE_SH_TO_UB "Fault code PKS_LL - OBD P-code reported for short to battery voltage [verified]" VALUE 0x716C0 RL_VAL_UW 0 CM_0000 0 65535 /end CHARACTERISTIC
/begin CHARACTERISTIC K_ED_PKS_LL.P_CODE_UNPLAUSIBEL "Fault code PKS_LL - OBD P-code reported for implausible signal [verified]" VALUE 0x716C6 RL_VAL_UW 0 CM_0000 0 65535 /end CHARACTERISTIC
/begin CHARACTERISTIC K_ED_PKS_MODELL.DEC_NACH_EINTRAG "Fault code PKS_MODELL - debounce filter decrement after fault-memory entry [verified]" VALUE 0x71E1D RL_VAL_UB 0 CM_0000 0 255 /end CHARACTERISTIC
/begin CHARACTERISTIC K_ED_PKS_MODELL.DEC_VOR_EINTRAG "Fault code PKS_MODELL - debounce filter decrement before fault-memory entry [verified]" VALUE 0x71E1B RL_VAL_UB 0 CM_0000 0 255 /end CHARACTERISTIC
/begin CHARACTERISTIC K_ED_PKS_MODELL.FEHLERSCHWELLE "Fault code PKS_MODELL - debounce filter threshold for setting the fault [verified]" VALUE 0x71E18 RL_VAL_UB 0 CM_0000 0 255 /end CHARACTERISTIC
/begin CHARACTERISTIC K_ED_PKS_MODELL.INC_NACH_EINTRAG "Fault code PKS_MODELL - debounce filter increment after fault-memory entry [verified]" VALUE 0x71E1C RL_VAL_UB 0 CM_0000 0 255 /end CHARACTERISTIC
/begin CHARACTERISTIC K_ED_PKS_MODELL.INC_VOR_EINTRAG "Fault code PKS_MODELL - debounce filter increment before fault-memory entry [verified]" VALUE 0x71E1A RL_VAL_UB 0 CM_0000 0 255 /end CHARACTERISTIC
/begin CHARACTERISTIC K_ED_PKS_MODELL.KLASSENINDEX "Fault code PKS_MODELL - fault class selection (lamp / warning behaviour) [verified]" VALUE 0x71E1E RL_VAL_UB 0 CM_0000 0 255 /end CHARACTERISTIC
/begin CHARACTERISTIC K_ED_PKS_MODELL.OK_SCHWELLE "Fault code PKS_MODELL - debounce filter threshold for clearing (healing) the fault [verified]" VALUE 0x71E19 RL_VAL_UB 0 CM_0000 0 255 /end CHARACTERISTIC
/begin CHARACTERISTIC K_ED_PKS_MODELL.P_CODE_OPENLOAD "Fault code PKS_MODELL - OBD P-code reported for open circuit [verified]" VALUE 0x71E14 RL_VAL_UW 0 CM_0000 0 65535 /end CHARACTERISTIC
/begin CHARACTERISTIC K_ED_PKS_MODELL.P_CODE_SH_TO_GND "Fault code PKS_MODELL - OBD P-code reported for short to ground [verified]" VALUE 0x71E12 RL_VAL_UW 0 CM_0000 0 65535 /end CHARACTERISTIC
/begin CHARACTERISTIC K_ED_PKS_MODELL.P_CODE_SH_TO_UB "Fault code PKS_MODELL - OBD P-code reported for short to battery voltage [verified]" VALUE 0x71E10 RL_VAL_UW 0 CM_0000 0 65535 /end CHARACTERISTIC
/begin CHARACTERISTIC K_ED_PKS_MODELL.P_CODE_UNPLAUSIBEL "Fault code PKS_MODELL - OBD P-code reported for implausible signal [verified]" VALUE 0x71E16 RL_VAL_UW 0 CM_0000 0 65535 /end CHARACTERISTIC
/begin CHARACTERISTIC K_ED_PKS_PAUFBAU.DEC_NACH_EINTRAG "Fault code PKS_PAUFBAU - debounce filter decrement after fault-memory entry [verified]" VALUE 0x71E37 RL_VAL_UB 0 CM_0000 0 255 /end CHARACTERISTIC
/begin CHARACTERISTIC K_ED_PKS_PAUFBAU.DEC_VOR_EINTRAG "Fault code PKS_PAUFBAU - debounce filter decrement before fault-memory entry [verified]" VALUE 0x71E35 RL_VAL_UB 0 CM_0000 0 255 /end CHARACTERISTIC
/begin CHARACTERISTIC K_ED_PKS_PAUFBAU.FEHLERSCHWELLE "Fault code PKS_PAUFBAU - debounce filter threshold for setting the fault [verified]" VALUE 0x71E32 RL_VAL_UB 0 CM_0000 0 255 /end CHARACTERISTIC
/begin CHARACTERISTIC K_ED_PKS_PAUFBAU.INC_NACH_EINTRAG "Fault code PKS_PAUFBAU - debounce filter increment after fault-memory entry [verified]" VALUE 0x71E36 RL_VAL_UB 0 CM_0000 0 255 /end CHARACTERISTIC
/begin CHARACTERISTIC K_ED_PKS_PAUFBAU.INC_VOR_EINTRAG "Fault code PKS_PAUFBAU - debounce filter increment before fault-memory entry [verified]" VALUE 0x71E34 RL_VAL_UB 0 CM_0000 0 255 /end CHARACTERISTIC
/begin CHARACTERISTIC K_ED_PKS_PAUFBAU.KLASSENINDEX "Fault code PKS_PAUFBAU - fault class selection (lamp / warning behaviour) [verified]" VALUE 0x71E38 RL_VAL_UB 0 CM_0000 0 255 /end CHARACTERISTIC
/begin CHARACTERISTIC K_ED_PKS_PAUFBAU.OK_SCHWELLE "Fault code PKS_PAUFBAU - debounce filter threshold for clearing (healing) the fault [verified]" VALUE 0x71E33 RL_VAL_UB 0 CM_0000 0 255 /end CHARACTERISTIC
/begin CHARACTERISTIC K_ED_PKS_PAUFBAU.P_CODE_OPENLOAD "Fault code PKS_PAUFBAU - OBD P-code reported for open circuit [verified]" VALUE 0x71E2E RL_VAL_UW 0 CM_0000 0 65535 /end CHARACTERISTIC
/begin CHARACTERISTIC K_ED_PKS_PAUFBAU.P_CODE_SH_TO_GND "Fault code PKS_PAUFBAU - OBD P-code reported for short to ground [verified]" VALUE 0x71E2C RL_VAL_UW 0 CM_0000 0 65535 /end CHARACTERISTIC
/begin CHARACTERISTIC K_ED_PKS_PAUFBAU.P_CODE_SH_TO_UB "Fault code PKS_PAUFBAU - OBD P-code reported for short to battery voltage [verified]" VALUE 0x71E2A RL_VAL_UW 0 CM_0000 0 65535 /end CHARACTERISTIC
/begin CHARACTERISTIC K_ED_PKS_PAUFBAU.P_CODE_UNPLAUSIBEL "Fault code PKS_PAUFBAU - OBD P-code reported for implausible signal [verified]" VALUE 0x71E30 RL_VAL_UW 0 CM_0000 0 65535 /end CHARACTERISTIC
/begin CHARACTERISTIC K_ED_PKS_Q.DEC_NACH_EINTRAG "Fault code PKS_Q - debounce filter decrement after fault-memory entry [verified]" VALUE 0x71701 RL_VAL_UB 0 CM_0000 0 255 /end CHARACTERISTIC
/begin CHARACTERISTIC K_ED_PKS_Q.DEC_VOR_EINTRAG "Fault code PKS_Q - debounce filter decrement before fault-memory entry [verified]" VALUE 0x716FF RL_VAL_UB 0 CM_0000 0 255 /end CHARACTERISTIC
/begin CHARACTERISTIC K_ED_PKS_Q.FEHLERSCHWELLE "Fault code PKS_Q - debounce filter threshold for setting the fault [verified]" VALUE 0x716FC RL_VAL_UB 0 CM_0000 0 255 /end CHARACTERISTIC
/begin CHARACTERISTIC K_ED_PKS_Q.INC_NACH_EINTRAG "Fault code PKS_Q - debounce filter increment after fault-memory entry [verified]" VALUE 0x71700 RL_VAL_UB 0 CM_0000 0 255 /end CHARACTERISTIC
/begin CHARACTERISTIC K_ED_PKS_Q.INC_VOR_EINTRAG "Fault code PKS_Q - debounce filter increment before fault-memory entry [verified]" VALUE 0x716FE RL_VAL_UB 0 CM_0000 0 255 /end CHARACTERISTIC
/begin CHARACTERISTIC K_ED_PKS_Q.KLASSENINDEX "Fault code PKS_Q - fault class selection (lamp / warning behaviour) [verified]" VALUE 0x71702 RL_VAL_UB 0 CM_0000 0 255 /end CHARACTERISTIC
/begin CHARACTERISTIC K_ED_PKS_Q.OK_SCHWELLE "Fault code PKS_Q - debounce filter threshold for clearing (healing) the fault [verified]" VALUE 0x716FD RL_VAL_UB 0 CM_0000 0 255 /end CHARACTERISTIC
/begin CHARACTERISTIC K_ED_PKS_Q.P_CODE_OPENLOAD "Fault code PKS_Q - OBD P-code reported for open circuit [verified]" VALUE 0x716F8 RL_VAL_UW 0 CM_0000 0 65535 /end CHARACTERISTIC
/begin CHARACTERISTIC K_ED_PKS_Q.P_CODE_SH_TO_GND "Fault code PKS_Q - OBD P-code reported for short to ground [verified]" VALUE 0x716F6 RL_VAL_UW 0 CM_0000 0 65535 /end CHARACTERISTIC
/begin CHARACTERISTIC K_ED_PKS_Q.P_CODE_SH_TO_UB "Fault code PKS_Q - OBD P-code reported for short to battery voltage [verified]" VALUE 0x716F4 RL_VAL_UW 0 CM_0000 0 65535 /end CHARACTERISTIC
/begin CHARACTERISTIC K_ED_PKS_Q.P_CODE_UNPLAUSIBEL "Fault code PKS_Q - OBD P-code reported for implausible signal [verified]" VALUE 0x716FA RL_VAL_UW 0 CM_0000 0 65535 /end CHARACTERISTIC
/begin CHARACTERISTIC K_ED_PKS_TL.DEC_NACH_EINTRAG "Fault code PKS_TL - debounce filter decrement after fault-memory entry [verified]" VALUE 0x716E7 RL_VAL_UB 0 CM_0000 0 255 /end CHARACTERISTIC
/begin CHARACTERISTIC K_ED_PKS_TL.DEC_VOR_EINTRAG "Fault code PKS_TL - debounce filter decrement before fault-memory entry [verified]" VALUE 0x716E5 RL_VAL_UB 0 CM_0000 0 255 /end CHARACTERISTIC
/begin CHARACTERISTIC K_ED_PKS_TL.FEHLERSCHWELLE "Fault code PKS_TL - debounce filter threshold for setting the fault [verified]" VALUE 0x716E2 RL_VAL_UB 0 CM_0000 0 255 /end CHARACTERISTIC
/begin CHARACTERISTIC K_ED_PKS_TL.INC_NACH_EINTRAG "Fault code PKS_TL - debounce filter increment after fault-memory entry [verified]" VALUE 0x716E6 RL_VAL_UB 0 CM_0000 0 255 /end CHARACTERISTIC
/begin CHARACTERISTIC K_ED_PKS_TL.INC_VOR_EINTRAG "Fault code PKS_TL - debounce filter increment before fault-memory entry [verified]" VALUE 0x716E4 RL_VAL_UB 0 CM_0000 0 255 /end CHARACTERISTIC
/begin CHARACTERISTIC K_ED_PKS_TL.KLASSENINDEX "Fault code PKS_TL - fault class selection (lamp / warning behaviour) [verified]" VALUE 0x716E8 RL_VAL_UB 0 CM_0000 0 255 /end CHARACTERISTIC
/begin CHARACTERISTIC K_ED_PKS_TL.OK_SCHWELLE "Fault code PKS_TL - debounce filter threshold for clearing (healing) the fault [verified]" VALUE 0x716E3 RL_VAL_UB 0 CM_0000 0 255 /end CHARACTERISTIC
/begin CHARACTERISTIC K_ED_PKS_TL.P_CODE_OPENLOAD "Fault code PKS_TL - OBD P-code reported for open circuit [verified]" VALUE 0x716DE RL_VAL_UW 0 CM_0000 0 65535 /end CHARACTERISTIC
/begin CHARACTERISTIC K_ED_PKS_TL.P_CODE_SH_TO_GND "Fault code PKS_TL - OBD P-code reported for short to ground [verified]" VALUE 0x716DC RL_VAL_UW 0 CM_0000 0 65535 /end CHARACTERISTIC
/begin CHARACTERISTIC K_ED_PKS_TL.P_CODE_SH_TO_UB "Fault code PKS_TL - OBD P-code reported for short to battery voltage [verified]" VALUE 0x716DA RL_VAL_UW 0 CM_0000 0 65535 /end CHARACTERISTIC
/begin CHARACTERISTIC K_ED_PKS_TL.P_CODE_UNPLAUSIBEL "Fault code PKS_TL - OBD P-code reported for implausible signal [verified]" VALUE 0x716E0 RL_VAL_UW 0 CM_0000 0 65535 /end CHARACTERISTIC
/begin CHARACTERISTIC K_ED_PSAU1.DEC_NACH_EINTRAG "Fault code PSAU1 - debounce filter decrement after fault-memory entry [verified]" VALUE 0x70B39 RL_VAL_UB 0 CM_0000 0 255 /end CHARACTERISTIC
/begin CHARACTERISTIC K_ED_PSAU1.DEC_VOR_EINTRAG "Fault code PSAU1 - debounce filter decrement before fault-memory entry [verified]" VALUE 0x70B37 RL_VAL_UB 0 CM_0000 0 255 /end CHARACTERISTIC
/begin CHARACTERISTIC K_ED_PSAU1.FEHLERSCHWELLE "Fault code PSAU1 - debounce filter threshold for setting the fault [verified]" VALUE 0x70B34 RL_VAL_UB 0 CM_0000 0 255 /end CHARACTERISTIC
/begin CHARACTERISTIC K_ED_PSAU1.INC_NACH_EINTRAG "Fault code PSAU1 - debounce filter increment after fault-memory entry [verified]" VALUE 0x70B38 RL_VAL_UB 0 CM_0000 0 255 /end CHARACTERISTIC
/begin CHARACTERISTIC K_ED_PSAU1.INC_VOR_EINTRAG "Fault code PSAU1 - debounce filter increment before fault-memory entry [verified]" VALUE 0x70B36 RL_VAL_UB 0 CM_0000 0 255 /end CHARACTERISTIC
/begin CHARACTERISTIC K_ED_PSAU1.KLASSENINDEX "Fault code PSAU1 - fault class selection (lamp / warning behaviour) [verified]" VALUE 0x70B3A RL_VAL_UB 0 CM_0000 0 255 /end CHARACTERISTIC
/begin CHARACTERISTIC K_ED_PSAU1.OK_SCHWELLE "Fault code PSAU1 - debounce filter threshold for clearing (healing) the fault [verified]" VALUE 0x70B35 RL_VAL_UB 0 CM_0000 0 255 /end CHARACTERISTIC
/begin CHARACTERISTIC K_ED_PSAU1.P_CODE_OPENLOAD "Fault code PSAU1 - OBD P-code reported for open circuit [verified]" VALUE 0x70B30 RL_VAL_UW 0 CM_0000 0 65535 /end CHARACTERISTIC
/begin CHARACTERISTIC K_ED_PSAU1.P_CODE_SH_TO_GND "Fault code PSAU1 - OBD P-code reported for short to ground [verified]" VALUE 0x70B2E RL_VAL_UW 0 CM_0000 0 65535 /end CHARACTERISTIC
/begin CHARACTERISTIC K_ED_PSAU1.P_CODE_SH_TO_UB "Fault code PSAU1 - OBD P-code reported for short to battery voltage [verified]" VALUE 0x70B2C RL_VAL_UW 0 CM_0000 0 65535 /end CHARACTERISTIC
/begin CHARACTERISTIC K_ED_PSAU1.P_CODE_UNPLAUSIBEL "Fault code PSAU1 - OBD P-code reported for implausible signal [verified]" VALUE 0x70B32 RL_VAL_UW 0 CM_0000 0 65535 /end CHARACTERISTIC
/begin CHARACTERISTIC K_ED_PSAU2.DEC_NACH_EINTRAG "Fault code PSAU2 - debounce filter decrement after fault-memory entry [verified]" VALUE 0x70B53 RL_VAL_UB 0 CM_0000 0 255 /end CHARACTERISTIC
/begin CHARACTERISTIC K_ED_PSAU2.DEC_VOR_EINTRAG "Fault code PSAU2 - debounce filter decrement before fault-memory entry [verified]" VALUE 0x70B51 RL_VAL_UB 0 CM_0000 0 255 /end CHARACTERISTIC
/begin CHARACTERISTIC K_ED_PSAU2.FEHLERSCHWELLE "Fault code PSAU2 - debounce filter threshold for setting the fault [verified]" VALUE 0x70B4E RL_VAL_UB 0 CM_0000 0 255 /end CHARACTERISTIC
/begin CHARACTERISTIC K_ED_PSAU2.INC_NACH_EINTRAG "Fault code PSAU2 - debounce filter increment after fault-memory entry [verified]" VALUE 0x70B52 RL_VAL_UB 0 CM_0000 0 255 /end CHARACTERISTIC
/begin CHARACTERISTIC K_ED_PSAU2.INC_VOR_EINTRAG "Fault code PSAU2 - debounce filter increment before fault-memory entry [verified]" VALUE 0x70B50 RL_VAL_UB 0 CM_0000 0 255 /end CHARACTERISTIC
/begin CHARACTERISTIC K_ED_PSAU2.KLASSENINDEX "Fault code PSAU2 - fault class selection (lamp / warning behaviour) [verified]" VALUE 0x70B54 RL_VAL_UB 0 CM_0000 0 255 /end CHARACTERISTIC
/begin CHARACTERISTIC K_ED_PSAU2.OK_SCHWELLE "Fault code PSAU2 - debounce filter threshold for clearing (healing) the fault [verified]" VALUE 0x70B4F RL_VAL_UB 0 CM_0000 0 255 /end CHARACTERISTIC
/begin CHARACTERISTIC K_ED_PSAU2.P_CODE_OPENLOAD "Fault code PSAU2 - OBD P-code reported for open circuit [verified]" VALUE 0x70B4A RL_VAL_UW 0 CM_0000 0 65535 /end CHARACTERISTIC
/begin CHARACTERISTIC K_ED_PSAU2.P_CODE_SH_TO_GND "Fault code PSAU2 - OBD P-code reported for short to ground [verified]" VALUE 0x70B48 RL_VAL_UW 0 CM_0000 0 65535 /end CHARACTERISTIC
/begin CHARACTERISTIC K_ED_PSAU2.P_CODE_SH_TO_UB "Fault code PSAU2 - OBD P-code reported for short to battery voltage [verified]" VALUE 0x70B46 RL_VAL_UW 0 CM_0000 0 65535 /end CHARACTERISTIC
/begin CHARACTERISTIC K_ED_PSAU2.P_CODE_UNPLAUSIBEL "Fault code PSAU2 - OBD P-code reported for implausible signal [verified]" VALUE 0x70B4C RL_VAL_UW 0 CM_0000 0 65535 /end CHARACTERISTIC
/begin CHARACTERISTIC K_ED_PT_ANFRADMOM.DEC_NACH_EINTRAG "Fault code PT_ANFRADMOM - debounce filter decrement after fault-memory entry [verified]" VALUE 0x71C97 RL_VAL_UB 0 CM_0000 0 255 /end CHARACTERISTIC
/begin CHARACTERISTIC K_ED_PT_ANFRADMOM.DEC_VOR_EINTRAG "Fault code PT_ANFRADMOM - debounce filter decrement before fault-memory entry [verified]" VALUE 0x71C95 RL_VAL_UB 0 CM_0000 0 255 /end CHARACTERISTIC
/begin CHARACTERISTIC K_ED_PT_ANFRADMOM.FEHLERSCHWELLE "Fault code PT_ANFRADMOM - debounce filter threshold for setting the fault [verified]" VALUE 0x71C92 RL_VAL_UB 0 CM_0000 0 255 /end CHARACTERISTIC
/begin CHARACTERISTIC K_ED_PT_ANFRADMOM.INC_NACH_EINTRAG "Fault code PT_ANFRADMOM - debounce filter increment after fault-memory entry [verified]" VALUE 0x71C96 RL_VAL_UB 0 CM_0000 0 255 /end CHARACTERISTIC
/begin CHARACTERISTIC K_ED_PT_ANFRADMOM.INC_VOR_EINTRAG "Fault code PT_ANFRADMOM - debounce filter increment before fault-memory entry [verified]" VALUE 0x71C94 RL_VAL_UB 0 CM_0000 0 255 /end CHARACTERISTIC
/begin CHARACTERISTIC K_ED_PT_ANFRADMOM.KLASSENINDEX "Fault code PT_ANFRADMOM - fault class selection (lamp / warning behaviour) [verified]" VALUE 0x71C98 RL_VAL_UB 0 CM_0000 0 255 /end CHARACTERISTIC
/begin CHARACTERISTIC K_ED_PT_ANFRADMOM.OK_SCHWELLE "Fault code PT_ANFRADMOM - debounce filter threshold for clearing (healing) the fault [verified]" VALUE 0x71C93 RL_VAL_UB 0 CM_0000 0 255 /end CHARACTERISTIC
/begin CHARACTERISTIC K_ED_PT_ANFRADMOM.P_CODE_OPENLOAD "Fault code PT_ANFRADMOM - OBD P-code reported for open circuit [verified]" VALUE 0x71C8E RL_VAL_UW 0 CM_0000 0 65535 /end CHARACTERISTIC
/begin CHARACTERISTIC K_ED_PT_ANFRADMOM.P_CODE_SH_TO_GND "Fault code PT_ANFRADMOM - OBD P-code reported for short to ground [verified]" VALUE 0x71C8C RL_VAL_UW 0 CM_0000 0 65535 /end CHARACTERISTIC
/begin CHARACTERISTIC K_ED_PT_ANFRADMOM.P_CODE_SH_TO_UB "Fault code PT_ANFRADMOM - OBD P-code reported for short to battery voltage [verified]" VALUE 0x71C8A RL_VAL_UW 0 CM_0000 0 65535 /end CHARACTERISTIC
/begin CHARACTERISTIC K_ED_PT_ANFRADMOM.P_CODE_UNPLAUSIBEL "Fault code PT_ANFRADMOM - OBD P-code reported for implausible signal [verified]" VALUE 0x71C90 RL_VAL_UW 0 CM_0000 0 65535 /end CHARACTERISTIC
/begin CHARACTERISTIC K_ED_PT_ATEMP.DEC_NACH_EINTRAG "Fault code PT_ATEMP - debounce filter decrement after fault-memory entry [verified]" VALUE 0x70E5F RL_VAL_UB 0 CM_0000 0 255 /end CHARACTERISTIC
/begin CHARACTERISTIC K_ED_PT_ATEMP.DEC_VOR_EINTRAG "Fault code PT_ATEMP - debounce filter decrement before fault-memory entry [verified]" VALUE 0x70E5D RL_VAL_UB 0 CM_0000 0 255 /end CHARACTERISTIC
/begin CHARACTERISTIC K_ED_PT_ATEMP.FEHLERSCHWELLE "Fault code PT_ATEMP - debounce filter threshold for setting the fault [verified]" VALUE 0x70E5A RL_VAL_UB 0 CM_0000 0 255 /end CHARACTERISTIC
/begin CHARACTERISTIC K_ED_PT_ATEMP.INC_NACH_EINTRAG "Fault code PT_ATEMP - debounce filter increment after fault-memory entry [verified]" VALUE 0x70E5E RL_VAL_UB 0 CM_0000 0 255 /end CHARACTERISTIC
/begin CHARACTERISTIC K_ED_PT_ATEMP.INC_VOR_EINTRAG "Fault code PT_ATEMP - debounce filter increment before fault-memory entry [verified]" VALUE 0x70E5C RL_VAL_UB 0 CM_0000 0 255 /end CHARACTERISTIC
/begin CHARACTERISTIC K_ED_PT_ATEMP.KLASSENINDEX "Fault code PT_ATEMP - fault class selection (lamp / warning behaviour) [verified]" VALUE 0x70E60 RL_VAL_UB 0 CM_0000 0 255 /end CHARACTERISTIC
/begin CHARACTERISTIC K_ED_PT_ATEMP.OK_SCHWELLE "Fault code PT_ATEMP - debounce filter threshold for clearing (healing) the fault [verified]" VALUE 0x70E5B RL_VAL_UB 0 CM_0000 0 255 /end CHARACTERISTIC
/begin CHARACTERISTIC K_ED_PT_ATEMP.P_CODE_OPENLOAD "Fault code PT_ATEMP - OBD P-code reported for open circuit [verified]" VALUE 0x70E56 RL_VAL_UW 0 CM_0000 0 65535 /end CHARACTERISTIC
/begin CHARACTERISTIC K_ED_PT_ATEMP.P_CODE_SH_TO_GND "Fault code PT_ATEMP - OBD P-code reported for short to ground [verified]" VALUE 0x70E54 RL_VAL_UW 0 CM_0000 0 65535 /end CHARACTERISTIC
/begin CHARACTERISTIC K_ED_PT_ATEMP.P_CODE_SH_TO_UB "Fault code PT_ATEMP - OBD P-code reported for short to battery voltage [verified]" VALUE 0x70E52 RL_VAL_UW 0 CM_0000 0 65535 /end CHARACTERISTIC
/begin CHARACTERISTIC K_ED_PT_ATEMP.P_CODE_UNPLAUSIBEL "Fault code PT_ATEMP - OBD P-code reported for implausible signal [verified]" VALUE 0x70E58 RL_VAL_UW 0 CM_0000 0 65535 /end CHARACTERISTIC
/begin CHARACTERISTIC K_ED_PT_AX.DEC_NACH_EINTRAG "Fault code PT_AX - debounce filter decrement after fault-memory entry [verified]" VALUE 0x71E9F RL_VAL_UB 0 CM_0000 0 255 /end CHARACTERISTIC
/begin CHARACTERISTIC K_ED_PT_AX.DEC_VOR_EINTRAG "Fault code PT_AX - debounce filter decrement before fault-memory entry [verified]" VALUE 0x71E9D RL_VAL_UB 0 CM_0000 0 255 /end CHARACTERISTIC
/begin CHARACTERISTIC K_ED_PT_AX.FEHLERSCHWELLE "Fault code PT_AX - debounce filter threshold for setting the fault [verified]" VALUE 0x71E9A RL_VAL_UB 0 CM_0000 0 255 /end CHARACTERISTIC
/begin CHARACTERISTIC K_ED_PT_AX.INC_NACH_EINTRAG "Fault code PT_AX - debounce filter increment after fault-memory entry [verified]" VALUE 0x71E9E RL_VAL_UB 0 CM_0000 0 255 /end CHARACTERISTIC
/begin CHARACTERISTIC K_ED_PT_AX.INC_VOR_EINTRAG "Fault code PT_AX - debounce filter increment before fault-memory entry [verified]" VALUE 0x71E9C RL_VAL_UB 0 CM_0000 0 255 /end CHARACTERISTIC
/begin CHARACTERISTIC K_ED_PT_AX.KLASSENINDEX "Fault code PT_AX - fault class selection (lamp / warning behaviour) [verified]" VALUE 0x71EA0 RL_VAL_UB 0 CM_0000 0 255 /end CHARACTERISTIC
/begin CHARACTERISTIC K_ED_PT_AX.OK_SCHWELLE "Fault code PT_AX - debounce filter threshold for clearing (healing) the fault [verified]" VALUE 0x71E9B RL_VAL_UB 0 CM_0000 0 255 /end CHARACTERISTIC
/begin CHARACTERISTIC K_ED_PT_AX.P_CODE_OPENLOAD "Fault code PT_AX - OBD P-code reported for open circuit [verified]" VALUE 0x71E96 RL_VAL_UW 0 CM_0000 0 65535 /end CHARACTERISTIC
/begin CHARACTERISTIC K_ED_PT_AX.P_CODE_SH_TO_GND "Fault code PT_AX - OBD P-code reported for short to ground [verified]" VALUE 0x71E94 RL_VAL_UW 0 CM_0000 0 65535 /end CHARACTERISTIC
/begin CHARACTERISTIC K_ED_PT_AX.P_CODE_SH_TO_UB "Fault code PT_AX - OBD P-code reported for short to battery voltage [verified]" VALUE 0x71E92 RL_VAL_UW 0 CM_0000 0 65535 /end CHARACTERISTIC
/begin CHARACTERISTIC K_ED_PT_AX.P_CODE_UNPLAUSIBEL "Fault code PT_AX - OBD P-code reported for implausible signal [verified]" VALUE 0x71E98 RL_VAL_UW 0 CM_0000 0 65535 /end CHARACTERISTIC
/begin CHARACTERISTIC K_ED_PT_BEDAT.DEC_NACH_EINTRAG "Fault code PT_BEDAT - debounce filter decrement after fault-memory entry [verified]" VALUE 0x71853 RL_VAL_UB 0 CM_0000 0 255 /end CHARACTERISTIC
/begin CHARACTERISTIC K_ED_PT_BEDAT.DEC_VOR_EINTRAG "Fault code PT_BEDAT - debounce filter decrement before fault-memory entry [verified]" VALUE 0x71851 RL_VAL_UB 0 CM_0000 0 255 /end CHARACTERISTIC
/begin CHARACTERISTIC K_ED_PT_BEDAT.FEHLERSCHWELLE "Fault code PT_BEDAT - debounce filter threshold for setting the fault [verified]" VALUE 0x7184E RL_VAL_UB 0 CM_0000 0 255 /end CHARACTERISTIC
/begin CHARACTERISTIC K_ED_PT_BEDAT.INC_NACH_EINTRAG "Fault code PT_BEDAT - debounce filter increment after fault-memory entry [verified]" VALUE 0x71852 RL_VAL_UB 0 CM_0000 0 255 /end CHARACTERISTIC
/begin CHARACTERISTIC K_ED_PT_BEDAT.INC_VOR_EINTRAG "Fault code PT_BEDAT - debounce filter increment before fault-memory entry [verified]" VALUE 0x71850 RL_VAL_UB 0 CM_0000 0 255 /end CHARACTERISTIC
/begin CHARACTERISTIC K_ED_PT_BEDAT.KLASSENINDEX "Fault code PT_BEDAT - fault class selection (lamp / warning behaviour) [verified]" VALUE 0x71854 RL_VAL_UB 0 CM_0000 0 255 /end CHARACTERISTIC
/begin CHARACTERISTIC K_ED_PT_BEDAT.OK_SCHWELLE "Fault code PT_BEDAT - debounce filter threshold for clearing (healing) the fault [verified]" VALUE 0x7184F RL_VAL_UB 0 CM_0000 0 255 /end CHARACTERISTIC
/begin CHARACTERISTIC K_ED_PT_BEDAT.P_CODE_OPENLOAD "Fault code PT_BEDAT - OBD P-code reported for open circuit [verified]" VALUE 0x7184A RL_VAL_UW 0 CM_0000 0 65535 /end CHARACTERISTIC
/begin CHARACTERISTIC K_ED_PT_BEDAT.P_CODE_SH_TO_GND "Fault code PT_BEDAT - OBD P-code reported for short to ground [verified]" VALUE 0x71848 RL_VAL_UW 0 CM_0000 0 65535 /end CHARACTERISTIC
/begin CHARACTERISTIC K_ED_PT_BEDAT.P_CODE_SH_TO_UB "Fault code PT_BEDAT - OBD P-code reported for short to battery voltage [verified]" VALUE 0x71846 RL_VAL_UW 0 CM_0000 0 65535 /end CHARACTERISTIC
/begin CHARACTERISTIC K_ED_PT_BEDAT.P_CODE_UNPLAUSIBEL "Fault code PT_BEDAT - OBD P-code reported for implausible signal [verified]" VALUE 0x7184C RL_VAL_UW 0 CM_0000 0 65535 /end CHARACTERISTIC
/begin CHARACTERISTIC K_ED_PT_BEDFGR.DEC_NACH_EINTRAG "Fault code PT_BEDFGR - debounce filter decrement after fault-memory entry [verified]" VALUE 0x71513 RL_VAL_UB 0 CM_0000 0 255 /end CHARACTERISTIC
/begin CHARACTERISTIC K_ED_PT_BEDFGR.DEC_VOR_EINTRAG "Fault code PT_BEDFGR - debounce filter decrement before fault-memory entry [verified]" VALUE 0x71511 RL_VAL_UB 0 CM_0000 0 255 /end CHARACTERISTIC
/begin CHARACTERISTIC K_ED_PT_BEDFGR.FEHLERSCHWELLE "Fault code PT_BEDFGR - debounce filter threshold for setting the fault [verified]" VALUE 0x7150E RL_VAL_UB 0 CM_0000 0 255 /end CHARACTERISTIC
/begin CHARACTERISTIC K_ED_PT_BEDFGR.INC_NACH_EINTRAG "Fault code PT_BEDFGR - debounce filter increment after fault-memory entry [verified]" VALUE 0x71512 RL_VAL_UB 0 CM_0000 0 255 /end CHARACTERISTIC
/begin CHARACTERISTIC K_ED_PT_BEDFGR.INC_VOR_EINTRAG "Fault code PT_BEDFGR - debounce filter increment before fault-memory entry [verified]" VALUE 0x71510 RL_VAL_UB 0 CM_0000 0 255 /end CHARACTERISTIC
/begin CHARACTERISTIC K_ED_PT_BEDFGR.KLASSENINDEX "Fault code PT_BEDFGR - fault class selection (lamp / warning behaviour) [verified]" VALUE 0x71514 RL_VAL_UB 0 CM_0000 0 255 /end CHARACTERISTIC
/begin CHARACTERISTIC K_ED_PT_BEDFGR.OK_SCHWELLE "Fault code PT_BEDFGR - debounce filter threshold for clearing (healing) the fault [verified]" VALUE 0x7150F RL_VAL_UB 0 CM_0000 0 255 /end CHARACTERISTIC
/begin CHARACTERISTIC K_ED_PT_BEDFGR.P_CODE_OPENLOAD "Fault code PT_BEDFGR - OBD P-code reported for open circuit [verified]" VALUE 0x7150A RL_VAL_UW 0 CM_0000 0 65535 /end CHARACTERISTIC
/begin CHARACTERISTIC K_ED_PT_BEDFGR.P_CODE_SH_TO_GND "Fault code PT_BEDFGR - OBD P-code reported for short to ground [verified]" VALUE 0x71508 RL_VAL_UW 0 CM_0000 0 65535 /end CHARACTERISTIC
/begin CHARACTERISTIC K_ED_PT_BEDFGR.P_CODE_SH_TO_UB "Fault code PT_BEDFGR - OBD P-code reported for short to battery voltage [verified]" VALUE 0x71506 RL_VAL_UW 0 CM_0000 0 65535 /end CHARACTERISTIC
/begin CHARACTERISTIC K_ED_PT_BEDFGR.P_CODE_UNPLAUSIBEL "Fault code PT_BEDFGR - OBD P-code reported for implausible signal [verified]" VALUE 0x7150C RL_VAL_UW 0 CM_0000 0 65535 /end CHARACTERISTIC
/begin CHARACTERISTIC K_ED_PT_BUSOFF.DEC_NACH_EINTRAG "Fault code PT_BUSOFF - debounce filter decrement after fault-memory entry [verified]" VALUE 0x70DDD RL_VAL_UB 0 CM_0000 0 255 /end CHARACTERISTIC
/begin CHARACTERISTIC K_ED_PT_BUSOFF.DEC_VOR_EINTRAG "Fault code PT_BUSOFF - debounce filter decrement before fault-memory entry [verified]" VALUE 0x70DDB RL_VAL_UB 0 CM_0000 0 255 /end CHARACTERISTIC
/begin CHARACTERISTIC K_ED_PT_BUSOFF.FEHLERSCHWELLE "Fault code PT_BUSOFF - debounce filter threshold for setting the fault [verified]" VALUE 0x70DD8 RL_VAL_UB 0 CM_0000 0 255 /end CHARACTERISTIC
/begin CHARACTERISTIC K_ED_PT_BUSOFF.INC_NACH_EINTRAG "Fault code PT_BUSOFF - debounce filter increment after fault-memory entry [verified]" VALUE 0x70DDC RL_VAL_UB 0 CM_0000 0 255 /end CHARACTERISTIC
/begin CHARACTERISTIC K_ED_PT_BUSOFF.INC_VOR_EINTRAG "Fault code PT_BUSOFF - debounce filter increment before fault-memory entry [verified]" VALUE 0x70DDA RL_VAL_UB 0 CM_0000 0 255 /end CHARACTERISTIC
/begin CHARACTERISTIC K_ED_PT_BUSOFF.KLASSENINDEX "Fault code PT_BUSOFF - fault class selection (lamp / warning behaviour) [verified]" VALUE 0x70DDE RL_VAL_UB 0 CM_0000 0 255 /end CHARACTERISTIC
/begin CHARACTERISTIC K_ED_PT_BUSOFF.OK_SCHWELLE "Fault code PT_BUSOFF - debounce filter threshold for clearing (healing) the fault [verified]" VALUE 0x70DD9 RL_VAL_UB 0 CM_0000 0 255 /end CHARACTERISTIC
/begin CHARACTERISTIC K_ED_PT_BUSOFF.P_CODE_OPENLOAD "Fault code PT_BUSOFF - OBD P-code reported for open circuit [verified]" VALUE 0x70DD4 RL_VAL_UW 0 CM_0000 0 65535 /end CHARACTERISTIC
/begin CHARACTERISTIC K_ED_PT_BUSOFF.P_CODE_SH_TO_GND "Fault code PT_BUSOFF - OBD P-code reported for short to ground [verified]" VALUE 0x70DD2 RL_VAL_UW 0 CM_0000 0 65535 /end CHARACTERISTIC
/begin CHARACTERISTIC K_ED_PT_BUSOFF.P_CODE_SH_TO_UB "Fault code PT_BUSOFF - OBD P-code reported for short to battery voltage [verified]" VALUE 0x70DD0 RL_VAL_UW 0 CM_0000 0 65535 /end CHARACTERISTIC
/begin CHARACTERISTIC K_ED_PT_BUSOFF.P_CODE_UNPLAUSIBEL "Fault code PT_BUSOFF - OBD P-code reported for implausible signal [verified]" VALUE 0x70DD6 RL_VAL_UW 0 CM_0000 0 65535 /end CHARACTERISTIC
/begin CHARACTERISTIC K_ED_PT_CRASH.DEC_NACH_EINTRAG "Fault code PT_CRASH - debounce filter decrement after fault-memory entry [verified]" VALUE 0x714DF RL_VAL_UB 0 CM_0000 0 255 /end CHARACTERISTIC
/begin CHARACTERISTIC K_ED_PT_CRASH.DEC_VOR_EINTRAG "Fault code PT_CRASH - debounce filter decrement before fault-memory entry [verified]" VALUE 0x714DD RL_VAL_UB 0 CM_0000 0 255 /end CHARACTERISTIC
/begin CHARACTERISTIC K_ED_PT_CRASH.FEHLERSCHWELLE "Fault code PT_CRASH - debounce filter threshold for setting the fault [verified]" VALUE 0x714DA RL_VAL_UB 0 CM_0000 0 255 /end CHARACTERISTIC
/begin CHARACTERISTIC K_ED_PT_CRASH.INC_NACH_EINTRAG "Fault code PT_CRASH - debounce filter increment after fault-memory entry [verified]" VALUE 0x714DE RL_VAL_UB 0 CM_0000 0 255 /end CHARACTERISTIC
/begin CHARACTERISTIC K_ED_PT_CRASH.INC_VOR_EINTRAG "Fault code PT_CRASH - debounce filter increment before fault-memory entry [verified]" VALUE 0x714DC RL_VAL_UB 0 CM_0000 0 255 /end CHARACTERISTIC
/begin CHARACTERISTIC K_ED_PT_CRASH.KLASSENINDEX "Fault code PT_CRASH - fault class selection (lamp / warning behaviour) [verified]" VALUE 0x714E0 RL_VAL_UB 0 CM_0000 0 255 /end CHARACTERISTIC
/begin CHARACTERISTIC K_ED_PT_CRASH.OK_SCHWELLE "Fault code PT_CRASH - debounce filter threshold for clearing (healing) the fault [verified]" VALUE 0x714DB RL_VAL_UB 0 CM_0000 0 255 /end CHARACTERISTIC
/begin CHARACTERISTIC K_ED_PT_CRASH.P_CODE_OPENLOAD "Fault code PT_CRASH - OBD P-code reported for open circuit [verified]" VALUE 0x714D6 RL_VAL_UW 0 CM_0000 0 65535 /end CHARACTERISTIC
/begin CHARACTERISTIC K_ED_PT_CRASH.P_CODE_SH_TO_GND "Fault code PT_CRASH - OBD P-code reported for short to ground [verified]" VALUE 0x714D4 RL_VAL_UW 0 CM_0000 0 65535 /end CHARACTERISTIC
/begin CHARACTERISTIC K_ED_PT_CRASH.P_CODE_SH_TO_UB "Fault code PT_CRASH - OBD P-code reported for short to battery voltage [verified]" VALUE 0x714D2 RL_VAL_UW 0 CM_0000 0 65535 /end CHARACTERISTIC
/begin CHARACTERISTIC K_ED_PT_CRASH.P_CODE_UNPLAUSIBEL "Fault code PT_CRASH - OBD P-code reported for implausible signal [verified]" VALUE 0x714D8 RL_VAL_UW 0 CM_0000 0 65535 /end CHARACTERISTIC
/begin CHARACTERISTIC K_ED_PT_GRB.DEC_NACH_EINTRAG "Fault code PT_GRB - debounce filter decrement after fault-memory entry [verified]" VALUE 0x710E9 RL_VAL_UB 0 CM_0000 0 255 /end CHARACTERISTIC
/begin CHARACTERISTIC K_ED_PT_GRB.DEC_VOR_EINTRAG "Fault code PT_GRB - debounce filter decrement before fault-memory entry [verified]" VALUE 0x710E7 RL_VAL_UB 0 CM_0000 0 255 /end CHARACTERISTIC
/begin CHARACTERISTIC K_ED_PT_GRB.FEHLERSCHWELLE "Fault code PT_GRB - debounce filter threshold for setting the fault [verified]" VALUE 0x710E4 RL_VAL_UB 0 CM_0000 0 255 /end CHARACTERISTIC
/begin CHARACTERISTIC K_ED_PT_GRB.INC_NACH_EINTRAG "Fault code PT_GRB - debounce filter increment after fault-memory entry [verified]" VALUE 0x710E8 RL_VAL_UB 0 CM_0000 0 255 /end CHARACTERISTIC
/begin CHARACTERISTIC K_ED_PT_GRB.INC_VOR_EINTRAG "Fault code PT_GRB - debounce filter increment before fault-memory entry [verified]" VALUE 0x710E6 RL_VAL_UB 0 CM_0000 0 255 /end CHARACTERISTIC
/begin CHARACTERISTIC K_ED_PT_GRB.KLASSENINDEX "Fault code PT_GRB - fault class selection (lamp / warning behaviour) [verified]" VALUE 0x710EA RL_VAL_UB 0 CM_0000 0 255 /end CHARACTERISTIC
/begin CHARACTERISTIC K_ED_PT_GRB.OK_SCHWELLE "Fault code PT_GRB - debounce filter threshold for clearing (healing) the fault [verified]" VALUE 0x710E5 RL_VAL_UB 0 CM_0000 0 255 /end CHARACTERISTIC
/begin CHARACTERISTIC K_ED_PT_GRB.P_CODE_OPENLOAD "Fault code PT_GRB - OBD P-code reported for open circuit [verified]" VALUE 0x710E0 RL_VAL_UW 0 CM_0000 0 65535 /end CHARACTERISTIC
/begin CHARACTERISTIC K_ED_PT_GRB.P_CODE_SH_TO_GND "Fault code PT_GRB - OBD P-code reported for short to ground [verified]" VALUE 0x710DE RL_VAL_UW 0 CM_0000 0 65535 /end CHARACTERISTIC
/begin CHARACTERISTIC K_ED_PT_GRB.P_CODE_SH_TO_UB "Fault code PT_GRB - OBD P-code reported for short to battery voltage [verified]" VALUE 0x710DC RL_VAL_UW 0 CM_0000 0 65535 /end CHARACTERISTIC
/begin CHARACTERISTIC K_ED_PT_GRB.P_CODE_UNPLAUSIBEL "Fault code PT_GRB - OBD P-code reported for implausible signal [verified]" VALUE 0x710E2 RL_VAL_UW 0 CM_0000 0 65535 /end CHARACTERISTIC
/begin CHARACTERISTIC K_ED_PT_GRB2.DEC_NACH_EINTRAG "Fault code PT_GRB2 - debounce filter decrement after fault-memory entry [verified]" VALUE 0x71103 RL_VAL_UB 0 CM_0000 0 255 /end CHARACTERISTIC
/begin CHARACTERISTIC K_ED_PT_GRB2.DEC_VOR_EINTRAG "Fault code PT_GRB2 - debounce filter decrement before fault-memory entry [verified]" VALUE 0x71101 RL_VAL_UB 0 CM_0000 0 255 /end CHARACTERISTIC
/begin CHARACTERISTIC K_ED_PT_GRB2.FEHLERSCHWELLE "Fault code PT_GRB2 - debounce filter threshold for setting the fault [verified]" VALUE 0x710FE RL_VAL_UB 0 CM_0000 0 255 /end CHARACTERISTIC
/begin CHARACTERISTIC K_ED_PT_GRB2.INC_NACH_EINTRAG "Fault code PT_GRB2 - debounce filter increment after fault-memory entry [verified]" VALUE 0x71102 RL_VAL_UB 0 CM_0000 0 255 /end CHARACTERISTIC
/begin CHARACTERISTIC K_ED_PT_GRB2.INC_VOR_EINTRAG "Fault code PT_GRB2 - debounce filter increment before fault-memory entry [verified]" VALUE 0x71100 RL_VAL_UB 0 CM_0000 0 255 /end CHARACTERISTIC
/begin CHARACTERISTIC K_ED_PT_GRB2.KLASSENINDEX "Fault code PT_GRB2 - fault class selection (lamp / warning behaviour) [verified]" VALUE 0x71104 RL_VAL_UB 0 CM_0000 0 255 /end CHARACTERISTIC
/begin CHARACTERISTIC K_ED_PT_GRB2.OK_SCHWELLE "Fault code PT_GRB2 - debounce filter threshold for clearing (healing) the fault [verified]" VALUE 0x710FF RL_VAL_UB 0 CM_0000 0 255 /end CHARACTERISTIC
/begin CHARACTERISTIC K_ED_PT_GRB2.P_CODE_OPENLOAD "Fault code PT_GRB2 - OBD P-code reported for open circuit [verified]" VALUE 0x710FA RL_VAL_UW 0 CM_0000 0 65535 /end CHARACTERISTIC
/begin CHARACTERISTIC K_ED_PT_GRB2.P_CODE_SH_TO_GND "Fault code PT_GRB2 - OBD P-code reported for short to ground [verified]" VALUE 0x710F8 RL_VAL_UW 0 CM_0000 0 65535 /end CHARACTERISTIC
/begin CHARACTERISTIC K_ED_PT_GRB2.P_CODE_SH_TO_UB "Fault code PT_GRB2 - OBD P-code reported for short to battery voltage [verified]" VALUE 0x710F6 RL_VAL_UW 0 CM_0000 0 65535 /end CHARACTERISTIC
/begin CHARACTERISTIC K_ED_PT_GRB2.P_CODE_UNPLAUSIBEL "Fault code PT_GRB2 - OBD P-code reported for implausible signal [verified]" VALUE 0x710FC RL_VAL_UW 0 CM_0000 0 65535 /end CHARACTERISTIC
/begin CHARACTERISTIC K_ED_PT_GRB3.DEC_NACH_EINTRAG "Fault code PT_GRB3 - debounce filter decrement after fault-memory entry [verified]" VALUE 0x71C7D RL_VAL_UB 0 CM_0000 0 255 /end CHARACTERISTIC
/begin CHARACTERISTIC K_ED_PT_GRB3.DEC_VOR_EINTRAG "Fault code PT_GRB3 - debounce filter decrement before fault-memory entry [verified]" VALUE 0x71C7B RL_VAL_UB 0 CM_0000 0 255 /end CHARACTERISTIC
/begin CHARACTERISTIC K_ED_PT_GRB3.FEHLERSCHWELLE "Fault code PT_GRB3 - debounce filter threshold for setting the fault [verified]" VALUE 0x71C78 RL_VAL_UB 0 CM_0000 0 255 /end CHARACTERISTIC
/begin CHARACTERISTIC K_ED_PT_GRB3.INC_NACH_EINTRAG "Fault code PT_GRB3 - debounce filter increment after fault-memory entry [verified]" VALUE 0x71C7C RL_VAL_UB 0 CM_0000 0 255 /end CHARACTERISTIC
/begin CHARACTERISTIC K_ED_PT_GRB3.INC_VOR_EINTRAG "Fault code PT_GRB3 - debounce filter increment before fault-memory entry [verified]" VALUE 0x71C7A RL_VAL_UB 0 CM_0000 0 255 /end CHARACTERISTIC
/begin CHARACTERISTIC K_ED_PT_GRB3.KLASSENINDEX "Fault code PT_GRB3 - fault class selection (lamp / warning behaviour) [verified]" VALUE 0x71C7E RL_VAL_UB 0 CM_0000 0 255 /end CHARACTERISTIC
/begin CHARACTERISTIC K_ED_PT_GRB3.OK_SCHWELLE "Fault code PT_GRB3 - debounce filter threshold for clearing (healing) the fault [verified]" VALUE 0x71C79 RL_VAL_UB 0 CM_0000 0 255 /end CHARACTERISTIC
/begin CHARACTERISTIC K_ED_PT_GRB3.P_CODE_OPENLOAD "Fault code PT_GRB3 - OBD P-code reported for open circuit [verified]" VALUE 0x71C74 RL_VAL_UW 0 CM_0000 0 65535 /end CHARACTERISTIC
/begin CHARACTERISTIC K_ED_PT_GRB3.P_CODE_SH_TO_GND "Fault code PT_GRB3 - OBD P-code reported for short to ground [verified]" VALUE 0x71C72 RL_VAL_UW 0 CM_0000 0 65535 /end CHARACTERISTIC
/begin CHARACTERISTIC K_ED_PT_GRB3.P_CODE_SH_TO_UB "Fault code PT_GRB3 - OBD P-code reported for short to battery voltage [verified]" VALUE 0x71C70 RL_VAL_UW 0 CM_0000 0 65535 /end CHARACTERISTIC
/begin CHARACTERISTIC K_ED_PT_GRB3.P_CODE_UNPLAUSIBEL "Fault code PT_GRB3 - OBD P-code reported for implausible signal [verified]" VALUE 0x71C76 RL_VAL_UW 0 CM_0000 0 65535 /end CHARACTERISTIC
/begin CHARACTERISTIC K_ED_PT_KKOS.DEC_NACH_EINTRAG "Fault code PT_KKOS - debounce filter decrement after fault-memory entry [verified]" VALUE 0x70E93 RL_VAL_UB 0 CM_0000 0 255 /end CHARACTERISTIC
/begin CHARACTERISTIC K_ED_PT_KKOS.DEC_VOR_EINTRAG "Fault code PT_KKOS - debounce filter decrement before fault-memory entry [verified]" VALUE 0x70E91 RL_VAL_UB 0 CM_0000 0 255 /end CHARACTERISTIC
/begin CHARACTERISTIC K_ED_PT_KKOS.FEHLERSCHWELLE "Fault code PT_KKOS - debounce filter threshold for setting the fault [verified]" VALUE 0x70E8E RL_VAL_UB 0 CM_0000 0 255 /end CHARACTERISTIC
/begin CHARACTERISTIC K_ED_PT_KKOS.INC_NACH_EINTRAG "Fault code PT_KKOS - debounce filter increment after fault-memory entry [verified]" VALUE 0x70E92 RL_VAL_UB 0 CM_0000 0 255 /end CHARACTERISTIC
/begin CHARACTERISTIC K_ED_PT_KKOS.INC_VOR_EINTRAG "Fault code PT_KKOS - debounce filter increment before fault-memory entry [verified]" VALUE 0x70E90 RL_VAL_UB 0 CM_0000 0 255 /end CHARACTERISTIC
/begin CHARACTERISTIC K_ED_PT_KKOS.KLASSENINDEX "Fault code PT_KKOS - fault class selection (lamp / warning behaviour) [verified]" VALUE 0x70E94 RL_VAL_UB 0 CM_0000 0 255 /end CHARACTERISTIC
/begin CHARACTERISTIC K_ED_PT_KKOS.OK_SCHWELLE "Fault code PT_KKOS - debounce filter threshold for clearing (healing) the fault [verified]" VALUE 0x70E8F RL_VAL_UB 0 CM_0000 0 255 /end CHARACTERISTIC
/begin CHARACTERISTIC K_ED_PT_KKOS.P_CODE_OPENLOAD "Fault code PT_KKOS - OBD P-code reported for open circuit [verified]" VALUE 0x70E8A RL_VAL_UW 0 CM_0000 0 65535 /end CHARACTERISTIC
/begin CHARACTERISTIC K_ED_PT_KKOS.P_CODE_SH_TO_GND "Fault code PT_KKOS - OBD P-code reported for short to ground [verified]" VALUE 0x70E88 RL_VAL_UW 0 CM_0000 0 65535 /end CHARACTERISTIC
/begin CHARACTERISTIC K_ED_PT_KKOS.P_CODE_SH_TO_UB "Fault code PT_KKOS - OBD P-code reported for short to battery voltage [verified]" VALUE 0x70E86 RL_VAL_UW 0 CM_0000 0 65535 /end CHARACTERISTIC
/begin CHARACTERISTIC K_ED_PT_KKOS.P_CODE_UNPLAUSIBEL "Fault code PT_KKOS - OBD P-code reported for implausible signal [verified]" VALUE 0x70E8C RL_VAL_UW 0 CM_0000 0 65535 /end CHARACTERISTIC
/begin CHARACTERISTIC K_ED_PT_KLST.DEC_NACH_EINTRAG "Fault code PT_KLST - debounce filter decrement after fault-memory entry [verified]" VALUE 0x70E79 RL_VAL_UB 0 CM_0000 0 255 /end CHARACTERISTIC
/begin CHARACTERISTIC K_ED_PT_KLST.DEC_VOR_EINTRAG "Fault code PT_KLST - debounce filter decrement before fault-memory entry [verified]" VALUE 0x70E77 RL_VAL_UB 0 CM_0000 0 255 /end CHARACTERISTIC
/begin CHARACTERISTIC K_ED_PT_KLST.FEHLERSCHWELLE "Fault code PT_KLST - debounce filter threshold for setting the fault [verified]" VALUE 0x70E74 RL_VAL_UB 0 CM_0000 0 255 /end CHARACTERISTIC
/begin CHARACTERISTIC K_ED_PT_KLST.INC_NACH_EINTRAG "Fault code PT_KLST - debounce filter increment after fault-memory entry [verified]" VALUE 0x70E78 RL_VAL_UB 0 CM_0000 0 255 /end CHARACTERISTIC
/begin CHARACTERISTIC K_ED_PT_KLST.INC_VOR_EINTRAG "Fault code PT_KLST - debounce filter increment before fault-memory entry [verified]" VALUE 0x70E76 RL_VAL_UB 0 CM_0000 0 255 /end CHARACTERISTIC
/begin CHARACTERISTIC K_ED_PT_KLST.KLASSENINDEX "Fault code PT_KLST - fault class selection (lamp / warning behaviour) [verified]" VALUE 0x70E7A RL_VAL_UB 0 CM_0000 0 255 /end CHARACTERISTIC
/begin CHARACTERISTIC K_ED_PT_KLST.OK_SCHWELLE "Fault code PT_KLST - debounce filter threshold for clearing (healing) the fault [verified]" VALUE 0x70E75 RL_VAL_UB 0 CM_0000 0 255 /end CHARACTERISTIC
/begin CHARACTERISTIC K_ED_PT_KLST.P_CODE_OPENLOAD "Fault code PT_KLST - OBD P-code reported for open circuit [verified]" VALUE 0x70E70 RL_VAL_UW 0 CM_0000 0 65535 /end CHARACTERISTIC
/begin CHARACTERISTIC K_ED_PT_KLST.P_CODE_SH_TO_GND "Fault code PT_KLST - OBD P-code reported for short to ground [verified]" VALUE 0x70E6E RL_VAL_UW 0 CM_0000 0 65535 /end CHARACTERISTIC
/begin CHARACTERISTIC K_ED_PT_KLST.P_CODE_SH_TO_UB "Fault code PT_KLST - OBD P-code reported for short to battery voltage [verified]" VALUE 0x70E6C RL_VAL_UW 0 CM_0000 0 65535 /end CHARACTERISTIC
/begin CHARACTERISTIC K_ED_PT_KLST.P_CODE_UNPLAUSIBEL "Fault code PT_KLST - OBD P-code reported for implausible signal [verified]" VALUE 0x70E72 RL_VAL_UW 0 CM_0000 0 65535 /end CHARACTERISTIC
/begin CHARACTERISTIC K_ED_PT_KM.DEC_NACH_EINTRAG "Fault code PT_KM - debounce filter decrement after fault-memory entry [verified]" VALUE 0x71699 RL_VAL_UB 0 CM_0000 0 255 /end CHARACTERISTIC
/begin CHARACTERISTIC K_ED_PT_KM.DEC_VOR_EINTRAG "Fault code PT_KM - debounce filter decrement before fault-memory entry [verified]" VALUE 0x71697 RL_VAL_UB 0 CM_0000 0 255 /end CHARACTERISTIC
/begin CHARACTERISTIC K_ED_PT_KM.FEHLERSCHWELLE "Fault code PT_KM - debounce filter threshold for setting the fault [verified]" VALUE 0x71694 RL_VAL_UB 0 CM_0000 0 255 /end CHARACTERISTIC
/begin CHARACTERISTIC K_ED_PT_KM.INC_NACH_EINTRAG "Fault code PT_KM - debounce filter increment after fault-memory entry [verified]" VALUE 0x71698 RL_VAL_UB 0 CM_0000 0 255 /end CHARACTERISTIC
/begin CHARACTERISTIC K_ED_PT_KM.INC_VOR_EINTRAG "Fault code PT_KM - debounce filter increment before fault-memory entry [verified]" VALUE 0x71696 RL_VAL_UB 0 CM_0000 0 255 /end CHARACTERISTIC
/begin CHARACTERISTIC K_ED_PT_KM.KLASSENINDEX "Fault code PT_KM - fault class selection (lamp / warning behaviour) [verified]" VALUE 0x7169A RL_VAL_UB 0 CM_0000 0 255 /end CHARACTERISTIC
/begin CHARACTERISTIC K_ED_PT_KM.OK_SCHWELLE "Fault code PT_KM - debounce filter threshold for clearing (healing) the fault [verified]" VALUE 0x71695 RL_VAL_UB 0 CM_0000 0 255 /end CHARACTERISTIC
/begin CHARACTERISTIC K_ED_PT_KM.P_CODE_OPENLOAD "Fault code PT_KM - OBD P-code reported for open circuit [verified]" VALUE 0x71690 RL_VAL_UW 0 CM_0000 0 65535 /end CHARACTERISTIC
/begin CHARACTERISTIC K_ED_PT_KM.P_CODE_SH_TO_GND "Fault code PT_KM - OBD P-code reported for short to ground [verified]" VALUE 0x7168E RL_VAL_UW 0 CM_0000 0 65535 /end CHARACTERISTIC
/begin CHARACTERISTIC K_ED_PT_KM.P_CODE_SH_TO_UB "Fault code PT_KM - OBD P-code reported for short to battery voltage [verified]" VALUE 0x7168C RL_VAL_UW 0 CM_0000 0 65535 /end CHARACTERISTIC
/begin CHARACTERISTIC K_ED_PT_KM.P_CODE_UNPLAUSIBEL "Fault code PT_KM - OBD P-code reported for implausible signal [verified]" VALUE 0x71692 RL_VAL_UW 0 CM_0000 0 65535 /end CHARACTERISTIC
/begin CHARACTERISTIC K_ED_PT_KOMBI.DEC_NACH_EINTRAG "Fault code PT_KOMBI - debounce filter decrement after fault-memory entry [verified]" VALUE 0x716B3 RL_VAL_UB 0 CM_0000 0 255 /end CHARACTERISTIC
/begin CHARACTERISTIC K_ED_PT_KOMBI.DEC_VOR_EINTRAG "Fault code PT_KOMBI - debounce filter decrement before fault-memory entry [verified]" VALUE 0x716B1 RL_VAL_UB 0 CM_0000 0 255 /end CHARACTERISTIC
/begin CHARACTERISTIC K_ED_PT_KOMBI.FEHLERSCHWELLE "Fault code PT_KOMBI - debounce filter threshold for setting the fault [verified]" VALUE 0x716AE RL_VAL_UB 0 CM_0000 0 255 /end CHARACTERISTIC
/begin CHARACTERISTIC K_ED_PT_KOMBI.INC_NACH_EINTRAG "Fault code PT_KOMBI - debounce filter increment after fault-memory entry [verified]" VALUE 0x716B2 RL_VAL_UB 0 CM_0000 0 255 /end CHARACTERISTIC
/begin CHARACTERISTIC K_ED_PT_KOMBI.INC_VOR_EINTRAG "Fault code PT_KOMBI - debounce filter increment before fault-memory entry [verified]" VALUE 0x716B0 RL_VAL_UB 0 CM_0000 0 255 /end CHARACTERISTIC
/begin CHARACTERISTIC K_ED_PT_KOMBI.KLASSENINDEX "Fault code PT_KOMBI - fault class selection (lamp / warning behaviour) [verified]" VALUE 0x716B4 RL_VAL_UB 0 CM_0000 0 255 /end CHARACTERISTIC
/begin CHARACTERISTIC K_ED_PT_KOMBI.OK_SCHWELLE "Fault code PT_KOMBI - debounce filter threshold for clearing (healing) the fault [verified]" VALUE 0x716AF RL_VAL_UB 0 CM_0000 0 255 /end CHARACTERISTIC
/begin CHARACTERISTIC K_ED_PT_KOMBI.P_CODE_OPENLOAD "Fault code PT_KOMBI - OBD P-code reported for open circuit [verified]" VALUE 0x716AA RL_VAL_UW 0 CM_0000 0 65535 /end CHARACTERISTIC
/begin CHARACTERISTIC K_ED_PT_KOMBI.P_CODE_SH_TO_GND "Fault code PT_KOMBI - OBD P-code reported for short to ground [verified]" VALUE 0x716A8 RL_VAL_UW 0 CM_0000 0 65535 /end CHARACTERISTIC
/begin CHARACTERISTIC K_ED_PT_KOMBI.P_CODE_SH_TO_UB "Fault code PT_KOMBI - OBD P-code reported for short to battery voltage [verified]" VALUE 0x716A6 RL_VAL_UW 0 CM_0000 0 65535 /end CHARACTERISTIC
/begin CHARACTERISTIC K_ED_PT_KOMBI.P_CODE_UNPLAUSIBEL "Fault code PT_KOMBI - OBD P-code reported for implausible signal [verified]" VALUE 0x716AC RL_VAL_UW 0 CM_0000 0 65535 /end CHARACTERISTIC
/begin CHARACTERISTIC K_ED_PT_LRW.DEC_NACH_EINTRAG "Fault code PT_LRW - debounce filter decrement after fault-memory entry [verified]" VALUE 0x70EAD RL_VAL_UB 0 CM_0000 0 255 /end CHARACTERISTIC
/begin CHARACTERISTIC K_ED_PT_LRW.DEC_VOR_EINTRAG "Fault code PT_LRW - debounce filter decrement before fault-memory entry [verified]" VALUE 0x70EAB RL_VAL_UB 0 CM_0000 0 255 /end CHARACTERISTIC
/begin CHARACTERISTIC K_ED_PT_LRW.FEHLERSCHWELLE "Fault code PT_LRW - debounce filter threshold for setting the fault [verified]" VALUE 0x70EA8 RL_VAL_UB 0 CM_0000 0 255 /end CHARACTERISTIC
/begin CHARACTERISTIC K_ED_PT_LRW.INC_NACH_EINTRAG "Fault code PT_LRW - debounce filter increment after fault-memory entry [verified]" VALUE 0x70EAC RL_VAL_UB 0 CM_0000 0 255 /end CHARACTERISTIC
/begin CHARACTERISTIC K_ED_PT_LRW.INC_VOR_EINTRAG "Fault code PT_LRW - debounce filter increment before fault-memory entry [verified]" VALUE 0x70EAA RL_VAL_UB 0 CM_0000 0 255 /end CHARACTERISTIC
/begin CHARACTERISTIC K_ED_PT_LRW.KLASSENINDEX "Fault code PT_LRW - fault class selection (lamp / warning behaviour) [verified]" VALUE 0x70EAE RL_VAL_UB 0 CM_0000 0 255 /end CHARACTERISTIC
/begin CHARACTERISTIC K_ED_PT_LRW.OK_SCHWELLE "Fault code PT_LRW - debounce filter threshold for clearing (healing) the fault [verified]" VALUE 0x70EA9 RL_VAL_UB 0 CM_0000 0 255 /end CHARACTERISTIC
/begin CHARACTERISTIC K_ED_PT_LRW.P_CODE_OPENLOAD "Fault code PT_LRW - OBD P-code reported for open circuit [verified]" VALUE 0x70EA4 RL_VAL_UW 0 CM_0000 0 65535 /end CHARACTERISTIC
/begin CHARACTERISTIC K_ED_PT_LRW.P_CODE_SH_TO_GND "Fault code PT_LRW - OBD P-code reported for short to ground [verified]" VALUE 0x70EA2 RL_VAL_UW 0 CM_0000 0 65535 /end CHARACTERISTIC
/begin CHARACTERISTIC K_ED_PT_LRW.P_CODE_SH_TO_UB "Fault code PT_LRW - OBD P-code reported for short to battery voltage [verified]" VALUE 0x70EA0 RL_VAL_UW 0 CM_0000 0 65535 /end CHARACTERISTIC
/begin CHARACTERISTIC K_ED_PT_LRW.P_CODE_UNPLAUSIBEL "Fault code PT_LRW - OBD P-code reported for implausible signal [verified]" VALUE 0x70EA6 RL_VAL_UW 0 CM_0000 0 65535 /end CHARACTERISTIC
/begin CHARACTERISTIC K_ED_PT_STATANH.DEC_NACH_EINTRAG "Fault code PT_STATANH - debounce filter decrement after fault-memory entry [verified]" VALUE 0x71BFB RL_VAL_UB 0 CM_0000 0 255 /end CHARACTERISTIC
/begin CHARACTERISTIC K_ED_PT_STATANH.DEC_VOR_EINTRAG "Fault code PT_STATANH - debounce filter decrement before fault-memory entry [verified]" VALUE 0x71BF9 RL_VAL_UB 0 CM_0000 0 255 /end CHARACTERISTIC
/begin CHARACTERISTIC K_ED_PT_STATANH.FEHLERSCHWELLE "Fault code PT_STATANH - debounce filter threshold for setting the fault [verified]" VALUE 0x71BF6 RL_VAL_UB 0 CM_0000 0 255 /end CHARACTERISTIC
/begin CHARACTERISTIC K_ED_PT_STATANH.INC_NACH_EINTRAG "Fault code PT_STATANH - debounce filter increment after fault-memory entry [verified]" VALUE 0x71BFA RL_VAL_UB 0 CM_0000 0 255 /end CHARACTERISTIC
/begin CHARACTERISTIC K_ED_PT_STATANH.INC_VOR_EINTRAG "Fault code PT_STATANH - debounce filter increment before fault-memory entry [verified]" VALUE 0x71BF8 RL_VAL_UB 0 CM_0000 0 255 /end CHARACTERISTIC
/begin CHARACTERISTIC K_ED_PT_STATANH.KLASSENINDEX "Fault code PT_STATANH - fault class selection (lamp / warning behaviour) [verified]" VALUE 0x71BFC RL_VAL_UB 0 CM_0000 0 255 /end CHARACTERISTIC
/begin CHARACTERISTIC K_ED_PT_STATANH.OK_SCHWELLE "Fault code PT_STATANH - debounce filter threshold for clearing (healing) the fault [verified]" VALUE 0x71BF7 RL_VAL_UB 0 CM_0000 0 255 /end CHARACTERISTIC
/begin CHARACTERISTIC K_ED_PT_STATANH.P_CODE_OPENLOAD "Fault code PT_STATANH - OBD P-code reported for open circuit [verified]" VALUE 0x71BF2 RL_VAL_UW 0 CM_0000 0 65535 /end CHARACTERISTIC
/begin CHARACTERISTIC K_ED_PT_STATANH.P_CODE_SH_TO_GND "Fault code PT_STATANH - OBD P-code reported for short to ground [verified]" VALUE 0x71BF0 RL_VAL_UW 0 CM_0000 0 65535 /end CHARACTERISTIC
/begin CHARACTERISTIC K_ED_PT_STATANH.P_CODE_SH_TO_UB "Fault code PT_STATANH - OBD P-code reported for short to battery voltage [verified]" VALUE 0x71BEE RL_VAL_UW 0 CM_0000 0 65535 /end CHARACTERISTIC
/begin CHARACTERISTIC K_ED_PT_STATANH.P_CODE_UNPLAUSIBEL "Fault code PT_STATANH - OBD P-code reported for implausible signal [verified]" VALUE 0x71BF4 RL_VAL_UW 0 CM_0000 0 65535 /end CHARACTERISTIC
/begin CHARACTERISTIC K_ED_PT_STATDKG.DEC_NACH_EINTRAG "Fault code PT_STATDKG - debounce filter decrement after fault-memory entry [verified]" VALUE 0x70C8B RL_VAL_UB 0 CM_0000 0 255 /end CHARACTERISTIC
/begin CHARACTERISTIC K_ED_PT_STATDKG.DEC_VOR_EINTRAG "Fault code PT_STATDKG - debounce filter decrement before fault-memory entry [verified]" VALUE 0x70C89 RL_VAL_UB 0 CM_0000 0 255 /end CHARACTERISTIC
/begin CHARACTERISTIC K_ED_PT_STATDKG.FEHLERSCHWELLE "Fault code PT_STATDKG - debounce filter threshold for setting the fault [verified]" VALUE 0x70C86 RL_VAL_UB 0 CM_0000 0 255 /end CHARACTERISTIC
/begin CHARACTERISTIC K_ED_PT_STATDKG.INC_NACH_EINTRAG "Fault code PT_STATDKG - debounce filter increment after fault-memory entry [verified]" VALUE 0x70C8A RL_VAL_UB 0 CM_0000 0 255 /end CHARACTERISTIC
/begin CHARACTERISTIC K_ED_PT_STATDKG.INC_VOR_EINTRAG "Fault code PT_STATDKG - debounce filter increment before fault-memory entry [verified]" VALUE 0x70C88 RL_VAL_UB 0 CM_0000 0 255 /end CHARACTERISTIC
/begin CHARACTERISTIC K_ED_PT_STATDKG.KLASSENINDEX "Fault code PT_STATDKG - fault class selection (lamp / warning behaviour) [verified]" VALUE 0x70C8C RL_VAL_UB 0 CM_0000 0 255 /end CHARACTERISTIC
/begin CHARACTERISTIC K_ED_PT_STATDKG.OK_SCHWELLE "Fault code PT_STATDKG - debounce filter threshold for clearing (healing) the fault [verified]" VALUE 0x70C87 RL_VAL_UB 0 CM_0000 0 255 /end CHARACTERISTIC
/begin CHARACTERISTIC K_ED_PT_STATDKG.P_CODE_OPENLOAD "Fault code PT_STATDKG - OBD P-code reported for open circuit [verified]" VALUE 0x70C82 RL_VAL_UW 0 CM_0000 0 65535 /end CHARACTERISTIC
/begin CHARACTERISTIC K_ED_PT_STATDKG.P_CODE_SH_TO_GND "Fault code PT_STATDKG - OBD P-code reported for short to ground [verified]" VALUE 0x70C80 RL_VAL_UW 0 CM_0000 0 65535 /end CHARACTERISTIC
/begin CHARACTERISTIC K_ED_PT_STATDKG.P_CODE_SH_TO_UB "Fault code PT_STATDKG - OBD P-code reported for short to battery voltage [verified]" VALUE 0x70C7E RL_VAL_UW 0 CM_0000 0 65535 /end CHARACTERISTIC
/begin CHARACTERISTIC K_ED_PT_STATDKG.P_CODE_UNPLAUSIBEL "Fault code PT_STATDKG - OBD P-code reported for implausible signal [verified]" VALUE 0x70C84 RL_VAL_UW 0 CM_0000 0 65535 /end CHARACTERISTIC
/begin CHARACTERISTIC K_ED_PT_STATR.DEC_NACH_EINTRAG "Fault code PT_STATR - debounce filter decrement after fault-memory entry [verified]" VALUE 0x70CBF RL_VAL_UB 0 CM_0000 0 255 /end CHARACTERISTIC
/begin CHARACTERISTIC K_ED_PT_STATR.DEC_VOR_EINTRAG "Fault code PT_STATR - debounce filter decrement before fault-memory entry [verified]" VALUE 0x70CBD RL_VAL_UB 0 CM_0000 0 255 /end CHARACTERISTIC
/begin CHARACTERISTIC K_ED_PT_STATR.FEHLERSCHWELLE "Fault code PT_STATR - debounce filter threshold for setting the fault [verified]" VALUE 0x70CBA RL_VAL_UB 0 CM_0000 0 255 /end CHARACTERISTIC
/begin CHARACTERISTIC K_ED_PT_STATR.INC_NACH_EINTRAG "Fault code PT_STATR - debounce filter increment after fault-memory entry [verified]" VALUE 0x70CBE RL_VAL_UB 0 CM_0000 0 255 /end CHARACTERISTIC
/begin CHARACTERISTIC K_ED_PT_STATR.INC_VOR_EINTRAG "Fault code PT_STATR - debounce filter increment before fault-memory entry [verified]" VALUE 0x70CBC RL_VAL_UB 0 CM_0000 0 255 /end CHARACTERISTIC
/begin CHARACTERISTIC K_ED_PT_STATR.KLASSENINDEX "Fault code PT_STATR - fault class selection (lamp / warning behaviour) [verified]" VALUE 0x70CC0 RL_VAL_UB 0 CM_0000 0 255 /end CHARACTERISTIC
/begin CHARACTERISTIC K_ED_PT_STATR.OK_SCHWELLE "Fault code PT_STATR - debounce filter threshold for clearing (healing) the fault [verified]" VALUE 0x70CBB RL_VAL_UB 0 CM_0000 0 255 /end CHARACTERISTIC
/begin CHARACTERISTIC K_ED_PT_STATR.P_CODE_OPENLOAD "Fault code PT_STATR - OBD P-code reported for open circuit [verified]" VALUE 0x70CB6 RL_VAL_UW 0 CM_0000 0 65535 /end CHARACTERISTIC
/begin CHARACTERISTIC K_ED_PT_STATR.P_CODE_SH_TO_GND "Fault code PT_STATR - OBD P-code reported for short to ground [verified]" VALUE 0x70CB4 RL_VAL_UW 0 CM_0000 0 65535 /end CHARACTERISTIC
/begin CHARACTERISTIC K_ED_PT_STATR.P_CODE_SH_TO_UB "Fault code PT_STATR - OBD P-code reported for short to battery voltage [verified]" VALUE 0x70CB2 RL_VAL_UW 0 CM_0000 0 65535 /end CHARACTERISTIC
/begin CHARACTERISTIC K_ED_PT_STATR.P_CODE_UNPLAUSIBEL "Fault code PT_STATR - OBD P-code reported for implausible signal [verified]" VALUE 0x70CB8 RL_VAL_UW 0 CM_0000 0 65535 /end CHARACTERISTIC
/begin CHARACTERISTIC K_ED_PT_STDSC.DEC_NACH_EINTRAG "Fault code PT_STDSC - debounce filter decrement after fault-memory entry [verified]" VALUE 0x70E11 RL_VAL_UB 0 CM_0000 0 255 /end CHARACTERISTIC
/begin CHARACTERISTIC K_ED_PT_STDSC.DEC_VOR_EINTRAG "Fault code PT_STDSC - debounce filter decrement before fault-memory entry [verified]" VALUE 0x70E0F RL_VAL_UB 0 CM_0000 0 255 /end CHARACTERISTIC
/begin CHARACTERISTIC K_ED_PT_STDSC.FEHLERSCHWELLE "Fault code PT_STDSC - debounce filter threshold for setting the fault [verified]" VALUE 0x70E0C RL_VAL_UB 0 CM_0000 0 255 /end CHARACTERISTIC
/begin CHARACTERISTIC K_ED_PT_STDSC.INC_NACH_EINTRAG "Fault code PT_STDSC - debounce filter increment after fault-memory entry [verified]" VALUE 0x70E10 RL_VAL_UB 0 CM_0000 0 255 /end CHARACTERISTIC
/begin CHARACTERISTIC K_ED_PT_STDSC.INC_VOR_EINTRAG "Fault code PT_STDSC - debounce filter increment before fault-memory entry [verified]" VALUE 0x70E0E RL_VAL_UB 0 CM_0000 0 255 /end CHARACTERISTIC
/begin CHARACTERISTIC K_ED_PT_STDSC.KLASSENINDEX "Fault code PT_STDSC - fault class selection (lamp / warning behaviour) [verified]" VALUE 0x70E12 RL_VAL_UB 0 CM_0000 0 255 /end CHARACTERISTIC
/begin CHARACTERISTIC K_ED_PT_STDSC.OK_SCHWELLE "Fault code PT_STDSC - debounce filter threshold for clearing (healing) the fault [verified]" VALUE 0x70E0D RL_VAL_UB 0 CM_0000 0 255 /end CHARACTERISTIC
/begin CHARACTERISTIC K_ED_PT_STDSC.P_CODE_OPENLOAD "Fault code PT_STDSC - OBD P-code reported for open circuit [verified]" VALUE 0x70E08 RL_VAL_UW 0 CM_0000 0 65535 /end CHARACTERISTIC
/begin CHARACTERISTIC K_ED_PT_STDSC.P_CODE_SH_TO_GND "Fault code PT_STDSC - OBD P-code reported for short to ground [verified]" VALUE 0x70E06 RL_VAL_UW 0 CM_0000 0 65535 /end CHARACTERISTIC
/begin CHARACTERISTIC K_ED_PT_STDSC.P_CODE_SH_TO_UB "Fault code PT_STDSC - OBD P-code reported for short to battery voltage [verified]" VALUE 0x70E04 RL_VAL_UW 0 CM_0000 0 65535 /end CHARACTERISTIC
/begin CHARACTERISTIC K_ED_PT_STDSC.P_CODE_UNPLAUSIBEL "Fault code PT_STDSC - OBD P-code reported for implausible signal [verified]" VALUE 0x70E0A RL_VAL_UW 0 CM_0000 0 65535 /end CHARACTERISTIC
/begin CHARACTERISTIC K_ED_PT_TOMA.DEC_NACH_EINTRAG "Fault code PT_TOMA - debounce filter decrement after fault-memory entry [verified]" VALUE 0x71CE5 RL_VAL_UB 0 CM_0000 0 255 /end CHARACTERISTIC
/begin CHARACTERISTIC K_ED_PT_TOMA.DEC_VOR_EINTRAG "Fault code PT_TOMA - debounce filter decrement before fault-memory entry [verified]" VALUE 0x71CE3 RL_VAL_UB 0 CM_0000 0 255 /end CHARACTERISTIC
/begin CHARACTERISTIC K_ED_PT_TOMA.FEHLERSCHWELLE "Fault code PT_TOMA - debounce filter threshold for setting the fault [verified]" VALUE 0x71CE0 RL_VAL_UB 0 CM_0000 0 255 /end CHARACTERISTIC
/begin CHARACTERISTIC K_ED_PT_TOMA.INC_NACH_EINTRAG "Fault code PT_TOMA - debounce filter increment after fault-memory entry [verified]" VALUE 0x71CE4 RL_VAL_UB 0 CM_0000 0 255 /end CHARACTERISTIC
/begin CHARACTERISTIC K_ED_PT_TOMA.INC_VOR_EINTRAG "Fault code PT_TOMA - debounce filter increment before fault-memory entry [verified]" VALUE 0x71CE2 RL_VAL_UB 0 CM_0000 0 255 /end CHARACTERISTIC
/begin CHARACTERISTIC K_ED_PT_TOMA.KLASSENINDEX "Fault code PT_TOMA - fault class selection (lamp / warning behaviour) [verified]" VALUE 0x71CE6 RL_VAL_UB 0 CM_0000 0 255 /end CHARACTERISTIC
/begin CHARACTERISTIC K_ED_PT_TOMA.OK_SCHWELLE "Fault code PT_TOMA - debounce filter threshold for clearing (healing) the fault [verified]" VALUE 0x71CE1 RL_VAL_UB 0 CM_0000 0 255 /end CHARACTERISTIC
/begin CHARACTERISTIC K_ED_PT_TOMA.P_CODE_OPENLOAD "Fault code PT_TOMA - OBD P-code reported for open circuit [verified]" VALUE 0x71CDC RL_VAL_UW 0 CM_0000 0 65535 /end CHARACTERISTIC
/begin CHARACTERISTIC K_ED_PT_TOMA.P_CODE_SH_TO_GND "Fault code PT_TOMA - OBD P-code reported for short to ground [verified]" VALUE 0x71CDA RL_VAL_UW 0 CM_0000 0 65535 /end CHARACTERISTIC
/begin CHARACTERISTIC K_ED_PT_TOMA.P_CODE_SH_TO_UB "Fault code PT_TOMA - OBD P-code reported for short to battery voltage [verified]" VALUE 0x71CD8 RL_VAL_UW 0 CM_0000 0 65535 /end CHARACTERISTIC
/begin CHARACTERISTIC K_ED_PT_TOMA.P_CODE_UNPLAUSIBEL "Fault code PT_TOMA - OBD P-code reported for implausible signal [verified]" VALUE 0x71CDE RL_VAL_UW 0 CM_0000 0 65535 /end CHARACTERISTIC
/begin CHARACTERISTIC K_ED_PT_TORQDSC.DEC_NACH_EINTRAG "Fault code PT_TORQDSC - debounce filter decrement after fault-memory entry [verified]" VALUE 0x70DF7 RL_VAL_UB 0 CM_0000 0 255 /end CHARACTERISTIC
/begin CHARACTERISTIC K_ED_PT_TORQDSC.DEC_VOR_EINTRAG "Fault code PT_TORQDSC - debounce filter decrement before fault-memory entry [verified]" VALUE 0x70DF5 RL_VAL_UB 0 CM_0000 0 255 /end CHARACTERISTIC
/begin CHARACTERISTIC K_ED_PT_TORQDSC.FEHLERSCHWELLE "Fault code PT_TORQDSC - debounce filter threshold for setting the fault [verified]" VALUE 0x70DF2 RL_VAL_UB 0 CM_0000 0 255 /end CHARACTERISTIC
/begin CHARACTERISTIC K_ED_PT_TORQDSC.INC_NACH_EINTRAG "Fault code PT_TORQDSC - debounce filter increment after fault-memory entry [verified]" VALUE 0x70DF6 RL_VAL_UB 0 CM_0000 0 255 /end CHARACTERISTIC
/begin CHARACTERISTIC K_ED_PT_TORQDSC.INC_VOR_EINTRAG "Fault code PT_TORQDSC - debounce filter increment before fault-memory entry [verified]" VALUE 0x70DF4 RL_VAL_UB 0 CM_0000 0 255 /end CHARACTERISTIC
/begin CHARACTERISTIC K_ED_PT_TORQDSC.KLASSENINDEX "Fault code PT_TORQDSC - fault class selection (lamp / warning behaviour) [verified]" VALUE 0x70DF8 RL_VAL_UB 0 CM_0000 0 255 /end CHARACTERISTIC
/begin CHARACTERISTIC K_ED_PT_TORQDSC.OK_SCHWELLE "Fault code PT_TORQDSC - debounce filter threshold for clearing (healing) the fault [verified]" VALUE 0x70DF3 RL_VAL_UB 0 CM_0000 0 255 /end CHARACTERISTIC
/begin CHARACTERISTIC K_ED_PT_TORQDSC.P_CODE_OPENLOAD "Fault code PT_TORQDSC - OBD P-code reported for open circuit [verified]" VALUE 0x70DEE RL_VAL_UW 0 CM_0000 0 65535 /end CHARACTERISTIC
/begin CHARACTERISTIC K_ED_PT_TORQDSC.P_CODE_SH_TO_GND "Fault code PT_TORQDSC - OBD P-code reported for short to ground [verified]" VALUE 0x70DEC RL_VAL_UW 0 CM_0000 0 65535 /end CHARACTERISTIC
/begin CHARACTERISTIC K_ED_PT_TORQDSC.P_CODE_SH_TO_UB "Fault code PT_TORQDSC - OBD P-code reported for short to battery voltage [verified]" VALUE 0x70DEA RL_VAL_UW 0 CM_0000 0 65535 /end CHARACTERISTIC
/begin CHARACTERISTIC K_ED_PT_TORQDSC.P_CODE_UNPLAUSIBEL "Fault code PT_TORQDSC - OBD P-code reported for implausible signal [verified]" VALUE 0x70DF0 RL_VAL_UW 0 CM_0000 0 65535 /end CHARACTERISTIC
/begin CHARACTERISTIC K_ED_PT_VEHMOD.DEC_NACH_EINTRAG "Fault code PT_VEHMOD - debounce filter decrement after fault-memory entry [verified]" VALUE 0x714F9 RL_VAL_UB 0 CM_0000 0 255 /end CHARACTERISTIC
/begin CHARACTERISTIC K_ED_PT_VEHMOD.DEC_VOR_EINTRAG "Fault code PT_VEHMOD - debounce filter decrement before fault-memory entry [verified]" VALUE 0x714F7 RL_VAL_UB 0 CM_0000 0 255 /end CHARACTERISTIC
/begin CHARACTERISTIC K_ED_PT_VEHMOD.FEHLERSCHWELLE "Fault code PT_VEHMOD - debounce filter threshold for setting the fault [verified]" VALUE 0x714F4 RL_VAL_UB 0 CM_0000 0 255 /end CHARACTERISTIC
/begin CHARACTERISTIC K_ED_PT_VEHMOD.INC_NACH_EINTRAG "Fault code PT_VEHMOD - debounce filter increment after fault-memory entry [verified]" VALUE 0x714F8 RL_VAL_UB 0 CM_0000 0 255 /end CHARACTERISTIC
/begin CHARACTERISTIC K_ED_PT_VEHMOD.INC_VOR_EINTRAG "Fault code PT_VEHMOD - debounce filter increment before fault-memory entry [verified]" VALUE 0x714F6 RL_VAL_UB 0 CM_0000 0 255 /end CHARACTERISTIC
/begin CHARACTERISTIC K_ED_PT_VEHMOD.KLASSENINDEX "Fault code PT_VEHMOD - fault class selection (lamp / warning behaviour) [verified]" VALUE 0x714FA RL_VAL_UB 0 CM_0000 0 255 /end CHARACTERISTIC
/begin CHARACTERISTIC K_ED_PT_VEHMOD.OK_SCHWELLE "Fault code PT_VEHMOD - debounce filter threshold for clearing (healing) the fault [verified]" VALUE 0x714F5 RL_VAL_UB 0 CM_0000 0 255 /end CHARACTERISTIC
/begin CHARACTERISTIC K_ED_PT_VEHMOD.P_CODE_OPENLOAD "Fault code PT_VEHMOD - OBD P-code reported for open circuit [verified]" VALUE 0x714F0 RL_VAL_UW 0 CM_0000 0 65535 /end CHARACTERISTIC
/begin CHARACTERISTIC K_ED_PT_VEHMOD.P_CODE_SH_TO_GND "Fault code PT_VEHMOD - OBD P-code reported for short to ground [verified]" VALUE 0x714EE RL_VAL_UW 0 CM_0000 0 65535 /end CHARACTERISTIC
/begin CHARACTERISTIC K_ED_PT_VEHMOD.P_CODE_SH_TO_UB "Fault code PT_VEHMOD - OBD P-code reported for short to battery voltage [verified]" VALUE 0x714EC RL_VAL_UW 0 CM_0000 0 65535 /end CHARACTERISTIC
/begin CHARACTERISTIC K_ED_PT_VEHMOD.P_CODE_UNPLAUSIBEL "Fault code PT_VEHMOD - OBD P-code reported for implausible signal [verified]" VALUE 0x714F2 RL_VAL_UW 0 CM_0000 0 65535 /end CHARACTERISTIC
/begin CHARACTERISTIC K_ED_PT_VFZG.DEC_NACH_EINTRAG "Fault code PT_VFZG - debounce filter decrement after fault-memory entry [verified]" VALUE 0x70E45 RL_VAL_UB 0 CM_0000 0 255 /end CHARACTERISTIC
/begin CHARACTERISTIC K_ED_PT_VFZG.DEC_VOR_EINTRAG "Fault code PT_VFZG - debounce filter decrement before fault-memory entry [verified]" VALUE 0x70E43 RL_VAL_UB 0 CM_0000 0 255 /end CHARACTERISTIC
/begin CHARACTERISTIC K_ED_PT_VFZG.FEHLERSCHWELLE "Fault code PT_VFZG - debounce filter threshold for setting the fault [verified]" VALUE 0x70E40 RL_VAL_UB 0 CM_0000 0 255 /end CHARACTERISTIC
/begin CHARACTERISTIC K_ED_PT_VFZG.INC_NACH_EINTRAG "Fault code PT_VFZG - debounce filter increment after fault-memory entry [verified]" VALUE 0x70E44 RL_VAL_UB 0 CM_0000 0 255 /end CHARACTERISTIC
/begin CHARACTERISTIC K_ED_PT_VFZG.INC_VOR_EINTRAG "Fault code PT_VFZG - debounce filter increment before fault-memory entry [verified]" VALUE 0x70E42 RL_VAL_UB 0 CM_0000 0 255 /end CHARACTERISTIC
/begin CHARACTERISTIC K_ED_PT_VFZG.KLASSENINDEX "Fault code PT_VFZG - fault class selection (lamp / warning behaviour) [verified]" VALUE 0x70E46 RL_VAL_UB 0 CM_0000 0 255 /end CHARACTERISTIC
/begin CHARACTERISTIC K_ED_PT_VFZG.OK_SCHWELLE "Fault code PT_VFZG - debounce filter threshold for clearing (healing) the fault [verified]" VALUE 0x70E41 RL_VAL_UB 0 CM_0000 0 255 /end CHARACTERISTIC
/begin CHARACTERISTIC K_ED_PT_VFZG.P_CODE_OPENLOAD "Fault code PT_VFZG - OBD P-code reported for open circuit [verified]" VALUE 0x70E3C RL_VAL_UW 0 CM_0000 0 65535 /end CHARACTERISTIC
/begin CHARACTERISTIC K_ED_PT_VFZG.P_CODE_SH_TO_GND "Fault code PT_VFZG - OBD P-code reported for short to ground [verified]" VALUE 0x70E3A RL_VAL_UW 0 CM_0000 0 65535 /end CHARACTERISTIC
/begin CHARACTERISTIC K_ED_PT_VFZG.P_CODE_SH_TO_UB "Fault code PT_VFZG - OBD P-code reported for short to battery voltage [verified]" VALUE 0x70E38 RL_VAL_UW 0 CM_0000 0 65535 /end CHARACTERISTIC
/begin CHARACTERISTIC K_ED_PT_VFZG.P_CODE_UNPLAUSIBEL "Fault code PT_VFZG - OBD P-code reported for implausible signal [verified]" VALUE 0x70E3E RL_VAL_UW 0 CM_0000 0 65535 /end CHARACTERISTIC
/begin CHARACTERISTIC K_ED_PT_VRAD.DEC_NACH_EINTRAG "Fault code PT_VRAD - debounce filter decrement after fault-memory entry [verified]" VALUE 0x70E2B RL_VAL_UB 0 CM_0000 0 255 /end CHARACTERISTIC
/begin CHARACTERISTIC K_ED_PT_VRAD.DEC_VOR_EINTRAG "Fault code PT_VRAD - debounce filter decrement before fault-memory entry [verified]" VALUE 0x70E29 RL_VAL_UB 0 CM_0000 0 255 /end CHARACTERISTIC
/begin CHARACTERISTIC K_ED_PT_VRAD.FEHLERSCHWELLE "Fault code PT_VRAD - debounce filter threshold for setting the fault [verified]" VALUE 0x70E26 RL_VAL_UB 0 CM_0000 0 255 /end CHARACTERISTIC
/begin CHARACTERISTIC K_ED_PT_VRAD.INC_NACH_EINTRAG "Fault code PT_VRAD - debounce filter increment after fault-memory entry [verified]" VALUE 0x70E2A RL_VAL_UB 0 CM_0000 0 255 /end CHARACTERISTIC
/begin CHARACTERISTIC K_ED_PT_VRAD.INC_VOR_EINTRAG "Fault code PT_VRAD - debounce filter increment before fault-memory entry [verified]" VALUE 0x70E28 RL_VAL_UB 0 CM_0000 0 255 /end CHARACTERISTIC
/begin CHARACTERISTIC K_ED_PT_VRAD.KLASSENINDEX "Fault code PT_VRAD - fault class selection (lamp / warning behaviour) [verified]" VALUE 0x70E2C RL_VAL_UB 0 CM_0000 0 255 /end CHARACTERISTIC
/begin CHARACTERISTIC K_ED_PT_VRAD.OK_SCHWELLE "Fault code PT_VRAD - debounce filter threshold for clearing (healing) the fault [verified]" VALUE 0x70E27 RL_VAL_UB 0 CM_0000 0 255 /end CHARACTERISTIC
/begin CHARACTERISTIC K_ED_PT_VRAD.P_CODE_OPENLOAD "Fault code PT_VRAD - OBD P-code reported for open circuit [verified]" VALUE 0x70E22 RL_VAL_UW 0 CM_0000 0 65535 /end CHARACTERISTIC
/begin CHARACTERISTIC K_ED_PT_VRAD.P_CODE_SH_TO_GND "Fault code PT_VRAD - OBD P-code reported for short to ground [verified]" VALUE 0x70E20 RL_VAL_UW 0 CM_0000 0 65535 /end CHARACTERISTIC
/begin CHARACTERISTIC K_ED_PT_VRAD.P_CODE_SH_TO_UB "Fault code PT_VRAD - OBD P-code reported for short to battery voltage [verified]" VALUE 0x70E1E RL_VAL_UW 0 CM_0000 0 65535 /end CHARACTERISTIC
/begin CHARACTERISTIC K_ED_PT_VRAD.P_CODE_UNPLAUSIBEL "Fault code PT_VRAD - OBD P-code reported for implausible signal [verified]" VALUE 0x70E24 RL_VAL_UW 0 CM_0000 0 65535 /end CHARACTERISTIC
/begin CHARACTERISTIC K_ED_PUMG.DEC_NACH_EINTRAG "Fault code PUMG - debounce filter decrement after fault-memory entry [verified]" VALUE 0x70AEB RL_VAL_UB 0 CM_0000 0 255 /end CHARACTERISTIC
/begin CHARACTERISTIC K_ED_PUMG.DEC_VOR_EINTRAG "Fault code PUMG - debounce filter decrement before fault-memory entry [verified]" VALUE 0x70AE9 RL_VAL_UB 0 CM_0000 0 255 /end CHARACTERISTIC
/begin CHARACTERISTIC K_ED_PUMG.FEHLERSCHWELLE "Fault code PUMG - debounce filter threshold for setting the fault [verified]" VALUE 0x70AE6 RL_VAL_UB 0 CM_0000 0 255 /end CHARACTERISTIC
/begin CHARACTERISTIC K_ED_PUMG.INC_NACH_EINTRAG "Fault code PUMG - debounce filter increment after fault-memory entry [verified]" VALUE 0x70AEA RL_VAL_UB 0 CM_0000 0 255 /end CHARACTERISTIC
/begin CHARACTERISTIC K_ED_PUMG.INC_VOR_EINTRAG "Fault code PUMG - debounce filter increment before fault-memory entry [verified]" VALUE 0x70AE8 RL_VAL_UB 0 CM_0000 0 255 /end CHARACTERISTIC
/begin CHARACTERISTIC K_ED_PUMG.KLASSENINDEX "Fault code PUMG - fault class selection (lamp / warning behaviour) [verified]" VALUE 0x70AEC RL_VAL_UB 0 CM_0000 0 255 /end CHARACTERISTIC
/begin CHARACTERISTIC K_ED_PUMG.OK_SCHWELLE "Fault code PUMG - debounce filter threshold for clearing (healing) the fault [verified]" VALUE 0x70AE7 RL_VAL_UB 0 CM_0000 0 255 /end CHARACTERISTIC
/begin CHARACTERISTIC K_ED_PUMG.P_CODE_OPENLOAD "Fault code PUMG - OBD P-code reported for open circuit [verified]" VALUE 0x70AE2 RL_VAL_UW 0 CM_0000 0 65535 /end CHARACTERISTIC
/begin CHARACTERISTIC K_ED_PUMG.P_CODE_SH_TO_GND "Fault code PUMG - OBD P-code reported for short to ground [verified]" VALUE 0x70AE0 RL_VAL_UW 0 CM_0000 0 65535 /end CHARACTERISTIC
/begin CHARACTERISTIC K_ED_PUMG.P_CODE_SH_TO_UB "Fault code PUMG - OBD P-code reported for short to battery voltage [verified]" VALUE 0x70ADE RL_VAL_UW 0 CM_0000 0 65535 /end CHARACTERISTIC
/begin CHARACTERISTIC K_ED_PUMG.P_CODE_UNPLAUSIBEL "Fault code PUMG - OBD P-code reported for implausible signal [verified]" VALUE 0x70AE4 RL_VAL_UW 0 CM_0000 0 65535 /end CHARACTERISTIC
/begin CHARACTERISTIC K_ED_PUMG_OBD.DEC_NACH_EINTRAG "Fault code PUMG_OBD - debounce filter decrement after fault-memory entry [verified]" VALUE 0x71D19 RL_VAL_UB 0 CM_0000 0 255 /end CHARACTERISTIC
/begin CHARACTERISTIC K_ED_PUMG_OBD.DEC_VOR_EINTRAG "Fault code PUMG_OBD - debounce filter decrement before fault-memory entry [verified]" VALUE 0x71D17 RL_VAL_UB 0 CM_0000 0 255 /end CHARACTERISTIC
/begin CHARACTERISTIC K_ED_PUMG_OBD.FEHLERSCHWELLE "Fault code PUMG_OBD - debounce filter threshold for setting the fault [verified]" VALUE 0x71D14 RL_VAL_UB 0 CM_0000 0 255 /end CHARACTERISTIC
/begin CHARACTERISTIC K_ED_PUMG_OBD.INC_NACH_EINTRAG "Fault code PUMG_OBD - debounce filter increment after fault-memory entry [verified]" VALUE 0x71D18 RL_VAL_UB 0 CM_0000 0 255 /end CHARACTERISTIC
/begin CHARACTERISTIC K_ED_PUMG_OBD.INC_VOR_EINTRAG "Fault code PUMG_OBD - debounce filter increment before fault-memory entry [verified]" VALUE 0x71D16 RL_VAL_UB 0 CM_0000 0 255 /end CHARACTERISTIC
/begin CHARACTERISTIC K_ED_PUMG_OBD.KLASSENINDEX "Fault code PUMG_OBD - fault class selection (lamp / warning behaviour) [verified]" VALUE 0x71D1A RL_VAL_UB 0 CM_0000 0 255 /end CHARACTERISTIC
/begin CHARACTERISTIC K_ED_PUMG_OBD.OK_SCHWELLE "Fault code PUMG_OBD - debounce filter threshold for clearing (healing) the fault [verified]" VALUE 0x71D15 RL_VAL_UB 0 CM_0000 0 255 /end CHARACTERISTIC
/begin CHARACTERISTIC K_ED_PUMG_OBD.P_CODE_OPENLOAD "Fault code PUMG_OBD - OBD P-code reported for open circuit [verified]" VALUE 0x71D10 RL_VAL_UW 0 CM_0000 0 65535 /end CHARACTERISTIC
/begin CHARACTERISTIC K_ED_PUMG_OBD.P_CODE_SH_TO_GND "Fault code PUMG_OBD - OBD P-code reported for short to ground [verified]" VALUE 0x71D0E RL_VAL_UW 0 CM_0000 0 65535 /end CHARACTERISTIC
/begin CHARACTERISTIC K_ED_PUMG_OBD.P_CODE_SH_TO_UB "Fault code PUMG_OBD - OBD P-code reported for short to battery voltage [verified]" VALUE 0x71D0C RL_VAL_UW 0 CM_0000 0 65535 /end CHARACTERISTIC
/begin CHARACTERISTIC K_ED_PUMG_OBD.P_CODE_UNPLAUSIBEL "Fault code PUMG_OBD - OBD P-code reported for implausible signal [verified]" VALUE 0x71D12 RL_VAL_UW 0 CM_0000 0 65535 /end CHARACTERISTIC
/begin CHARACTERISTIC K_ED_RBM_PUMG_MIN__INJ_ "Minimum air pressure for rate-based OBD monitoring [verified]" VALUE 0x7219A RL_VAL_SW 0 CM_0022 -2048 2047.9375 /end CHARACTERISTIC
/begin CHARACTERISTIC K_ED_RBM_TIME__INJ_ "Total time for drive cycle (rate-based monitoring) [verified]" VALUE 0x7219E RL_VAL_UW 0 CM_0023 0 6553.5 /end CHARACTERISTIC
/begin CHARACTERISTIC K_ED_RBM_TIME_LL__INJ_ "Minimum idle time in drive cycle (rate-based monitoring) [verified]" VALUE 0x721A2 RL_VAL_UW 0 CM_0023 0 6553.5 /end CHARACTERISTIC
/begin CHARACTERISTIC K_ED_RBM_TIME_V__INJ_ "Time at speed in drive cycle (rate-based monitoring) [verified]" VALUE 0x721A0 RL_VAL_UW 0 CM_0023 0 6553.5 /end CHARACTERISTIC
/begin CHARACTERISTIC K_ED_RBM_TUMG_MIN__INJ_ "Minimum ambient temperature (rate-based monitoring) [verified]" VALUE 0x7219C RL_VAL_SW 0 CM_0006 -3550 3003.5 /end CHARACTERISTIC
/begin CHARACTERISTIC K_ED_RBM_V_MIN__INJ_ "Minimum vehicle speed in drive cycle (rate-based monitoring) [verified]" VALUE 0x721A4 RL_VAL_SW 0 CM_0010 -2048 2047.9375 /end CHARACTERISTIC
/begin CHARACTERISTIC K_ED_RLSLP.DEC_NACH_EINTRAG "Fault code RLSLP - debounce filter decrement after fault-memory entry [verified]" VALUE 0x71665 RL_VAL_UB 0 CM_0000 0 255 /end CHARACTERISTIC
/begin CHARACTERISTIC K_ED_RLSLP.DEC_VOR_EINTRAG "Fault code RLSLP - debounce filter decrement before fault-memory entry [verified]" VALUE 0x71663 RL_VAL_UB 0 CM_0000 0 255 /end CHARACTERISTIC
/begin CHARACTERISTIC K_ED_RLSLP.FEHLERSCHWELLE "Fault code RLSLP - debounce filter threshold for setting the fault [verified]" VALUE 0x71660 RL_VAL_UB 0 CM_0000 0 255 /end CHARACTERISTIC
/begin CHARACTERISTIC K_ED_RLSLP.INC_NACH_EINTRAG "Fault code RLSLP - debounce filter increment after fault-memory entry [verified]" VALUE 0x71664 RL_VAL_UB 0 CM_0000 0 255 /end CHARACTERISTIC
/begin CHARACTERISTIC K_ED_RLSLP.INC_VOR_EINTRAG "Fault code RLSLP - debounce filter increment before fault-memory entry [verified]" VALUE 0x71662 RL_VAL_UB 0 CM_0000 0 255 /end CHARACTERISTIC
/begin CHARACTERISTIC K_ED_RLSLP.KLASSENINDEX "Fault code RLSLP - fault class selection (lamp / warning behaviour) [verified]" VALUE 0x71666 RL_VAL_UB 0 CM_0000 0 255 /end CHARACTERISTIC
/begin CHARACTERISTIC K_ED_RLSLP.OK_SCHWELLE "Fault code RLSLP - debounce filter threshold for clearing (healing) the fault [verified]" VALUE 0x71661 RL_VAL_UB 0 CM_0000 0 255 /end CHARACTERISTIC
/begin CHARACTERISTIC K_ED_RLSLP.P_CODE_OPENLOAD "Fault code RLSLP - OBD P-code reported for open circuit [verified]" VALUE 0x7165C RL_VAL_UW 0 CM_0000 0 65535 /end CHARACTERISTIC
/begin CHARACTERISTIC K_ED_RLSLP.P_CODE_SH_TO_GND "Fault code RLSLP - OBD P-code reported for short to ground [verified]" VALUE 0x7165A RL_VAL_UW 0 CM_0000 0 65535 /end CHARACTERISTIC
/begin CHARACTERISTIC K_ED_RLSLP.P_CODE_SH_TO_UB "Fault code RLSLP - OBD P-code reported for short to battery voltage [verified]" VALUE 0x71658 RL_VAL_UW 0 CM_0000 0 65535 /end CHARACTERISTIC
/begin CHARACTERISTIC K_ED_RLSLP.P_CODE_UNPLAUSIBEL "Fault code RLSLP - OBD P-code reported for implausible signal [verified]" VALUE 0x7165E RL_VAL_UW 0 CM_0000 0 65535 /end CHARACTERISTIC
/begin CHARACTERISTIC K_ED_RLU87.DEC_NACH_EINTRAG "Fault code RLU87 - debounce filter decrement after fault-memory entry [verified]" VALUE 0x715FD RL_VAL_UB 0 CM_0000 0 255 /end CHARACTERISTIC
/begin CHARACTERISTIC K_ED_RLU87.DEC_VOR_EINTRAG "Fault code RLU87 - debounce filter decrement before fault-memory entry [verified]" VALUE 0x715FB RL_VAL_UB 0 CM_0000 0 255 /end CHARACTERISTIC
/begin CHARACTERISTIC K_ED_RLU87.FEHLERSCHWELLE "Fault code RLU87 - debounce filter threshold for setting the fault [verified]" VALUE 0x715F8 RL_VAL_UB 0 CM_0000 0 255 /end CHARACTERISTIC
/begin CHARACTERISTIC K_ED_RLU87.INC_NACH_EINTRAG "Fault code RLU87 - debounce filter increment after fault-memory entry [verified]" VALUE 0x715FC RL_VAL_UB 0 CM_0000 0 255 /end CHARACTERISTIC
/begin CHARACTERISTIC K_ED_RLU87.INC_VOR_EINTRAG "Fault code RLU87 - debounce filter increment before fault-memory entry [verified]" VALUE 0x715FA RL_VAL_UB 0 CM_0000 0 255 /end CHARACTERISTIC
/begin CHARACTERISTIC K_ED_RLU87.KLASSENINDEX "Fault code RLU87 - fault class selection (lamp / warning behaviour) [verified]" VALUE 0x715FE RL_VAL_UB 0 CM_0000 0 255 /end CHARACTERISTIC
/begin CHARACTERISTIC K_ED_RLU87.OK_SCHWELLE "Fault code RLU87 - debounce filter threshold for clearing (healing) the fault [verified]" VALUE 0x715F9 RL_VAL_UB 0 CM_0000 0 255 /end CHARACTERISTIC
/begin CHARACTERISTIC K_ED_RLU87.P_CODE_OPENLOAD "Fault code RLU87 - OBD P-code reported for open circuit [verified]" VALUE 0x715F4 RL_VAL_UW 0 CM_0000 0 65535 /end CHARACTERISTIC
/begin CHARACTERISTIC K_ED_RLU87.P_CODE_SH_TO_GND "Fault code RLU87 - OBD P-code reported for short to ground [verified]" VALUE 0x715F2 RL_VAL_UW 0 CM_0000 0 65535 /end CHARACTERISTIC
/begin CHARACTERISTIC K_ED_RLU87.P_CODE_SH_TO_UB "Fault code RLU87 - OBD P-code reported for short to battery voltage [verified]" VALUE 0x715F0 RL_VAL_UW 0 CM_0000 0 65535 /end CHARACTERISTIC
/begin CHARACTERISTIC K_ED_RLU87.P_CODE_UNPLAUSIBEL "Fault code RLU87 - OBD P-code reported for implausible signal [verified]" VALUE 0x715F6 RL_VAL_UW 0 CM_0000 0 65535 /end CHARACTERISTIC
/begin CHARACTERISTIC K_ED_SG_INJ.DEC_NACH_EINTRAG "Fault code SG_INJ - debounce filter decrement after fault-memory entry [verified]" VALUE 0x71971 RL_VAL_UB 0 CM_0000 0 255 /end CHARACTERISTIC
/begin CHARACTERISTIC K_ED_SG_INJ.DEC_VOR_EINTRAG "Fault code SG_INJ - debounce filter decrement before fault-memory entry [verified]" VALUE 0x7196F RL_VAL_UB 0 CM_0000 0 255 /end CHARACTERISTIC
/begin CHARACTERISTIC K_ED_SG_INJ.FEHLERSCHWELLE "Fault code SG_INJ - debounce filter threshold for setting the fault [verified]" VALUE 0x7196C RL_VAL_UB 0 CM_0000 0 255 /end CHARACTERISTIC
/begin CHARACTERISTIC K_ED_SG_INJ.INC_NACH_EINTRAG "Fault code SG_INJ - debounce filter increment after fault-memory entry [verified]" VALUE 0x71970 RL_VAL_UB 0 CM_0000 0 255 /end CHARACTERISTIC
/begin CHARACTERISTIC K_ED_SG_INJ.INC_VOR_EINTRAG "Fault code SG_INJ - debounce filter increment before fault-memory entry [verified]" VALUE 0x7196E RL_VAL_UB 0 CM_0000 0 255 /end CHARACTERISTIC
/begin CHARACTERISTIC K_ED_SG_INJ.KLASSENINDEX "Fault code SG_INJ - fault class selection (lamp / warning behaviour) [verified]" VALUE 0x71972 RL_VAL_UB 0 CM_0000 0 255 /end CHARACTERISTIC
/begin CHARACTERISTIC K_ED_SG_INJ.OK_SCHWELLE "Fault code SG_INJ - debounce filter threshold for clearing (healing) the fault [verified]" VALUE 0x7196D RL_VAL_UB 0 CM_0000 0 255 /end CHARACTERISTIC
/begin CHARACTERISTIC K_ED_SG_INJ.P_CODE_OPENLOAD "Fault code SG_INJ - OBD P-code reported for open circuit [verified]" VALUE 0x71968 RL_VAL_UW 0 CM_0000 0 65535 /end CHARACTERISTIC
/begin CHARACTERISTIC K_ED_SG_INJ.P_CODE_SH_TO_GND "Fault code SG_INJ - OBD P-code reported for short to ground [verified]" VALUE 0x71966 RL_VAL_UW 0 CM_0000 0 65535 /end CHARACTERISTIC
/begin CHARACTERISTIC K_ED_SG_INJ.P_CODE_SH_TO_UB "Fault code SG_INJ - OBD P-code reported for short to battery voltage [verified]" VALUE 0x71964 RL_VAL_UW 0 CM_0000 0 65535 /end CHARACTERISTIC
/begin CHARACTERISTIC K_ED_SG_INJ.P_CODE_UNPLAUSIBEL "Fault code SG_INJ - OBD P-code reported for implausible signal [verified]" VALUE 0x7196A RL_VAL_UW 0 CM_0000 0 65535 /end CHARACTERISTIC
/begin CHARACTERISTIC K_ED_SK_MANAGER_INJ.DEC_NACH_EINTRAG "Fault code SK_MANAGER_INJ - debounce filter decrement after fault-memory entry [verified]" VALUE 0x7186D RL_VAL_UB 0 CM_0000 0 255 /end CHARACTERISTIC
/begin CHARACTERISTIC K_ED_SK_MANAGER_INJ.DEC_VOR_EINTRAG "Fault code SK_MANAGER_INJ - debounce filter decrement before fault-memory entry [verified]" VALUE 0x7186B RL_VAL_UB 0 CM_0000 0 255 /end CHARACTERISTIC
/begin CHARACTERISTIC K_ED_SK_MANAGER_INJ.FEHLERSCHWELLE "Fault code SK_MANAGER_INJ - debounce filter threshold for setting the fault [verified]" VALUE 0x71868 RL_VAL_UB 0 CM_0000 0 255 /end CHARACTERISTIC
/begin CHARACTERISTIC K_ED_SK_MANAGER_INJ.INC_NACH_EINTRAG "Fault code SK_MANAGER_INJ - debounce filter increment after fault-memory entry [verified]" VALUE 0x7186C RL_VAL_UB 0 CM_0000 0 255 /end CHARACTERISTIC
/begin CHARACTERISTIC K_ED_SK_MANAGER_INJ.INC_VOR_EINTRAG "Fault code SK_MANAGER_INJ - debounce filter increment before fault-memory entry [verified]" VALUE 0x7186A RL_VAL_UB 0 CM_0000 0 255 /end CHARACTERISTIC
/begin CHARACTERISTIC K_ED_SK_MANAGER_INJ.KLASSENINDEX "Fault code SK_MANAGER_INJ - fault class selection (lamp / warning behaviour) [verified]" VALUE 0x7186E RL_VAL_UB 0 CM_0000 0 255 /end CHARACTERISTIC
/begin CHARACTERISTIC K_ED_SK_MANAGER_INJ.OK_SCHWELLE "Fault code SK_MANAGER_INJ - debounce filter threshold for clearing (healing) the fault [verified]" VALUE 0x71869 RL_VAL_UB 0 CM_0000 0 255 /end CHARACTERISTIC
/begin CHARACTERISTIC K_ED_SK_MANAGER_INJ.P_CODE_OPENLOAD "Fault code SK_MANAGER_INJ - OBD P-code reported for open circuit [verified]" VALUE 0x71864 RL_VAL_UW 0 CM_0000 0 65535 /end CHARACTERISTIC
/begin CHARACTERISTIC K_ED_SK_MANAGER_INJ.P_CODE_SH_TO_GND "Fault code SK_MANAGER_INJ - OBD P-code reported for short to ground [verified]" VALUE 0x71862 RL_VAL_UW 0 CM_0000 0 65535 /end CHARACTERISTIC
/begin CHARACTERISTIC K_ED_SK_MANAGER_INJ.P_CODE_SH_TO_UB "Fault code SK_MANAGER_INJ - OBD P-code reported for short to battery voltage [verified]" VALUE 0x71860 RL_VAL_UW 0 CM_0000 0 65535 /end CHARACTERISTIC
/begin CHARACTERISTIC K_ED_SK_MANAGER_INJ.P_CODE_UNPLAUSIBEL "Fault code SK_MANAGER_INJ - OBD P-code reported for implausible signal [verified]" VALUE 0x71866 RL_VAL_UW 0 CM_0000 0 65535 /end CHARACTERISTIC
/begin CHARACTERISTIC K_ED_SK_TR_INJ.KLASSENINDEX "Fault code SK_TR_INJ - fault class selection (lamp / warning behaviour) [verified]" VALUE 0x70AD2 RL_VAL_UB 0 CM_0000 0 255 /end CHARACTERISTIC
/begin CHARACTERISTIC K_ED_SLP.DEC_NACH_EINTRAG "Fault code SLP - debounce filter decrement after fault-memory entry [verified]" VALUE 0x71AF7 RL_VAL_UB 0 CM_0000 0 255 /end CHARACTERISTIC
/begin CHARACTERISTIC K_ED_SLP.DEC_VOR_EINTRAG "Fault code SLP - debounce filter decrement before fault-memory entry [verified]" VALUE 0x71AF5 RL_VAL_UB 0 CM_0000 0 255 /end CHARACTERISTIC
/begin CHARACTERISTIC K_ED_SLP.FEHLERSCHWELLE "Fault code SLP - debounce filter threshold for setting the fault [verified]" VALUE 0x71AF2 RL_VAL_UB 0 CM_0000 0 255 /end CHARACTERISTIC
/begin CHARACTERISTIC K_ED_SLP.INC_NACH_EINTRAG "Fault code SLP - debounce filter increment after fault-memory entry [verified]" VALUE 0x71AF6 RL_VAL_UB 0 CM_0000 0 255 /end CHARACTERISTIC
/begin CHARACTERISTIC K_ED_SLP.INC_VOR_EINTRAG "Fault code SLP - debounce filter increment before fault-memory entry [verified]" VALUE 0x71AF4 RL_VAL_UB 0 CM_0000 0 255 /end CHARACTERISTIC
/begin CHARACTERISTIC K_ED_SLP.KLASSENINDEX "Fault code SLP - fault class selection (lamp / warning behaviour) [verified]" VALUE 0x71AF8 RL_VAL_UB 0 CM_0000 0 255 /end CHARACTERISTIC
/begin CHARACTERISTIC K_ED_SLP.OK_SCHWELLE "Fault code SLP - debounce filter threshold for clearing (healing) the fault [verified]" VALUE 0x71AF3 RL_VAL_UB 0 CM_0000 0 255 /end CHARACTERISTIC
/begin CHARACTERISTIC K_ED_SLP.P_CODE_OPENLOAD "Fault code SLP - OBD P-code reported for open circuit [verified]" VALUE 0x71AEE RL_VAL_UW 0 CM_0000 0 65535 /end CHARACTERISTIC
/begin CHARACTERISTIC K_ED_SLP.P_CODE_SH_TO_GND "Fault code SLP - OBD P-code reported for short to ground [verified]" VALUE 0x71AEC RL_VAL_UW 0 CM_0000 0 65535 /end CHARACTERISTIC
/begin CHARACTERISTIC K_ED_SLP.P_CODE_SH_TO_UB "Fault code SLP - OBD P-code reported for short to battery voltage [verified]" VALUE 0x71AEA RL_VAL_UW 0 CM_0000 0 65535 /end CHARACTERISTIC
/begin CHARACTERISTIC K_ED_SLP.P_CODE_UNPLAUSIBEL "Fault code SLP - OBD P-code reported for implausible signal [verified]" VALUE 0x71AF0 RL_VAL_UW 0 CM_0000 0 65535 /end CHARACTERISTIC
/begin CHARACTERISTIC K_ED_SLV.DEC_NACH_EINTRAG "Fault code SLV - debounce filter decrement after fault-memory entry [verified]" VALUE 0x7167F RL_VAL_UB 0 CM_0000 0 255 /end CHARACTERISTIC
/begin CHARACTERISTIC K_ED_SLV.DEC_VOR_EINTRAG "Fault code SLV - debounce filter decrement before fault-memory entry [verified]" VALUE 0x7167D RL_VAL_UB 0 CM_0000 0 255 /end CHARACTERISTIC
/begin CHARACTERISTIC K_ED_SLV.FEHLERSCHWELLE "Fault code SLV - debounce filter threshold for setting the fault [verified]" VALUE 0x7167A RL_VAL_UB 0 CM_0000 0 255 /end CHARACTERISTIC
/begin CHARACTERISTIC K_ED_SLV.INC_NACH_EINTRAG "Fault code SLV - debounce filter increment after fault-memory entry [verified]" VALUE 0x7167E RL_VAL_UB 0 CM_0000 0 255 /end CHARACTERISTIC
/begin CHARACTERISTIC K_ED_SLV.INC_VOR_EINTRAG "Fault code SLV - debounce filter increment before fault-memory entry [verified]" VALUE 0x7167C RL_VAL_UB 0 CM_0000 0 255 /end CHARACTERISTIC
/begin CHARACTERISTIC K_ED_SLV.KLASSENINDEX "Fault code SLV - fault class selection (lamp / warning behaviour) [verified]" VALUE 0x71680 RL_VAL_UB 0 CM_0000 0 255 /end CHARACTERISTIC
/begin CHARACTERISTIC K_ED_SLV.OK_SCHWELLE "Fault code SLV - debounce filter threshold for clearing (healing) the fault [verified]" VALUE 0x7167B RL_VAL_UB 0 CM_0000 0 255 /end CHARACTERISTIC
/begin CHARACTERISTIC K_ED_SLV.P_CODE_OPENLOAD "Fault code SLV - OBD P-code reported for open circuit [verified]" VALUE 0x71676 RL_VAL_UW 0 CM_0000 0 65535 /end CHARACTERISTIC
/begin CHARACTERISTIC K_ED_SLV.P_CODE_SH_TO_GND "Fault code SLV - OBD P-code reported for short to ground [verified]" VALUE 0x71674 RL_VAL_UW 0 CM_0000 0 65535 /end CHARACTERISTIC
/begin CHARACTERISTIC K_ED_SLV.P_CODE_SH_TO_UB "Fault code SLV - OBD P-code reported for short to battery voltage [verified]" VALUE 0x71672 RL_VAL_UW 0 CM_0000 0 65535 /end CHARACTERISTIC
/begin CHARACTERISTIC K_ED_SLV.P_CODE_UNPLAUSIBEL "Fault code SLV - OBD P-code reported for implausible signal [verified]" VALUE 0x71678 RL_VAL_UW 0 CM_0000 0 65535 /end CHARACTERISTIC
/begin CHARACTERISTIC K_ED_SL_DURCHS_B1.DEC_NACH_EINTRAG "Fault code SL_DURCHS_B1 - debounce filter decrement after fault-memory entry [verified]" VALUE 0x71B11 RL_VAL_UB 0 CM_0000 0 255 /end CHARACTERISTIC
/begin CHARACTERISTIC K_ED_SL_DURCHS_B1.DEC_VOR_EINTRAG "Fault code SL_DURCHS_B1 - debounce filter decrement before fault-memory entry [verified]" VALUE 0x71B0F RL_VAL_UB 0 CM_0000 0 255 /end CHARACTERISTIC
/begin CHARACTERISTIC K_ED_SL_DURCHS_B1.FEHLERSCHWELLE "Fault code SL_DURCHS_B1 - debounce filter threshold for setting the fault [verified]" VALUE 0x71B0C RL_VAL_UB 0 CM_0000 0 255 /end CHARACTERISTIC
/begin CHARACTERISTIC K_ED_SL_DURCHS_B1.INC_NACH_EINTRAG "Fault code SL_DURCHS_B1 - debounce filter increment after fault-memory entry [verified]" VALUE 0x71B10 RL_VAL_UB 0 CM_0000 0 255 /end CHARACTERISTIC
/begin CHARACTERISTIC K_ED_SL_DURCHS_B1.INC_VOR_EINTRAG "Fault code SL_DURCHS_B1 - debounce filter increment before fault-memory entry [verified]" VALUE 0x71B0E RL_VAL_UB 0 CM_0000 0 255 /end CHARACTERISTIC
/begin CHARACTERISTIC K_ED_SL_DURCHS_B1.KLASSENINDEX "Fault code SL_DURCHS_B1 - fault class selection (lamp / warning behaviour) [verified]" VALUE 0x71B12 RL_VAL_UB 0 CM_0000 0 255 /end CHARACTERISTIC
/begin CHARACTERISTIC K_ED_SL_DURCHS_B1.OK_SCHWELLE "Fault code SL_DURCHS_B1 - debounce filter threshold for clearing (healing) the fault [verified]" VALUE 0x71B0D RL_VAL_UB 0 CM_0000 0 255 /end CHARACTERISTIC
/begin CHARACTERISTIC K_ED_SL_DURCHS_B1.P_CODE_OPENLOAD "Fault code SL_DURCHS_B1 - OBD P-code reported for open circuit [verified]" VALUE 0x71B08 RL_VAL_UW 0 CM_0000 0 65535 /end CHARACTERISTIC
/begin CHARACTERISTIC K_ED_SL_DURCHS_B1.P_CODE_SH_TO_GND "Fault code SL_DURCHS_B1 - OBD P-code reported for short to ground [verified]" VALUE 0x71B06 RL_VAL_UW 0 CM_0000 0 65535 /end CHARACTERISTIC
/begin CHARACTERISTIC K_ED_SL_DURCHS_B1.P_CODE_SH_TO_UB "Fault code SL_DURCHS_B1 - OBD P-code reported for short to battery voltage [verified]" VALUE 0x71B04 RL_VAL_UW 0 CM_0000 0 65535 /end CHARACTERISTIC
/begin CHARACTERISTIC K_ED_SL_DURCHS_B1.P_CODE_UNPLAUSIBEL "Fault code SL_DURCHS_B1 - OBD P-code reported for implausible signal [verified]" VALUE 0x71B0A RL_VAL_UW 0 CM_0000 0 65535 /end CHARACTERISTIC
/begin CHARACTERISTIC K_ED_SL_DURCHS_B2.DEC_NACH_EINTRAG "Fault code SL_DURCHS_B2 - debounce filter decrement after fault-memory entry [verified]" VALUE 0x71B2B RL_VAL_UB 0 CM_0000 0 255 /end CHARACTERISTIC
/begin CHARACTERISTIC K_ED_SL_DURCHS_B2.DEC_VOR_EINTRAG "Fault code SL_DURCHS_B2 - debounce filter decrement before fault-memory entry [verified]" VALUE 0x71B29 RL_VAL_UB 0 CM_0000 0 255 /end CHARACTERISTIC
/begin CHARACTERISTIC K_ED_SL_DURCHS_B2.FEHLERSCHWELLE "Fault code SL_DURCHS_B2 - debounce filter threshold for setting the fault [verified]" VALUE 0x71B26 RL_VAL_UB 0 CM_0000 0 255 /end CHARACTERISTIC
/begin CHARACTERISTIC K_ED_SL_DURCHS_B2.INC_NACH_EINTRAG "Fault code SL_DURCHS_B2 - debounce filter increment after fault-memory entry [verified]" VALUE 0x71B2A RL_VAL_UB 0 CM_0000 0 255 /end CHARACTERISTIC
/begin CHARACTERISTIC K_ED_SL_DURCHS_B2.INC_VOR_EINTRAG "Fault code SL_DURCHS_B2 - debounce filter increment before fault-memory entry [verified]" VALUE 0x71B28 RL_VAL_UB 0 CM_0000 0 255 /end CHARACTERISTIC
/begin CHARACTERISTIC K_ED_SL_DURCHS_B2.KLASSENINDEX "Fault code SL_DURCHS_B2 - fault class selection (lamp / warning behaviour) [verified]" VALUE 0x71B2C RL_VAL_UB 0 CM_0000 0 255 /end CHARACTERISTIC
/begin CHARACTERISTIC K_ED_SL_DURCHS_B2.OK_SCHWELLE "Fault code SL_DURCHS_B2 - debounce filter threshold for clearing (healing) the fault [verified]" VALUE 0x71B27 RL_VAL_UB 0 CM_0000 0 255 /end CHARACTERISTIC
/begin CHARACTERISTIC K_ED_SL_DURCHS_B2.P_CODE_OPENLOAD "Fault code SL_DURCHS_B2 - OBD P-code reported for open circuit [verified]" VALUE 0x71B22 RL_VAL_UW 0 CM_0000 0 65535 /end CHARACTERISTIC
/begin CHARACTERISTIC K_ED_SL_DURCHS_B2.P_CODE_SH_TO_GND "Fault code SL_DURCHS_B2 - OBD P-code reported for short to ground [verified]" VALUE 0x71B20 RL_VAL_UW 0 CM_0000 0 65535 /end CHARACTERISTIC
/begin CHARACTERISTIC K_ED_SL_DURCHS_B2.P_CODE_SH_TO_UB "Fault code SL_DURCHS_B2 - OBD P-code reported for short to battery voltage [verified]" VALUE 0x71B1E RL_VAL_UW 0 CM_0000 0 65535 /end CHARACTERISTIC
/begin CHARACTERISTIC K_ED_SL_DURCHS_B2.P_CODE_UNPLAUSIBEL "Fault code SL_DURCHS_B2 - OBD P-code reported for implausible signal [verified]" VALUE 0x71B24 RL_VAL_UW 0 CM_0000 0 65535 /end CHARACTERISTIC
/begin CHARACTERISTIC K_ED_SL_DURCHS_HSTRANG.DEC_NACH_EINTRAG "Fault code SL_DURCHS_HSTRANG - debounce filter decrement after fault-memory entry [verified]" VALUE 0x71B45 RL_VAL_UB 0 CM_0000 0 255 /end CHARACTERISTIC
/begin CHARACTERISTIC K_ED_SL_DURCHS_HSTRANG.DEC_VOR_EINTRAG "Fault code SL_DURCHS_HSTRANG - debounce filter decrement before fault-memory entry [verified]" VALUE 0x71B43 RL_VAL_UB 0 CM_0000 0 255 /end CHARACTERISTIC
/begin CHARACTERISTIC K_ED_SL_DURCHS_HSTRANG.FEHLERSCHWELLE "Fault code SL_DURCHS_HSTRANG - debounce filter threshold for setting the fault [verified]" VALUE 0x71B40 RL_VAL_UB 0 CM_0000 0 255 /end CHARACTERISTIC
/begin CHARACTERISTIC K_ED_SL_DURCHS_HSTRANG.INC_NACH_EINTRAG "Fault code SL_DURCHS_HSTRANG - debounce filter increment after fault-memory entry [verified]" VALUE 0x71B44 RL_VAL_UB 0 CM_0000 0 255 /end CHARACTERISTIC
/begin CHARACTERISTIC K_ED_SL_DURCHS_HSTRANG.INC_VOR_EINTRAG "Fault code SL_DURCHS_HSTRANG - debounce filter increment before fault-memory entry [verified]" VALUE 0x71B42 RL_VAL_UB 0 CM_0000 0 255 /end CHARACTERISTIC
/begin CHARACTERISTIC K_ED_SL_DURCHS_HSTRANG.KLASSENINDEX "Fault code SL_DURCHS_HSTRANG - fault class selection (lamp / warning behaviour) [verified]" VALUE 0x71B46 RL_VAL_UB 0 CM_0000 0 255 /end CHARACTERISTIC
/begin CHARACTERISTIC K_ED_SL_DURCHS_HSTRANG.OK_SCHWELLE "Fault code SL_DURCHS_HSTRANG - debounce filter threshold for clearing (healing) the fault [verified]" VALUE 0x71B41 RL_VAL_UB 0 CM_0000 0 255 /end CHARACTERISTIC
/begin COMPU_METHOD CM_0000 "X" RAT_FUNC "%.4g" "-" COEFFS 0 1 0 0 0 1 /end COMPU_METHOD
/begin COMPU_METHOD CM_0006 "X*0.1-273.2" RAT_FUNC "%.4g" "?C" COEFFS 0 1 273.2 0 0 0.1 /end COMPU_METHOD
/begin COMPU_METHOD CM_0010 "X*0.0625" RAT_FUNC "%.4g" "km/h" COEFFS 0 1 0 0 0 0.0625 /end COMPU_METHOD
/begin COMPU_METHOD CM_0022 "X*0.0625" RAT_FUNC "%.4g" "mbar" COEFFS 0 1 0 0 0 0.0625 /end COMPU_METHOD
/begin COMPU_METHOD CM_0023 "X*0.1" RAT_FUNC "%.4g" "s" COEFFS 0 1 0 0 0 0.1 /end COMPU_METHOD
/begin RECORD_LAYOUT RL_VAL_SW FNC_VALUES 1 SWORD COLUMN_DIR DIRECT /end RECORD_LAYOUT
/begin RECORD_LAYOUT RL_VAL_UB FNC_VALUES 1 UBYTE COLUMN_DIR DIRECT /end RECORD_LAYOUT
/begin RECORD_LAYOUT RL_VAL_UW FNC_VALUES 1 UWORD COLUMN_DIR DIRECT /end RECORD_LAYOUT
/begin GROUP G_y_Fault_paths__K_ED_ "y Fault paths (K_ED)" ROOT
 /begin REF_CHARACTERISTIC K_ED_LAVK1_UN_OPENLOAD.OK_SCHWELLE K_ED_LAVK1_UN_OPENLOAD.P_CODE_OPENLOAD K_ED_LAVK1_UN_OPENLOAD.P_CODE_SH_TO_GND K_ED_LAVK1_UN_OPENLOAD.P_CODE_SH_TO_UB K_ED_LAVK1_UN_OPENLOAD.P_CODE_UNPLAUSIBEL K_ED_LAVK2.DEC_NACH_EINTRAG K_ED_LAVK2.DEC_VOR_EINTRAG K_ED_LAVK2.FEHLERSCHWELLE K_ED_LAVK2.INC_NACH_EINTRAG K_ED_LAVK2.INC_VOR_EINTRAG K_ED_LAVK2.KLASSENINDEX K_ED_LAVK2.OK_SCHWELLE K_ED_LAVK2.P_CODE_OPENLOAD K_ED_LAVK2.P_CODE_SH_TO_GND K_ED_LAVK2.P_CODE_SH_TO_UB K_ED_LAVK2.P_CODE_UNPLAUSIBEL K_ED_LAVK2_DIAG.DEC_NACH_EINTRAG K_ED_LAVK2_DIAG.DEC_VOR_EINTRAG K_ED_LAVK2_DIAG.FEHLERSCHWELLE K_ED_LAVK2_DIAG.INC_NACH_EINTRAG K_ED_LAVK2_DIAG.INC_VOR_EINTRAG K_ED_LAVK2_DIAG.KLASSENINDEX K_ED_LAVK2_DIAG.OK_SCHWELLE K_ED_LAVK2_DIAG.P_CODE_OPENLOAD K_ED_LAVK2_DIAG.P_CODE_SH_TO_GND K_ED_LAVK2_DIAG.P_CODE_SH_TO_UB K_ED_LAVK2_DIAG.P_CODE_UNPLAUSIBEL K_ED_LAVK2_IA_OPENLOAD.DEC_NACH_EINTRAG K_ED_LAVK2_IA_OPENLOAD.DEC_VOR_EINTRAG K_ED_LAVK2_IA_OPENLOAD.FEHLERSCHWELLE K_ED_LAVK2_IA_OPENLOAD.INC_NACH_EINTRAG K_ED_LAVK2_IA_OPENLOAD.INC_VOR_EINTRAG K_ED_LAVK2_IA_OPENLOAD.KLASSENINDEX K_ED_LAVK2_IA_OPENLOAD.OK_SCHWELLE K_ED_LAVK2_IA_OPENLOAD.P_CODE_OPENLOAD K_ED_LAVK2_IA_OPENLOAD.P_CODE_SH_TO_GND K_ED_LAVK2_IA_OPENLOAD.P_CODE_SH_TO_UB K_ED_LAVK2_IA_OPENLOAD.P_CODE_UNPLAUSIBEL K_ED_LAVK2_IP_OPENLOAD.DEC_NACH_EINTRAG K_ED_LAVK2_IP_OPENLOAD.DEC_VOR_EINTRAG K_ED_LAVK2_IP_OPENLOAD.FEHLERSCHWELLE K_ED_LAVK2_IP_OPENLOAD.INC_NACH_EINTRAG K_ED_LAVK2_IP_OPENLOAD.INC_VOR_EINTRAG K_ED_LAVK2_IP_OPENLOAD.KLASSENINDEX K_ED_LAVK2_IP_OPENLOAD.OK_SCHWELLE K_ED_LAVK2_IP_OPENLOAD.P_CODE_OPENLOAD K_ED_LAVK2_IP_OPENLOAD.P_CODE_SH_TO_GND K_ED_LAVK2_IP_OPENLOAD.P_CODE_SH_TO_UB K_ED_LAVK2_IP_OPENLOAD.P_CODE_UNPLAUSIBEL K_ED_LAVK2_OBD_DYN.DEC_NACH_EINTRAG K_ED_LAVK2_OBD_DYN.DEC_VOR_EINTRAG K_ED_LAVK2_OBD_DYN.FEHLERSCHWELLE K_ED_LAVK2_OBD_DYN.INC_NACH_EINTRAG K_ED_LAVK2_OBD_DYN.INC_VOR_EINTRAG K_ED_LAVK2_OBD_DYN.KLASSENINDEX K_ED_LAVK2_OBD_DYN.OK_SCHWELLE K_ED_LAVK2_OBD_DYN.P_CODE_OPENLOAD K_ED_LAVK2_OBD_DYN.P_CODE_SH_TO_GND K_ED_LAVK2_OBD_DYN.P_CODE_SH_TO_UB K_ED_LAVK2_OBD_DYN.P_CODE_UNPLAUSIBEL K_ED_LAVK2_OBD_PLAU.DEC_NACH_EINTRAG K_ED_LAVK2_OBD_PLAU.DEC_VOR_EINTRAG K_ED_LAVK2_OBD_PLAU.FEHLERSCHWELLE K_ED_LAVK2_OBD_PLAU.INC_NACH_EINTRAG K_ED_LAVK2_OBD_PLAU.INC_VOR_EINTRAG K_ED_LAVK2_OBD_PLAU.KLASSENINDEX K_ED_LAVK2_OBD_PLAU.OK_SCHWELLE K_ED_LAVK2_OBD_PLAU.P_CODE_OPENLOAD K_ED_LAVK2_OBD_PLAU.P_CODE_SH_TO_GND K_ED_LAVK2_OBD_PLAU.P_CODE_SH_TO_UB K_ED_LAVK2_OBD_PLAU.P_CODE_UNPLAUSIBEL K_ED_LAVK2_OBD_SA.DEC_NACH_EINTRAG K_ED_LAVK2_OBD_SA.DEC_VOR_EINTRAG K_ED_LAVK2_OBD_SA.FEHLERSCHWELLE K_ED_LAVK2_OBD_SA.INC_NACH_EINTRAG K_ED_LAVK2_OBD_SA.INC_VOR_EINTRAG K_ED_LAVK2_OBD_SA.KLASSENINDEX K_ED_LAVK2_OBD_SA.OK_SCHWELLE K_ED_LAVK2_OBD_SA.P_CODE_OPENLOAD K_ED_LAVK2_OBD_SA.P_CODE_SH_TO_GND K_ED_LAVK2_OBD_SA.P_CODE_SH_TO_UB K_ED_LAVK2_OBD_SA.P_CODE_UNPLAUSIBEL K_ED_LAVK2_OBD_TL.DEC_NACH_EINTRAG K_ED_LAVK2_OBD_TL.DEC_VOR_EINTRAG K_ED_LAVK2_OBD_TL.FEHLERSCHWELLE K_ED_LAVK2_OBD_TL.INC_NACH_EINTRAG K_ED_LAVK2_OBD_TL.INC_VOR_EINTRAG K_ED_LAVK2_OBD_TL.KLASSENINDEX K_ED_LAVK2_OBD_TL.OK_SCHWELLE K_ED_LAVK2_OBD_TL.P_CODE_OPENLOAD K_ED_LAVK2_OBD_TL.P_CODE_SH_TO_GND K_ED_LAVK2_OBD_TL.P_CODE_SH_TO_UB K_ED_LAVK2_OBD_TL.P_CODE_UNPLAUSIBEL K_ED_LAVK2_TRIM.DEC_NACH_EINTRAG K_ED_LAVK2_TRIM.DEC_VOR_EINTRAG K_ED_LAVK2_TRIM.FEHLERSCHWELLE K_ED_LAVK2_TRIM.INC_NACH_EINTRAG K_ED_LAVK2_TRIM.INC_VOR_EINTRAG K_ED_LAVK2_TRIM.KLASSENINDEX K_ED_LAVK2_TRIM.OK_SCHWELLE K_ED_LAVK2_TRIM.P_CODE_OPENLOAD K_ED_LAVK2_TRIM.P_CODE_SH_TO_GND K_ED_LAVK2_TRIM.P_CODE_SH_TO_UB K_ED_LAVK2_TRIM.P_CODE_UNPLAUSIBEL K_ED_LAVK2_UN_OPENLOAD.DEC_NACH_EINTRAG K_ED_LAVK2_UN_OPENLOAD.DEC_VOR_EINTRAG K_ED_LAVK2_UN_OPENLOAD.FEHLERSCHWELLE K_ED_LAVK2_UN_OPENLOAD.INC_NACH_EINTRAG K_ED_LAVK2_UN_OPENLOAD.INC_VOR_EINTRAG K_ED_LAVK2_UN_OPENLOAD.KLASSENINDEX K_ED_LAVK2_UN_OPENLOAD.OK_SCHWELLE K_ED_LAVK2_UN_OPENLOAD.P_CODE_OPENLOAD K_ED_LAVK2_UN_OPENLOAD.P_CODE_SH_TO_GND K_ED_LAVK2_UN_OPENLOAD.P_CODE_SH_TO_UB K_ED_LAVK2_UN_OPENLOAD.P_CODE_UNPLAUSIBEL K_ED_LAVK_ATIC42.DEC_NACH_EINTRAG K_ED_LAVK_ATIC42.DEC_VOR_EINTRAG K_ED_LAVK_ATIC42.FEHLERSCHWELLE K_ED_LAVK_ATIC42.INC_NACH_EINTRAG K_ED_LAVK_ATIC42.INC_VOR_EINTRAG K_ED_LAVK_ATIC42.KLASSENINDEX K_ED_LAVK_ATIC42.OK_SCHWELLE K_ED_LAVK_ATIC42.P_CODE_OPENLOAD K_ED_LAVK_ATIC42.P_CODE_SH_TO_GND K_ED_LAVK_ATIC42.P_CODE_SH_TO_UB K_ED_LAVK_ATIC42.P_CODE_UNPLAUSIBEL K_ED_LSHNK1.DEC_NACH_EINTRAG K_ED_LSHNK1.DEC_VOR_EINTRAG K_ED_LSHNK1.FEHLERSCHWELLE K_ED_LSHNK1.INC_NACH_EINTRAG K_ED_LSHNK1.INC_VOR_EINTRAG K_ED_LSHNK1.KLASSENINDEX K_ED_LSHNK1.OK_SCHWELLE K_ED_LSHNK1.P_CODE_OPENLOAD K_ED_LSHNK1.P_CODE_SH_TO_GND K_ED_LSHNK1.P_CODE_SH_TO_UB K_ED_LSHNK1.P_CODE_UNPLAUSIBEL K_ED_LSHNK1_R.DEC_NACH_EINTRAG K_ED_LSHNK1_R.DEC_VOR_EINTRAG K_ED_LSHNK1_R.FEHLERSCHWELLE K_ED_LSHNK1_R.INC_NACH_EINTRAG K_ED_LSHNK1_R.INC_VOR_EINTRAG K_ED_LSHNK1_R.KLASSENINDEX K_ED_LSHNK1_R.OK_SCHWELLE K_ED_LSHNK1_R.P_CODE_OPENLOAD K_ED_LSHNK1_R.P_CODE_SH_TO_GND K_ED_LSHNK1_R.P_CODE_SH_TO_UB K_ED_LSHNK1_R.P_CODE_UNPLAUSIBEL K_ED_LSHNK2.DEC_NACH_EINTRAG K_ED_LSHNK2.DEC_VOR_EINTRAG K_ED_LSHNK2.FEHLERSCHWELLE K_ED_LSHNK2.INC_NACH_EINTRAG K_ED_LSHNK2.INC_VOR_EINTRAG K_ED_LSHNK2.KLASSENINDEX K_ED_LSHNK2.OK_SCHWELLE K_ED_LSHNK2.P_CODE_OPENLOAD K_ED_LSHNK2.P_CODE_SH_TO_GND K_ED_LSHNK2.P_CODE_SH_TO_UB K_ED_LSHNK2.P_CODE_UNPLAUSIBEL K_ED_LSHNK2_R.DEC_NACH_EINTRAG K_ED_LSHNK2_R.DEC_VOR_EINTRAG K_ED_LSHNK2_R.FEHLERSCHWELLE K_ED_LSHNK2_R.INC_NACH_EINTRAG K_ED_LSHNK2_R.INC_VOR_EINTRAG K_ED_LSHNK2_R.KLASSENINDEX K_ED_LSHNK2_R.OK_SCHWELLE K_ED_LSHNK2_R.P_CODE_OPENLOAD K_ED_LSHNK2_R.P_CODE_SH_TO_GND K_ED_LSHNK2_R.P_CODE_SH_TO_UB K_ED_LSHNK2_R.P_CODE_UNPLAUSIBEL K_ED_LSHVK1.DEC_NACH_EINTRAG K_ED_LSHVK1.DEC_VOR_EINTRAG K_ED_LSHVK1.FEHLERSCHWELLE K_ED_LSHVK1.INC_NACH_EINTRAG K_ED_LSHVK1.INC_VOR_EINTRAG K_ED_LSHVK1.KLASSENINDEX K_ED_LSHVK1.OK_SCHWELLE K_ED_LSHVK1.P_CODE_OPENLOAD K_ED_LSHVK1.P_CODE_SH_TO_GND K_ED_LSHVK1.P_CODE_SH_TO_UB K_ED_LSHVK1.P_CODE_UNPLAUSIBEL K_ED_LSHVK1_R.DEC_NACH_EINTRAG K_ED_LSHVK1_R.DEC_VOR_EINTRAG K_ED_LSHVK1_R.FEHLERSCHWELLE K_ED_LSHVK1_R.INC_NACH_EINTRAG K_ED_LSHVK1_R.INC_VOR_EINTRAG K_ED_LSHVK1_R.KLASSENINDEX K_ED_LSHVK1_R.OK_SCHWELLE K_ED_LSHVK1_R.P_CODE_OPENLOAD K_ED_LSHVK1_R.P_CODE_SH_TO_GND K_ED_LSHVK1_R.P_CODE_SH_TO_UB K_ED_LSHVK1_R.P_CODE_UNPLAUSIBEL K_ED_LSHVK2.DEC_NACH_EINTRAG K_ED_LSHVK2.DEC_VOR_EINTRAG K_ED_LSHVK2.FEHLERSCHWELLE K_ED_LSHVK2.INC_NACH_EINTRAG K_ED_LSHVK2.INC_VOR_EINTRAG K_ED_LSHVK2.KLASSENINDEX K_ED_LSHVK2.OK_SCHWELLE K_ED_LSHVK2.P_CODE_OPENLOAD K_ED_LSHVK2.P_CODE_SH_TO_GND K_ED_LSHVK2.P_CODE_SH_TO_UB K_ED_LSHVK2.P_CODE_UNPLAUSIBEL K_ED_LSHVK2_R.DEC_NACH_EINTRAG K_ED_LSHVK2_R.DEC_VOR_EINTRAG K_ED_LSHVK2_R.FEHLERSCHWELLE K_ED_LSHVK2_R.INC_NACH_EINTRAG K_ED_LSHVK2_R.INC_VOR_EINTRAG K_ED_LSHVK2_R.KLASSENINDEX K_ED_LSHVK2_R.OK_SCHWELLE K_ED_LSHVK2_R.P_CODE_OPENLOAD K_ED_LSHVK2_R.P_CODE_SH_TO_GND K_ED_LSHVK2_R.P_CODE_SH_TO_UB K_ED_LSHVK2_R.P_CODE_UNPLAUSIBEL K_ED_LSRVK1_OBD_REF.DEC_NACH_EINTRAG K_ED_LSRVK1_OBD_REF.DEC_VOR_EINTRAG K_ED_LSRVK1_OBD_REF.FEHLERSCHWELLE K_ED_LSRVK1_OBD_REF.INC_NACH_EINTRAG K_ED_LSRVK1_OBD_REF.INC_VOR_EINTRAG K_ED_LSRVK1_OBD_REF.KLASSENINDEX K_ED_LSRVK1_OBD_REF.OK_SCHWELLE K_ED_LSRVK1_OBD_REF.P_CODE_OPENLOAD K_ED_LSRVK1_OBD_REF.P_CODE_SH_TO_GND K_ED_LSRVK1_OBD_REF.P_CODE_SH_TO_UB K_ED_LSRVK1_OBD_REF.P_CODE_UNPLAUSIBEL K_ED_LSRVK1_OBD_REG.DEC_NACH_EINTRAG K_ED_LSRVK1_OBD_REG.DEC_VOR_EINTRAG K_ED_LSRVK1_OBD_REG.FEHLERSCHWELLE K_ED_LSRVK1_OBD_REG.INC_NACH_EINTRAG K_ED_LSRVK1_OBD_REG.INC_VOR_EINTRAG K_ED_LSRVK1_OBD_REG.KLASSENINDEX K_ED_LSRVK1_OBD_REG.OK_SCHWELLE K_ED_LSRVK1_OBD_REG.P_CODE_OPENLOAD K_ED_LSRVK1_OBD_REG.P_CODE_SH_TO_GND K_ED_LSRVK1_OBD_REG.P_CODE_SH_TO_UB K_ED_LSRVK1_OBD_REG.P_CODE_UNPLAUSIBEL K_ED_LSRVK1_OBD_START.DEC_NACH_EINTRAG K_ED_LSRVK1_OBD_START.DEC_VOR_EINTRAG K_ED_LSRVK1_OBD_START.FEHLERSCHWELLE K_ED_LSRVK1_OBD_START.INC_NACH_EINTRAG K_ED_LSRVK1_OBD_START.INC_VOR_EINTRAG K_ED_LSRVK1_OBD_START.KLASSENINDEX K_ED_LSRVK1_OBD_START.OK_SCHWELLE K_ED_LSRVK1_OBD_START.P_CODE_OPENLOAD K_ED_LSRVK1_OBD_START.P_CODE_SH_TO_GND K_ED_LSRVK1_OBD_START.P_CODE_SH_TO_UB K_ED_LSRVK1_OBD_START.P_CODE_UNPLAUSIBEL K_ED_LSRVK2_OBD_REF.DEC_NACH_EINTRAG K_ED_LSRVK2_OBD_REF.DEC_VOR_EINTRAG K_ED_LSRVK2_OBD_REF.FEHLERSCHWELLE K_ED_LSRVK2_OBD_REF.INC_NACH_EINTRAG K_ED_LSRVK2_OBD_REF.INC_VOR_EINTRAG K_ED_LSRVK2_OBD_REF.KLASSENINDEX K_ED_LSRVK2_OBD_REF.OK_SCHWELLE K_ED_LSRVK2_OBD_REF.P_CODE_OPENLOAD K_ED_LSRVK2_OBD_REF.P_CODE_SH_TO_GND K_ED_LSRVK2_OBD_REF.P_CODE_SH_TO_UB K_ED_LSRVK2_OBD_REF.P_CODE_UNPLAUSIBEL K_ED_LSRVK2_OBD_REG.DEC_NACH_EINTRAG K_ED_LSRVK2_OBD_REG.DEC_VOR_EINTRAG K_ED_LSRVK2_OBD_REG.FEHLERSCHWELLE K_ED_LSRVK2_OBD_REG.INC_NACH_EINTRAG K_ED_LSRVK2_OBD_REG.INC_VOR_EINTRAG K_ED_LSRVK2_OBD_REG.KLASSENINDEX K_ED_LSRVK2_OBD_REG.OK_SCHWELLE K_ED_LSRVK2_OBD_REG.P_CODE_OPENLOAD K_ED_LSRVK2_OBD_REG.P_CODE_SH_TO_GND K_ED_LSRVK2_OBD_REG.P_CODE_SH_TO_UB K_ED_LSRVK2_OBD_REG.P_CODE_UNPLAUSIBEL K_ED_LSRVK2_OBD_START.DEC_NACH_EINTRAG K_ED_LSRVK2_OBD_START.DEC_VOR_EINTRAG K_ED_LSRVK2_OBD_START.FEHLERSCHWELLE K_ED_LSRVK2_OBD_START.INC_NACH_EINTRAG K_ED_LSRVK2_OBD_START.INC_VOR_EINTRAG K_ED_LSRVK2_OBD_START.KLASSENINDEX K_ED_LSRVK2_OBD_START.OK_SCHWELLE K_ED_LSRVK2_OBD_START.P_CODE_OPENLOAD K_ED_LSRVK2_OBD_START.P_CODE_SH_TO_GND K_ED_LSRVK2_OBD_START.P_CODE_SH_TO_UB K_ED_LSRVK2_OBD_START.P_CODE_UNPLAUSIBEL K_ED_MVAC_DRUCKSENSOR.DEC_NACH_EINTRAG K_ED_MVAC_DRUCKSENSOR.DEC_VOR_EINTRAG K_ED_MVAC_DRUCKSENSOR.FEHLERSCHWELLE K_ED_MVAC_DRUCKSENSOR.INC_NACH_EINTRAG K_ED_MVAC_DRUCKSENSOR.INC_VOR_EINTRAG K_ED_MVAC_DRUCKSENSOR.KLASSENINDEX K_ED_MVAC_DRUCKSENSOR.OK_SCHWELLE K_ED_MVAC_DRUCKSENSOR.P_CODE_OPENLOAD K_ED_MVAC_DRUCKSENSOR.P_CODE_SH_TO_GND K_ED_MVAC_DRUCKSENSOR.P_CODE_SH_TO_UB K_ED_MVAC_DRUCKSENSOR.P_CODE_UNPLAUSIBEL K_ED_NW_SYNC.DEC_NACH_EINTRAG K_ED_NW_SYNC.DEC_VOR_EINTRAG K_ED_NW_SYNC.FEHLERSCHWELLE K_ED_NW_SYNC.INC_NACH_EINTRAG K_ED_NW_SYNC.INC_VOR_EINTRAG K_ED_NW_SYNC.KLASSENINDEX K_ED_NW_SYNC.OK_SCHWELLE K_ED_NW_SYNC.P_CODE_OPENLOAD K_ED_NW_SYNC.P_CODE_SH_TO_GND K_ED_NW_SYNC.P_CODE_SH_TO_UB K_ED_NW_SYNC.P_CODE_UNPLAUSIBEL K_ED_PCTRL_INJ.DEC_NACH_EINTRAG K_ED_PCTRL_INJ.DEC_VOR_EINTRAG K_ED_PCTRL_INJ.FEHLERSCHWELLE K_ED_PCTRL_INJ.INC_NACH_EINTRAG K_ED_PCTRL_INJ.INC_VOR_EINTRAG K_ED_PCTRL_INJ.KLASSENINDEX K_ED_PCTRL_INJ.OK_SCHWELLE K_ED_PCTRL_INJ.P_CODE_OPENLOAD K_ED_PCTRL_INJ.P_CODE_SH_TO_GND K_ED_PCTRL_INJ.P_CODE_SH_TO_UB K_ED_PCTRL_INJ.P_CODE_UNPLAUSIBEL K_ED_PKS.DEC_NACH_EINTRAG K_ED_PKS.DEC_VOR_EINTRAG K_ED_PKS.FEHLERSCHWELLE K_ED_PKS.INC_NACH_EINTRAG K_ED_PKS.INC_VOR_EINTRAG K_ED_PKS.KLASSENINDEX K_ED_PKS.OK_SCHWELLE K_ED_PKS.P_CODE_OPENLOAD K_ED_PKS.P_CODE_SH_TO_GND K_ED_PKS.P_CODE_SH_TO_UB K_ED_PKS.P_CODE_UNPLAUSIBEL K_ED_PKS_ADAPT_ANSCHL.DEC_NACH_EINTRAG K_ED_PKS_ADAPT_ANSCHL.DEC_VOR_EINTRAG K_ED_PKS_ADAPT_ANSCHL.FEHLERSCHWELLE K_ED_PKS_ADAPT_ANSCHL.INC_NACH_EINTRAG K_ED_PKS_ADAPT_ANSCHL.INC_VOR_EINTRAG K_ED_PKS_ADAPT_ANSCHL.KLASSENINDEX K_ED_PKS_ADAPT_ANSCHL.OK_SCHWELLE K_ED_PKS_ADAPT_ANSCHL.P_CODE_OPENLOAD K_ED_PKS_ADAPT_ANSCHL.P_CODE_SH_TO_GND K_ED_PKS_ADAPT_ANSCHL.P_CODE_SH_TO_UB K_ED_PKS_ADAPT_ANSCHL.P_CODE_UNPLAUSIBEL K_ED_PKS_LL.DEC_NACH_EINTRAG K_ED_PKS_LL.DEC_VOR_EINTRAG K_ED_PKS_LL.FEHLERSCHWELLE K_ED_PKS_LL.INC_NACH_EINTRAG K_ED_PKS_LL.INC_VOR_EINTRAG K_ED_PKS_LL.KLASSENINDEX K_ED_PKS_LL.OK_SCHWELLE K_ED_PKS_LL.P_CODE_OPENLOAD K_ED_PKS_LL.P_CODE_SH_TO_GND K_ED_PKS_LL.P_CODE_SH_TO_UB K_ED_PKS_LL.P_CODE_UNPLAUSIBEL K_ED_PKS_MODELL.DEC_NACH_EINTRAG K_ED_PKS_MODELL.DEC_VOR_EINTRAG K_ED_PKS_MODELL.FEHLERSCHWELLE K_ED_PKS_MODELL.INC_NACH_EINTRAG K_ED_PKS_MODELL.INC_VOR_EINTRAG K_ED_PKS_MODELL.KLASSENINDEX K_ED_PKS_MODELL.OK_SCHWELLE K_ED_PKS_MODELL.P_CODE_OPENLOAD K_ED_PKS_MODELL.P_CODE_SH_TO_GND K_ED_PKS_MODELL.P_CODE_SH_TO_UB K_ED_PKS_MODELL.P_CODE_UNPLAUSIBEL K_ED_PKS_PAUFBAU.DEC_NACH_EINTRAG K_ED_PKS_PAUFBAU.DEC_VOR_EINTRAG K_ED_PKS_PAUFBAU.FEHLERSCHWELLE K_ED_PKS_PAUFBAU.INC_NACH_EINTRAG K_ED_PKS_PAUFBAU.INC_VOR_EINTRAG K_ED_PKS_PAUFBAU.KLASSENINDEX K_ED_PKS_PAUFBAU.OK_SCHWELLE K_ED_PKS_PAUFBAU.P_CODE_OPENLOAD K_ED_PKS_PAUFBAU.P_CODE_SH_TO_GND K_ED_PKS_PAUFBAU.P_CODE_SH_TO_UB K_ED_PKS_PAUFBAU.P_CODE_UNPLAUSIBEL K_ED_PKS_Q.DEC_NACH_EINTRAG K_ED_PKS_Q.DEC_VOR_EINTRAG K_ED_PKS_Q.FEHLERSCHWELLE K_ED_PKS_Q.INC_NACH_EINTRAG K_ED_PKS_Q.INC_VOR_EINTRAG K_ED_PKS_Q.KLASSENINDEX K_ED_PKS_Q.OK_SCHWELLE K_ED_PKS_Q.P_CODE_OPENLOAD K_ED_PKS_Q.P_CODE_SH_TO_GND K_ED_PKS_Q.P_CODE_SH_TO_UB K_ED_PKS_Q.P_CODE_UNPLAUSIBEL K_ED_PKS_TL.DEC_NACH_EINTRAG K_ED_PKS_TL.DEC_VOR_EINTRAG K_ED_PKS_TL.FEHLERSCHWELLE K_ED_PKS_TL.INC_NACH_EINTRAG K_ED_PKS_TL.INC_VOR_EINTRAG K_ED_PKS_TL.KLASSENINDEX K_ED_PKS_TL.OK_SCHWELLE K_ED_PKS_TL.P_CODE_OPENLOAD K_ED_PKS_TL.P_CODE_SH_TO_GND K_ED_PKS_TL.P_CODE_SH_TO_UB K_ED_PKS_TL.P_CODE_UNPLAUSIBEL K_ED_PSAU1.DEC_NACH_EINTRAG K_ED_PSAU1.DEC_VOR_EINTRAG K_ED_PSAU1.FEHLERSCHWELLE K_ED_PSAU1.INC_NACH_EINTRAG K_ED_PSAU1.INC_VOR_EINTRAG K_ED_PSAU1.KLASSENINDEX K_ED_PSAU1.OK_SCHWELLE K_ED_PSAU1.P_CODE_OPENLOAD K_ED_PSAU1.P_CODE_SH_TO_GND K_ED_PSAU1.P_CODE_SH_TO_UB K_ED_PSAU1.P_CODE_UNPLAUSIBEL K_ED_PSAU2.DEC_NACH_EINTRAG K_ED_PSAU2.DEC_VOR_EINTRAG K_ED_PSAU2.FEHLERSCHWELLE K_ED_PSAU2.INC_NACH_EINTRAG K_ED_PSAU2.INC_VOR_EINTRAG K_ED_PSAU2.KLASSENINDEX K_ED_PSAU2.OK_SCHWELLE K_ED_PSAU2.P_CODE_OPENLOAD K_ED_PSAU2.P_CODE_SH_TO_GND K_ED_PSAU2.P_CODE_SH_TO_UB K_ED_PSAU2.P_CODE_UNPLAUSIBEL K_ED_PT_ANFRADMOM.DEC_NACH_EINTRAG K_ED_PT_ANFRADMOM.DEC_VOR_EINTRAG K_ED_PT_ANFRADMOM.FEHLERSCHWELLE K_ED_PT_ANFRADMOM.INC_NACH_EINTRAG K_ED_PT_ANFRADMOM.INC_VOR_EINTRAG K_ED_PT_ANFRADMOM.KLASSENINDEX K_ED_PT_ANFRADMOM.OK_SCHWELLE K_ED_PT_ANFRADMOM.P_CODE_OPENLOAD K_ED_PT_ANFRADMOM.P_CODE_SH_TO_GND K_ED_PT_ANFRADMOM.P_CODE_SH_TO_UB K_ED_PT_ANFRADMOM.P_CODE_UNPLAUSIBEL K_ED_PT_ATEMP.DEC_NACH_EINTRAG K_ED_PT_ATEMP.DEC_VOR_EINTRAG K_ED_PT_ATEMP.FEHLERSCHWELLE K_ED_PT_ATEMP.INC_NACH_EINTRAG K_ED_PT_ATEMP.INC_VOR_EINTRAG K_ED_PT_ATEMP.KLASSENINDEX K_ED_PT_ATEMP.OK_SCHWELLE K_ED_PT_ATEMP.P_CODE_OPENLOAD K_ED_PT_ATEMP.P_CODE_SH_TO_GND K_ED_PT_ATEMP.P_CODE_SH_TO_UB K_ED_PT_ATEMP.P_CODE_UNPLAUSIBEL K_ED_PT_AX.DEC_NACH_EINTRAG K_ED_PT_AX.DEC_VOR_EINTRAG K_ED_PT_AX.FEHLERSCHWELLE K_ED_PT_AX.INC_NACH_EINTRAG K_ED_PT_AX.INC_VOR_EINTRAG K_ED_PT_AX.KLASSENINDEX K_ED_PT_AX.OK_SCHWELLE K_ED_PT_AX.P_CODE_OPENLOAD K_ED_PT_AX.P_CODE_SH_TO_GND K_ED_PT_AX.P_CODE_SH_TO_UB K_ED_PT_AX.P_CODE_UNPLAUSIBEL K_ED_PT_BEDAT.DEC_NACH_EINTRAG K_ED_PT_BEDAT.DEC_VOR_EINTRAG K_ED_PT_BEDAT.FEHLERSCHWELLE K_ED_PT_BEDAT.INC_NACH_EINTRAG K_ED_PT_BEDAT.INC_VOR_EINTRAG K_ED_PT_BEDAT.KLASSENINDEX K_ED_PT_BEDAT.OK_SCHWELLE K_ED_PT_BEDAT.P_CODE_OPENLOAD K_ED_PT_BEDAT.P_CODE_SH_TO_GND K_ED_PT_BEDAT.P_CODE_SH_TO_UB K_ED_PT_BEDAT.P_CODE_UNPLAUSIBEL K_ED_PT_BEDFGR.DEC_NACH_EINTRAG K_ED_PT_BEDFGR.DEC_VOR_EINTRAG K_ED_PT_BEDFGR.FEHLERSCHWELLE K_ED_PT_BEDFGR.INC_NACH_EINTRAG K_ED_PT_BEDFGR.INC_VOR_EINTRAG K_ED_PT_BEDFGR.KLASSENINDEX K_ED_PT_BEDFGR.OK_SCHWELLE K_ED_PT_BEDFGR.P_CODE_OPENLOAD K_ED_PT_BEDFGR.P_CODE_SH_TO_GND K_ED_PT_BEDFGR.P_CODE_SH_TO_UB K_ED_PT_BEDFGR.P_CODE_UNPLAUSIBEL K_ED_PT_BUSOFF.DEC_NACH_EINTRAG K_ED_PT_BUSOFF.DEC_VOR_EINTRAG K_ED_PT_BUSOFF.FEHLERSCHWELLE K_ED_PT_BUSOFF.INC_NACH_EINTRAG K_ED_PT_BUSOFF.INC_VOR_EINTRAG K_ED_PT_BUSOFF.KLASSENINDEX K_ED_PT_BUSOFF.OK_SCHWELLE K_ED_PT_BUSOFF.P_CODE_OPENLOAD K_ED_PT_BUSOFF.P_CODE_SH_TO_GND K_ED_PT_BUSOFF.P_CODE_SH_TO_UB K_ED_PT_BUSOFF.P_CODE_UNPLAUSIBEL K_ED_PT_CRASH.DEC_NACH_EINTRAG K_ED_PT_CRASH.DEC_VOR_EINTRAG K_ED_PT_CRASH.FEHLERSCHWELLE K_ED_PT_CRASH.INC_NACH_EINTRAG K_ED_PT_CRASH.INC_VOR_EINTRAG K_ED_PT_CRASH.KLASSENINDEX K_ED_PT_CRASH.OK_SCHWELLE K_ED_PT_CRASH.P_CODE_OPENLOAD K_ED_PT_CRASH.P_CODE_SH_TO_GND K_ED_PT_CRASH.P_CODE_SH_TO_UB K_ED_PT_CRASH.P_CODE_UNPLAUSIBEL K_ED_PT_GRB.DEC_NACH_EINTRAG K_ED_PT_GRB.DEC_VOR_EINTRAG K_ED_PT_GRB.FEHLERSCHWELLE K_ED_PT_GRB.INC_NACH_EINTRAG K_ED_PT_GRB.INC_VOR_EINTRAG K_ED_PT_GRB.KLASSENINDEX K_ED_PT_GRB.OK_SCHWELLE K_ED_PT_GRB.P_CODE_OPENLOAD K_ED_PT_GRB.P_CODE_SH_TO_GND K_ED_PT_GRB.P_CODE_SH_TO_UB K_ED_PT_GRB.P_CODE_UNPLAUSIBEL K_ED_PT_GRB2.DEC_NACH_EINTRAG K_ED_PT_GRB2.DEC_VOR_EINTRAG K_ED_PT_GRB2.FEHLERSCHWELLE K_ED_PT_GRB2.INC_NACH_EINTRAG K_ED_PT_GRB2.INC_VOR_EINTRAG K_ED_PT_GRB2.KLASSENINDEX K_ED_PT_GRB2.OK_SCHWELLE K_ED_PT_GRB2.P_CODE_OPENLOAD K_ED_PT_GRB2.P_CODE_SH_TO_GND K_ED_PT_GRB2.P_CODE_SH_TO_UB K_ED_PT_GRB2.P_CODE_UNPLAUSIBEL K_ED_PT_GRB3.DEC_NACH_EINTRAG K_ED_PT_GRB3.DEC_VOR_EINTRAG K_ED_PT_GRB3.FEHLERSCHWELLE K_ED_PT_GRB3.INC_NACH_EINTRAG K_ED_PT_GRB3.INC_VOR_EINTRAG K_ED_PT_GRB3.KLASSENINDEX K_ED_PT_GRB3.OK_SCHWELLE K_ED_PT_GRB3.P_CODE_OPENLOAD K_ED_PT_GRB3.P_CODE_SH_TO_GND K_ED_PT_GRB3.P_CODE_SH_TO_UB K_ED_PT_GRB3.P_CODE_UNPLAUSIBEL K_ED_PT_KKOS.DEC_NACH_EINTRAG K_ED_PT_KKOS.DEC_VOR_EINTRAG K_ED_PT_KKOS.FEHLERSCHWELLE K_ED_PT_KKOS.INC_NACH_EINTRAG K_ED_PT_KKOS.INC_VOR_EINTRAG K_ED_PT_KKOS.KLASSENINDEX K_ED_PT_KKOS.OK_SCHWELLE K_ED_PT_KKOS.P_CODE_OPENLOAD K_ED_PT_KKOS.P_CODE_SH_TO_GND K_ED_PT_KKOS.P_CODE_SH_TO_UB K_ED_PT_KKOS.P_CODE_UNPLAUSIBEL K_ED_PT_KLST.DEC_NACH_EINTRAG K_ED_PT_KLST.DEC_VOR_EINTRAG K_ED_PT_KLST.FEHLERSCHWELLE K_ED_PT_KLST.INC_NACH_EINTRAG K_ED_PT_KLST.INC_VOR_EINTRAG K_ED_PT_KLST.KLASSENINDEX K_ED_PT_KLST.OK_SCHWELLE K_ED_PT_KLST.P_CODE_OPENLOAD K_ED_PT_KLST.P_CODE_SH_TO_GND K_ED_PT_KLST.P_CODE_SH_TO_UB K_ED_PT_KLST.P_CODE_UNPLAUSIBEL K_ED_PT_KM.DEC_NACH_EINTRAG K_ED_PT_KM.DEC_VOR_EINTRAG K_ED_PT_KM.FEHLERSCHWELLE K_ED_PT_KM.INC_NACH_EINTRAG K_ED_PT_KM.INC_VOR_EINTRAG K_ED_PT_KM.KLASSENINDEX K_ED_PT_KM.OK_SCHWELLE K_ED_PT_KM.P_CODE_OPENLOAD K_ED_PT_KM.P_CODE_SH_TO_GND K_ED_PT_KM.P_CODE_SH_TO_UB K_ED_PT_KM.P_CODE_UNPLAUSIBEL K_ED_PT_KOMBI.DEC_NACH_EINTRAG K_ED_PT_KOMBI.DEC_VOR_EINTRAG K_ED_PT_KOMBI.FEHLERSCHWELLE K_ED_PT_KOMBI.INC_NACH_EINTRAG K_ED_PT_KOMBI.INC_VOR_EINTRAG K_ED_PT_KOMBI.KLASSENINDEX K_ED_PT_KOMBI.OK_SCHWELLE K_ED_PT_KOMBI.P_CODE_OPENLOAD K_ED_PT_KOMBI.P_CODE_SH_TO_GND K_ED_PT_KOMBI.P_CODE_SH_TO_UB K_ED_PT_KOMBI.P_CODE_UNPLAUSIBEL K_ED_PT_LRW.DEC_NACH_EINTRAG K_ED_PT_LRW.DEC_VOR_EINTRAG K_ED_PT_LRW.FEHLERSCHWELLE K_ED_PT_LRW.INC_NACH_EINTRAG K_ED_PT_LRW.INC_VOR_EINTRAG K_ED_PT_LRW.KLASSENINDEX K_ED_PT_LRW.OK_SCHWELLE K_ED_PT_LRW.P_CODE_OPENLOAD K_ED_PT_LRW.P_CODE_SH_TO_GND K_ED_PT_LRW.P_CODE_SH_TO_UB K_ED_PT_LRW.P_CODE_UNPLAUSIBEL K_ED_PT_STATANH.DEC_NACH_EINTRAG K_ED_PT_STATANH.DEC_VOR_EINTRAG K_ED_PT_STATANH.FEHLERSCHWELLE K_ED_PT_STATANH.INC_NACH_EINTRAG K_ED_PT_STATANH.INC_VOR_EINTRAG K_ED_PT_STATANH.KLASSENINDEX K_ED_PT_STATANH.OK_SCHWELLE K_ED_PT_STATANH.P_CODE_OPENLOAD K_ED_PT_STATANH.P_CODE_SH_TO_GND K_ED_PT_STATANH.P_CODE_SH_TO_UB K_ED_PT_STATANH.P_CODE_UNPLAUSIBEL K_ED_PT_STATDKG.DEC_NACH_EINTRAG K_ED_PT_STATDKG.DEC_VOR_EINTRAG K_ED_PT_STATDKG.FEHLERSCHWELLE K_ED_PT_STATDKG.INC_NACH_EINTRAG K_ED_PT_STATDKG.INC_VOR_EINTRAG K_ED_PT_STATDKG.KLASSENINDEX K_ED_PT_STATDKG.OK_SCHWELLE K_ED_PT_STATDKG.P_CODE_OPENLOAD K_ED_PT_STATDKG.P_CODE_SH_TO_GND K_ED_PT_STATDKG.P_CODE_SH_TO_UB K_ED_PT_STATDKG.P_CODE_UNPLAUSIBEL K_ED_PT_STATR.DEC_NACH_EINTRAG K_ED_PT_STATR.DEC_VOR_EINTRAG K_ED_PT_STATR.FEHLERSCHWELLE K_ED_PT_STATR.INC_NACH_EINTRAG K_ED_PT_STATR.INC_VOR_EINTRAG K_ED_PT_STATR.KLASSENINDEX K_ED_PT_STATR.OK_SCHWELLE K_ED_PT_STATR.P_CODE_OPENLOAD K_ED_PT_STATR.P_CODE_SH_TO_GND K_ED_PT_STATR.P_CODE_SH_TO_UB K_ED_PT_STATR.P_CODE_UNPLAUSIBEL K_ED_PT_STDSC.DEC_NACH_EINTRAG K_ED_PT_STDSC.DEC_VOR_EINTRAG K_ED_PT_STDSC.FEHLERSCHWELLE K_ED_PT_STDSC.INC_NACH_EINTRAG K_ED_PT_STDSC.INC_VOR_EINTRAG K_ED_PT_STDSC.KLASSENINDEX K_ED_PT_STDSC.OK_SCHWELLE K_ED_PT_STDSC.P_CODE_OPENLOAD K_ED_PT_STDSC.P_CODE_SH_TO_GND K_ED_PT_STDSC.P_CODE_SH_TO_UB K_ED_PT_STDSC.P_CODE_UNPLAUSIBEL K_ED_PT_TOMA.DEC_NACH_EINTRAG K_ED_PT_TOMA.DEC_VOR_EINTRAG K_ED_PT_TOMA.FEHLERSCHWELLE K_ED_PT_TOMA.INC_NACH_EINTRAG K_ED_PT_TOMA.INC_VOR_EINTRAG K_ED_PT_TOMA.KLASSENINDEX K_ED_PT_TOMA.OK_SCHWELLE K_ED_PT_TOMA.P_CODE_OPENLOAD K_ED_PT_TOMA.P_CODE_SH_TO_GND K_ED_PT_TOMA.P_CODE_SH_TO_UB K_ED_PT_TOMA.P_CODE_UNPLAUSIBEL K_ED_PT_TORQDSC.DEC_NACH_EINTRAG K_ED_PT_TORQDSC.DEC_VOR_EINTRAG K_ED_PT_TORQDSC.FEHLERSCHWELLE K_ED_PT_TORQDSC.INC_NACH_EINTRAG K_ED_PT_TORQDSC.INC_VOR_EINTRAG K_ED_PT_TORQDSC.KLASSENINDEX K_ED_PT_TORQDSC.OK_SCHWELLE K_ED_PT_TORQDSC.P_CODE_OPENLOAD K_ED_PT_TORQDSC.P_CODE_SH_TO_GND K_ED_PT_TORQDSC.P_CODE_SH_TO_UB K_ED_PT_TORQDSC.P_CODE_UNPLAUSIBEL K_ED_PT_VEHMOD.DEC_NACH_EINTRAG K_ED_PT_VEHMOD.DEC_VOR_EINTRAG K_ED_PT_VEHMOD.FEHLERSCHWELLE K_ED_PT_VEHMOD.INC_NACH_EINTRAG K_ED_PT_VEHMOD.INC_VOR_EINTRAG K_ED_PT_VEHMOD.KLASSENINDEX K_ED_PT_VEHMOD.OK_SCHWELLE K_ED_PT_VEHMOD.P_CODE_OPENLOAD K_ED_PT_VEHMOD.P_CODE_SH_TO_GND K_ED_PT_VEHMOD.P_CODE_SH_TO_UB K_ED_PT_VEHMOD.P_CODE_UNPLAUSIBEL K_ED_PT_VFZG.DEC_NACH_EINTRAG K_ED_PT_VFZG.DEC_VOR_EINTRAG K_ED_PT_VFZG.FEHLERSCHWELLE K_ED_PT_VFZG.INC_NACH_EINTRAG K_ED_PT_VFZG.INC_VOR_EINTRAG K_ED_PT_VFZG.KLASSENINDEX K_ED_PT_VFZG.OK_SCHWELLE K_ED_PT_VFZG.P_CODE_OPENLOAD K_ED_PT_VFZG.P_CODE_SH_TO_GND K_ED_PT_VFZG.P_CODE_SH_TO_UB K_ED_PT_VFZG.P_CODE_UNPLAUSIBEL K_ED_PT_VRAD.DEC_NACH_EINTRAG K_ED_PT_VRAD.DEC_VOR_EINTRAG K_ED_PT_VRAD.FEHLERSCHWELLE K_ED_PT_VRAD.INC_NACH_EINTRAG K_ED_PT_VRAD.INC_VOR_EINTRAG K_ED_PT_VRAD.KLASSENINDEX K_ED_PT_VRAD.OK_SCHWELLE K_ED_PT_VRAD.P_CODE_OPENLOAD K_ED_PT_VRAD.P_CODE_SH_TO_GND K_ED_PT_VRAD.P_CODE_SH_TO_UB K_ED_PT_VRAD.P_CODE_UNPLAUSIBEL K_ED_PUMG.DEC_NACH_EINTRAG K_ED_PUMG.DEC_VOR_EINTRAG K_ED_PUMG.FEHLERSCHWELLE K_ED_PUMG.INC_NACH_EINTRAG K_ED_PUMG.INC_VOR_EINTRAG K_ED_PUMG.KLASSENINDEX K_ED_PUMG.OK_SCHWELLE K_ED_PUMG.P_CODE_OPENLOAD K_ED_PUMG.P_CODE_SH_TO_GND K_ED_PUMG.P_CODE_SH_TO_UB K_ED_PUMG.P_CODE_UNPLAUSIBEL K_ED_PUMG_OBD.DEC_NACH_EINTRAG K_ED_PUMG_OBD.DEC_VOR_EINTRAG K_ED_PUMG_OBD.FEHLERSCHWELLE K_ED_PUMG_OBD.INC_NACH_EINTRAG K_ED_PUMG_OBD.INC_VOR_EINTRAG K_ED_PUMG_OBD.KLASSENINDEX K_ED_PUMG_OBD.OK_SCHWELLE K_ED_PUMG_OBD.P_CODE_OPENLOAD K_ED_PUMG_OBD.P_CODE_SH_TO_GND K_ED_PUMG_OBD.P_CODE_SH_TO_UB K_ED_PUMG_OBD.P_CODE_UNPLAUSIBEL K_ED_RBM_PUMG_MIN__INJ_ K_ED_RBM_TIME__INJ_ K_ED_RBM_TIME_LL__INJ_ K_ED_RBM_TIME_V__INJ_ K_ED_RBM_TUMG_MIN__INJ_ K_ED_RBM_V_MIN__INJ_ K_ED_RLSLP.DEC_NACH_EINTRAG K_ED_RLSLP.DEC_VOR_EINTRAG K_ED_RLSLP.FEHLERSCHWELLE K_ED_RLSLP.INC_NACH_EINTRAG K_ED_RLSLP.INC_VOR_EINTRAG K_ED_RLSLP.KLASSENINDEX K_ED_RLSLP.OK_SCHWELLE K_ED_RLSLP.P_CODE_OPENLOAD K_ED_RLSLP.P_CODE_SH_TO_GND K_ED_RLSLP.P_CODE_SH_TO_UB K_ED_RLSLP.P_CODE_UNPLAUSIBEL K_ED_RLU87.DEC_NACH_EINTRAG K_ED_RLU87.DEC_VOR_EINTRAG K_ED_RLU87.FEHLERSCHWELLE K_ED_RLU87.INC_NACH_EINTRAG K_ED_RLU87.INC_VOR_EINTRAG K_ED_RLU87.KLASSENINDEX K_ED_RLU87.OK_SCHWELLE K_ED_RLU87.P_CODE_OPENLOAD K_ED_RLU87.P_CODE_SH_TO_GND K_ED_RLU87.P_CODE_SH_TO_UB K_ED_RLU87.P_CODE_UNPLAUSIBEL K_ED_SG_INJ.DEC_NACH_EINTRAG K_ED_SG_INJ.DEC_VOR_EINTRAG K_ED_SG_INJ.FEHLERSCHWELLE K_ED_SG_INJ.INC_NACH_EINTRAG K_ED_SG_INJ.INC_VOR_EINTRAG K_ED_SG_INJ.KLASSENINDEX K_ED_SG_INJ.OK_SCHWELLE K_ED_SG_INJ.P_CODE_OPENLOAD K_ED_SG_INJ.P_CODE_SH_TO_GND K_ED_SG_INJ.P_CODE_SH_TO_UB K_ED_SG_INJ.P_CODE_UNPLAUSIBEL K_ED_SK_MANAGER_INJ.DEC_NACH_EINTRAG K_ED_SK_MANAGER_INJ.DEC_VOR_EINTRAG K_ED_SK_MANAGER_INJ.FEHLERSCHWELLE K_ED_SK_MANAGER_INJ.INC_NACH_EINTRAG K_ED_SK_MANAGER_INJ.INC_VOR_EINTRAG K_ED_SK_MANAGER_INJ.KLASSENINDEX K_ED_SK_MANAGER_INJ.OK_SCHWELLE K_ED_SK_MANAGER_INJ.P_CODE_OPENLOAD K_ED_SK_MANAGER_INJ.P_CODE_SH_TO_GND K_ED_SK_MANAGER_INJ.P_CODE_SH_TO_UB K_ED_SK_MANAGER_INJ.P_CODE_UNPLAUSIBEL K_ED_SK_TR_INJ.KLASSENINDEX K_ED_SLP.DEC_NACH_EINTRAG K_ED_SLP.DEC_VOR_EINTRAG K_ED_SLP.FEHLERSCHWELLE K_ED_SLP.INC_NACH_EINTRAG K_ED_SLP.INC_VOR_EINTRAG K_ED_SLP.KLASSENINDEX K_ED_SLP.OK_SCHWELLE K_ED_SLP.P_CODE_OPENLOAD K_ED_SLP.P_CODE_SH_TO_GND K_ED_SLP.P_CODE_SH_TO_UB K_ED_SLP.P_CODE_UNPLAUSIBEL K_ED_SLV.DEC_NACH_EINTRAG K_ED_SLV.DEC_VOR_EINTRAG K_ED_SLV.FEHLERSCHWELLE K_ED_SLV.INC_NACH_EINTRAG K_ED_SLV.INC_VOR_EINTRAG K_ED_SLV.KLASSENINDEX K_ED_SLV.OK_SCHWELLE K_ED_SLV.P_CODE_OPENLOAD K_ED_SLV.P_CODE_SH_TO_GND K_ED_SLV.P_CODE_SH_TO_UB K_ED_SLV.P_CODE_UNPLAUSIBEL K_ED_SL_DURCHS_B1.DEC_NACH_EINTRAG K_ED_SL_DURCHS_B1.DEC_VOR_EINTRAG K_ED_SL_DURCHS_B1.FEHLERSCHWELLE K_ED_SL_DURCHS_B1.INC_NACH_EINTRAG K_ED_SL_DURCHS_B1.INC_VOR_EINTRAG K_ED_SL_DURCHS_B1.KLASSENINDEX K_ED_SL_DURCHS_B1.OK_SCHWELLE K_ED_SL_DURCHS_B1.P_CODE_OPENLOAD K_ED_SL_DURCHS_B1.P_CODE_SH_TO_GND K_ED_SL_DURCHS_B1.P_CODE_SH_TO_UB K_ED_SL_DURCHS_B1.P_CODE_UNPLAUSIBEL K_ED_SL_DURCHS_B2.DEC_NACH_EINTRAG K_ED_SL_DURCHS_B2.DEC_VOR_EINTRAG K_ED_SL_DURCHS_B2.FEHLERSCHWELLE K_ED_SL_DURCHS_B2.INC_NACH_EINTRAG K_ED_SL_DURCHS_B2.INC_VOR_EINTRAG K_ED_SL_DURCHS_B2.KLASSENINDEX K_ED_SL_DURCHS_B2.OK_SCHWELLE K_ED_SL_DURCHS_B2.P_CODE_OPENLOAD K_ED_SL_DURCHS_B2.P_CODE_SH_TO_GND K_ED_SL_DURCHS_B2.P_CODE_SH_TO_UB K_ED_SL_DURCHS_B2.P_CODE_UNPLAUSIBEL K_ED_SL_DURCHS_HSTRANG.DEC_NACH_EINTRAG K_ED_SL_DURCHS_HSTRANG.DEC_VOR_EINTRAG K_ED_SL_DURCHS_HSTRANG.FEHLERSCHWELLE K_ED_SL_DURCHS_HSTRANG.INC_NACH_EINTRAG K_ED_SL_DURCHS_HSTRANG.INC_VOR_EINTRAG K_ED_SL_DURCHS_HSTRANG.KLASSENINDEX K_ED_SL_DURCHS_HSTRANG.OK_SCHWELLE /end REF_CHARACTERISTIC
/end GROUP
/end MODULE
/end PROJECT
