ASAP2_VERSION 1 60
/begin PROJECT MSS60_V762_INJ "MSS60 (S65) V762 INJ CPU - generated 04.11.2026 from the reverse-engineered XDF"
/begin HEADER "Calibration description (characteristics from the XDF; measurements = V530 RAM names transferred to V762 addresses, confidence in each long identifier). Status tag in every long identifier: verified (checked against the code) / A2L-ref (placed from the V530 A2L) / EST (estimated) / unassigned (UNK placeholder)." VERSION "V762-RE-04112026" /end HEADER
/begin MODULE INJ "MSS60 V762 INJ"
/begin MOD_COMMON "" BYTE_ORDER MSB_FIRST ALIGNMENT_BYTE 1 ALIGNMENT_WORD 2 ALIGNMENT_LONG 4 /end MOD_COMMON
/begin CHARACTERISTIC K_DIAGNOSE_INDEX_HI__INJ_ "Diagnostic index [verified]" VALUE 0x7024B RL_VAL_UB 0 CM_0000 0 255 /end CHARACTERISTIC
/begin CHARACTERISTIC K_DIAGNOSE_INDEX_LO__INJ_ "Diagnostic index [verified]" VALUE 0x7024C RL_VAL_UB 0 CM_0000 0 255 /end CHARACTERISTIC
/begin CHARACTERISTIC K_VERS_DATEN__INJ_ "Data version [verified]" VALUE 0x70254 RL_VAL_UW 0 CM_0000 0 65535 /end CHARACTERISTIC
/begin CHARACTERISTIC K_VERS_NAME__INJ_ "Calibrator ID [verified]" VALUE 0x70253 RL_VAL_UB 0 CM_0000 0 255 /end CHARACTERISTIC
/begin CHARACTERISTIC K_VERS_PROG__INJ_ "Program version [verified]" VALUE 0x70250 RL_VAL_UW 0 CM_0000 0 65535 /end CHARACTERISTIC
/begin CHARACTERISTIC K_VERS_PROZ__INJ_ "Processor ID [verified]" VALUE 0x70252 RL_VAL_UB 0 CM_0000 0 255 /end CHARACTERISTIC
/begin CHARACTERISTIC K_DEBUG_READ_ADR__INJ_ "Debug read address [verified]" VALUE 0x708FC RL_VAL_UL 0 CM_0000 0 4294967295 /end CHARACTERISTIC
/begin CHARACTERISTIC K_DEBUG_RW_LENGTH__INJ_ "Debug read/write length [verified]" VALUE 0x70908 RL_VAL_UB 0 CM_0000 0 255 /end CHARACTERISTIC
/begin CHARACTERISTIC K_DEBUG_WRITE_ADR__INJ_ "Debug write address [verified]" VALUE 0x70900 RL_VAL_UL 0 CM_0000 0 4294967295 /end CHARACTERISTIC
/begin CHARACTERISTIC K_DEBUG_WRITE_VALUE__INJ_ "Debug write value [verified]" VALUE 0x70904 RL_VAL_UL 0 CM_0000 0 4294967295 /end CHARACTERISTIC
/begin CHARACTERISTIC K_DIAG_TR_UB_MIN__INJ_ "Battery-voltage threshold above which driver diagnosis starts [verified]" VALUE 0x70926 RL_VAL_SW 0 CM_0021 -3276.8 3276.7 /end CHARACTERISTIC
/begin CHARACTERISTIC K_ED_APPL_DATA_INJ.DEC_NACH_EINTRAG "Fault code APPL_DATA_INJ - debounce filter decrement after fault-memory entry [verified]" VALUE 0x71185 RL_VAL_UB 0 CM_0000 0 255 /end CHARACTERISTIC
/begin CHARACTERISTIC K_ED_APPL_DATA_INJ.DEC_VOR_EINTRAG "Fault code APPL_DATA_INJ - debounce filter decrement before fault-memory entry [verified]" VALUE 0x71183 RL_VAL_UB 0 CM_0000 0 255 /end CHARACTERISTIC
/begin CHARACTERISTIC K_ED_APPL_DATA_INJ.FEHLERSCHWELLE "Fault code APPL_DATA_INJ - debounce filter threshold for setting the fault [verified]" VALUE 0x71180 RL_VAL_UB 0 CM_0000 0 255 /end CHARACTERISTIC
/begin CHARACTERISTIC K_ED_APPL_DATA_INJ.INC_NACH_EINTRAG "Fault code APPL_DATA_INJ - debounce filter increment after fault-memory entry [verified]" VALUE 0x71184 RL_VAL_UB 0 CM_0000 0 255 /end CHARACTERISTIC
/begin CHARACTERISTIC K_ED_APPL_DATA_INJ.INC_VOR_EINTRAG "Fault code APPL_DATA_INJ - debounce filter increment before fault-memory entry [verified]" VALUE 0x71182 RL_VAL_UB 0 CM_0000 0 255 /end CHARACTERISTIC
/begin CHARACTERISTIC K_ED_APPL_DATA_INJ.KLASSENINDEX "Fault code APPL_DATA_INJ - fault class selection (lamp / warning behaviour) [verified]" VALUE 0x71186 RL_VAL_UB 0 CM_0000 0 255 /end CHARACTERISTIC
/begin CHARACTERISTIC K_ED_APPL_DATA_INJ.OK_SCHWELLE "Fault code APPL_DATA_INJ - debounce filter threshold for clearing (healing) the fault [verified]" VALUE 0x71181 RL_VAL_UB 0 CM_0000 0 255 /end CHARACTERISTIC
/begin CHARACTERISTIC K_ED_APPL_DATA_INJ.P_CODE_OPENLOAD "Fault code APPL_DATA_INJ - OBD P-code reported for open circuit [verified]" VALUE 0x7117C RL_VAL_UW 0 CM_0000 0 65535 /end CHARACTERISTIC
/begin CHARACTERISTIC K_ED_APPL_DATA_INJ.P_CODE_SH_TO_GND "Fault code APPL_DATA_INJ - OBD P-code reported for short to ground [verified]" VALUE 0x7117A RL_VAL_UW 0 CM_0000 0 65535 /end CHARACTERISTIC
/begin CHARACTERISTIC K_ED_APPL_DATA_INJ.P_CODE_SH_TO_UB "Fault code APPL_DATA_INJ - OBD P-code reported for short to battery voltage [verified]" VALUE 0x71178 RL_VAL_UW 0 CM_0000 0 65535 /end CHARACTERISTIC
/begin CHARACTERISTIC K_ED_APPL_DATA_INJ.P_CODE_UNPLAUSIBEL "Fault code APPL_DATA_INJ - OBD P-code reported for implausible signal [verified]" VALUE 0x7117E RL_VAL_UW 0 CM_0000 0 65535 /end CHARACTERISTIC
/begin CHARACTERISTIC K_ED_CODIERUNG.DEC_NACH_EINTRAG "Fault code CODIERUNG - debounce filter decrement after fault-memory entry [verified]" VALUE 0x71631 RL_VAL_UB 0 CM_0000 0 255 /end CHARACTERISTIC
/begin CHARACTERISTIC K_ED_CODIERUNG.DEC_VOR_EINTRAG "Fault code CODIERUNG - debounce filter decrement before fault-memory entry [verified]" VALUE 0x7162F RL_VAL_UB 0 CM_0000 0 255 /end CHARACTERISTIC
/begin CHARACTERISTIC K_ED_CODIERUNG.FEHLERSCHWELLE "Fault code CODIERUNG - debounce filter threshold for setting the fault [verified]" VALUE 0x7162C RL_VAL_UB 0 CM_0000 0 255 /end CHARACTERISTIC
/begin CHARACTERISTIC K_ED_CODIERUNG.INC_NACH_EINTRAG "Fault code CODIERUNG - debounce filter increment after fault-memory entry [verified]" VALUE 0x71630 RL_VAL_UB 0 CM_0000 0 255 /end CHARACTERISTIC
/begin CHARACTERISTIC K_ED_CODIERUNG.INC_VOR_EINTRAG "Fault code CODIERUNG - debounce filter increment before fault-memory entry [verified]" VALUE 0x7162E RL_VAL_UB 0 CM_0000 0 255 /end CHARACTERISTIC
/begin CHARACTERISTIC K_ED_CODIERUNG.KLASSENINDEX "Fault code CODIERUNG - fault class selection (lamp / warning behaviour) [verified]" VALUE 0x71632 RL_VAL_UB 0 CM_0000 0 255 /end CHARACTERISTIC
/begin CHARACTERISTIC K_ED_CODIERUNG.OK_SCHWELLE "Fault code CODIERUNG - debounce filter threshold for clearing (healing) the fault [verified]" VALUE 0x7162D RL_VAL_UB 0 CM_0000 0 255 /end CHARACTERISTIC
/begin CHARACTERISTIC K_ED_CODIERUNG.P_CODE_OPENLOAD "Fault code CODIERUNG - OBD P-code reported for open circuit [verified]" VALUE 0x71628 RL_VAL_UW 0 CM_0000 0 65535 /end CHARACTERISTIC
/begin CHARACTERISTIC K_ED_CODIERUNG.P_CODE_SH_TO_GND "Fault code CODIERUNG - OBD P-code reported for short to ground [verified]" VALUE 0x71626 RL_VAL_UW 0 CM_0000 0 65535 /end CHARACTERISTIC
/begin CHARACTERISTIC K_ED_CODIERUNG.P_CODE_SH_TO_UB "Fault code CODIERUNG - OBD P-code reported for short to battery voltage [verified]" VALUE 0x71624 RL_VAL_UW 0 CM_0000 0 65535 /end CHARACTERISTIC
/begin CHARACTERISTIC K_ED_CODIERUNG.P_CODE_UNPLAUSIBEL "Fault code CODIERUNG - OBD P-code reported for implausible signal [verified]" VALUE 0x7162A RL_VAL_UW 0 CM_0000 0 65535 /end CHARACTERISTIC
/begin CHARACTERISTIC K_ED_DK1_ENLTG.DEC_NACH_EINTRAG "Fault code DK1_ENLTG - debounce filter decrement after fault-memory entry [verified]" VALUE 0x7198B RL_VAL_UB 0 CM_0000 0 255 /end CHARACTERISTIC
/begin CHARACTERISTIC K_ED_DK1_ENLTG.DEC_VOR_EINTRAG "Fault code DK1_ENLTG - debounce filter decrement before fault-memory entry [verified]" VALUE 0x71989 RL_VAL_UB 0 CM_0000 0 255 /end CHARACTERISTIC
/begin CHARACTERISTIC K_ED_DK1_ENLTG.FEHLERSCHWELLE "Fault code DK1_ENLTG - debounce filter threshold for setting the fault [verified]" VALUE 0x71986 RL_VAL_UB 0 CM_0000 0 255 /end CHARACTERISTIC
/begin CHARACTERISTIC K_ED_DK1_ENLTG.INC_NACH_EINTRAG "Fault code DK1_ENLTG - debounce filter increment after fault-memory entry [verified]" VALUE 0x7198A RL_VAL_UB 0 CM_0000 0 255 /end CHARACTERISTIC
/begin CHARACTERISTIC K_ED_DK1_ENLTG.INC_VOR_EINTRAG "Fault code DK1_ENLTG - debounce filter increment before fault-memory entry [verified]" VALUE 0x71988 RL_VAL_UB 0 CM_0000 0 255 /end CHARACTERISTIC
/begin CHARACTERISTIC K_ED_DK1_ENLTG.KLASSENINDEX "Fault code DK1_ENLTG - fault class selection (lamp / warning behaviour) [verified]" VALUE 0x7198C RL_VAL_UB 0 CM_0000 0 255 /end CHARACTERISTIC
/begin CHARACTERISTIC K_ED_DK1_ENLTG.OK_SCHWELLE "Fault code DK1_ENLTG - debounce filter threshold for clearing (healing) the fault [verified]" VALUE 0x71987 RL_VAL_UB 0 CM_0000 0 255 /end CHARACTERISTIC
/begin CHARACTERISTIC K_ED_DK1_ENLTG.P_CODE_OPENLOAD "Fault code DK1_ENLTG - OBD P-code reported for open circuit [verified]" VALUE 0x71982 RL_VAL_UW 0 CM_0000 0 65535 /end CHARACTERISTIC
/begin CHARACTERISTIC K_ED_DK1_ENLTG.P_CODE_SH_TO_GND "Fault code DK1_ENLTG - OBD P-code reported for short to ground [verified]" VALUE 0x71980 RL_VAL_UW 0 CM_0000 0 65535 /end CHARACTERISTIC
/begin CHARACTERISTIC K_ED_DK1_ENLTG.P_CODE_SH_TO_UB "Fault code DK1_ENLTG - OBD P-code reported for short to battery voltage [verified]" VALUE 0x7197E RL_VAL_UW 0 CM_0000 0 65535 /end CHARACTERISTIC
/begin CHARACTERISTIC K_ED_DK1_ENLTG.P_CODE_UNPLAUSIBEL "Fault code DK1_ENLTG - OBD P-code reported for implausible signal [verified]" VALUE 0x71984 RL_VAL_UW 0 CM_0000 0 65535 /end CHARACTERISTIC
/begin CHARACTERISTIC K_ED_DK2_ENLTG.DEC_NACH_EINTRAG "Fault code DK2_ENLTG - debounce filter decrement after fault-memory entry [verified]" VALUE 0x719A5 RL_VAL_UB 0 CM_0000 0 255 /end CHARACTERISTIC
/begin CHARACTERISTIC K_ED_DK2_ENLTG.DEC_VOR_EINTRAG "Fault code DK2_ENLTG - debounce filter decrement before fault-memory entry [verified]" VALUE 0x719A3 RL_VAL_UB 0 CM_0000 0 255 /end CHARACTERISTIC
/begin CHARACTERISTIC K_ED_DK2_ENLTG.FEHLERSCHWELLE "Fault code DK2_ENLTG - debounce filter threshold for setting the fault [verified]" VALUE 0x719A0 RL_VAL_UB 0 CM_0000 0 255 /end CHARACTERISTIC
/begin CHARACTERISTIC K_ED_DK2_ENLTG.INC_NACH_EINTRAG "Fault code DK2_ENLTG - debounce filter increment after fault-memory entry [verified]" VALUE 0x719A4 RL_VAL_UB 0 CM_0000 0 255 /end CHARACTERISTIC
/begin CHARACTERISTIC K_ED_DK2_ENLTG.INC_VOR_EINTRAG "Fault code DK2_ENLTG - debounce filter increment before fault-memory entry [verified]" VALUE 0x719A2 RL_VAL_UB 0 CM_0000 0 255 /end CHARACTERISTIC
/begin CHARACTERISTIC K_ED_DK2_ENLTG.KLASSENINDEX "Fault code DK2_ENLTG - fault class selection (lamp / warning behaviour) [verified]" VALUE 0x719A6 RL_VAL_UB 0 CM_0000 0 255 /end CHARACTERISTIC
/begin CHARACTERISTIC K_ED_DK2_ENLTG.OK_SCHWELLE "Fault code DK2_ENLTG - debounce filter threshold for clearing (healing) the fault [verified]" VALUE 0x719A1 RL_VAL_UB 0 CM_0000 0 255 /end CHARACTERISTIC
/begin CHARACTERISTIC K_ED_DK2_ENLTG.P_CODE_OPENLOAD "Fault code DK2_ENLTG - OBD P-code reported for open circuit [verified]" VALUE 0x7199C RL_VAL_UW 0 CM_0000 0 65535 /end CHARACTERISTIC
/begin CHARACTERISTIC K_ED_DK2_ENLTG.P_CODE_SH_TO_GND "Fault code DK2_ENLTG - OBD P-code reported for short to ground [verified]" VALUE 0x7199A RL_VAL_UW 0 CM_0000 0 65535 /end CHARACTERISTIC
/begin CHARACTERISTIC K_ED_DK2_ENLTG.P_CODE_SH_TO_UB "Fault code DK2_ENLTG - OBD P-code reported for short to battery voltage [verified]" VALUE 0x71998 RL_VAL_UW 0 CM_0000 0 65535 /end CHARACTERISTIC
/begin CHARACTERISTIC K_ED_DK2_ENLTG.P_CODE_UNPLAUSIBEL "Fault code DK2_ENLTG - OBD P-code reported for implausible signal [verified]" VALUE 0x7199E RL_VAL_UW 0 CM_0000 0 65535 /end CHARACTERISTIC
/begin CHARACTERISTIC K_ED_DMTL_DECKEL.DEC_NACH_EINTRAG "Fault code DMTL_DECKEL - debounce filter decrement after fault-memory entry [verified]" VALUE 0x715AF RL_VAL_UB 0 CM_0000 0 255 /end CHARACTERISTIC
/begin CHARACTERISTIC K_ED_DMTL_DECKEL.DEC_VOR_EINTRAG "Fault code DMTL_DECKEL - debounce filter decrement before fault-memory entry [verified]" VALUE 0x715AD RL_VAL_UB 0 CM_0000 0 255 /end CHARACTERISTIC
/begin CHARACTERISTIC K_ED_DMTL_DECKEL.FEHLERSCHWELLE "Fault code DMTL_DECKEL - debounce filter threshold for setting the fault [verified]" VALUE 0x715AA RL_VAL_UB 0 CM_0000 0 255 /end CHARACTERISTIC
/begin CHARACTERISTIC K_ED_DMTL_DECKEL.INC_NACH_EINTRAG "Fault code DMTL_DECKEL - debounce filter increment after fault-memory entry [verified]" VALUE 0x715AE RL_VAL_UB 0 CM_0000 0 255 /end CHARACTERISTIC
/begin CHARACTERISTIC K_ED_DMTL_DECKEL.INC_VOR_EINTRAG "Fault code DMTL_DECKEL - debounce filter increment before fault-memory entry [verified]" VALUE 0x715AC RL_VAL_UB 0 CM_0000 0 255 /end CHARACTERISTIC
/begin CHARACTERISTIC K_ED_DMTL_DECKEL.KLASSENINDEX "Fault code DMTL_DECKEL - fault class selection (lamp / warning behaviour) [verified]" VALUE 0x715B0 RL_VAL_UB 0 CM_0000 0 255 /end CHARACTERISTIC
/begin CHARACTERISTIC K_ED_DMTL_DECKEL.OK_SCHWELLE "Fault code DMTL_DECKEL - debounce filter threshold for clearing (healing) the fault [verified]" VALUE 0x715AB RL_VAL_UB 0 CM_0000 0 255 /end CHARACTERISTIC
/begin CHARACTERISTIC K_ED_DMTL_DECKEL.P_CODE_OPENLOAD "Fault code DMTL_DECKEL - OBD P-code reported for open circuit [verified]" VALUE 0x715A6 RL_VAL_UW 0 CM_0000 0 65535 /end CHARACTERISTIC
/begin CHARACTERISTIC K_ED_DMTL_DECKEL.P_CODE_SH_TO_GND "Fault code DMTL_DECKEL - OBD P-code reported for short to ground [verified]" VALUE 0x715A4 RL_VAL_UW 0 CM_0000 0 65535 /end CHARACTERISTIC
/begin CHARACTERISTIC K_ED_DMTL_DECKEL.P_CODE_SH_TO_UB "Fault code DMTL_DECKEL - OBD P-code reported for short to battery voltage [verified]" VALUE 0x715A2 RL_VAL_UW 0 CM_0000 0 65535 /end CHARACTERISTIC
/begin CHARACTERISTIC K_ED_DMTL_DECKEL.P_CODE_UNPLAUSIBEL "Fault code DMTL_DECKEL - OBD P-code reported for implausible signal [verified]" VALUE 0x715A8 RL_VAL_UW 0 CM_0000 0 65535 /end CHARACTERISTIC
/begin CHARACTERISTIC K_ED_DMTL_FEINLECK.DEC_NACH_EINTRAG "Fault code DMTL_FEINLECK - debounce filter decrement after fault-memory entry [verified]" VALUE 0x71CFF RL_VAL_UB 0 CM_0000 0 255 /end CHARACTERISTIC
/begin CHARACTERISTIC K_ED_DMTL_FEINLECK.DEC_VOR_EINTRAG "Fault code DMTL_FEINLECK - debounce filter decrement before fault-memory entry [verified]" VALUE 0x71CFD RL_VAL_UB 0 CM_0000 0 255 /end CHARACTERISTIC
/begin CHARACTERISTIC K_ED_DMTL_FEINLECK.FEHLERSCHWELLE "Fault code DMTL_FEINLECK - debounce filter threshold for setting the fault [verified]" VALUE 0x71CFA RL_VAL_UB 0 CM_0000 0 255 /end CHARACTERISTIC
/begin CHARACTERISTIC K_ED_DMTL_FEINLECK.INC_NACH_EINTRAG "Fault code DMTL_FEINLECK - debounce filter increment after fault-memory entry [verified]" VALUE 0x71CFE RL_VAL_UB 0 CM_0000 0 255 /end CHARACTERISTIC
/begin CHARACTERISTIC K_ED_DMTL_FEINLECK.INC_VOR_EINTRAG "Fault code DMTL_FEINLECK - debounce filter increment before fault-memory entry [verified]" VALUE 0x71CFC RL_VAL_UB 0 CM_0000 0 255 /end CHARACTERISTIC
/begin CHARACTERISTIC K_ED_DMTL_FEINLECK.KLASSENINDEX "Fault code DMTL_FEINLECK - fault class selection (lamp / warning behaviour) [verified]" VALUE 0x71D00 RL_VAL_UB 0 CM_0000 0 255 /end CHARACTERISTIC
/begin CHARACTERISTIC K_ED_DMTL_FEINLECK.OK_SCHWELLE "Fault code DMTL_FEINLECK - debounce filter threshold for clearing (healing) the fault [verified]" VALUE 0x71CFB RL_VAL_UB 0 CM_0000 0 255 /end CHARACTERISTIC
/begin CHARACTERISTIC K_ED_DMTL_FEINLECK.P_CODE_OPENLOAD "Fault code DMTL_FEINLECK - OBD P-code reported for open circuit [verified]" VALUE 0x71CF6 RL_VAL_UW 0 CM_0000 0 65535 /end CHARACTERISTIC
/begin CHARACTERISTIC K_ED_DMTL_FEINLECK.P_CODE_SH_TO_GND "Fault code DMTL_FEINLECK - OBD P-code reported for short to ground [verified]" VALUE 0x71CF4 RL_VAL_UW 0 CM_0000 0 65535 /end CHARACTERISTIC
/begin CHARACTERISTIC K_ED_DMTL_FEINLECK.P_CODE_SH_TO_UB "Fault code DMTL_FEINLECK - OBD P-code reported for short to battery voltage [verified]" VALUE 0x71CF2 RL_VAL_UW 0 CM_0000 0 65535 /end CHARACTERISTIC
/begin CHARACTERISTIC K_ED_DMTL_FEINLECK.P_CODE_UNPLAUSIBEL "Fault code DMTL_FEINLECK - OBD P-code reported for implausible signal [verified]" VALUE 0x71CF8 RL_VAL_UW 0 CM_0000 0 65535 /end CHARACTERISTIC
/begin CHARACTERISTIC K_ED_DMTL_FEUCHT.DEC_NACH_EINTRAG "Fault code DMTL_FEUCHT - debounce filter decrement after fault-memory entry [verified]" VALUE 0x71595 RL_VAL_UB 0 CM_0000 0 255 /end CHARACTERISTIC
/begin CHARACTERISTIC K_ED_DMTL_FEUCHT.DEC_VOR_EINTRAG "Fault code DMTL_FEUCHT - debounce filter decrement before fault-memory entry [verified]" VALUE 0x71593 RL_VAL_UB 0 CM_0000 0 255 /end CHARACTERISTIC
/begin CHARACTERISTIC K_ED_DMTL_FEUCHT.FEHLERSCHWELLE "Fault code DMTL_FEUCHT - debounce filter threshold for setting the fault [verified]" VALUE 0x71590 RL_VAL_UB 0 CM_0000 0 255 /end CHARACTERISTIC
/begin CHARACTERISTIC K_ED_DMTL_FEUCHT.INC_NACH_EINTRAG "Fault code DMTL_FEUCHT - debounce filter increment after fault-memory entry [verified]" VALUE 0x71594 RL_VAL_UB 0 CM_0000 0 255 /end CHARACTERISTIC
/begin CHARACTERISTIC K_ED_DMTL_FEUCHT.INC_VOR_EINTRAG "Fault code DMTL_FEUCHT - debounce filter increment before fault-memory entry [verified]" VALUE 0x71592 RL_VAL_UB 0 CM_0000 0 255 /end CHARACTERISTIC
/begin CHARACTERISTIC K_ED_DMTL_FEUCHT.KLASSENINDEX "Fault code DMTL_FEUCHT - fault class selection (lamp / warning behaviour) [verified]" VALUE 0x71596 RL_VAL_UB 0 CM_0000 0 255 /end CHARACTERISTIC
/begin CHARACTERISTIC K_ED_DMTL_FEUCHT.OK_SCHWELLE "Fault code DMTL_FEUCHT - debounce filter threshold for clearing (healing) the fault [verified]" VALUE 0x71591 RL_VAL_UB 0 CM_0000 0 255 /end CHARACTERISTIC
/begin CHARACTERISTIC K_ED_DMTL_FEUCHT.P_CODE_OPENLOAD "Fault code DMTL_FEUCHT - OBD P-code reported for open circuit [verified]" VALUE 0x7158C RL_VAL_UW 0 CM_0000 0 65535 /end CHARACTERISTIC
/begin CHARACTERISTIC K_ED_DMTL_FEUCHT.P_CODE_SH_TO_GND "Fault code DMTL_FEUCHT - OBD P-code reported for short to ground [verified]" VALUE 0x7158A RL_VAL_UW 0 CM_0000 0 65535 /end CHARACTERISTIC
/begin CHARACTERISTIC K_ED_DMTL_FEUCHT.P_CODE_SH_TO_UB "Fault code DMTL_FEUCHT - OBD P-code reported for short to battery voltage [verified]" VALUE 0x71588 RL_VAL_UW 0 CM_0000 0 65535 /end CHARACTERISTIC
/begin CHARACTERISTIC K_ED_DMTL_FEUCHT.P_CODE_UNPLAUSIBEL "Fault code DMTL_FEUCHT - OBD P-code reported for implausible signal [verified]" VALUE 0x7158E RL_VAL_UW 0 CM_0000 0 65535 /end CHARACTERISTIC
/begin CHARACTERISTIC K_ED_DMTL_GROBLECK.DEC_NACH_EINTRAG "Fault code DMTL_GROBLECK - debounce filter decrement after fault-memory entry [verified]" VALUE 0x7157B RL_VAL_UB 0 CM_0000 0 255 /end CHARACTERISTIC
/begin CHARACTERISTIC K_ED_DMTL_GROBLECK.DEC_VOR_EINTRAG "Fault code DMTL_GROBLECK - debounce filter decrement before fault-memory entry [verified]" VALUE 0x71579 RL_VAL_UB 0 CM_0000 0 255 /end CHARACTERISTIC
/begin CHARACTERISTIC K_ED_DMTL_GROBLECK.FEHLERSCHWELLE "Fault code DMTL_GROBLECK - debounce filter threshold for setting the fault [verified]" VALUE 0x71576 RL_VAL_UB 0 CM_0000 0 255 /end CHARACTERISTIC
/begin CHARACTERISTIC K_ED_DMTL_GROBLECK.INC_NACH_EINTRAG "Fault code DMTL_GROBLECK - debounce filter increment after fault-memory entry [verified]" VALUE 0x7157A RL_VAL_UB 0 CM_0000 0 255 /end CHARACTERISTIC
/begin CHARACTERISTIC K_ED_DMTL_GROBLECK.INC_VOR_EINTRAG "Fault code DMTL_GROBLECK - debounce filter increment before fault-memory entry [verified]" VALUE 0x71578 RL_VAL_UB 0 CM_0000 0 255 /end CHARACTERISTIC
/begin CHARACTERISTIC K_ED_DMTL_GROBLECK.KLASSENINDEX "Fault code DMTL_GROBLECK - fault class selection (lamp / warning behaviour) [verified]" VALUE 0x7157C RL_VAL_UB 0 CM_0000 0 255 /end CHARACTERISTIC
/begin CHARACTERISTIC K_ED_DMTL_GROBLECK.OK_SCHWELLE "Fault code DMTL_GROBLECK - debounce filter threshold for clearing (healing) the fault [verified]" VALUE 0x71577 RL_VAL_UB 0 CM_0000 0 255 /end CHARACTERISTIC
/begin CHARACTERISTIC K_ED_DMTL_GROBLECK.P_CODE_OPENLOAD "Fault code DMTL_GROBLECK - OBD P-code reported for open circuit [verified]" VALUE 0x71572 RL_VAL_UW 0 CM_0000 0 65535 /end CHARACTERISTIC
/begin CHARACTERISTIC K_ED_DMTL_GROBLECK.P_CODE_SH_TO_GND "Fault code DMTL_GROBLECK - OBD P-code reported for short to ground [verified]" VALUE 0x71570 RL_VAL_UW 0 CM_0000 0 65535 /end CHARACTERISTIC
/begin CHARACTERISTIC K_ED_DMTL_GROBLECK.P_CODE_SH_TO_UB "Fault code DMTL_GROBLECK - OBD P-code reported for short to battery voltage [verified]" VALUE 0x7156E RL_VAL_UW 0 CM_0000 0 65535 /end CHARACTERISTIC
/begin CHARACTERISTIC K_ED_DMTL_GROBLECK.P_CODE_UNPLAUSIBEL "Fault code DMTL_GROBLECK - OBD P-code reported for implausible signal [verified]" VALUE 0x71574 RL_VAL_UW 0 CM_0000 0 65535 /end CHARACTERISTIC
/begin CHARACTERISTIC K_ED_DMTL_H.DEC_NACH_EINTRAG "Fault code DMTL_H - debounce filter decrement after fault-memory entry [verified]" VALUE 0x71561 RL_VAL_UB 0 CM_0000 0 255 /end CHARACTERISTIC
/begin CHARACTERISTIC K_ED_DMTL_H.DEC_VOR_EINTRAG "Fault code DMTL_H - debounce filter decrement before fault-memory entry [verified]" VALUE 0x7155F RL_VAL_UB 0 CM_0000 0 255 /end CHARACTERISTIC
/begin CHARACTERISTIC K_ED_DMTL_H.FEHLERSCHWELLE "Fault code DMTL_H - debounce filter threshold for setting the fault [verified]" VALUE 0x7155C RL_VAL_UB 0 CM_0000 0 255 /end CHARACTERISTIC
/begin CHARACTERISTIC K_ED_DMTL_H.INC_NACH_EINTRAG "Fault code DMTL_H - debounce filter increment after fault-memory entry [verified]" VALUE 0x71560 RL_VAL_UB 0 CM_0000 0 255 /end CHARACTERISTIC
/begin CHARACTERISTIC K_ED_DMTL_H.INC_VOR_EINTRAG "Fault code DMTL_H - debounce filter increment before fault-memory entry [verified]" VALUE 0x7155E RL_VAL_UB 0 CM_0000 0 255 /end CHARACTERISTIC
/begin CHARACTERISTIC K_ED_DMTL_H.KLASSENINDEX "Fault code DMTL_H - fault class selection (lamp / warning behaviour) [verified]" VALUE 0x71562 RL_VAL_UB 0 CM_0000 0 255 /end CHARACTERISTIC
/begin CHARACTERISTIC K_ED_DMTL_H.OK_SCHWELLE "Fault code DMTL_H - debounce filter threshold for clearing (healing) the fault [verified]" VALUE 0x7155D RL_VAL_UB 0 CM_0000 0 255 /end CHARACTERISTIC
/begin CHARACTERISTIC K_ED_DMTL_H.P_CODE_OPENLOAD "Fault code DMTL_H - OBD P-code reported for open circuit [verified]" VALUE 0x71558 RL_VAL_UW 0 CM_0000 0 65535 /end CHARACTERISTIC
/begin CHARACTERISTIC K_ED_DMTL_H.P_CODE_SH_TO_GND "Fault code DMTL_H - OBD P-code reported for short to ground [verified]" VALUE 0x71556 RL_VAL_UW 0 CM_0000 0 65535 /end CHARACTERISTIC
/begin CHARACTERISTIC K_ED_DMTL_H.P_CODE_SH_TO_UB "Fault code DMTL_H - OBD P-code reported for short to battery voltage [verified]" VALUE 0x71554 RL_VAL_UW 0 CM_0000 0 65535 /end CHARACTERISTIC
/begin CHARACTERISTIC K_ED_DMTL_H.P_CODE_UNPLAUSIBEL "Fault code DMTL_H - OBD P-code reported for implausible signal [verified]" VALUE 0x7155A RL_VAL_UW 0 CM_0000 0 65535 /end CHARACTERISTIC
/begin CHARACTERISTIC K_ED_DMTL_P.DEC_NACH_EINTRAG "Fault code DMTL_P - debounce filter decrement after fault-memory entry [verified]" VALUE 0x7152D RL_VAL_UB 0 CM_0000 0 255 /end CHARACTERISTIC
/begin CHARACTERISTIC K_ED_DMTL_P.DEC_VOR_EINTRAG "Fault code DMTL_P - debounce filter decrement before fault-memory entry [verified]" VALUE 0x7152B RL_VAL_UB 0 CM_0000 0 255 /end CHARACTERISTIC
/begin CHARACTERISTIC K_ED_DMTL_P.FEHLERSCHWELLE "Fault code DMTL_P - debounce filter threshold for setting the fault [verified]" VALUE 0x71528 RL_VAL_UB 0 CM_0000 0 255 /end CHARACTERISTIC
/begin CHARACTERISTIC K_ED_DMTL_P.INC_NACH_EINTRAG "Fault code DMTL_P - debounce filter increment after fault-memory entry [verified]" VALUE 0x7152C RL_VAL_UB 0 CM_0000 0 255 /end CHARACTERISTIC
/begin CHARACTERISTIC K_ED_DMTL_P.INC_VOR_EINTRAG "Fault code DMTL_P - debounce filter increment before fault-memory entry [verified]" VALUE 0x7152A RL_VAL_UB 0 CM_0000 0 255 /end CHARACTERISTIC
/begin CHARACTERISTIC K_ED_DMTL_P.KLASSENINDEX "Fault code DMTL_P - fault class selection (lamp / warning behaviour) [verified]" VALUE 0x7152E RL_VAL_UB 0 CM_0000 0 255 /end CHARACTERISTIC
/begin CHARACTERISTIC K_ED_DMTL_P.OK_SCHWELLE "Fault code DMTL_P - debounce filter threshold for clearing (healing) the fault [verified]" VALUE 0x71529 RL_VAL_UB 0 CM_0000 0 255 /end CHARACTERISTIC
/begin CHARACTERISTIC K_ED_DMTL_P.P_CODE_OPENLOAD "Fault code DMTL_P - OBD P-code reported for open circuit [verified]" VALUE 0x71524 RL_VAL_UW 0 CM_0000 0 65535 /end CHARACTERISTIC
/begin CHARACTERISTIC K_ED_DMTL_P.P_CODE_SH_TO_GND "Fault code DMTL_P - OBD P-code reported for short to ground [verified]" VALUE 0x71522 RL_VAL_UW 0 CM_0000 0 65535 /end CHARACTERISTIC
/begin CHARACTERISTIC K_ED_DMTL_P.P_CODE_SH_TO_UB "Fault code DMTL_P - OBD P-code reported for short to battery voltage [verified]" VALUE 0x71520 RL_VAL_UW 0 CM_0000 0 65535 /end CHARACTERISTIC
/begin CHARACTERISTIC K_ED_DMTL_P.P_CODE_UNPLAUSIBEL "Fault code DMTL_P - OBD P-code reported for implausible signal [verified]" VALUE 0x71526 RL_VAL_UW 0 CM_0000 0 65535 /end CHARACTERISTIC
/begin CHARACTERISTIC K_ED_DMTL_V.DEC_NACH_EINTRAG "Fault code DMTL_V - debounce filter decrement after fault-memory entry [verified]" VALUE 0x71547 RL_VAL_UB 0 CM_0000 0 255 /end CHARACTERISTIC
/begin CHARACTERISTIC K_ED_DMTL_V.DEC_VOR_EINTRAG "Fault code DMTL_V - debounce filter decrement before fault-memory entry [verified]" VALUE 0x71545 RL_VAL_UB 0 CM_0000 0 255 /end CHARACTERISTIC
/begin CHARACTERISTIC K_ED_DMTL_V.FEHLERSCHWELLE "Fault code DMTL_V - debounce filter threshold for setting the fault [verified]" VALUE 0x71542 RL_VAL_UB 0 CM_0000 0 255 /end CHARACTERISTIC
/begin CHARACTERISTIC K_ED_DMTL_V.INC_NACH_EINTRAG "Fault code DMTL_V - debounce filter increment after fault-memory entry [verified]" VALUE 0x71546 RL_VAL_UB 0 CM_0000 0 255 /end CHARACTERISTIC
/begin CHARACTERISTIC K_ED_DMTL_V.INC_VOR_EINTRAG "Fault code DMTL_V - debounce filter increment before fault-memory entry [verified]" VALUE 0x71544 RL_VAL_UB 0 CM_0000 0 255 /end CHARACTERISTIC
/begin CHARACTERISTIC K_ED_DMTL_V.KLASSENINDEX "Fault code DMTL_V - fault class selection (lamp / warning behaviour) [verified]" VALUE 0x71548 RL_VAL_UB 0 CM_0000 0 255 /end CHARACTERISTIC
/begin CHARACTERISTIC K_ED_DMTL_V.OK_SCHWELLE "Fault code DMTL_V - debounce filter threshold for clearing (healing) the fault [verified]" VALUE 0x71543 RL_VAL_UB 0 CM_0000 0 255 /end CHARACTERISTIC
/begin CHARACTERISTIC K_ED_DMTL_V.P_CODE_OPENLOAD "Fault code DMTL_V - OBD P-code reported for open circuit [verified]" VALUE 0x7153E RL_VAL_UW 0 CM_0000 0 65535 /end CHARACTERISTIC
/begin CHARACTERISTIC K_ED_DMTL_V.P_CODE_SH_TO_GND "Fault code DMTL_V - OBD P-code reported for short to ground [verified]" VALUE 0x7153C RL_VAL_UW 0 CM_0000 0 65535 /end CHARACTERISTIC
/begin CHARACTERISTIC K_ED_DMTL_V.P_CODE_SH_TO_UB "Fault code DMTL_V - OBD P-code reported for short to battery voltage [verified]" VALUE 0x7153A RL_VAL_UW 0 CM_0000 0 65535 /end CHARACTERISTIC
/begin CHARACTERISTIC K_ED_DMTL_V.P_CODE_UNPLAUSIBEL "Fault code DMTL_V - OBD P-code reported for implausible signal [verified]" VALUE 0x71540 RL_VAL_UW 0 CM_0000 0 65535 /end CHARACTERISTIC
/begin CHARACTERISTIC K_ED_E2_INJ.DEC_NACH_EINTRAG "Fault code E2_INJ - debounce filter decrement after fault-memory entry [verified]" VALUE 0x71A41 RL_VAL_UB 0 CM_0000 0 255 /end CHARACTERISTIC
/begin CHARACTERISTIC K_ED_E2_INJ.DEC_VOR_EINTRAG "Fault code E2_INJ - debounce filter decrement before fault-memory entry [verified]" VALUE 0x71A3F RL_VAL_UB 0 CM_0000 0 255 /end CHARACTERISTIC
/begin CHARACTERISTIC K_ED_E2_INJ.FEHLERSCHWELLE "Fault code E2_INJ - debounce filter threshold for setting the fault [verified]" VALUE 0x71A3C RL_VAL_UB 0 CM_0000 0 255 /end CHARACTERISTIC
/begin CHARACTERISTIC K_ED_E2_INJ.INC_NACH_EINTRAG "Fault code E2_INJ - debounce filter increment after fault-memory entry [verified]" VALUE 0x71A40 RL_VAL_UB 0 CM_0000 0 255 /end CHARACTERISTIC
/begin CHARACTERISTIC K_ED_E2_INJ.INC_VOR_EINTRAG "Fault code E2_INJ - debounce filter increment before fault-memory entry [verified]" VALUE 0x71A3E RL_VAL_UB 0 CM_0000 0 255 /end CHARACTERISTIC
/begin CHARACTERISTIC K_ED_E2_INJ.KLASSENINDEX "Fault code E2_INJ - fault class selection (lamp / warning behaviour) [verified]" VALUE 0x71A42 RL_VAL_UB 0 CM_0000 0 255 /end CHARACTERISTIC
/begin CHARACTERISTIC K_ED_E2_INJ.OK_SCHWELLE "Fault code E2_INJ - debounce filter threshold for clearing (healing) the fault [verified]" VALUE 0x71A3D RL_VAL_UB 0 CM_0000 0 255 /end CHARACTERISTIC
/begin CHARACTERISTIC K_ED_E2_INJ.P_CODE_OPENLOAD "Fault code E2_INJ - OBD P-code reported for open circuit [verified]" VALUE 0x71A38 RL_VAL_UW 0 CM_0000 0 65535 /end CHARACTERISTIC
/begin CHARACTERISTIC K_ED_E2_INJ.P_CODE_SH_TO_GND "Fault code E2_INJ - OBD P-code reported for short to ground [verified]" VALUE 0x71A36 RL_VAL_UW 0 CM_0000 0 65535 /end CHARACTERISTIC
/begin CHARACTERISTIC K_ED_E2_INJ.P_CODE_SH_TO_UB "Fault code E2_INJ - OBD P-code reported for short to battery voltage [verified]" VALUE 0x71A34 RL_VAL_UW 0 CM_0000 0 65535 /end CHARACTERISTIC
/begin CHARACTERISTIC K_ED_E2_INJ.P_CODE_UNPLAUSIBEL "Fault code E2_INJ - OBD P-code reported for implausible signal [verified]" VALUE 0x71A3A RL_VAL_UW 0 CM_0000 0 65535 /end CHARACTERISTIC
/begin CHARACTERISTIC K_ED_EBOX_ELU.DEC_NACH_EINTRAG "Fault code EBOX_ELU - debounce filter decrement after fault-memory entry [verified]" VALUE 0x71957 RL_VAL_UB 0 CM_0000 0 255 /end CHARACTERISTIC
/begin CHARACTERISTIC K_ED_EBOX_ELU.DEC_VOR_EINTRAG "Fault code EBOX_ELU - debounce filter decrement before fault-memory entry [verified]" VALUE 0x71955 RL_VAL_UB 0 CM_0000 0 255 /end CHARACTERISTIC
/begin CHARACTERISTIC K_ED_EBOX_ELU.FEHLERSCHWELLE "Fault code EBOX_ELU - debounce filter threshold for setting the fault [verified]" VALUE 0x71952 RL_VAL_UB 0 CM_0000 0 255 /end CHARACTERISTIC
/begin CHARACTERISTIC K_ED_EBOX_ELU.INC_NACH_EINTRAG "Fault code EBOX_ELU - debounce filter increment after fault-memory entry [verified]" VALUE 0x71956 RL_VAL_UB 0 CM_0000 0 255 /end CHARACTERISTIC
/begin CHARACTERISTIC K_ED_EBOX_ELU.INC_VOR_EINTRAG "Fault code EBOX_ELU - debounce filter increment before fault-memory entry [verified]" VALUE 0x71954 RL_VAL_UB 0 CM_0000 0 255 /end CHARACTERISTIC
/begin CHARACTERISTIC K_ED_EBOX_ELU.KLASSENINDEX "Fault code EBOX_ELU - fault class selection (lamp / warning behaviour) [verified]" VALUE 0x71958 RL_VAL_UB 0 CM_0000 0 255 /end CHARACTERISTIC
/begin CHARACTERISTIC K_ED_EBOX_ELU.OK_SCHWELLE "Fault code EBOX_ELU - debounce filter threshold for clearing (healing) the fault [verified]" VALUE 0x71953 RL_VAL_UB 0 CM_0000 0 255 /end CHARACTERISTIC
/begin CHARACTERISTIC K_ED_EBOX_ELU.P_CODE_OPENLOAD "Fault code EBOX_ELU - OBD P-code reported for open circuit [verified]" VALUE 0x7194E RL_VAL_UW 0 CM_0000 0 65535 /end CHARACTERISTIC
/begin CHARACTERISTIC K_ED_EBOX_ELU.P_CODE_SH_TO_GND "Fault code EBOX_ELU - OBD P-code reported for short to ground [verified]" VALUE 0x7194C RL_VAL_UW 0 CM_0000 0 65535 /end CHARACTERISTIC
/begin CHARACTERISTIC K_ED_EBOX_ELU.P_CODE_SH_TO_UB "Fault code EBOX_ELU - OBD P-code reported for short to battery voltage [verified]" VALUE 0x7194A RL_VAL_UW 0 CM_0000 0 65535 /end CHARACTERISTIC
/begin CHARACTERISTIC K_ED_EBOX_ELU.P_CODE_UNPLAUSIBEL "Fault code EBOX_ELU - OBD P-code reported for implausible signal [verified]" VALUE 0x71950 RL_VAL_UW 0 CM_0000 0 65535 /end CHARACTERISTIC
/begin CHARACTERISTIC K_ED_EKP_PWM.DEC_NACH_EINTRAG "Fault code EKP_PWM - debounce filter decrement after fault-memory entry [verified]" VALUE 0x71617 RL_VAL_UB 0 CM_0000 0 255 /end CHARACTERISTIC
/begin CHARACTERISTIC K_ED_EKP_PWM.DEC_VOR_EINTRAG "Fault code EKP_PWM - debounce filter decrement before fault-memory entry [verified]" VALUE 0x71615 RL_VAL_UB 0 CM_0000 0 255 /end CHARACTERISTIC
/begin CHARACTERISTIC K_ED_EKP_PWM.FEHLERSCHWELLE "Fault code EKP_PWM - debounce filter threshold for setting the fault [verified]" VALUE 0x71612 RL_VAL_UB 0 CM_0000 0 255 /end CHARACTERISTIC
/begin CHARACTERISTIC K_ED_EKP_PWM.INC_NACH_EINTRAG "Fault code EKP_PWM - debounce filter increment after fault-memory entry [verified]" VALUE 0x71616 RL_VAL_UB 0 CM_0000 0 255 /end CHARACTERISTIC
/begin CHARACTERISTIC K_ED_EKP_PWM.INC_VOR_EINTRAG "Fault code EKP_PWM - debounce filter increment before fault-memory entry [verified]" VALUE 0x71614 RL_VAL_UB 0 CM_0000 0 255 /end CHARACTERISTIC
/begin CHARACTERISTIC K_ED_EKP_PWM.KLASSENINDEX "Fault code EKP_PWM - fault class selection (lamp / warning behaviour) [verified]" VALUE 0x71618 RL_VAL_UB 0 CM_0000 0 255 /end CHARACTERISTIC
/begin CHARACTERISTIC K_ED_EKP_PWM.OK_SCHWELLE "Fault code EKP_PWM - debounce filter threshold for clearing (healing) the fault [verified]" VALUE 0x71613 RL_VAL_UB 0 CM_0000 0 255 /end CHARACTERISTIC
/begin CHARACTERISTIC K_ED_EKP_PWM.P_CODE_OPENLOAD "Fault code EKP_PWM - OBD P-code reported for open circuit [verified]" VALUE 0x7160E RL_VAL_UW 0 CM_0000 0 65535 /end CHARACTERISTIC
/begin CHARACTERISTIC K_ED_EKP_PWM.P_CODE_SH_TO_GND "Fault code EKP_PWM - OBD P-code reported for short to ground [verified]" VALUE 0x7160C RL_VAL_UW 0 CM_0000 0 65535 /end CHARACTERISTIC
/begin CHARACTERISTIC K_ED_EKP_PWM.P_CODE_SH_TO_UB "Fault code EKP_PWM - OBD P-code reported for short to battery voltage [verified]" VALUE 0x7160A RL_VAL_UW 0 CM_0000 0 65535 /end CHARACTERISTIC
/begin CHARACTERISTIC K_ED_EKP_PWM.P_CODE_UNPLAUSIBEL "Fault code EKP_PWM - OBD P-code reported for implausible signal [verified]" VALUE 0x71610 RL_VAL_UW 0 CM_0000 0 65535 /end CHARACTERISTIC
/begin CHARACTERISTIC K_ED_ELU.DEC_NACH_EINTRAG "Fault code ELU - debounce filter decrement after fault-memory entry [verified]" VALUE 0x71BE1 RL_VAL_UB 0 CM_0000 0 255 /end CHARACTERISTIC
/begin CHARACTERISTIC K_ED_ELU.DEC_VOR_EINTRAG "Fault code ELU - debounce filter decrement before fault-memory entry [verified]" VALUE 0x71BDF RL_VAL_UB 0 CM_0000 0 255 /end CHARACTERISTIC
/begin CHARACTERISTIC K_ED_ELU.FEHLERSCHWELLE "Fault code ELU - debounce filter threshold for setting the fault [verified]" VALUE 0x71BDC RL_VAL_UB 0 CM_0000 0 255 /end CHARACTERISTIC
/begin CHARACTERISTIC K_ED_ELU.INC_NACH_EINTRAG "Fault code ELU - debounce filter increment after fault-memory entry [verified]" VALUE 0x71BE0 RL_VAL_UB 0 CM_0000 0 255 /end CHARACTERISTIC
/begin CHARACTERISTIC K_ED_ELU.INC_VOR_EINTRAG "Fault code ELU - debounce filter increment before fault-memory entry [verified]" VALUE 0x71BDE RL_VAL_UB 0 CM_0000 0 255 /end CHARACTERISTIC
/begin CHARACTERISTIC K_ED_ELU.KLASSENINDEX "Fault code ELU - fault class selection (lamp / warning behaviour) [verified]" VALUE 0x71BE2 RL_VAL_UB 0 CM_0000 0 255 /end CHARACTERISTIC
/begin CHARACTERISTIC K_ED_ELU.OK_SCHWELLE "Fault code ELU - debounce filter threshold for clearing (healing) the fault [verified]" VALUE 0x71BDD RL_VAL_UB 0 CM_0000 0 255 /end CHARACTERISTIC
/begin CHARACTERISTIC K_ED_ELU.P_CODE_OPENLOAD "Fault code ELU - OBD P-code reported for open circuit [verified]" VALUE 0x71BD8 RL_VAL_UW 0 CM_0000 0 65535 /end CHARACTERISTIC
/begin CHARACTERISTIC K_ED_ELU.P_CODE_SH_TO_GND "Fault code ELU - OBD P-code reported for short to ground [verified]" VALUE 0x71BD6 RL_VAL_UW 0 CM_0000 0 65535 /end CHARACTERISTIC
/begin CHARACTERISTIC K_ED_ELU.P_CODE_SH_TO_UB "Fault code ELU - OBD P-code reported for short to battery voltage [verified]" VALUE 0x71BD4 RL_VAL_UW 0 CM_0000 0 65535 /end CHARACTERISTIC
/begin CHARACTERISTIC K_ED_ELU.P_CODE_UNPLAUSIBEL "Fault code ELU - OBD P-code reported for implausible signal [verified]" VALUE 0x71BDA RL_VAL_UW 0 CM_0000 0 65535 /end CHARACTERISTIC
/begin CHARACTERISTIC K_ED_ELUP.DEC_NACH_EINTRAG "Fault code ELUP - debounce filter decrement after fault-memory entry [verified]" VALUE 0x71BC7 RL_VAL_UB 0 CM_0000 0 255 /end CHARACTERISTIC
/begin CHARACTERISTIC K_ED_ELUP.DEC_VOR_EINTRAG "Fault code ELUP - debounce filter decrement before fault-memory entry [verified]" VALUE 0x71BC5 RL_VAL_UB 0 CM_0000 0 255 /end CHARACTERISTIC
/begin CHARACTERISTIC K_ED_ELUP.FEHLERSCHWELLE "Fault code ELUP - debounce filter threshold for setting the fault [verified]" VALUE 0x71BC2 RL_VAL_UB 0 CM_0000 0 255 /end CHARACTERISTIC
/begin CHARACTERISTIC K_ED_ELUP.INC_NACH_EINTRAG "Fault code ELUP - debounce filter increment after fault-memory entry [verified]" VALUE 0x71BC6 RL_VAL_UB 0 CM_0000 0 255 /end CHARACTERISTIC
/begin CHARACTERISTIC K_ED_ELUP.INC_VOR_EINTRAG "Fault code ELUP - debounce filter increment before fault-memory entry [verified]" VALUE 0x71BC4 RL_VAL_UB 0 CM_0000 0 255 /end CHARACTERISTIC
/begin CHARACTERISTIC K_ED_ELUP.KLASSENINDEX "Fault code ELUP - fault class selection (lamp / warning behaviour) [verified]" VALUE 0x71BC8 RL_VAL_UB 0 CM_0000 0 255 /end CHARACTERISTIC
/begin CHARACTERISTIC K_ED_ELUP.OK_SCHWELLE "Fault code ELUP - debounce filter threshold for clearing (healing) the fault [verified]" VALUE 0x71BC3 RL_VAL_UB 0 CM_0000 0 255 /end CHARACTERISTIC
/begin CHARACTERISTIC K_ED_ELUP.P_CODE_OPENLOAD "Fault code ELUP - OBD P-code reported for open circuit [verified]" VALUE 0x71BBE RL_VAL_UW 0 CM_0000 0 65535 /end CHARACTERISTIC
/begin CHARACTERISTIC K_ED_ELUP.P_CODE_SH_TO_GND "Fault code ELUP - OBD P-code reported for short to ground [verified]" VALUE 0x71BBC RL_VAL_UW 0 CM_0000 0 65535 /end CHARACTERISTIC
/begin CHARACTERISTIC K_ED_ELUP.P_CODE_SH_TO_UB "Fault code ELUP - OBD P-code reported for short to battery voltage [verified]" VALUE 0x71BBA RL_VAL_UW 0 CM_0000 0 65535 /end CHARACTERISTIC
/begin CHARACTERISTIC K_ED_ELUP.P_CODE_UNPLAUSIBEL "Fault code ELUP - OBD P-code reported for implausible signal [verified]" VALUE 0x71BC0 RL_VAL_UW 0 CM_0000 0 65535 /end CHARACTERISTIC
/begin CHARACTERISTIC K_ED_EV1.DEC_NACH_EINTRAG "Fault code EV1 - debounce filter decrement after fault-memory entry [verified]" VALUE 0x713A7 RL_VAL_UB 0 CM_0000 0 255 /end CHARACTERISTIC
/begin CHARACTERISTIC K_ED_EV1.DEC_VOR_EINTRAG "Fault code EV1 - debounce filter decrement before fault-memory entry [verified]" VALUE 0x713A5 RL_VAL_UB 0 CM_0000 0 255 /end CHARACTERISTIC
/begin CHARACTERISTIC K_ED_EV1.FEHLERSCHWELLE "Fault code EV1 - debounce filter threshold for setting the fault [verified]" VALUE 0x713A2 RL_VAL_UB 0 CM_0000 0 255 /end CHARACTERISTIC
/begin CHARACTERISTIC K_ED_EV1.INC_NACH_EINTRAG "Fault code EV1 - debounce filter increment after fault-memory entry [verified]" VALUE 0x713A6 RL_VAL_UB 0 CM_0000 0 255 /end CHARACTERISTIC
/begin CHARACTERISTIC K_ED_EV1.INC_VOR_EINTRAG "Fault code EV1 - debounce filter increment before fault-memory entry [verified]" VALUE 0x713A4 RL_VAL_UB 0 CM_0000 0 255 /end CHARACTERISTIC
/begin CHARACTERISTIC K_ED_EV1.KLASSENINDEX "Fault code EV1 - fault class selection (lamp / warning behaviour) [verified]" VALUE 0x713A8 RL_VAL_UB 0 CM_0000 0 255 /end CHARACTERISTIC
/begin CHARACTERISTIC K_ED_EV1.OK_SCHWELLE "Fault code EV1 - debounce filter threshold for clearing (healing) the fault [verified]" VALUE 0x713A3 RL_VAL_UB 0 CM_0000 0 255 /end CHARACTERISTIC
/begin CHARACTERISTIC K_ED_EV1.P_CODE_OPENLOAD "Fault code EV1 - OBD P-code reported for open circuit [verified]" VALUE 0x7139E RL_VAL_UW 0 CM_0000 0 65535 /end CHARACTERISTIC
/begin CHARACTERISTIC K_ED_EV1.P_CODE_SH_TO_GND "Fault code EV1 - OBD P-code reported for short to ground [verified]" VALUE 0x7139C RL_VAL_UW 0 CM_0000 0 65535 /end CHARACTERISTIC
/begin CHARACTERISTIC K_ED_EV1.P_CODE_SH_TO_UB "Fault code EV1 - OBD P-code reported for short to battery voltage [verified]" VALUE 0x7139A RL_VAL_UW 0 CM_0000 0 65535 /end CHARACTERISTIC
/begin CHARACTERISTIC K_ED_EV1.P_CODE_UNPLAUSIBEL "Fault code EV1 - OBD P-code reported for implausible signal [verified]" VALUE 0x713A0 RL_VAL_UW 0 CM_0000 0 65535 /end CHARACTERISTIC
/begin CHARACTERISTIC K_ED_EV10.DEC_NACH_EINTRAG "Fault code EV10 - debounce filter decrement after fault-memory entry [verified]" VALUE 0x71491 RL_VAL_UB 0 CM_0000 0 255 /end CHARACTERISTIC
/begin CHARACTERISTIC K_ED_EV10.DEC_VOR_EINTRAG "Fault code EV10 - debounce filter decrement before fault-memory entry [verified]" VALUE 0x7148F RL_VAL_UB 0 CM_0000 0 255 /end CHARACTERISTIC
/begin CHARACTERISTIC K_ED_EV10.FEHLERSCHWELLE "Fault code EV10 - debounce filter threshold for setting the fault [verified]" VALUE 0x7148C RL_VAL_UB 0 CM_0000 0 255 /end CHARACTERISTIC
/begin CHARACTERISTIC K_ED_EV10.INC_NACH_EINTRAG "Fault code EV10 - debounce filter increment after fault-memory entry [verified]" VALUE 0x71490 RL_VAL_UB 0 CM_0000 0 255 /end CHARACTERISTIC
/begin CHARACTERISTIC K_ED_EV10.INC_VOR_EINTRAG "Fault code EV10 - debounce filter increment before fault-memory entry [verified]" VALUE 0x7148E RL_VAL_UB 0 CM_0000 0 255 /end CHARACTERISTIC
/begin CHARACTERISTIC K_ED_EV10.KLASSENINDEX "Fault code EV10 - fault class selection (lamp / warning behaviour) [verified]" VALUE 0x71492 RL_VAL_UB 0 CM_0000 0 255 /end CHARACTERISTIC
/begin CHARACTERISTIC K_ED_EV10.OK_SCHWELLE "Fault code EV10 - debounce filter threshold for clearing (healing) the fault [verified]" VALUE 0x7148D RL_VAL_UB 0 CM_0000 0 255 /end CHARACTERISTIC
/begin CHARACTERISTIC K_ED_EV10.P_CODE_OPENLOAD "Fault code EV10 - OBD P-code reported for open circuit [verified]" VALUE 0x71488 RL_VAL_UW 0 CM_0000 0 65535 /end CHARACTERISTIC
/begin CHARACTERISTIC K_ED_EV10.P_CODE_SH_TO_GND "Fault code EV10 - OBD P-code reported for short to ground [verified]" VALUE 0x71486 RL_VAL_UW 0 CM_0000 0 65535 /end CHARACTERISTIC
/begin CHARACTERISTIC K_ED_EV10.P_CODE_SH_TO_UB "Fault code EV10 - OBD P-code reported for short to battery voltage [verified]" VALUE 0x71484 RL_VAL_UW 0 CM_0000 0 65535 /end CHARACTERISTIC
/begin CHARACTERISTIC K_ED_EV10.P_CODE_UNPLAUSIBEL "Fault code EV10 - OBD P-code reported for implausible signal [verified]" VALUE 0x7148A RL_VAL_UW 0 CM_0000 0 65535 /end CHARACTERISTIC
/begin CHARACTERISTIC K_ED_EV2.DEC_NACH_EINTRAG "Fault code EV2 - debounce filter decrement after fault-memory entry [verified]" VALUE 0x713C1 RL_VAL_UB 0 CM_0000 0 255 /end CHARACTERISTIC
/begin CHARACTERISTIC K_ED_EV2.DEC_VOR_EINTRAG "Fault code EV2 - debounce filter decrement before fault-memory entry [verified]" VALUE 0x713BF RL_VAL_UB 0 CM_0000 0 255 /end CHARACTERISTIC
/begin CHARACTERISTIC K_ED_EV2.FEHLERSCHWELLE "Fault code EV2 - debounce filter threshold for setting the fault [verified]" VALUE 0x713BC RL_VAL_UB 0 CM_0000 0 255 /end CHARACTERISTIC
/begin CHARACTERISTIC K_ED_EV2.INC_NACH_EINTRAG "Fault code EV2 - debounce filter increment after fault-memory entry [verified]" VALUE 0x713C0 RL_VAL_UB 0 CM_0000 0 255 /end CHARACTERISTIC
/begin CHARACTERISTIC K_ED_EV2.INC_VOR_EINTRAG "Fault code EV2 - debounce filter increment before fault-memory entry [verified]" VALUE 0x713BE RL_VAL_UB 0 CM_0000 0 255 /end CHARACTERISTIC
/begin CHARACTERISTIC K_ED_EV2.KLASSENINDEX "Fault code EV2 - fault class selection (lamp / warning behaviour) [verified]" VALUE 0x713C2 RL_VAL_UB 0 CM_0000 0 255 /end CHARACTERISTIC
/begin CHARACTERISTIC K_ED_EV2.OK_SCHWELLE "Fault code EV2 - debounce filter threshold for clearing (healing) the fault [verified]" VALUE 0x713BD RL_VAL_UB 0 CM_0000 0 255 /end CHARACTERISTIC
/begin CHARACTERISTIC K_ED_EV2.P_CODE_OPENLOAD "Fault code EV2 - OBD P-code reported for open circuit [verified]" VALUE 0x713B8 RL_VAL_UW 0 CM_0000 0 65535 /end CHARACTERISTIC
/begin CHARACTERISTIC K_ED_EV2.P_CODE_SH_TO_GND "Fault code EV2 - OBD P-code reported for short to ground [verified]" VALUE 0x713B6 RL_VAL_UW 0 CM_0000 0 65535 /end CHARACTERISTIC
/begin CHARACTERISTIC K_ED_EV2.P_CODE_SH_TO_UB "Fault code EV2 - OBD P-code reported for short to battery voltage [verified]" VALUE 0x713B4 RL_VAL_UW 0 CM_0000 0 65535 /end CHARACTERISTIC
/begin CHARACTERISTIC K_ED_EV2.P_CODE_UNPLAUSIBEL "Fault code EV2 - OBD P-code reported for implausible signal [verified]" VALUE 0x713BA RL_VAL_UW 0 CM_0000 0 65535 /end CHARACTERISTIC
/begin CHARACTERISTIC K_ED_EV3.DEC_NACH_EINTRAG "Fault code EV3 - debounce filter decrement after fault-memory entry [verified]" VALUE 0x713DB RL_VAL_UB 0 CM_0000 0 255 /end CHARACTERISTIC
/begin CHARACTERISTIC K_ED_EV3.DEC_VOR_EINTRAG "Fault code EV3 - debounce filter decrement before fault-memory entry [verified]" VALUE 0x713D9 RL_VAL_UB 0 CM_0000 0 255 /end CHARACTERISTIC
/begin CHARACTERISTIC K_ED_EV3.FEHLERSCHWELLE "Fault code EV3 - debounce filter threshold for setting the fault [verified]" VALUE 0x713D6 RL_VAL_UB 0 CM_0000 0 255 /end CHARACTERISTIC
/begin CHARACTERISTIC K_ED_EV3.INC_NACH_EINTRAG "Fault code EV3 - debounce filter increment after fault-memory entry [verified]" VALUE 0x713DA RL_VAL_UB 0 CM_0000 0 255 /end CHARACTERISTIC
/begin CHARACTERISTIC K_ED_EV3.INC_VOR_EINTRAG "Fault code EV3 - debounce filter increment before fault-memory entry [verified]" VALUE 0x713D8 RL_VAL_UB 0 CM_0000 0 255 /end CHARACTERISTIC
/begin CHARACTERISTIC K_ED_EV3.KLASSENINDEX "Fault code EV3 - fault class selection (lamp / warning behaviour) [verified]" VALUE 0x713DC RL_VAL_UB 0 CM_0000 0 255 /end CHARACTERISTIC
/begin CHARACTERISTIC K_ED_EV3.OK_SCHWELLE "Fault code EV3 - debounce filter threshold for clearing (healing) the fault [verified]" VALUE 0x713D7 RL_VAL_UB 0 CM_0000 0 255 /end CHARACTERISTIC
/begin CHARACTERISTIC K_ED_EV3.P_CODE_OPENLOAD "Fault code EV3 - OBD P-code reported for open circuit [verified]" VALUE 0x713D2 RL_VAL_UW 0 CM_0000 0 65535 /end CHARACTERISTIC
/begin CHARACTERISTIC K_ED_EV3.P_CODE_SH_TO_GND "Fault code EV3 - OBD P-code reported for short to ground [verified]" VALUE 0x713D0 RL_VAL_UW 0 CM_0000 0 65535 /end CHARACTERISTIC
/begin CHARACTERISTIC K_ED_EV3.P_CODE_SH_TO_UB "Fault code EV3 - OBD P-code reported for short to battery voltage [verified]" VALUE 0x713CE RL_VAL_UW 0 CM_0000 0 65535 /end CHARACTERISTIC
/begin CHARACTERISTIC K_ED_EV3.P_CODE_UNPLAUSIBEL "Fault code EV3 - OBD P-code reported for implausible signal [verified]" VALUE 0x713D4 RL_VAL_UW 0 CM_0000 0 65535 /end CHARACTERISTIC
/begin CHARACTERISTIC K_ED_EV4.DEC_NACH_EINTRAG "Fault code EV4 - debounce filter decrement after fault-memory entry [verified]" VALUE 0x713F5 RL_VAL_UB 0 CM_0000 0 255 /end CHARACTERISTIC
/begin CHARACTERISTIC K_ED_EV4.DEC_VOR_EINTRAG "Fault code EV4 - debounce filter decrement before fault-memory entry [verified]" VALUE 0x713F3 RL_VAL_UB 0 CM_0000 0 255 /end CHARACTERISTIC
/begin CHARACTERISTIC K_ED_EV4.FEHLERSCHWELLE "Fault code EV4 - debounce filter threshold for setting the fault [verified]" VALUE 0x713F0 RL_VAL_UB 0 CM_0000 0 255 /end CHARACTERISTIC
/begin CHARACTERISTIC K_ED_EV4.INC_NACH_EINTRAG "Fault code EV4 - debounce filter increment after fault-memory entry [verified]" VALUE 0x713F4 RL_VAL_UB 0 CM_0000 0 255 /end CHARACTERISTIC
/begin CHARACTERISTIC K_EGAS_CFG_DIAG "Throttle configuration, electrical diagnosis [verified]" VALUE 0x721E1 RL_VAL_UB 0 CM_0000 0 255 /end CHARACTERISTIC
/begin CHARACTERISTIC K_N_BEGR_FERTIGUNG "Rev limit for production/factory [Upm] [verified]" VALUE 0x76020 RL_VAL_SW 0 CM_0002 -32768 32767 /end CHARACTERISTIC
/begin CHARACTERISTIC K_N_BEGR_FETRAWE_WEG "Permitted mileage for rev limit in production or transport mode [km] [verified]" VALUE 0x76026 RL_VAL_UW 0 CM_0082 0 65535 /end CHARACTERISTIC
/begin CHARACTERISTIC K_N_BEGR_SK_RAMPE "Ramp for safety-concept limit [Upm/s] [verified]" VALUE 0x7601F RL_VAL_UB 0 CM_0083 0 25500 /end CHARACTERISTIC
/begin CHARACTERISTIC K_N_BEGR_TI_MAX_E2 "Maximum rev-limit injection, level 2 [Upm] [verified]" VALUE 0x7B67C RL_VAL_SW 0 CM_0002 -32768 32767 /end CHARACTERISTIC
/begin CHARACTERISTIC K_N_BEGR_TRANSPORT "Rev limit for production/factory [Upm] [verified]" VALUE 0x76022 RL_VAL_SW 0 CM_0002 -32768 32767 /end CHARACTERISTIC
/begin CHARACTERISTIC K_N_BEGR_V_FEHLER "Rev limit for production/factory [Upm] [verified]" VALUE 0x76028 RL_VAL_SW 0 CM_0002 -32768 32767 /end CHARACTERISTIC
/begin CHARACTERISTIC K_N_BEGR_WERKSTATT "Rev limit for production/factory [Upm] [verified]" VALUE 0x76024 RL_VAL_SW 0 CM_0002 -32768 32767 /end CHARACTERISTIC
/begin CHARACTERISTIC K_N_OBD_DYN_DELTA "Speed difference for dynamics detection [verified]" VALUE 0x7600C RL_VAL_SW 0 CM_0002 -32768 32767 /end CHARACTERISTIC
/begin CHARACTERISTIC K_N_OBD_DYN_T "Lock-out time for withdrawing speed dynamics [verified]" VALUE 0x7600E RL_VAL_UW 0 CM_0025 0 655.35 /end CHARACTERISTIC
/begin CHARACTERISTIC K_N_OBD_DYN_TAU "Time constant for speed filter, dynamics detection [verified]" VALUE 0x7600A RL_VAL_UB 0 CM_0027 0 255 /end CHARACTERISTIC
/begin CHARACTERISTIC K_SK_CFG__INJ_ "Source: PSB MS_S60 program 754 [verified]" VALUE 0x7851E RL_VAL_UB 0 CM_0000 0 255 /end CHARACTERISTIC
/begin CHARACTERISTIC K_SK_CRC32__INJ_ "Source: PSB MS_S60 program 754 [verified]" VALUE 0x7852C RL_VAL_UB 0 CM_0000 0 255 /end CHARACTERISTIC
/begin CHARACTERISTIC K_SK_EGAS_OFF_TIME__INJ_ "Time until throttle (E-gas) shut-off [s] [verified]" VALUE 0x78538 RL_VAL_UW 0 CM_0025 0 655.35 /end CHARACTERISTIC
/begin CHARACTERISTIC K_SK_FGR_SPERRE__INJ_ "Cruise control lock [verified]" VALUE 0x78531 RL_VAL_UB 0 CM_0000 0 255 /end CHARACTERISTIC
/begin CHARACTERISTIC K_SK_FM_EGAS_TEST__INJ_ "Safety-concept E-gas test mask [verified]" VALUE 0x78521 RL_VAL_UB 0 CM_0000 0 255 /end CHARACTERISTIC
/begin CHARACTERISTIC K_SK_FM_FAIL_ZYL_TEST__INJ_ "Safety-concept injection test mask (1=off) [verified]" VALUE 0x78524 RL_VAL_UW 0 CM_0000 0 65535 /end CHARACTERISTIC
/begin CHARACTERISTIC K_SK_FM_GEMISCH_TEST__INJ_ "Safety-concept mixture test mask [verified]" VALUE 0x78520 RL_VAL_UB 0 CM_0000 0 255 /end CHARACTERISTIC
/begin CHARACTERISTIC K_SK_FM_LAM_TEST__INJ_ "Safety-concept lambda test mask [verified]" VALUE 0x78528 RL_VAL_UB 0 CM_0000 0 255 /end CHARACTERISTIC
/begin CHARACTERISTIC K_SK_FM_MD_TEST__INJ_ "Safety-concept torque test mask [verified]" VALUE 0x78527 RL_VAL_UB 0 CM_0000 0 255 /end CHARACTERISTIC
/begin CHARACTERISTIC K_SK_FM_MVAC_TEST__INJ_ "Source: PSB MS_S60 program 754 [verified]" VALUE 0x78529 RL_VAL_UB 0 CM_0000 0 255 /end CHARACTERISTIC
/begin CHARACTERISTIC K_SK_FM_SMG_TEST__INJ_ "Safety-concept SMG test mask [verified]" VALUE 0x78526 RL_VAL_UB 0 CM_0000 0 255 /end CHARACTERISTIC
/begin CHARACTERISTIC K_SK_FRA_SPERRE__INJ_ "Charge-adaptation lock [verified]" VALUE 0x7852F RL_VAL_UB 0 CM_0000 0 255 /end CHARACTERISTIC
/begin CHARACTERISTIC K_SK_HW_AD_DELTA_MAX "Maximum permitted master-slave difference [digit] [verified]" VALUE 0x786DA RL_VAL_UB 0 CM_0087 0 255 /end CHARACTERISTIC
/begin CHARACTERISTIC K_SK_HW_AD_ED_ZAEHLER "Filter counter for faulty A/D value [s] [verified]" VALUE 0x786DD RL_VAL_UB 0 CM_0020 0 1.275 /end CHARACTERISTIC
/begin CHARACTERISTIC K_SK_HW_AD_STAT "Maximum voltage swing for steady state, pedal sensor 1 [digit] [verified]" VALUE 0x786DB RL_VAL_UB 0 CM_0087 0 255 /end CHARACTERISTIC
/begin CHARACTERISTIC K_SK_HW_AD_STAT_ZAEHLER "Counter for steady state, pedal sensor 1 [s] [verified]" VALUE 0x786DC RL_VAL_UB 0 CM_0020 0 1.275 /end CHARACTERISTIC
/begin CHARACTERISTIC K_SK_KH_SPERRE__INJ_ "Catalyst-heating lock [verified]" VALUE 0x78530 RL_VAL_UB 0 CM_0000 0 255 /end CHARACTERISTIC
/begin CHARACTERISTIC K_SK_LAM_EINGR_TI__INJ_ "Source: PSB MS_S60 program 754 [verified]" VALUE 0x78535 RL_VAL_UB 0 CM_0000 0 255 /end CHARACTERISTIC
/begin CHARACTERISTIC K_SK_LLRA_SPERRE__INJ_ "Idle-controller adaptation lock [verified]" VALUE 0x7852E RL_VAL_UB 0 CM_0000 0 255 /end CHARACTERISTIC
/begin CHARACTERISTIC K_SK_MAX_OS_ERR__INJ_ "Permitted operating-system faults before reset [verified]" VALUE 0x7852A RL_VAL_UB 0 CM_0000 0 255 /end CHARACTERISTIC
/begin CHARACTERISTIC K_SK_MAX_RESETS__INJ_ "Maximum number of resets per ECU run [verified]" VALUE 0x7851F RL_VAL_UB 0 CM_0000 0 255 /end CHARACTERISTIC
/begin CHARACTERISTIC K_SK_MD_BEGR_DK_OFFEN__INJ_ "Limitation with open flaps [verified]" VALUE 0x78534 RL_VAL_UB 0 CM_0000 0 255 /end CHARACTERISTIC
/begin CHARACTERISTIC K_SK_MD_BEGR_MVAC_SYS__INJ_ "Limitation with brake-booster vacuum system fault [verified]" VALUE 0x7853C RL_VAL_UB 0 CM_0000 0 255 /end CHARACTERISTIC
/begin CHARACTERISTIC K_SK_MD_BEGR_RESET__INJ_ "Limitation from the 1st reset [verified]" VALUE 0x7853D RL_VAL_UB 0 CM_0000 0 255 /end CHARACTERISTIC
/begin CHARACTERISTIC K_SK_MD_TI_EINGR__INJ_ "Enable partial firing (cylinder cut-out) [verified]" VALUE 0x78532 RL_VAL_UB 0 CM_0000 0 255 /end CHARACTERISTIC
/begin CHARACTERISTIC K_SK_MD_VL_SPERRE__INJ_ "Full-load lock [verified]" VALUE 0x78533 RL_VAL_UB 0 CM_0000 0 255 /end CHARACTERISTIC
/begin CHARACTERISTIC K_SK_PKS_NOTLAUF__INJ_ "Fuel-pressure-control activation [verified]" VALUE 0x7852D RL_VAL_UB 0 CM_0000 0 255 /end CHARACTERISTIC
/begin CHARACTERISTIC K_SK_PROZ_ERR__INJ_ "Process monitoring mask [verified]" VALUE 0x7853A RL_VAL_UW 0 CM_0000 0 65535 /end CHARACTERISTIC
/begin CHARACTERISTIC K_SK_TASK_ERR__INJ_ "Task monitoring mask [verified]" VALUE 0x7852B RL_VAL_UB 0 CM_0000 0 255 /end CHARACTERISTIC
/begin CHARACTERISTIC K_SK_T_RESET_DELAY_OS__INJ_ "Reset delay for operating-system fault [s] [verified]" VALUE 0x78536 RL_VAL_UB 0 CM_0025 0 2.55 /end CHARACTERISTIC
/begin CHARACTERISTIC K_SK_ZYL_OFF_MAX__INJ_ "Number of cylinders cut per bank [verified]" VALUE 0x78522 RL_VAL_UB 0 CM_0000 0 255 /end CHARACTERISTIC
/begin CHARACTERISTIC K_SCHALTER_GETR_DIAG_N_GETR_EIN_MIN "Minimum gearbox input speed for diagnosis [Upm] [verified]" VALUE 0x784C4 RL_VAL_SW 0 CM_0002 -32768 32767 /end CHARACTERISTIC
/begin CHARACTERISTIC K_SCHALTER_GETR_DIAG_STABIL "Relative stability limit of gearbox ratio for diagnosis [%] [verified]" VALUE 0x784C8 RL_VAL_UB 0 CM_0026 0 199.21875 /end CHARACTERISTIC
/begin CHARACTERISTIC K_SCHALTER_GETR_DIAG_T "Timer limit to end diagnosis [s] [verified]" VALUE 0x784CA RL_VAL_UW 0 CM_0023 0 6553.5 /end CHARACTERISTIC
/begin CHARACTERISTIC K_SCHALTER_GETR_DIAG_V_MIN "Minimum vehicle speed for diagnosis [km/h] [verified]" VALUE 0x784C6 RL_VAL_SW 0 CM_0010 -2048 2047.9375 /end CHARACTERISTIC
/begin CHARACTERISTIC K_SCHALTER_KUPP_DIAG_N "Engine speed to start diagnosis timer [Upm] [verified]" VALUE 0x784D6 RL_VAL_SW 0 CM_0002 -32768 32767 /end CHARACTERISTIC
/begin CHARACTERISTIC K_SCHALTER_KUPP_DIAG_RF "Relative charge to start diagnosis timer [verified]" VALUE 0x784D4 RL_VAL_SW 0 CM_0003 -3.2768 3.2767 /end CHARACTERISTIC
/begin CHARACTERISTIC K_SCHALTER_KUPP_DIAG_T "Timer limit to end diagnosis [s] [verified]" VALUE 0x784D8 RL_VAL_UW 0 CM_0023 0 6553.5 /end CHARACTERISTIC
/begin CHARACTERISTIC K_SCHALTER_KUPP_DIAG_V_MAX "Vehicle speed to start diagnosis timer [km/h] [verified]" VALUE 0x784D2 RL_VAL_SW 0 CM_0010 -2048 2047.9375 /end CHARACTERISTIC
/begin CHARACTERISTIC K_SCHALTER_KUPP_DIAG_V_MIN "Vehicle speed to arm diagnosis [km/h] [verified]" VALUE 0x784D0 RL_VAL_SW 0 CM_0010 -2048 2047.9375 /end CHARACTERISTIC
/begin CHARACTERISTIC K_SCHALTER_POEL_N_DIAG "Oil pressure engine-speed threshold [Upm] [verified]" VALUE 0x784AA RL_VAL_SW 0 CM_0002 -32768 32767 /end CHARACTERISTIC
/begin CHARACTERISTIC K_SCHALTER_POEL_T_DIAG "Oil pressure lock [s] [verified]" VALUE 0x784AC RL_VAL_UW 0 CM_0025 0 655.35 /end CHARACTERISTIC
/begin CHARACTERISTIC K_SK_E2_KOMP_ERR_MAX__INJ_ "Maximum faults for complement comparison [verified]" VALUE 0x7864C RL_VAL_UB 0 CM_0000 0 255 /end CHARACTERISTIC
/begin CHARACTERISTIC K_SK_MAX_RESETS_E2__INJ_ "Maximum number of resets per ECU run, level 2 [verified]" VALUE 0x7864D RL_VAL_UB 0 CM_0000 0 255 /end CHARACTERISTIC
/begin CHARACTERISTIC K_CODIER_INDEX__INJ_ "Coding index [verified]" VALUE 0x7024A RL_VAL_UB 0 CM_0000 0 255 /end CHARACTERISTIC
/begin CHARACTERISTIC K_TPU_KW_N_MIN__INJ_ "Under-speed [verified]" VALUE 0x7A33C RL_VAL_UW 0 CM_0002 0 65535 /end CHARACTERISTIC
/begin CHARACTERISTIC K_TPU_KW_SYNC_ZAHN__INJ_ "Crankshaft interrupt tooth for camshaft sync [verified]" VALUE 0x7A33E RL_VAL_UB 0 CM_0000 0 255 /end CHARACTERISTIC
/begin CHARACTERISTIC KF_OZ_TEMP_KOR "Temperature correction, short-term measurement [verified]" MAP 0x70396 RL_MAP_SW_SW_UW 0 CM_0016 0 63.99902344 /begin AXIS_DESCR STD_AXIS NO_INPUT_QUANTITY CM_0123 6 -9600 9599.707031 /end AXIS_DESCR /begin AXIS_DESCR STD_AXIS NO_INPUT_QUANTITY CM_0124 6 -32768 32767 /end AXIS_DESCR /end CHARACTERISTIC
/begin CHARACTERISTIC KF_SCHNELLMSG_OZNIVR_MIN "Minimum level shortly after terminal 15 on [verified]" MAP 0x7045A RL_MAP_SW_SW_SW 0 CM_0125 -9723.442135 9723.145399 /begin AXIS_DESCR STD_AXIS NO_INPUT_QUANTITY CM_0002 6 -32768 32767 /end AXIS_DESCR /begin AXIS_DESCR STD_AXIS NO_INPUT_QUANTITY CM_0006 6 -3550 3003.5 /end AXIS_DESCR /end CHARACTERISTIC
/begin CHARACTERISTIC KL_GEN_AUSL_BEGR "Generator load limit [verified]" CURVE 0x70318 RL_CUR_SW_UB 0 CM_0126 0 3187.5 /begin AXIS_DESCR STD_AXIS NO_INPUT_QUANTITY CM_0002 5 -32768 32767 /end AXIS_DESCR /end CHARACTERISTIC
/begin CHARACTERISTIC K_GEN_SLP_UG "Generator voltage target during secondary-air-pump operation [verified]" VALUE 0x702A0 RL_VAL_UW 0 CM_0021 0 6553.5 /end CHARACTERISTIC
/begin CHARACTERISTIC K_BSD_BUS_ENABLE "Activate BSD bus [verified]" VALUE 0x70526 RL_VAL_UB 0 CM_0000 0 255 /end CHARACTERISTIC
/begin CHARACTERISTIC K_BSD_KTENABLE "Code word: activated BSD component drivers [verified]" VALUE 0x70547 RL_VAL_UB 0 CM_0000 0 255 /end CHARACTERISTIC
/begin CHARACTERISTIC K_DI1000DT "[verified]" VALUE 0x741AE RL_VAL_UB 0 CM_0127 0 12.75 /end CHARACTERISTIC
/begin CHARACTERISTIC K_DI1000STG "[verified]" VALUE 0x741AC RL_VAL_UB 0 CM_0128 0 20.4 /end CHARACTERISTIC
/begin CHARACTERISTIC K_DI1000TGRZ "[verified]" VALUE 0x741A3 RL_VAL_UB 0 CM_0108 0 255 /end CHARACTERISTIC
/begin CHARACTERISTIC K_DI200DT "[verified]" VALUE 0x741AD RL_VAL_UB 0 CM_0127 0 12.75 /end CHARACTERISTIC
/begin CHARACTERISTIC K_DI200STG "[verified]" VALUE 0x741AB RL_VAL_UB 0 CM_0129 0 5.1 /end CHARACTERISTIC
/begin CHARACTERISTIC K_DIHIGHGRZ "[verified]" VALUE 0x741A7 RL_VAL_UB 0 CM_0128 0 20.4 /end CHARACTERISTIC
/begin CHARACTERISTIC K_DILOWGRZ "[verified]" VALUE 0x741A6 RL_VAL_UB 0 CM_0129 0 5.1 /end CHARACTERISTIC
/begin CHARACTERISTIC K_DIPL5 "[verified]" VALUE 0x741B1 RL_VAL_UB 0 CM_0000 0 255 /end CHARACTERISTIC
/begin CHARACTERISTIC K_DIPL6 "[verified]" VALUE 0x741B2 RL_VAL_UB 0 CM_0000 0 255 /end CHARACTERISTIC
/begin CHARACTERISTIC K_DIPL8 "[verified]" VALUE 0x741C3 RL_VAL_UB 0 CM_0000 0 255 /end CHARACTERISTIC
/begin CHARACTERISTIC K_DKL15FIL "[verified]" VALUE 0x741A9 RL_VAL_UB 0 CM_0130 0 1.59375 /end CHARACTERISTIC
/begin CHARACTERISTIC K_DTMAXGRZI "[verified]" VALUE 0x741A5 RL_VAL_UB 0 CM_0108 0 255 /end CHARACTERISTIC
/begin CHARACTERISTIC K_DUIGRZ "[verified]" VALUE 0x741A4 RL_VAL_UB 0 CM_0129 0 5.1 /end CHARACTERISTIC
/begin CHARACTERISTIC K_DUMINTGRZ "[verified]" VALUE 0x741A8 RL_VAL_UB 0 CM_0127 0 12.75 /end CHARACTERISTIC
/begin CHARACTERISTIC K_DUREFMAX "[verified]" VALUE 0x741AA RL_VAL_UB 0 CM_0131 0 4.998 /end CHARACTERISTIC
/begin CHARACTERISTIC K_DUREFMINI "[verified]" VALUE 0x741C4 RL_VAL_UB 0 CM_0131 0 4.998 /end CHARACTERISTIC
/begin CHARACTERISTIC K_ENABSDIBS "Enable intelligent-battery-sensor communication [verified]" VALUE 0x741D7 RL_VAL_UB 0 CM_0000 0 255 /end CHARACTERISTIC
/begin CHARACTERISTIC K_ENISOC0 "[verified]" VALUE 0x74194 RL_VAL_UB 0 CM_0129 0 5.1 /end CHARACTERISTIC
/begin CHARACTERISTIC K_ENUSOC0 "[verified]" VALUE 0x74195 RL_VAL_UB 0 CM_0132 6 22.32 /end CHARACTERISTIC
/begin CHARACTERISTIC K_IBTEMPMAXI "[verified]" VALUE 0x741C5 RL_VAL_UB 0 CM_0000 0 255 /end CHARACTERISTIC
/begin CHARACTERISTIC K_IBTEMPMINI "[verified]" VALUE 0x741C6 RL_VAL_UB 0 CM_0000 0 255 /end CHARACTERISTIC
/begin CHARACTERISTIC K_ISLEEPGRZ "[verified]" VALUE 0x741A2 RL_VAL_UB 0 CM_0129 0 5.1 /end CHARACTERISTIC
/begin CHARACTERISTIC K_ISTARTTRIG "[verified]" VALUE 0x74199 RL_VAL_UB 0 CM_0133 0 1305.6 /end CHARACTERISTIC
/begin CHARACTERISTIC K_S_CLERRIBS "Intelligent battery sensor fault clearing switchable [verified]" VALUE 0x741DC RL_VAL_UB 0 CM_0000 0 255 /end CHARACTERISTIC
/begin CHARACTERISTIC K_T1SCHWELLE "[verified]" VALUE 0x7419F RL_VAL_UB 0 CM_0134 0 10.2 /end CHARACTERISTIC
/begin CHARACTERISTIC K_T1SOC0 "[verified]" VALUE 0x74196 RL_VAL_UB 0 CM_0135 0 65280 /end CHARACTERISTIC
/begin CHARACTERISTIC K_T2SCHWELLE "[verified]" VALUE 0x741A0 RL_VAL_UB 0 CM_0134 0 10.2 /end CHARACTERISTIC
/begin CHARACTERISTIC K_T2SOC0 "[verified]" VALUE 0x74197 RL_VAL_UB 0 CM_0135 0 65280 /end CHARACTERISTIC
/begin CHARACTERISTIC K_T3SCHWELLE "[verified]" VALUE 0x741A1 RL_VAL_UB 0 CM_0134 0 10.2 /end CHARACTERISTIC
/begin CHARACTERISTIC K_T3SOC0 "[verified]" VALUE 0x74198 RL_VAL_UB 0 CM_0135 0 65280 /end CHARACTERISTIC
/begin CHARACTERISTIC K_TMPCOM_DIV "[verified]" VALUE 0x741B0 RL_VAL_UB 0 CM_0000 0 255 /end CHARACTERISTIC
/begin CHARACTERISTIC K_TMPCOM_MUL "[verified]" VALUE 0x741AF RL_VAL_UB 0 CM_0000 0 255 /end CHARACTERISTIC
/begin CHARACTERISTIC K_TNUSTART "[verified]" VALUE 0x7419A RL_VAL_UB 0 CM_0136 0 3.1875 /end CHARACTERISTIC
/begin CHARACTERISTIC K_TNUSTARTFL "[verified]" VALUE 0x7419B RL_VAL_UB 0 CM_0137 0.01 0.52 /end CHARACTERISTIC
/begin CHARACTERISTIC K_TSLEEPRUH "[verified]" VALUE 0x7419E RL_VAL_UB 0 CM_0138 0 4080 /end CHARACTERISTIC
/begin CHARACTERISTIC K_T_CLERRIBS "Time for clearing intelligent battery sensor faults [verified]" VALUE 0x741DD RL_VAL_UB 0 CM_0000 0 255 /end CHARACTERISTIC
/begin CHARACTERISTIC K_T_UTIEFSET "[verified]" VALUE 0x7419D RL_VAL_UB 0 CM_0108 0 255 /end CHARACTERISTIC
/begin CHARACTERISTIC K_UTIEFAPP "[verified]" VALUE 0x7419C RL_VAL_UB 0 CM_0132 6 22.32 /end CHARACTERISTIC
/begin CHARACTERISTIC K_DIAG_TR_MAX_ERR__INJ_ "Permitted faults before entry as ECU-internal [verified]" VALUE 0x7092C RL_VAL_UB 0 CM_0000 0 255 /end CHARACTERISTIC
/begin CHARACTERISTIC K_ELUP_OBD_BRPGRAD_SW "Diagnosis threshold from brake-pressure gradient [verified]" VALUE 0x72524 RL_VAL_SW 0 CM_0153 -102400 102396.875 /end CHARACTERISTIC
/begin CHARACTERISTIC K_ELUP_OBD_BRPGRAD_T "Filter constant for elup_ed_brp_grad [verified]" VALUE 0x7251F RL_VAL_UB 0 CM_0027 0 255 /end CHARACTERISTIC
/begin CHARACTERISTIC K_ELUP_OBD_MVACP_GRAD_SW "Diagnosis threshold from differential-pressure gradient [verified]" VALUE 0x72522 RL_VAL_SW 0 CM_0154 -2048 2047.9375 /end CHARACTERISTIC
/begin CHARACTERISTIC K_ELUP_OBD_MVACP_GRAD_T "Filter constant for elup_ed_mvacp_grad [verified]" VALUE 0x7251E RL_VAL_UB 0 CM_0027 0 255 /end CHARACTERISTIC
/begin CHARACTERISTIC K_ELUP_OBD_PSAU_SW "Diagnosis threshold from intake pressure vs ambient pressure [verified]" VALUE 0x72520 RL_VAL_SW 0 CM_0022 -2048 2047.9375 /end CHARACTERISTIC
/begin CHARACTERISTIC K_EWS_FETRAWE_WEG "Permitted mileage for auto-activating production mode on EWS-DME alignment [km] [verified]" VALUE 0x725A8 RL_VAL_UW 0 CM_0082 0 65535 /end CHARACTERISTIC
/begin CHARACTERISTIC KF_FPLAU_FRA_OUT_ABW "Relative deviation of fra_out (charge adaptation output) [verified]" MAP 0x72630 RL_MAP_SW_UW_SW 0 CM_0155 -1.000000717 0.9999701992 /begin AXIS_DESCR STD_AXIS NO_INPUT_QUANTITY CM_0002 4 -32768 32767 /end AXIS_DESCR /begin AXIS_DESCR STD_AXIS NO_INPUT_QUANTITY CM_0082 2 0 65535 /end AXIS_DESCR /end CHARACTERISTIC
/begin CHARACTERISTIC KF_FPLAU_OBD_AQ_DELTA_ML_MAX "Maximum permitted deviation [verified]" MAP 0x726F0 RL_MAP_SW_SW_SW 0 CM_0044 -327.68 327.67 /begin AXIS_DESCR STD_AXIS NO_INPUT_QUANTITY CM_0002 8 -32768 32767 /end AXIS_DESCR /begin AXIS_DESCR STD_AXIS NO_INPUT_QUANTITY CM_0003 8 -3.2768 3.2767 /end AXIS_DESCR /end CHARACTERISTIC
/begin CHARACTERISTIC KF_FPLAU_OBD_HFM_DELTA_ML_MAX "Maximum permitted deviation [verified]" MAP 0x72792 RL_MAP_SW_SW_SW 0 CM_0044 -327.68 327.67 /begin AXIS_DESCR STD_AXIS NO_INPUT_QUANTITY CM_0002 8 -32768 32767 /end AXIS_DESCR /begin AXIS_DESCR STD_AXIS NO_INPUT_QUANTITY CM_0003 8 -3.2768 3.2767 /end AXIS_DESCR /end CHARACTERISTIC
/begin CHARACTERISTIC K_FPLAU_OBD_CFG "Enable bit for the plausibility diagnosis [verified]" VALUE 0x725AA RL_VAL_UB 0 CM_0000 0 255 /end CHARACTERISTIC
/begin CHARACTERISTIC KL_LA_TRIM_I_FAK_OBD "Factor on integral share from catalyst ageing [verified]" CURVE 0x742FA RL_CUR_UW_UW 0 CM_0016 0 63.99902344 /begin AXIS_DESCR STD_AXIS NO_INPUT_QUANTITY CM_0019 8 0 3.999941832 /end AXIS_DESCR /end CHARACTERISTIC
/begin CHARACTERISTIC KL_LA_TRIM_P_FAK_OBD "Factor on P share from catalyst ageing [verified]" CURVE 0x7431C RL_CUR_UW_UW 0 CM_0016 0 63.99902344 /begin AXIS_DESCR STD_AXIS NO_INPUT_QUANTITY CM_0019 8 0 3.999941832 /end AXIS_DESCR /end CHARACTERISTIC
/begin CHARACTERISTIC KL_KAT_OBD_LANK_LAM "Lambda from post-cat sensor [verified]" CURVE 0x757C8 RL_CUR_UW_UW 0 CM_0019 0 3.999941832 /begin AXIS_DESCR STD_AXIS NO_INPUT_QUANTITY CM_0163 16 0 319995.1172 /end AXIS_DESCR /end CHARACTERISTIC
/begin CHARACTERISTIC KF_LAM_REG_K_OBD "Controller gain - during OBD pulse generator [verified]" MAP 0x74B26 RL_MAP_SW_SW_SW 0 CM_0164 -128 127.9960938
 /begin AXIS_DESCR STD_AXIS NO_INPUT_QUANTITY CM_0019 7 -2.000001434 1.999940398 /end AXIS_DESCR
 /begin AXIS_DESCR STD_AXIS NO_INPUT_QUANTITY CM_0016 3 -32 31.99902344 /end AXIS_DESCR
/end CHARACTERISTIC
/begin CHARACTERISTIC KF_LAM_SOLL_ADD_NEG_OBD "Lambda pulse amplitude towards RICH [verified]" MAP 0x7548C RL_MAP_SW_SW_UW 0 CM_0019 0 3.999941832 /begin AXIS_DESCR STD_AXIS NO_INPUT_QUANTITY CM_0002 6 -32768 32767 /end AXIS_DESCR /begin AXIS_DESCR STD_AXIS NO_INPUT_QUANTITY CM_0003 6 -3.2768 3.2767 /end AXIS_DESCR /end CHARACTERISTIC
/begin CHARACTERISTIC KF_LAM_SOLL_ADD_POS_OBD "Lambda pulse amplitude towards LEAN [verified]" MAP 0x7542A RL_MAP_SW_SW_UW 0 CM_0019 0 3.999941832 /begin AXIS_DESCR STD_AXIS NO_INPUT_QUANTITY CM_0002 6 -32768 32767 /end AXIS_DESCR /begin AXIS_DESCR STD_AXIS NO_INPUT_QUANTITY CM_0003 6 -3.2768 3.2767 /end AXIS_DESCR /end CHARACTERISTIC
/begin CHARACTERISTIC KF_LAM_SOLL_MS_KAT_SOLL_MIN_OBD "Minimum stored oxygen mass in catalyst - O2 determination [verified]" MAP 0x753C8 RL_MAP_SW_SW_SW 0 CM_0104 -3276.8 3276.7 /begin AXIS_DESCR STD_AXIS NO_INPUT_QUANTITY CM_0002 6 -32768 32767 /end AXIS_DESCR /begin AXIS_DESCR STD_AXIS NO_INPUT_QUANTITY CM_0003 6 -3.2768 3.2767 /end AXIS_DESCR /end CHARACTERISTIC
/begin CHARACTERISTIC K_LAM_DIAG_LAA_F_HYS "Factor hysteresis for lambda adaptation diagnosis [verified]" VALUE 0x74990 RL_VAL_UW 0 CM_0051 0 1.999970916 /end CHARACTERISTIC
/begin CHARACTERISTIC K_LAM_DIAG_LAA_OFFS_HYS "Offset hysteresis for lambda adaptation diagnosis [mg/ASP] [verified]" VALUE 0x74992 RL_VAL_SW 0 CM_0170 -512 511.984375 /end CHARACTERISTIC
/begin CHARACTERISTIC K_LAM_SOLL_MS_KAT_F_OBD "Weighting factor on lambda pulse amplitude when catalyst passive [verified]" VALUE 0x74C8E RL_VAL_UW 0 CM_0016 0 63.99902344 /end CHARACTERISTIC
/begin CHARACTERISTIC K_LAVK_AD_TEST "Sensor adaptation [verified]" VALUE 0x748E8 RL_VAL_UW 0 CM_0000 0 65535 /end CHARACTERISTIC
/begin CHARACTERISTIC K_LAVK_OBD_ACT_CFG "Source: PSB MS_S60 program 754 [verified]" VALUE 0x7592A RL_VAL_UW 0 CM_0000 0 65535 /end CHARACTERISTIC
/begin CHARACTERISTIC K_LAVK_OBD_ACT_ML_SUM "Minimum summed air mass flow after start [mg] [verified]" VALUE 0x7592E RL_VAL_UW 0 CM_0168 0 65535 /end CHARACTERISTIC
/begin CHARACTERISTIC K_LAVK_OBD_ACT_M_T "LEAN delay time - active plausibility diagnosis [s] [verified]" VALUE 0x75938 RL_VAL_UW 0 CM_0023 0 6553.5 /end CHARACTERISTIC
/begin CHARACTERISTIC K_LAVK_OBD_ACT_N_MAX "Maximum engine speed for active plausibility diagnosis [Upm] [verified]" VALUE 0x75934 RL_VAL_SW 0 CM_0002 -32768 32767 /end CHARACTERISTIC
/begin CHARACTERISTIC K_LAVK_OBD_ACT_N_MIN "Minimum engine speed for active plausibility diagnosis [Upm] [verified]" VALUE 0x75936 RL_VAL_SW 0 CM_0002 -32768 32767 /end CHARACTERISTIC
/begin CHARACTERISTIC K_LAVK_OBD_ACT_RF_MAX "Maximum relative charge for active plausibility diagnosis [verified]" VALUE 0x75930 RL_VAL_SW 0 CM_0003 -3.2768 3.2767 /end CHARACTERISTIC
/begin CHARACTERISTIC K_LAVK_OBD_ACT_RF_MIN "Minimum relative charge for active plausibility diagnosis [verified]" VALUE 0x75932 RL_VAL_SW 0 CM_0003 -3.2768 3.2767 /end CHARACTERISTIC
/begin CHARACTERISTIC K_LAVK_OBD_ACT_TKAT "Minimum catalyst temperature - active plausibility diagnosis [?C] [verified]" VALUE 0x7592C RL_VAL_SW 0 CM_0006 -3550 3003.5 /end CHARACTERISTIC
/begin CHARACTERISTIC K_LAVK_OBD_ACT_TRIM_F "Source: PSB MS_S60 program 754 [verified]" VALUE 0x75926 RL_VAL_UW 0 CM_0000 0 65535 /end CHARACTERISTIC
/begin CHARACTERISTIC K_LAVK_OBD_ACT_TRIM_M "Source: PSB MS_S60 program 754 [verified]" VALUE 0x75928 RL_VAL_UW 0 CM_0000 0 65535 /end CHARACTERISTIC
/begin CHARACTERISTIC K_LAVK_OBD_PLAU_F_CNT "RICH plausibility fault counter [verified]" VALUE 0x758F6 RL_VAL_UW 0 CM_0000 0 65535 /end CHARACTERISTIC
/begin CHARACTERISTIC K_LAVK_OBD_PLAU_LAM_FETT "Pre-cat lambda RICH threshold for OBD plausibility [verified]" VALUE 0x758EE RL_VAL_UW 0 CM_0019 0 3.999941832 /end CHARACTERISTIC
/begin CHARACTERISTIC K_LAVK_OBD_PLAU_LAM_MAGER "Pre-cat lambda LEAN threshold for OBD plausibility [verified]" VALUE 0x758F0 RL_VAL_UW 0 CM_0019 0 3.999941832 /end CHARACTERISTIC
/begin CHARACTERISTIC K_LAVK_OBD_PLAU_LAM_MAX "Pre-cat lambda MIN threshold for OBD plausibility [verified]" VALUE 0x758F4 RL_VAL_UW 0 CM_0019 0 3.999941832 /end CHARACTERISTIC
/begin CHARACTERISTIC K_LAVK_OBD_PLAU_LAM_MIN "Pre-cat lambda MIN threshold for OBD plausibility [verified]" VALUE 0x758F2 RL_VAL_UW 0 CM_0019 0 3.999941832 /end CHARACTERISTIC
/begin CHARACTERISTIC K_LAVK_OBD_PLAU_LANK_MAX "Post-cat signal LEAN threshold for OBD plausibility [verified]" VALUE 0x758E0 RL_VAL_UW 0 CM_0163 0 319995.1172 /end CHARACTERISTIC
/begin CHARACTERISTIC K_LAVK_OBD_PLAU_LANK_MIN "Post-cat signal RICH threshold for OBD plausibility [verified]" VALUE 0x758DE RL_VAL_UW 0 CM_0163 0 319995.1172 /end CHARACTERISTIC
/begin CHARACTERISTIC K_LAVK_OBD_PLAU_M_CNT "LEAN plausibility fault counter [verified]" VALUE 0x758F8 RL_VAL_UW 0 CM_0000 0 65535 /end CHARACTERISTIC
/begin CHARACTERISTIC K_LAVK_OBD_PLAU_OL_CNT "Rich/lean plausibility fault counter [verified]" VALUE 0x758FA RL_VAL_UW 0 CM_0000 0 65535 /end CHARACTERISTIC
/begin CHARACTERISTIC K_LAVK_OBD_PLAU_RF_MAX "Maximum relative charge for OBD plausibility [verified]" VALUE 0x758D6 RL_VAL_SW 0 CM_0003 -3.2768 3.2767 /end CHARACTERISTIC
/begin CHARACTERISTIC K_LAVK_OBD_PLAU_RF_MIN "Minimum relative charge for OBD plausibility [verified]" VALUE 0x758D8 RL_VAL_SW 0 CM_0003 -3.2768 3.2767 /end CHARACTERISTIC
/begin CHARACTERISTIC K_LAVK_OBD_PLAU_T "Delay time for OBD plausibility check [s] [verified]" VALUE 0x758FC RL_VAL_UW 0 CM_0023 0 6553.5 /end CHARACTERISTIC
/begin CHARACTERISTIC K_LAVK_OBD_PLAU_TKAT_MAX "Maximum catalyst temperature for OBD plausibility [?C] [verified]" VALUE 0x758DC RL_VAL_SW 0 CM_0006 -3550 3003.5 /end CHARACTERISTIC
/begin CHARACTERISTIC K_LAVK_OBD_PLAU_TKAT_MIN "Minimum catalyst temperature for OBD plausibility [?C] [verified]" VALUE 0x758DA RL_VAL_SW 0 CM_0006 -3550 3003.5 /end CHARACTERISTIC
/begin CHARACTERISTIC K_LAVK_OBD_PLAU_UN_SCHW "Pre-cat threshold for open-load diagnosis [mV] [verified]" VALUE 0x758E2 RL_VAL_UW 0 CM_0163 0 319995.1172 /end CHARACTERISTIC
/begin CHARACTERISTIC K_LSHNK_DIAG_RO "Upper post-cat resistance threshold [Ohm] [verified]" VALUE 0x75B5C RL_VAL_UW 0 CM_0174 0 6553.5 /end CHARACTERISTIC
/begin CHARACTERISTIC K_LSHNK_DIAG_RU "Lower post-cat resistance threshold [Ohm] [verified]" VALUE 0x75B5E RL_VAL_UW 0 CM_0174 0 6553.5 /end CHARACTERISTIC
/begin CHARACTERISTIC K_LSHVK_AD_TEST "Source: PSB MS_S60 program 754 [verified]" VALUE 0x75C7E RL_VAL_UW 0 CM_0000 0 65535 /end CHARACTERISTIC
/begin CHARACTERISTIC K_LSHVK_DIAG_ANZ_MESS "Number of valid measurements [verified]" VALUE 0x75C70 RL_VAL_UW 0 CM_0000 0 65535 /end CHARACTERISTIC
/begin CHARACTERISTIC K_LSHVK_DIAG_CFG "Source: PSB MS_S60 program 754 [verified]" VALUE 0x75C60 RL_VAL_UB 0 CM_0000 0 255 /end CHARACTERISTIC
/begin CHARACTERISTIC K_LSHVK_DIAG_RO "Upper pre-cat resistance threshold [Ohm] [verified]" VALUE 0x75C68 RL_VAL_UW 0 CM_0174 0 6553.5 /end CHARACTERISTIC
/begin CHARACTERISTIC K_LSHVK_DIAG_RU "Lower pre-cat resistance threshold [Ohm] [verified]" VALUE 0x75C6A RL_VAL_UW 0 CM_0174 0 6553.5 /end CHARACTERISTIC
/begin CHARACTERISTIC K_LSHVK_DIAG_R_ADAPT "Initial value of resistance adaptation [Ohm] [verified]" VALUE 0x75C6E RL_VAL_UW 0 CM_0174 0 6553.5 /end CHARACTERISTIC
/begin CHARACTERISTIC K_LSHVK_DIAG_R_OFFSET "Pre-cat heater power diagnosis offset [Ohm] [verified]" VALUE 0x75C6C RL_VAL_UW 0 CM_0174 0 6553.5 /end CHARACTERISTIC
/begin CHARACTERISTIC K_LSHVK_DIAG_R_TAU "Time constant for pre-cat averaging [s] [verified]" VALUE 0x75C66 RL_VAL_UB 0 CM_0027 0 255 /end CHARACTERISTIC
/begin CHARACTERISTIC K_LSHVK_DIAG_TEMP_IST_MAX "Maximum sensor temperature for pre-cat heater diagnosis [?C] [verified]" VALUE 0x75C64 RL_VAL_SW 0 CM_0151 -32768 32767 /end CHARACTERISTIC
/begin CHARACTERISTIC K_LSHVK_DIAG_TEMP_IST_MIN "Minimum sensor temperature for pre-cat heater diagnosis [?C] [verified]" VALUE 0x75C62 RL_VAL_SW 0 CM_0151 -32768 32767 /end CHARACTERISTIC
/begin CHARACTERISTIC K_LSRVK_OBD_CFG "Source: PSB MS_S60 program 754 [verified]" VALUE 0x75C72 RL_VAL_UB 0 CM_0000 0 255 /end CHARACTERISTIC
/begin CHARACTERISTIC K_LSRVK_OBD_ML_SUM "Minimum summed air mass flow after start [mg] [verified]" VALUE 0x75C74 RL_VAL_UW 0 CM_0168 0 65535 /end CHARACTERISTIC
/begin CHARACTERISTIC K_LSRVK_OBD_REF_GAIN_MIN "Minimum gain Ri threshold - reference current diagnosis [verified]" VALUE 0x75CA2 RL_VAL_UW 0 CM_0016 0 63.99902344 /end CHARACTERISTIC
/begin CHARACTERISTIC K_LSRVK_OBD_REG_T "Diagnosis time for maximum end-stop time of heater controller [s] [verified]" VALUE 0x75C7A RL_VAL_UW 0 CM_0027 0 65535 /end CHARACTERISTIC
/begin CHARACTERISTIC K_LSRVK_OBD_START_R "Maximum Ri threshold for diagnosis after engine start [verified]" VALUE 0x75C7C RL_VAL_UW 0 CM_0163 0 319995.1172 /end CHARACTERISTIC
/begin CHARACTERISTIC K_LSRVK_OBD_TKAT_MAX "Maximum catalyst temperature for pre-cat sensor OBD diagnosis [?C] [verified]" VALUE 0x75C78 RL_VAL_SW 0 CM_0006 -3550 3003.5 /end CHARACTERISTIC
/begin CHARACTERISTIC K_LSRVK_OBD_TKAT_MIN "Minimum catalyst temperature for pre-cat sensor OBD diagnosis [?C] [verified]" VALUE 0x75C76 RL_VAL_SW 0 CM_0006 -3550 3003.5 /end CHARACTERISTIC
/begin CHARACTERISTIC K_MVAC_P_DIAG_MAX "Upper limit, brake-booster vacuum [mbar] [verified]" VALUE 0x75ED0 RL_VAL_SW 0 CM_0022 -2048 2047.9375 /end CHARACTERISTIC
/begin CHARACTERISTIC K_MVAC_P_DIAG_MIN "Lower limit, brake-booster vacuum [mbar] [verified]" VALUE 0x75ECE RL_VAL_SW 0 CM_0022 -2048 2047.9375 /end CHARACTERISTIC
/begin CHARACTERISTIC K_MVAC_P_OBD_PDIFF_DELAY "Time delay for calculating mvac_p_diag_pdiff_roh [verified]" VALUE 0x75ED6 RL_VAL_UW 0 CM_0020 0 327.675 /end CHARACTERISTIC
/begin CHARACTERISTIC K_MVAC_P_OBD_PDIFF_ROH_TAU "Time constant for mvac_p_diag_pdiff_roh filter value [verified]" VALUE 0x75ED2 RL_VAL_UW 0 CM_0027 0 65535 /end CHARACTERISTIC
/begin CHARACTERISTIC K_MVAC_P_OBD_PDIFF_TAU "Time constant for mvac_p_diag_pdiff filter value [verified]" VALUE 0x75ED4 RL_VAL_UW 0 CM_0027 0 65535 /end CHARACTERISTIC
/begin CHARACTERISTIC K_MVAC_P_DIAG_TIME_ML "Diagnosis enable via time_ml [verified]" VALUE 0x75ECC RL_VAL_UW 0 CM_0025 0 655.35 /end CHARACTERISTIC
/begin CHARACTERISTIC KF_KAT_OBD_TEMP_REF "Steady-state exhaust temperature after catalyst (aged catalyst) [verified]" MAP 0x76510 RL_MAP_SW_SW_SW 0 CM_0006 -3550 3003.5 /begin AXIS_DESCR STD_AXIS NO_INPUT_QUANTITY CM_0002 7 -32768 32767 /end AXIS_DESCR /begin AXIS_DESCR STD_AXIS NO_INPUT_QUANTITY CM_0003 6 -3.2768 3.2767 /end AXIS_DESCR /end CHARACTERISTIC
/begin CHARACTERISTIC KF_KAT_OBD_WICHT_GESAMT "Determination - overall system diagnosis value [verified]" MAP 0x763CA RL_MAP_UW_UW_UW 0 CM_0019 0 3.999941832 /begin AXIS_DESCR STD_AXIS NO_INPUT_QUANTITY CM_0019 10 0 3.999941832 /end AXIS_DESCR /begin AXIS_DESCR STD_AXIS NO_INPUT_QUANTITY CM_0019 10 0 3.999941832 /end AXIS_DESCR /end CHARACTERISTIC
/begin CHARACTERISTIC KF_LAVK_OBD_DYN_WICHT_GESAMT "Determination - overall system diagnosis value [verified]" MAP 0x766D6 RL_MAP_UW_UW_UW 0 CM_0019 0 3.999941832 /begin AXIS_DESCR STD_AXIS NO_INPUT_QUANTITY CM_0019 10 0 3.999941832 /end AXIS_DESCR /begin AXIS_DESCR STD_AXIS NO_INPUT_QUANTITY CM_0019 10 0 3.999941832 /end AXIS_DESCR /end CHARACTERISTIC
/begin CHARACTERISTIC KL_KAT_OBD_IO_VERZ "Delay of healing depending on diagnosis value [verified]" CURVE 0x762C0 RL_CUR_UW_UW 0 CM_0025 0 655.35 /begin AXIS_DESCR STD_AXIS NO_INPUT_QUANTITY CM_0019 5 0 3.999941832 /end AXIS_DESCR /end CHARACTERISTIC
/begin CHARACTERISTIC KL_LAVK_OBD_DYN_GESAMT_MAX "X: Carbon-canister concentration at purge valve | Value: lavk_obd_dyn_gesamt_max [verified]" CURVE 0x76338 RL_CUR_UW_UW 0 CM_0019 0 3.999941832 /begin AXIS_DESCR STD_AXIS NO_INPUT_QUANTITY CM_0019 4 0 3.999941832 /end AXIS_DESCR /end CHARACTERISTIC
/begin CHARACTERISTIC KL_LAVK_OBD_DYN_IO_VERZ "Delay of healing depending on diagnosis value [verified]" CURVE 0x762D6 RL_CUR_UW_UW 0 CM_0025 0 655.35 /begin AXIS_DESCR STD_AXIS NO_INPUT_QUANTITY CM_0019 5 0 3.999941832 /end AXIS_DESCR /end CHARACTERISTIC
/begin CHARACTERISTIC KL_LAVK_OBD_DYN_RF_MIN "Minimum relative charge for dynamic sensor diagnosis [verified]" CURVE 0x762FE RL_CUR_SW_SW 0 CM_0003 -3.2768 3.2767 /begin AXIS_DESCR STD_AXIS NO_INPUT_QUANTITY CM_0002 5 -32768 32767 /end AXIS_DESCR /end CHARACTERISTIC
/begin CHARACTERISTIC KL_LAVK_OBD_DYN_WERT_MAX "Diagnosis threshold - dynamic sensor diagnosis [verified]" CURVE 0x762EC RL_CUR_UW_UW 0 CM_0019 0 3.999941832 /begin AXIS_DESCR STD_AXIS NO_INPUT_QUANTITY CM_0019 4 0 3.999941832 /end AXIS_DESCR /end CHARACTERISTIC
/begin CHARACTERISTIC K_KAT_OBD_CFG "Source: PSB MS_S60 program 754 [verified]" VALUE 0x7624A RL_VAL_UW 0 CM_0000 0 65535 /end CHARACTERISTIC
/begin CHARACTERISTIC K_KAT_OBD_M_HUB_CNT "Minimum number - forced excitation [verified]" VALUE 0x7624C RL_VAL_UW 0 CM_0000 0 65535 /end CHARACTERISTIC
/begin CHARACTERISTIC K_O2_OBD_DYN_T_VERZ "Delay time during dynamics [s] [verified]" VALUE 0x76240 RL_VAL_UW 0 CM_0064 0 65.535 /end CHARACTERISTIC
/begin CHARACTERISTIC K_O2_OBD_LAM_SOLL_OFFS "Target-lambda offset - additional enrichment/enleanment [verified]" VALUE 0x76248 RL_VAL_SW 0 CM_0019 -2.000001434 1.999940398 /end CHARACTERISTIC
/begin CHARACTERISTIC K_O2_OBD_LAVK_AD_OFFS_MAX "Maximum sensor offset adaptation for pulse enable [mV] [verified]" VALUE 0x76244 RL_VAL_SW 0 CM_0163 -160000 159995.1172 /end CHARACTERISTIC
/begin CHARACTERISTIC K_O2_OBD_LAVK_AD_OFFS_MIN "Minimum sensor offset adaptation for pulse enable [mV] [verified]" VALUE 0x76246 RL_VAL_SW 0 CM_0163 -160000 159995.1172 /end CHARACTERISTIC
/begin CHARACTERISTIC K_O2_OBD_N_MIN "Minimum engine speed for O2 loading [Upm] [verified]" VALUE 0x7623C RL_VAL_SW 0 CM_0002 -32768 32767 /end CHARACTERISTIC
/begin CHARACTERISTIC K_O2_OBD_PUMG_MIN "Minimum ambient pressure [mbar] [verified]" VALUE 0x76242 RL_VAL_SW 0 CM_0022 -2048 2047.9375 /end CHARACTERISTIC
/begin CHARACTERISTIC K_O2_OBD_RF_T_MIN "Delay time when relative charge drops below minimum [s] [verified]" VALUE 0x7623E RL_VAL_UW 0 CM_0064 0 65.535 /end CHARACTERISTIC
/begin CHARACTERISTIC K_OZDIAGNMOT "Minimum engine speed for oil-quality diagnosis [Upm] [verified]" VALUE 0x70A2C RL_VAL_SW 0 CM_0002 -32768 32767 /end CHARACTERISTIC
/begin CHARACTERISTIC K_OZDIAGNMOT2 "Maximum engine speed for oil-quality diagnosis [Upm] [verified]" VALUE 0x70A2E RL_VAL_SW 0 CM_0002 -32768 32767 /end CHARACTERISTIC
/begin CHARACTERISTIC K_OZDIAGSPG "Voltage below which the diagnosis is suppressed [V] [verified]" VALUE 0x70A36 RL_VAL_UW 0 CM_0191 0 6173.397 /end CHARACTERISTIC
/begin CHARACTERISTIC K_PKS_OBD_AY "Maximum lateral acceleration for fuel-pressure diagnosis [m/(s*s)] [verified]" VALUE 0x76D04 RL_VAL_SW 0 CM_0042 -819.2 819.175 /end CHARACTERISTIC
/begin CHARACTERISTIC K_PKS_OBD_CFG "Source: PSB MS_S60 program 754 [verified]" VALUE 0x76CFC RL_VAL_UB 0 CM_0000 0 255 /end CHARACTERISTIC
/begin CHARACTERISTIC K_PKS_OBD_FST "Minimum tank fill level [l] [verified]" VALUE 0x76D02 RL_VAL_UW 0 CM_0192 0 32767.5 /end CHARACTERISTIC
/begin CHARACTERISTIC K_PKS_OBD_LL_MAX "Fuel pressure deviation at idle, maximum [%] [verified]" VALUE 0x76D10 RL_VAL_SW 0 CM_0150 -32768 32767 /end CHARACTERISTIC
/begin CHARACTERISTIC K_PKS_OBD_LL_MIN "Fuel pressure deviation at idle, minimum [%] [verified]" VALUE 0x76D12 RL_VAL_SW 0 CM_0150 -32768 32767 /end CHARACTERISTIC
/begin CHARACTERISTIC K_PKS_OBD_PUMG_MIN "Minimum ambient pressure for fuel-pressure diagnosis [mbar] [verified]" VALUE 0x76CFE RL_VAL_SW 0 CM_0022 -2048 2047.9375 /end CHARACTERISTIC
/begin CHARACTERISTIC K_PKS_OBD_PUMPE_VL "Fuel-pump lead time before diagnosis [s] [verified]" VALUE 0x76D06 RL_VAL_UW 0 CM_0023 0 6553.5 /end CHARACTERISTIC
/begin CHARACTERISTIC K_PKS_OBD_Q_EKP_MAX "Fuel-pump volume flow, maximum [l/h] [verified]" VALUE 0x76D1C RL_VAL_SW 0 CM_0161 -4096 4095.875 /end CHARACTERISTIC
/begin CHARACTERISTIC K_PKS_OBD_Q_EKP_MIN "Fuel-pump volume flow, minimum [l/h] [verified]" VALUE 0x76D1E RL_VAL_SW 0 CM_0161 -4096 4095.875 /end CHARACTERISTIC
/begin CHARACTERISTIC K_PKS_OBD_Q_MAX "Fuel pressure deviation at flow Q, maximum [%] [verified]" VALUE 0x76D18 RL_VAL_SW 0 CM_0150 -32768 32767 /end CHARACTERISTIC
/begin CHARACTERISTIC K_PKS_OBD_Q_MIN "Fuel pressure deviation at flow Q, minimum [%] [verified]" VALUE 0x76D1A RL_VAL_SW 0 CM_0150 -32768 32767 /end CHARACTERISTIC
/begin CHARACTERISTIC K_PKS_OBD_SOLL_DYN_MAX "Maximum dynamics of fuel-pump target pressure [bar] [verified]" VALUE 0x76D0C RL_VAL_SW 0 CM_0142 -32.768 32.767 /end CHARACTERISTIC
/begin CHARACTERISTIC K_PKS_OBD_TL_MAX "Fuel pressure deviation at part load, maximum [%] [verified]" VALUE 0x76D14 RL_VAL_SW 0 CM_0150 -32768 32767 /end CHARACTERISTIC
/begin CHARACTERISTIC K_PKS_OBD_TL_MIN "Fuel pressure deviation at part load, minimum [%] [verified]" VALUE 0x76D16 RL_VAL_SW 0 CM_0150 -32768 32767 /end CHARACTERISTIC
/begin CHARACTERISTIC K_PKS_OBD_TMOT_MIN "Lower engine-temperature limit for diagnosis [?C] [verified]" VALUE 0x76D0E RL_VAL_SW 0 CM_0006 -3550 3003.5 /end CHARACTERISTIC
/begin CHARACTERISTIC K_PKS_OBD_UB_MIN "Minimum terminal-87 voltage for fuel-pressure diagnosis [V] [verified]" VALUE 0x76D00 RL_VAL_SW 0 CM_0021 -3276.8 3276.7 /end CHARACTERISTIC
/begin CHARACTERISTIC K_PKS_OBD_VERZ "Fuel-pump diagnosis delay after dynamics [s] [verified]" VALUE 0x76D08 RL_VAL_UW 0 CM_0023 0 6553.5 /end CHARACTERISTIC
/begin CHARACTERISTIC K_PKS_OBD_VERZ_Q_MAX "Fuel-pump diagnosis delay at maximum flow [s] [verified]" VALUE 0x76D0A RL_VAL_UW 0 CM_0023 0 6553.5 /end CHARACTERISTIC
/begin CHARACTERISTIC S_PM_TEST1 "Calibration switch to force start calculation [verified]" VALUE 0x77974 RL_VAL_UB 0 CM_0000 0 255 /end CHARACTERISTIC
/begin CHARACTERISTIC K_CAN_KEY_NO_MCS "Key number via MCS [verified]" VALUE 0x708FB RL_VAL_UB 0 CM_0000 0 255 /end CHARACTERISTIC
/begin CHARACTERISTIC KL_RF_E2_PUMG_KORR "Correction factor depending on air pressure [verified]" CURVE 0x7B89E RL_CUR_SW_SW 0 CM_0016 -32 31.99902344 /begin AXIS_DESCR STD_AXIS NO_INPUT_QUANTITY CM_0022 8 -2048 2047.9375 /end AXIS_DESCR /end CHARACTERISTIC
/begin CHARACTERISTIC KL_RF_E2_TAN_KORR "- [verified]" CURVE 0x7B8C0 RL_CUR_SW_UW 0 CM_0016 0 63.99902344 /begin AXIS_DESCR STD_AXIS NO_INPUT_QUANTITY CM_0006 8 -3550 3003.5 /end AXIS_DESCR /end CHARACTERISTIC
/begin CHARACTERISTIC KL_SLS_OBDH_ASV_DIA_T "Diagnosis duration, secondary-air valve [verified]" CURVE 0x78C84 RL_CUR_SW_UW 0 CM_0025 0 655.35 /begin AXIS_DESCR STD_AXIS NO_INPUT_QUANTITY CM_0006 6 -3550 3003.5 /end AXIS_DESCR /end CHARACTERISTIC
/begin CHARACTERISTIC KL_SLS_OBDH_HFM_DIAG_MIN "Minimum air-mass delta for detecting air-mass meter OK [EST]" CURVE 0x7891C RL_CUR_UW_SW 0 CM_0087 -32768 32767 /begin AXIS_DESCR STD_AXIS NO_INPUT_QUANTITY CM_0016 4 0 63.99902344 /end AXIS_DESCR /end CHARACTERISTIC
/begin CHARACTERISTIC KL_SLS_OBDH_ML_MDF_DIAG "Switch-on delay of minimum-flow diagnosis [verified]" CURVE 0x73BF4 RL_CUR_SW_UW 0 CM_0025 0 655.35 /begin AXIS_DESCR STD_AXIS NO_INPUT_QUANTITY CM_0006 6 -3550 3003.5 /end AXIS_DESCR /end CHARACTERISTIC
/begin CHARACTERISTIC KL_SPGR_FREQ "Voltage regulator switching frequency [verified]" CURVE 0x78A6C RL_CUR_SW_UW 0 CM_0207 0 65535 /begin AXIS_DESCR STD_AXIS NO_INPUT_QUANTITY CM_0006 2 -3550 3003.5 /end AXIS_DESCR /end CHARACTERISTIC
/begin CHARACTERISTIC KL_STAT_DATA_N "Curve: engine speed for statistics [verified]" CURVE 0x78A76 RL_CUR_SW_SW 0 CM_0000 -32768 32767 /begin AXIS_DESCR STD_AXIS NO_INPUT_QUANTITY CM_0002 8 -32768 32767 /end AXIS_DESCR /end CHARACTERISTIC
/begin CHARACTERISTIC KL_STAT_DATA_RF "Curve: relative charge for statistics [verified]" CURVE 0x78A98 RL_CUR_SW_SW 0 CM_0000 -32768 32767 /begin AXIS_DESCR STD_AXIS NO_INPUT_QUANTITY CM_0003 7 -3.2768 3.2767 /end AXIS_DESCR /end CHARACTERISTIC
/begin CHARACTERISTIC KL_STAT_DATA_TDME "Curve: ECU temperature for statistics [verified]" CURVE 0x78AFA RL_CUR_SW_SW 0 CM_0000 -32768 32767 /begin AXIS_DESCR STD_AXIS NO_INPUT_QUANTITY CM_0006 8 -3550 3003.5 /end AXIS_DESCR /end CHARACTERISTIC
/begin CHARACTERISTIC KL_STAT_DATA_TMOT "Curve: engine temperature for statistics [verified]" CURVE 0x78AB6 RL_CUR_SW_SW 0 CM_0000 -32768 32767 /begin AXIS_DESCR STD_AXIS NO_INPUT_QUANTITY CM_0006 8 -3550 3003.5 /end AXIS_DESCR /end CHARACTERISTIC
/begin CHARACTERISTIC KL_STAT_DATA_TOEL "Curve: oil temperature at oil filter head for statistics [verified]" CURVE 0x78AD8 RL_CUR_SW_SW 0 CM_0000 -32768 32767 /begin AXIS_DESCR STD_AXIS NO_INPUT_QUANTITY CM_0006 8 -3550 3003.5 /end AXIS_DESCR /end CHARACTERISTIC
/begin CHARACTERISTIC KL_STAT_DATA_V "Curve: vehicle speed v_vorne for statistics [verified]" CURVE 0x78B1C RL_CUR_SW_SW 0 CM_0208 -32768 32767 /begin AXIS_DESCR STD_AXIS NO_INPUT_QUANTITY CM_0209 8 -2048 2047.9375 /end AXIS_DESCR /end CHARACTERISTIC
/begin CHARACTERISTIC KL_TE_OBD_RAMPE "Opening profile during purge-valve check [verified]" CURVE 0x79366 RL_CUR_UW_UW 0 CM_0219 0 6399.902344 /begin AXIS_DESCR STD_AXIS NO_INPUT_QUANTITY CM_0091 5 0 6399.902344 /end AXIS_DESCR /end CHARACTERISTIC
/begin CHARACTERISTIC K_TE_OBD_LAM_FREIG "Maximum control error for controller enable [verified]" VALUE 0x7933A RL_VAL_UW 0 CM_0019 0 3.999941832 /end CHARACTERISTIC
/begin CHARACTERISTIC K_TE_OBD_LAM_OK "Number of required lambda reactions [verified]" VALUE 0x79341 RL_VAL_UB 0 CM_0000 0 255 /end CHARACTERISTIC
/begin CHARACTERISTIC K_TE_OBD_LL_DELAY "Wait time after reaching idle [s] [verified]" VALUE 0x7933C RL_VAL_UB 0 CM_0023 0 25.5 /end CHARACTERISTIC
/begin CHARACTERISTIC K_TE_OBD_LL_DELTA "Minimum air mass/rpm reaction on opening for OK [%] [verified]" VALUE 0x7933E RL_VAL_SW 0 CM_0044 -327.68 327.67 /end CHARACTERISTIC
/begin CHARACTERISTIC K_TE_OBD_LL_ZU_DELTA "Minimum air mass/rpm reaction on closing for OK [%] [verified]" VALUE 0x79342 RL_VAL_SW 0 CM_0044 -327.68 327.67 /end CHARACTERISTIC
/begin CHARACTERISTIC K_TE_OBD_LRW_ABBR "Steering-angle change for abort [verified]" VALUE 0x79344 RL_VAL_SW 0 CM_0220 -1440.1536 1440.10965 /end CHARACTERISTIC
/begin CHARACTERISTIC K_TE_OBD_MD_GEN_ABBR "Generator-torque change for abort [Nm] [verified]" VALUE 0x79346 RL_VAL_SW 0 CM_0017 -3276.8 3276.7 /end CHARACTERISTIC
/begin CHARACTERISTIC K_TE_OBD_MD_KKOS_ABBR "A/C compressor torque change for abort [Nm] [verified]" VALUE 0x79348 RL_VAL_SW 0 CM_0221 -16384 16383.5 /end CHARACTERISTIC
/begin CHARACTERISTIC K_TE_OBD_ML_MAX "Maximum air mass ml_ges [kg/h] [verified]" VALUE 0x7934A RL_VAL_SW 0 CM_0102 -3276.8 3276.7 /end CHARACTERISTIC
/begin CHARACTERISTIC K_TE_OBD_TV_MAX "Maximum purge-valve opening [%] [verified]" VALUE 0x79360 RL_VAL_UW 0 CM_0091 0 6399.902344 /end CHARACTERISTIC
/begin CHARACTERISTIC K_TE_OBD_TZ_ABBR "Ignition-angle change for abort [?KW] [verified]" VALUE 0x79362 RL_VAL_SW 0 CM_0028 -3276.8 3276.7 /end CHARACTERISTIC
/begin CHARACTERISTIC K_TE_OBD_UB_ABBR "Voltage change for abort [V] [verified]" VALUE 0x79364 RL_VAL_SW 0 CM_0021 -3276.8 3276.7 /end CHARACTERISTIC
/begin CHARACTERISTIC KF_PUMG_OBD_P_STAU_KOMP "Ambient-pressure ram-pressure compensation [verified]" MAP 0x73F3A RL_MAP_SW_SW_SW 0 CM_0022 -2048 2047.9375 /begin AXIS_DESCR STD_AXIS NO_INPUT_QUANTITY CM_0002 4 -32768 32767 /end AXIS_DESCR /begin AXIS_DESCR STD_AXIS NO_INPUT_QUANTITY CM_0010 4 -2048 2047.9375 /end AXIS_DESCR /end CHARACTERISTIC
/begin CHARACTERISTIC K_PUMG_DIAG_MAX "Upper limit, ambient pressure [mbar] [verified]" VALUE 0x77E96 RL_VAL_SW 0 CM_0022 -2048 2047.9375 /end CHARACTERISTIC
/begin CHARACTERISTIC K_PUMG_DIAG_MIN "Lower limit, ambient pressure [mbar] [verified]" VALUE 0x77E94 RL_VAL_SW 0 CM_0022 -2048 2047.9375 /end CHARACTERISTIC
/begin CHARACTERISTIC KL_FPLAU_OBD_PUMG_F "Minimum limit cold start, intake [verified]" CURVE 0x725D8 RL_CUR_SW_SW 0 CM_0028 -3276.8 3276.7 /begin AXIS_DESCR STD_AXIS NO_INPUT_QUANTITY CM_0106 5 -32768 32767 /end AXIS_DESCR /end CHARACTERISTIC
/begin CHARACTERISTIC K_VAN_INVERT_E2 "Normalisation: de-energised = maximum spread [verified]" VALUE 0x7A3B2 RL_VAL_UB 0 CM_0000 0 255 /end CHARACTERISTIC
/begin CHARACTERISTIC K_LAM_SOLL_MS_KAT_MAX_OBD "Cat filled with max. O2 mass - O2 determination [verified]" VALUE 0x74CCC RL_VAL_SW 0 CM_0104 -3276.8 3276.7 /end CHARACTERISTIC
/begin CHARACTERISTIC K_LAM_SOLL_MS_KAT_MIN_OBD "Cat filled with min. O2 mass - O2 determination [verified]" VALUE 0x74CCE RL_VAL_SW 0 CM_0104 -3276.8 3276.7 /end CHARACTERISTIC
/begin CHARACTERISTIC K_LAM_SOLL_MS_KAT_SOLL_MAX_OBD "Max. stored O2 mass in cat - O2 determination [verified]" VALUE 0x74CA4 RL_VAL_SW 0 CM_0104 -3276.8 3276.7 /end CHARACTERISTIC
/begin CHARACTERISTIC KF_PKSR_PDIAG "Model pressure vs pump speed and volume flow [verified]" MAP 0x77036 RL_MAP_SW_SW_SW 0 CM_0142 -32.768 32.767 /begin AXIS_DESCR STD_AXIS NO_INPUT_QUANTITY CM_0235 12 -32768 32767 /end AXIS_DESCR /begin AXIS_DESCR STD_AXIS NO_INPUT_QUANTITY CM_0252 8 -4096 4095.875 /end AXIS_DESCR /end CHARACTERISTIC
/begin CHARACTERISTIC KF_PKSR_IDIAG "Pump current vs pump speed and volume flow [verified]" MAP 0x77120 RL_MAP_SW_SW_UW 0 CM_0253 0 6553.5 /begin AXIS_DESCR STD_AXIS NO_INPUT_QUANTITY CM_0235 12 -32768 32767 /end AXIS_DESCR /begin AXIS_DESCR STD_AXIS NO_INPUT_QUANTITY CM_0252 8 -4096 4095.875 /end AXIS_DESCR /end CHARACTERISTIC
/begin CHARACTERISTIC KL_PKS_PLAU_INC "Increment values for deviation integrator (plausibility) [verified]" CURVE 0x76D60 RL_CUR_SW_SW 0 CM_0142 -32.768 32.767 /begin AXIS_DESCR STD_AXIS NO_INPUT_QUANTITY CM_0142 11 -32.768 32.767 /end AXIS_DESCR /end CHARACTERISTIC
/begin CHARACTERISTIC K_LA_TRIM_DIAG_I_ED_F "Aufweitungsfaktor auf d. I-Anteils-Bereichsgrenzen [verified]" VALUE 0x74244 RL_VAL_UW 0 CM_0245 0 63.99902344 /end CHARACTERISTIC
/begin CHARACTERISTIC K_LA_TRIM_DIAG_I_AD_F "Aufweitungsfaktor auf d. I-Adaptionss-Bereichsgrenzen [verified]" VALUE 0x7424C RL_VAL_UW 0 CM_0245 0 63.99902344 /end CHARACTERISTIC
/begin CHARACTERISTIC K_LA_TRIM_DIAG_P_SCHW "Anzahl P-Anteil-Fkt.-Durchlaeufe [verified]" VALUE 0x74236 RL_VAL_UW 0 CM_0000 0 65535 /end CHARACTERISTIC
/begin CHARACTERISTIC K_LA_TRIM_DIAG_P_SCHW_T "Resetzeit fuer la_trim_diag_p_cnt [verified]" VALUE 0x7423E RL_VAL_UW 0 CM_0027 0 65535 /end CHARACTERISTIC
/begin CHARACTERISTIC K_N_BEGR_DKG_ERR "Max-Drehzahl bei DKG Fehler [verified]" VALUE 0x7603A RL_VAL_SW 0 CM_0235 -32768 32767 /end CHARACTERISTIC
/begin CHARACTERISTIC K_ELUP_OBD_ABS_DEL "Verzoegerung ELUP_OBD UNPLAUSIBEL durch Einschaltschwelle [EST]" VALUE 0x72054 RL_VAL_UB 0 CM_0023 0 25.5 /end CHARACTERISTIC
/begin CHARACTERISTIC K_ELUP_OBD_DEL "Verzoegerung ELUP_OBD UNPLAUSIBEL durch Druckgradient [EST]" VALUE 0x72055 RL_VAL_UB 0 CM_0023 0 25.5 /end CHARACTERISTIC
/begin CHARACTERISTIC K_N_BEGR_DKG_ERR_NEG "neg. Begrenzung Abregelrampe [verified]" VALUE 0x76038 RL_VAL_UW 0 CM_0081 0 655350 /end CHARACTERISTIC
/begin CHARACTERISTIC K_VAN_KW_SPR_MAX_E2 "KW-Zahn bei max Spreizung [verified]" VALUE 0x7A3CA RL_VAL_SB 0 CM_0292 -128 127 /end CHARACTERISTIC
/begin CHARACTERISTIC K_VAN_EXD_N_SOLL "Van Prueflauf LLR-Sollwert [verified]" VALUE 0x7A388 RL_VAL_SW 0 CM_0002 -32768 32767 /end CHARACTERISTIC
/begin CHARACTERISTIC K_VAN_EXD_SPR_MAX_MIN_E "kleinste gelernte MaxSpr f?r min-Pr?fen [verified]" VALUE 0x7A38A RL_VAL_SW 0 CM_0280 -3276.8 3276.7 /end CHARACTERISTIC
/begin CHARACTERISTIC K_VAN_EXD_SPR_MAX_MIN_A "kleinste gelernte MaxSpr f?r min-Pr?fen [verified]" VALUE 0x7A38C RL_VAL_SW 0 CM_0280 -3276.8 3276.7 /end CHARACTERISTIC
/begin CHARACTERISTIC K_VAN_EXD_T_ANSCHL "Dauer Anschlag pr?fen [verified]" VALUE 0x7A38E RL_VAL_UB 0 CM_0247 0 2.55 /end CHARACTERISTIC
/begin CHARACTERISTIC K_VAN_EXD_LLR_TMAX "Timeout Warten auf Lee rlauf eingeregelt [verified]" VALUE 0x7A390 RL_VAL_UW 0 CM_0247 0 655.35 /end CHARACTERISTIC
/begin CHARACTERISTIC K_VAN_EXD_TMOT_MIN "Min. Temp.f?r Pr?flauf [verified]" VALUE 0x7A392 RL_VAL_SW 0 CM_0256 -3550 3003.5 /end CHARACTERISTIC
/begin CHARACTERISTIC K_VAN_EXD_VERST_SOLL_MAX_E "grosse Spr bei Verstellzei t-messung [verified]" VALUE 0x7A394 RL_VAL_SW 0 CM_0280 -3276.8 3276.7 /end CHARACTERISTIC
/begin CHARACTERISTIC K_VAN_EXD_VERST_SOLL_MIN_E "kleine Spr bei Verstellzeitme s-sung [verified]" VALUE 0x7A398 RL_VAL_SW 0 CM_0280 -3276.8 3276.7 /end CHARACTERISTIC
/begin CHARACTERISTIC K_VAN_EXD_VERST_SOLL_MAX_A "grosse Spr bei Verstellzei t-messung [verified]" VALUE 0x7A396 RL_VAL_SW 0 CM_0280 -3276.8 3276.7 /end CHARACTERISTIC
/begin CHARACTERISTIC K_VAN_EXD_VERST_SOLL_MIN_A "kleine Spr bei Verstellzeitme s-sung [verified]" VALUE 0x7A39A RL_VAL_SW 0 CM_0280 -3276.8 3276.7 /end CHARACTERISTIC
/begin CHARACTERISTIC K_VAN_EXD_VERST_TMAX "Timeout Verstellzeitmessung [verified]" VALUE 0x7A39C RL_VAL_UB 0 CM_0247 0 2.55 /end CHARACTERISTIC
/begin CHARACTERISTIC K_VAN_EXD_VERST_TOL "Abweichung Verstellme ssung Ende [verified]" VALUE 0x7A39E RL_VAL_SW 0 CM_0280 -3276.8 3276.7 /end CHARACTERISTIC
/begin CHARACTERISTIC K_VAN_EXD_VERST_TOL_START "Abweichung Verstellme ssung Start [verified]" VALUE 0x7A3A0 RL_VAL_SW 0 CM_0280 -3276.8 3276.7 /end CHARACTERISTIC
/begin CHARACTERISTIC K_VAN_CFG_E2 "0x0 Flueg 0x1 Hochdr 0x2 MCS ELSE undef. Konfig Vanos Steller/Geberrad [verified]" VALUE 0x7A37D RL_VAL_UB 0 CM_0000 0 255 /end CHARACTERISTIC
/begin CHARACTERISTIC K_VAN_ANSCHL_I_E2 "Ventilstrom am Anschlag max. Spr. [verified]" VALUE 0x7A36E RL_VAL_SW 0 CM_0228 -32768 32767 /end CHARACTERISTIC
/begin CHARACTERISTIC K_VAN_ERR_CFG "0x0 lls+wdk+ti 0x1 lls+ti 0x2 wdk+ti 0x3 ti 0x4 lls+wdk 0x5 lls 0x6 wdk Ersatz-Sollwert bei Fehler 0 [verified]" VALUE 0x7A37F RL_VAL_UB 0 CM_0000 0 255 /end CHARACTERISTIC
/begin CHARACTERISTIC KL_FPLAU_OBD_AQ_PSAU_CSS_F "Tmot-dependent widening factor for AQ/PSAU plausibility (cold start) [EST]" CURVE 0x725EE RL_CUR_SW_UW 0 CM_0016 0 63.99902344 /begin AXIS_DESCR STD_AXIS NO_INPUT_QUANTITY CM_0006 5 -3550 3003.5 /end AXIS_DESCR /end CHARACTERISTIC
/begin CHARACTERISTIC KL_FPLAU_OBD_LAM_CSS_F "Tmot-dependent widening factor for lambda plausibility (cold start) [EST]" CURVE 0x72604 RL_CUR_SW_UW 0 CM_0016 0 63.99902344 /begin AXIS_DESCR STD_AXIS NO_INPUT_QUANTITY CM_0006 5 -3550 3003.5 /end AXIS_DESCR /end CHARACTERISTIC
/begin CHARACTERISTIC KL_FPLAU_OBD_TE_TMOT_T "Diagnosis delay after start vs start coolant temperature (tank vent influence) [verified]" CURVE 0x7261A RL_CUR_SW_UW 0 CM_0025 0 655.35 /begin AXIS_DESCR STD_AXIS NO_INPUT_QUANTITY CM_0006 5 -3550 3003.5 /end AXIS_DESCR /end CHARACTERISTIC
/begin CHARACTERISTIC K_FPLAU_OBD_TMOT_WARM "K?hlwassertemperaturschwelle zum Aktivieren der Diag. Im Wa r- men [verified]" VALUE 0x725AC RL_VAL_SW 0 CM_0256 -3550 3003.5 /end CHARACTERISTIC
/begin CHARACTERISTIC K_FPLAU_OBD_KH_CFG "0 KH inaktiv 1 KH aktiv Auswahl-Bit ? KH muss aktiv f?r die Plausibilit?tsdiagnose [EST]" VALUE 0x725AE RL_VAL_UB 0 CM_0000 0 255 /end CHARACTERISTIC
/begin CHARACTERISTIC K_FPLAU_OBD_SLP_CFG "0 SLS inaktiv 1 SLS aktiv Auswahl-Bit ? SLS muss aktiv f?r die Plausibilit?tsdiagnose [EST]" VALUE 0x725AF RL_VAL_UB 0 CM_0000 0 255 /end CHARACTERISTIC
/begin CHARACTERISTIC K_FPLAU_OBD_TMOT_CSS_MAX "Diag. Im Zustand CSS -TMOT-MAX-Schwelle [verified]" VALUE 0x725B2 RL_VAL_SW 0 CM_0256 -3550 3003.5 /end CHARACTERISTIC
/begin CHARACTERISTIC K_FPLAU_OBD_T_MIN "Diagnose Sperrzeit nach Motor Start [verified]" VALUE 0x725B4 RL_VAL_UW 0 CM_0301 0 6553.5 /end CHARACTERISTIC
/begin CHARACTERISTIC K_FPLAU_OBD_N_MIN "Minimale Motordrehzahl zum Aktiveren der Diagnose [verified]" VALUE 0x725B8 RL_VAL_SW 0 CM_0002 -32768 32767 /end CHARACTERISTIC
/begin CHARACTERISTIC K_FPLAU_OBD_N_MAX "Maximale Motordrehzahl zum Aktiveren der Diagnose [verified]" VALUE 0x725BA RL_VAL_SW 0 CM_0002 -32768 32767 /end CHARACTERISTIC
/begin CHARACTERISTIC K_FPLAU_OBD_RML_MIN "Minimale Luftmasse zum Aktiv e-ren der Diagnose [verified]" VALUE 0x725C8 RL_VAL_SW 0 CM_0255 -3276.8 3276.7 /end CHARACTERISTIC
/begin CHARACTERISTIC K_FPLAU_OBD_ML_MAX "Maximale Luftmasse zum Aktiv e-ren der Diagnose [verified]" VALUE 0x725CA RL_VAL_SW 0 CM_0255 -3276.8 3276.7 /end CHARACTERISTIC
/begin CHARACTERISTIC K_FPLAU_OBD_TE_F "/1024 Aufweitungsfaktor bei TE Einflu? [verified]" VALUE 0x725CC RL_VAL_UW 0 CM_0000 0 65535 /end CHARACTERISTIC
/begin CHARACTERISTIC K_FPLAU_OBD_AQ_RBM_F "/1024 AQ-RBM-Faktor [EST]" VALUE 0x725CE RL_VAL_UW 0 CM_0000 0 65535 /end CHARACTERISTIC
/begin CHARACTERISTIC K_FPLAU_OBD_TE_C_AKF "Schwelle f?r TE-Aufweitungsfaktor [verified]" VALUE 0x725D0 RL_VAL_UW 0 CM_0259 0 3.999938965 /end CHARACTERISTIC
/begin CHARACTERISTIC K_FPLAU_OBD_SPUELEN_INT_F "Aufweitungsfaktor beim ersten Sp?len [EST]" VALUE 0x725D4 RL_VAL_UW 0 CM_0302 0 63.99902344 /end CHARACTERISTIC
/begin CHARACTERISTIC K_FPLAU_OBD_LL_V_MAX "Maxgeschwindigkeit f. FPLAU im LL [verified]" VALUE 0x725D6 RL_VAL_SW 0 CM_0260 -2048 2047.9375 /end CHARACTERISTIC
/begin CHARACTERISTIC K_TE_OBD_AUSS_DELTA "min. auss_int -Reaktion fuer OK [verified]" VALUE 0x7932E RL_VAL_SW 0 CM_0311 -327.68 327.67 /end CHARACTERISTIC
/begin CHARACTERISTIC K_TE_OBD_AUSS_DELTA_NEG "min. negative auss_lp_int -Reaktion fuer OK [verified]" VALUE 0x79330 RL_VAL_SW 0 CM_0311 -327.68 327.67 /end CHARACTERISTIC
/begin CHARACTERISTIC K_TE_OBD_ANZ "0 max. Anzahl der Durchlaeufe [verified]" VALUE 0x79334 RL_VAL_UB 0 CM_0000 0 255 /end CHARACTERISTIC
/begin CHARACTERISTIC K_TE_OBD_CFG "0x0 oh- ne_KKOS_Abwurf LAA_reset 0x1 LAA_freeze 0x2 KKOS_Abwurf 0x3 KKOS_Abwurf LAA_freeze 0x4 RESET [verified]" VALUE 0x79335 RL_VAL_UB 0 CM_0000 0 255 /end CHARACTERISTIC
/begin CHARACTERISTIC K_TE_OBD_LAM_DELTA "min. Reaktion lam_ist_mw fuer OK [verified]" VALUE 0x79336 RL_VAL_UW 0 CM_0259 0 3.999938965 /end CHARACTERISTIC
/begin CHARACTERISTIC K_TE_OBD_F_MIN "min. Tankentl?ftungsfaktor fuer OK [verified]" VALUE 0x79338 RL_VAL_SW 0 CM_0312 -100 99.99694824 /end CHARACTERISTIC
/begin CHARACTERISTIC K_TE_OBD_N_SOLL_ABBR "Aenderung llr_n_soll fuer Abbruch [verified]" VALUE 0x7934C RL_VAL_SW 0 CM_0002 -32768 32767 /end CHARACTERISTIC
/begin CHARACTERISTIC K_TE_OBD_RAMPE_ABBRUCH "Abbruchrampe TEV [verified]" VALUE 0x7934E RL_VAL_UW 0 CM_0219 0 6399.902344 /end CHARACTERISTIC
/begin CHARACTERISTIC K_TE_OBD_RAMPE_ZU "Abregelrampe TEV [verified]" VALUE 0x79350 RL_VAL_UW 0 CM_0219 0 6399.902344 /end CHARACTERISTIC
/begin CHARACTERISTIC K_TE_OBD_T_GEIST "RBM-Geisterj?ger Wart e-zeit te_obd_t_geist [verified]" VALUE 0x79354 RL_VAL_UW 0 CM_0301 0 6553.5 /end CHARACTERISTIC
/begin CHARACTERISTIC K_TE_OBD_T_GEIST_DC "RBM-Geisterj?ger Wart e-zeit te_dc [verified]" VALUE 0x79356 RL_VAL_UW 0 CM_0301 0 6553.5 /end CHARACTERISTIC
/begin CHARACTERISTIC K_TE_OBD_T_LAM_REG_OFF "Max. Sperrzeit Lam-Reg [verified]" VALUE 0x79358 RL_VAL_UB 0 CM_0301 0 25.5 /end CHARACTERISTIC
/begin CHARACTERISTIC K_TE_OBD_T_MESS_OFFEN "Max. Messzeit bei offenen TEV [verified]" VALUE 0x79359 RL_VAL_UB 0 CM_0301 0 25.5 /end CHARACTERISTIC
/begin CHARACTERISTIC K_TE_OBD_T_MESS_ZU "Max. Messzeit bei geschl. TEV [verified]" VALUE 0x7935A RL_VAL_UB 0 CM_0301 0 25.5 /end CHARACTERISTIC
/begin CHARACTERISTIC K_TE_OBD_TOEL_MIN "Mindest toel_modell [verified]" VALUE 0x7935C RL_VAL_SW 0 CM_0256 -3550 3003.5 /end CHARACTERISTIC
/begin CHARACTERISTIC K_TE_OBD_TOEL_MIN_EXD "Mindest toel_modell f?r ext. Diagnose [verified]" VALUE 0x7935E RL_VAL_SW 0 CM_0256 -3550 3003.5 /end CHARACTERISTIC
/begin CHARACTERISTIC K_PKS_PLAU_DELTA_TAU "Filterkonstante f. Abweichung Ist- Modellkraftstoffdruck [verified]" VALUE 0x76D26 RL_VAL_UW 0 CM_0286 0.01 655.35 /end CHARACTERISTIC
/begin CHARACTERISTIC K_PKS_OBD_ABW_TAU "Filterkonstante f. Abweichung Kraftstoffdruck [verified]" VALUE 0x76D28 RL_VAL_UB 0 CM_0306 0.1003921569 25.6 /end CHARACTERISTIC
/begin CHARACTERISTIC K_PKS_OBD_ABW_TAU_QMAX "Filterkonstante bei hohen Volumenstrom [verified]" VALUE 0x76D29 RL_VAL_UB 0 CM_0306 0.1003921569 25.6 /end CHARACTERISTIC
/begin CHARACTERISTIC K_PKS_DIAG_MIN "untere Grenze Kraftstoffdruck [verified]" VALUE 0x76D2A RL_VAL_SW 0 CM_0240 -32.768 32.767 /end CHARACTERISTIC
/begin CHARACTERISTIC K_PKS_DIAG_MAX "obere Grenze Kraftstoffdruck [verified]" VALUE 0x76D2C RL_VAL_SW 0 CM_0240 -32.768 32.767 /end CHARACTERISTIC
/begin CHARACTERISTIC K_PKS_OBD_ERSATZ "Ersatzwert Kraftstoffdruck bei OBD-Fehler [EST]" VALUE 0x76D30 RL_VAL_SW 0 CM_0240 -32.768 32.767 /end CHARACTERISTIC
/begin CHARACTERISTIC K_PKS_OBD_TIME_ML_MIN "Sperrzeit Diagnose nach Start [verified]" VALUE 0x76D32 RL_VAL_UW 0 CM_0247 0 655.35 /end CHARACTERISTIC
/begin CHARACTERISTIC K_PKS_PLAU_SCHWELLE "Fehlerschwelle fuer pks_plau_intg [verified]" VALUE 0x76D34 RL_VAL_SW 0 CM_0315 -32.768 32.767 /end CHARACTERISTIC
/begin CHARACTERISTIC K_PKS_PLAU_INTG_MAX "Minbegrenzung fuer pks_plau_intg [verified]" VALUE 0x76D36 RL_VAL_UW 0 CM_0315 0 65.535 /end CHARACTERISTIC
/begin CHARACTERISTIC K_PKS_PLAU_INTG_MIN "Minbegrenzung fuer pks_plau_intg [verified]" VALUE 0x76D38 RL_VAL_UW 0 CM_0315 0 65.535 /end CHARACTERISTIC
/begin CHARACTERISTIC K_PKS_DIAG_AUFBAU_MIN "Min-Druck bei Druckaufbau Vorlauf/-Start [verified]" VALUE 0x76D3A RL_VAL_SW 0 CM_0240 -32.768 32.767 /end CHARACTERISTIC
/begin CHARACTERISTIC K_PKS_DIAG_AUFBAU_TAU "TAU fuer Druckabweichung s-integral [verified]" VALUE 0x76D3C RL_VAL_UB 0 CM_0306 0.1003921569 25.6 /end CHARACTERISTIC
/begin CHARACTERISTIC K_PKS_AUFBAU_FEHLER_VERZ "Vorzoegerung Kraftstof f-druckaufbau-Diagnose [verified]" VALUE 0x76D3E RL_VAL_UW 0 CM_0301 0 6553.5 /end CHARACTERISTIC
/begin CHARACTERISTIC K_PKS_DIAG_FEHLER_SCHW "Fehlerschwelle fuer Drucka b-weichung [verified]" VALUE 0x76D40 RL_VAL_SW 0 CM_0240 -32.768 32.767 /end CHARACTERISTIC
/begin CHARACTERISTIC K_PKS_PLAU_MAX_I "MAX I -Anteil bis zu der die Plausi durchgefuehrt wird [verified]" VALUE 0x76D42 RL_VAL_SW 0 CM_0254 -3200 3199.902344 /end CHARACTERISTIC
/begin CHARACTERISTIC K_PKS_PLAU_MIN_T_REG "Zeit in Regeleung bis die Plausi durchgefuehrt wird [verified]" VALUE 0x76D44 RL_VAL_UW 0 CM_0247 0 655.35 /end CHARACTERISTIC
/begin CHARACTERISTIC K_PKS_DIAG_AUFBAU_DELAY "Verzoegerungszeit fuer Druckaufbaudiagnose [verified]" VALUE 0x76D46 RL_VAL_UW 0 CM_0247 0 655.35 /end CHARACTERISTIC
/begin CHARACTERISTIC K_PKS_PLAU_QMIN_N "Sperrschwelle bei hoher Drezahl und geringem KVA [verified]" VALUE 0x76D48 RL_VAL_SW 0 CM_0002 -32768 32767 /end CHARACTERISTIC
/begin CHARACTERISTIC K_PKS_PLAU_QMIN_KVA "Sperrschwelle bei hoher Drezahl und geringem KVA [verified]" VALUE 0x76D4A RL_VAL_SW 0 CM_0252 -4096 4095.875 /end CHARACTERISTIC
/begin CHARACTERISTIC K_PKS_PLAU_MIN_RF "min. RF -Schwelle fuer PKS -Plausi [verified]" VALUE 0x76D4C RL_VAL_SW 0 CM_0282 -3.2768 3.2767 /end CHARACTERISTIC
/begin CHARACTERISTIC K_PKS_PLAU_MAX_RF "max. RF -Schwelle fuer PKS -Plausi [verified]" VALUE 0x76D4E RL_VAL_SW 0 CM_0282 -3.2768 3.2767 /end CHARACTERISTIC
/begin CHARACTERISTIC K_PKS_PLAU_MIN_N "min. Drehzahl fuer PKS-Plausi [verified]" VALUE 0x76D50 RL_VAL_SW 0 CM_0002 -32768 32767 /end CHARACTERISTIC
/begin CHARACTERISTIC K_PKS_PLAU_MAX_N "max. Drehzahl fuer PKS -Plausi [verified]" VALUE 0x76D52 RL_VAL_SW 0 CM_0002 -32768 32767 /end CHARACTERISTIC
/begin CHARACTERISTIC K_PKS_PLAU_MIN_Q_EKP "min. Volumenstrom fuer PKS-Plausi [verified]" VALUE 0x76D54 RL_VAL_SW 0 CM_0252 -4096 4095.875 /end CHARACTERISTIC
/begin CHARACTERISTIC K_PKS_PLAU_MAX_Q_EKP "max. Volumenstrom fuer PKS-Plausi [verified]" VALUE 0x76D56 RL_VAL_SW 0 CM_0252 -4096 4095.875 /end CHARACTERISTIC
/begin CHARACTERISTIC K_MVAC_P_OBD_PDIFF_POS "Maximale Differenz zum Modell [EST]" VALUE 0x75ED8 RL_VAL_SW 0 CM_0291 -2048 2047.9375 /end CHARACTERISTIC
/begin CHARACTERISTIC K_MVAC_P_OBD_PDIFF_NEG "minimale Differenz zum M o-dell [EST]" VALUE 0x75EDA RL_VAL_SW 0 CM_0291 -2048 2047.9375 /end CHARACTERISTIC
/begin CHARACTERISTIC K_MVAC_P_OBD_PDIFF_TMOT "minimale Differenz zum M o-dell [EST]" VALUE 0x75EDC RL_VAL_SW 0 CM_0256 -3550 3003.5 /end CHARACTERISTIC
/begin CHARACTERISTIC K_SLS_OBD_CFG "0x0 AUS 0x2 AN-HFM 0x4 AN-LAM 0x8 Prueflauf 0xA AN -HFM- PL ELSE undef i- niert SLS-OBD Konfigbyte [EST]" VALUE 0x788CF RL_VAL_UB 0 CM_0000 0 255 /end CHARACTERISTIC
/begin CHARACTERISTIC K_SLS_OBDH_T_AUFHEIZ "Aufheizverzoegerung fuer Mini-HFM [EST]" VALUE 0x788CE RL_VAL_UB 0 CM_0247 0 2.55 /end CHARACTERISTIC
/begin CHARACTERISTIC K_SLS_OBDH_N_MIN "Abbruchdrezahl n kleiner Schwelle [verified]" VALUE 0x788EA RL_VAL_SW 0 CM_0002 -32768 32767 /end CHARACTERISTIC
/begin CHARACTERISTIC K_SLS_OBDH_N_MAX "Abbruchdrezahl n groesser Schwelle [verified]" VALUE 0x788EC RL_VAL_SW 0 CM_0002 -32768 32767 /end CHARACTERISTIC
/begin CHARACTERISTIC K_SLS_OBDH_ML_MIN "Abbruchlastschwelle bei ml_ges unter Schelle [verified]" VALUE 0x788F0 RL_VAL_SW 0 CM_0255 -3276.8 3276.7 /end CHARACTERISTIC
/begin CHARACTERISTIC K_SLS_OBDH_ML_MAX "Abbruchlastschwelle bei ml_ges ueber Schelle [verified]" VALUE 0x788F2 RL_VAL_SW 0 CM_0255 -3276.8 3276.7 /end CHARACTERISTIC
/begin CHARACTERISTIC K_SLS_OBDH_RF_MIN "Abbruchlastschwelle bei rf unter Schelle [EST]" VALUE 0x788EE RL_VAL_SW 0 CM_0282 -3.2768 3.2767 /end CHARACTERISTIC
/begin CHARACTERISTIC K_SLS_OBD_TMOT_MIN "Min. Temp. fuer die Diagnose [verified]" VALUE 0x788E8 RL_VAL_SW 0 CM_0256 -3550 3003.5 /end CHARACTERISTIC
/begin CHARACTERISTIC K_SLS_OBDH_UB_MIN "UB min. Schwelle fuer di e SLS -Diagnose [verified]" VALUE 0x788E2 RL_VAL_SW 0 CM_0297 -3276.8 3276.7 /end CHARACTERISTIC
/begin CHARACTERISTIC K_SLS_OBDH_PUMG_MIN "Abbruchlastschwelle bei ml_verh unter Schelle [verified]" VALUE 0x788F6 RL_VAL_SW 0 CM_0291 -2048 2047.9375 /end CHARACTERISTIC
/begin CHARACTERISTIC K_SLS_OBDH_MLVERH_MIN "Abbruchlastschwelle bei ml_verh unter Schelle [verified]" VALUE 0x788F4 RL_VAL_UB 0 CM_0150 0 255 /end CHARACTERISTIC
/begin CHARACTERISTIC K_SLS_OBDH_T_SA "Diagnoseabbruch nach time_sa [EST]" VALUE 0x788F8 RL_VAL_UW 0 CM_0247 0 655.35 /end CHARACTERISTIC
/begin CHARACTERISTIC K_PSAU_DIAG_MAX "MAX PSAU fuer Diagnose [verified]" VALUE 0x77BBC RL_VAL_SW 0 CM_0291 -2048 2047.9375 /end CHARACTERISTIC
/begin CHARACTERISTIC K_PSAU_DIAG_MIN "MIN Saugrohrdruch fuer Dia g-nose [verified]" VALUE 0x77BBE RL_VAL_SW 0 CM_0291 -2048 2047.9375 /end CHARACTERISTIC
/begin CHARACTERISTIC K_PSAU_DIAG_TIME_MS_MIN "time_ms fuer PSAU_FEHLER UNPLAUSIBEL [verified]" VALUE 0x77BCF RL_VAL_UB 0 CM_0027 0 255 /end CHARACTERISTIC
/begin CHARACTERISTIC K_PSAU_DIAG_PUMG_ABW "zulaessige psau -Abweichung bei B_ZUST_MS_A [verified]" VALUE 0x77BD0 RL_VAL_SW 0 CM_0291 -2048 2047.9375 /end CHARACTERISTIC
/begin CHARACTERISTIC K_LA_TRIM_DIAG_CFG "0 inaktiv 1 aktiv Freigabe Trimmregelungsdiagnose [verified]" VALUE 0x74230 RL_VAL_UW 0 CM_0000 0 65535 /end CHARACTERISTIC
/begin CHARACTERISTIC K_TGETR_DIAG_TUMG_MIN "Untere Diagnosegrenze Umgebungstemperatur [verified]" VALUE 0x7937C RL_VAL_SW 0 CM_0256 -3550 3003.5 /end CHARACTERISTIC
/begin CHARACTERISTIC K_TGETR_DIAG_MIN "Untere Grenze Getriebetemperatur [verified]" VALUE 0x7937E RL_VAL_SW 0 CM_0303 -1092.35 546.025 /end CHARACTERISTIC
/begin CHARACTERISTIC K_TGETR_DIAG_MAX "Obere Grenze Getriebetemperatur [verified]" VALUE 0x79380 RL_VAL_SW 0 CM_0303 -1092.35 546.025 /end CHARACTERISTIC
/begin CHARACTERISTIC KF_KAT_OBD_INT_WICHT "Wichtungskennfeld [verified]" MAP 0x76368 RL_MAP_SW_SW_UW 0 CM_0245 0 63.99902344 /begin AXIS_DESCR STD_AXIS NO_INPUT_QUANTITY CM_0002 6 -32768 32767 /end AXIS_DESCR /begin AXIS_DESCR STD_AXIS NO_INPUT_QUANTITY CM_0282 6 -3.2768 3.2767 /end AXIS_DESCR /end CHARACTERISTIC
/begin CHARACTERISTIC KL_KAT_OBD_GESAMT_MAX "Diagnoseschwelle - Gesamt-system-KAT-Diag. [verified]" CURVE 0x76326 RL_CUR_UW_UW 0 CM_0259 0 3.999938965 /begin AXIS_DESCR STD_AXIS NO_INPUT_QUANTITY CM_0259 4 0 3.999938965 /end AXIS_DESCR /end CHARACTERISTIC
/begin CHARACTERISTIC KL_KAT_OBD_WERT_MAX "Diagnoseschwelle - max. KAT-Diag. [verified]" CURVE 0x76314 RL_CUR_UW_UW 0 CM_0259 0 3.999938965 /begin AXIS_DESCR STD_AXIS NO_INPUT_QUANTITY CM_0259 4 0 3.999938965 /end AXIS_DESCR /end CHARACTERISTIC
/begin CHARACTERISTIC KL_O2_OBD_RF_MIN "min. relative F?llung f. O2 -Beladung [verified]" CURVE 0x762AA RL_CUR_SW_SW 0 CM_0282 -3.2768 3.2767 /begin AXIS_DESCR STD_AXIS NO_INPUT_QUANTITY CM_0002 5 -32768 32767 /end AXIS_DESCR /end CHARACTERISTIC
/begin CHARACTERISTIC K_BSD_SCHEDTAB_10of32_ "BSD Schedulertabelle [A2L-ref]" VALUE 0x70530 RL_VAL_UB 0 CM_0000 0 255 /end CHARACTERISTIC
/begin CHARACTERISTIC K_BSD_SCHEDTAB_11of32_ "BSD Schedulertabelle [A2L-ref]" VALUE 0x70531 RL_VAL_UB 0 CM_0000 0 255 /end CHARACTERISTIC
/begin CHARACTERISTIC K_BSD_SCHEDTAB_12of32_ "BSD Schedulertabelle [A2L-ref]" VALUE 0x70532 RL_VAL_UB 0 CM_0000 0 255 /end CHARACTERISTIC
/begin CHARACTERISTIC K_BSD_SCHEDTAB_13of32_ "BSD Schedulertabelle [A2L-ref]" VALUE 0x70533 RL_VAL_UB 0 CM_0000 0 255 /end CHARACTERISTIC
/begin CHARACTERISTIC K_BSD_SCHEDTAB_14of32_ "BSD Schedulertabelle [A2L-ref]" VALUE 0x70534 RL_VAL_UB 0 CM_0000 0 255 /end CHARACTERISTIC
/begin CHARACTERISTIC K_BSD_SCHEDTAB_15of32_ "BSD Schedulertabelle [A2L-ref]" VALUE 0x70535 RL_VAL_UB 0 CM_0000 0 255 /end CHARACTERISTIC
/begin CHARACTERISTIC K_BSD_SCHEDTAB_16of32_ "BSD Schedulertabelle [A2L-ref]" VALUE 0x70536 RL_VAL_UB 0 CM_0000 0 255 /end CHARACTERISTIC
/begin CHARACTERISTIC K_BSD_SCHEDTAB_17of32_ "BSD Schedulertabelle [A2L-ref]" VALUE 0x70537 RL_VAL_UB 0 CM_0000 0 255 /end CHARACTERISTIC
/begin CHARACTERISTIC K_BSD_SCHEDTAB_18of32_ "BSD Schedulertabelle [A2L-ref]" VALUE 0x70538 RL_VAL_UB 0 CM_0000 0 255 /end CHARACTERISTIC
/begin CHARACTERISTIC K_BSD_SCHEDTAB_19of32_ "BSD Schedulertabelle [A2L-ref]" VALUE 0x70539 RL_VAL_UB 0 CM_0000 0 255 /end CHARACTERISTIC
/begin CHARACTERISTIC K_BSD_SCHEDTAB_1of32_ "BSD Schedulertabelle [A2L-ref]" VALUE 0x70527 RL_VAL_UB 0 CM_0000 0 255 /end CHARACTERISTIC
/begin CHARACTERISTIC K_BSD_SCHEDTAB_20of32_ "BSD Schedulertabelle [A2L-ref]" VALUE 0x7053A RL_VAL_UB 0 CM_0000 0 255 /end CHARACTERISTIC
/begin CHARACTERISTIC K_BSD_SCHEDTAB_21of32_ "BSD Schedulertabelle [A2L-ref]" VALUE 0x7053B RL_VAL_UB 0 CM_0000 0 255 /end CHARACTERISTIC
/begin CHARACTERISTIC K_BSD_SCHEDTAB_22of32_ "BSD Schedulertabelle [A2L-ref]" VALUE 0x7053C RL_VAL_UB 0 CM_0000 0 255 /end CHARACTERISTIC
/begin CHARACTERISTIC K_BSD_SCHEDTAB_23of32_ "BSD Schedulertabelle [A2L-ref]" VALUE 0x7053D RL_VAL_UB 0 CM_0000 0 255 /end CHARACTERISTIC
/begin CHARACTERISTIC K_BSD_SCHEDTAB_24of32_ "BSD Schedulertabelle [A2L-ref]" VALUE 0x7053E RL_VAL_UB 0 CM_0000 0 255 /end CHARACTERISTIC
/begin CHARACTERISTIC K_BSD_SCHEDTAB_25of32_ "BSD Schedulertabelle [A2L-ref]" VALUE 0x7053F RL_VAL_UB 0 CM_0000 0 255 /end CHARACTERISTIC
/begin CHARACTERISTIC K_BSD_SCHEDTAB_26of32_ "BSD Schedulertabelle [A2L-ref]" VALUE 0x70540 RL_VAL_UB 0 CM_0000 0 255 /end CHARACTERISTIC
/begin CHARACTERISTIC K_BSD_SCHEDTAB_27of32_ "BSD Schedulertabelle [A2L-ref]" VALUE 0x70541 RL_VAL_UB 0 CM_0000 0 255 /end CHARACTERISTIC
/begin CHARACTERISTIC K_BSD_SCHEDTAB_28of32_ "BSD Schedulertabelle [A2L-ref]" VALUE 0x70542 RL_VAL_UB 0 CM_0000 0 255 /end CHARACTERISTIC
/begin CHARACTERISTIC K_BSD_SCHEDTAB_29of32_ "BSD Schedulertabelle [A2L-ref]" VALUE 0x70543 RL_VAL_UB 0 CM_0000 0 255 /end CHARACTERISTIC
/begin CHARACTERISTIC K_BSD_SCHEDTAB_2of32_ "BSD Schedulertabelle [A2L-ref]" VALUE 0x70528 RL_VAL_UB 0 CM_0000 0 255 /end CHARACTERISTIC
/begin CHARACTERISTIC K_BSD_SCHEDTAB_30of32_ "BSD Schedulertabelle [A2L-ref]" VALUE 0x70544 RL_VAL_UB 0 CM_0000 0 255 /end CHARACTERISTIC
/begin CHARACTERISTIC K_BSD_SCHEDTAB_31of32_ "BSD Schedulertabelle [A2L-ref]" VALUE 0x70545 RL_VAL_UB 0 CM_0000 0 255 /end CHARACTERISTIC
/begin CHARACTERISTIC K_BSD_SCHEDTAB_32of32_ "BSD Schedulertabelle [A2L-ref]" VALUE 0x70546 RL_VAL_UB 0 CM_0000 0 255 /end CHARACTERISTIC
/begin CHARACTERISTIC K_BSD_SCHEDTAB_3of32_ "BSD Schedulertabelle [A2L-ref]" VALUE 0x70529 RL_VAL_UB 0 CM_0000 0 255 /end CHARACTERISTIC
/begin CHARACTERISTIC K_BSD_SCHEDTAB_4of32_ "BSD Schedulertabelle [A2L-ref]" VALUE 0x7052A RL_VAL_UB 0 CM_0000 0 255 /end CHARACTERISTIC
/begin CHARACTERISTIC K_BSD_SCHEDTAB_5of32_ "BSD Schedulertabelle [A2L-ref]" VALUE 0x7052B RL_VAL_UB 0 CM_0000 0 255 /end CHARACTERISTIC
/begin CHARACTERISTIC K_BSD_SCHEDTAB_6of32_ "BSD Schedulertabelle [A2L-ref]" VALUE 0x7052C RL_VAL_UB 0 CM_0000 0 255 /end CHARACTERISTIC
/begin CHARACTERISTIC K_BSD_SCHEDTAB_7of32_ "BSD Schedulertabelle [A2L-ref]" VALUE 0x7052D RL_VAL_UB 0 CM_0000 0 255 /end CHARACTERISTIC
/begin CHARACTERISTIC K_BSD_SCHEDTAB_8of32_ "BSD Schedulertabelle [A2L-ref]" VALUE 0x7052E RL_VAL_UB 0 CM_0000 0 255 /end CHARACTERISTIC
/begin CHARACTERISTIC K_BSD_SCHEDTAB_9of32_ "BSD Schedulertabelle [A2L-ref]" VALUE 0x7052F RL_VAL_UB 0 CM_0000 0 255 /end CHARACTERISTIC
/begin CHARACTERISTIC K_CAN_CHKSUM_ERR_MAX "0 Schwelle Chksum-Error [A2L-ref]" VALUE 0x7054E RL_VAL_UB 0 CM_0348 0 255 /end CHARACTERISTIC
/begin CHARACTERISTIC K_CAN_CRASH_CTR_TOUT "5 EKP an 10 EKP aus 15 ungueltig Crash-Kontrolle bei Timeout [A2L-ref]" VALUE 0x7054F RL_VAL_UB 0 CM_0348 0 255 /end CHARACTERISTIC
/begin CHARACTERISTIC K_CAN_ED_TSPERR "ED-Sperrzeit [A2L-ref]" VALUE 0x7054A RL_VAL_UW 0 CM_0020 0 327.675 /end CHARACTERISTIC
/begin CHARACTERISTIC K_CAN_ED_UB_MIN "min. Ub fuer CAN-Diagnose [A2L-ref]" VALUE 0x70548 RL_VAL_SW 0 CM_0021 -3276.8 3276.7 /end CHARACTERISTIC
/begin CHARACTERISTIC K_CAN_TUMG_MCS "Tumg per MCS [A2L-ref]" VALUE 0x70550 RL_VAL_UB 0 CM_0393 -40 87.5 /end CHARACTERISTIC
/begin CHARACTERISTIC K_DIAG_TR_UB_MIN "UB-Schwelle ab der die Treiberdiagnose beginnen [A2L-ref]" VALUE 0x7092A RL_VAL_SW 0 CM_0021 -3276.8 3276.7 /end CHARACTERISTIC
/begin CHARACTERISTIC K_FPLAU_AQ_OBD_CNT "Fehlerschwelle, wenn ?berschri t-ten erfolgt ein Fehlereintrag [A2L-ref]" VALUE 0x725C2 RL_VAL_UB 0 CM_0000 0 255 /end CHARACTERISTIC
/begin CHARACTERISTIC K_FPLAU_HFM_OBD_CNT "Fehlerschwelle, wenn ???berschritten erfolgt ein Fehlereintrag [A2L-ref]" VALUE 0x725C0 RL_VAL_UB 0 CM_0000 0 255 /end CHARACTERISTIC
/begin CHARACTERISTIC K_FPLAU_LAM_OBD_CNT "Fehlerschwelle, wenn ?berschri t-ten erfolgt ein Fehlereintrag [A2L-ref]" VALUE 0x725C1 RL_VAL_UB 0 CM_0000 0 255 /end CHARACTERISTIC
/begin CHARACTERISTIC K_FPLAU_OBD_DYN_DELTA_RF "Dynamikschwelle RF [verified]" VALUE 0x725C4 RL_VAL_SW 0 CM_0003 -3.2768 3.2767 /end CHARACTERISTIC
/begin CHARACTERISTIC K_FPLAU_OBD_DYN_RF_T "Zeit nach Dynamikabbruch durch rf, bevor die Diagnose weiterlaeuft [verified]" VALUE 0x725C6 RL_VAL_UW 0 CM_0025 0 655.35 /end CHARACTERISTIC
/begin CHARACTERISTIC K_FPLAU_OBD_T_DELTA "Zeit nach der die Diagnose als IO betrachtet wird Luftmassenmesser/ Saugrohrdrucksensor Plausibilit? [A2L-ref]" VALUE 0x725BE RL_VAL_UW 0 CM_0023 0 6553.5 /end CHARACTERISTIC
/begin CHARACTERISTIC K_FPLAU_OBD_T_MAX "Maximale Zeit, in der die Abwe i- chung anliegen muss, bis ein Fehler eingetragen wird [A2L-ref]" VALUE 0x725BC RL_VAL_UW 0 CM_0023 0 6553.5 /end CHARACTERISTIC
/begin CHARACTERISTIC K_HFM_OBD_DYN_DELTA_RF "rf Differnez fuer Dynamikerkennung [EST]" VALUE 0x7366E RL_VAL_SW 0 CM_0003 -3.2768 3.2767 /end CHARACTERISTIC
/begin CHARACTERISTIC K_KAT_OBD_LANK_MW_DELTA_MAX "max. Diff d. akt. Wertes zum MW [A2L-ref]" VALUE 0x76252 RL_VAL_UW 0 CM_0236 0 3.999938965 /end CHARACTERISTIC
/begin CHARACTERISTIC K_KAT_OBD_LANK_MW_DIFF_MAX "max. Diff d. MW zum vorher i-gen Zyklus [A2L-ref]" VALUE 0x76254 RL_VAL_UW 0 CM_0236 0 3.999938965 /end CHARACTERISTIC
/begin CHARACTERISTIC K_KAT_OBD_LANK_MW_HYS_CHK1 "Hys. um kat_obd_lank_mw f. Verifikation CHK1 [A2L-ref]" VALUE 0x762A0 RL_VAL_UW 0 CM_0236 0 3.999938965 /end CHARACTERISTIC
/begin CHARACTERISTIC K_KAT_OBD_LANK_MW_MAX "max. Mittelwert LAM-NKAT [A2L-ref]" VALUE 0x7624E RL_VAL_UW 0 CM_0236 0 3.999938965 /end CHARACTERISTIC
/begin CHARACTERISTIC K_KAT_OBD_LANK_MW_MIN "min. Mittelwert LAM-NKAT [A2L-ref]" VALUE 0x76250 RL_VAL_UW 0 CM_0236 0 3.999938965 /end CHARACTERISTIC
/begin CHARACTERISTIC K_KAT_OBD_TABG_T_VERZ "Verzoegerungszeit bei A b-gas-Temperaturgradient [verified]" VALUE 0x7625E RL_VAL_UW 0 CM_0025 0 655.35 /end CHARACTERISTIC
/begin CHARACTERISTIC K_KAT_OBD_VERH "Schwelle f. Wichtungsverhaeltnis - Diag.Wert [A2L-ref]" VALUE 0x76258 RL_VAL_UW 0 CM_0016 0 63.99902344 /end CHARACTERISTIC
/begin CHARACTERISTIC K_KAT_OBD_VERH_SCHWELLE "max. Schelle f. Anzahl d. verworfenen Messungen [A2L-ref]" VALUE 0x7625A RL_VAL_UW 0 CM_0000 0 65535 /end CHARACTERISTIC
/begin CHARACTERISTIC K_KAT_OBD_WERT_MODE6 "max. KAT-Diag.-Schwelle fuer MODE6 [verified]" VALUE 0x7625C RL_VAL_UW 0 CM_0236 0 3.999938965 /end CHARACTERISTIC
/begin CHARACTERISTIC K_KAT_OBD_ZYKL_CNT_MAX "max. Anzahl fuer Diag.Zyklus [verified]" VALUE 0x76256 RL_VAL_UW 0 CM_0000 0 65535 /end CHARACTERISTIC
/begin CHARACTERISTIC K_LAM_DIAG_CFG "0 inaktiv 1 aktiv Diagnose LAM_REG/LAA- Anschlag [verified]" VALUE 0x74986 RL_VAL_UW 0 CM_0348 0 65535 /end CHARACTERISTIC
/begin CHARACTERISTIC K_LAM_DIAG_REG_T "Diagnosezeit - LA-Regleranschlag [verified]" VALUE 0x74988 RL_VAL_UW 0 CM_0023 0 6553.5 /end CHARACTERISTIC
/begin CHARACTERISTIC K_LAM_SOLL_MS_KAT_OFFSET_OBD "OFFSET f?r max. Sauerstoff- masse im Zustand PASSIV /WARTEN [verified]" VALUE 0x74CC4 RL_VAL_SW 0 CM_0104 -3276.8 3276.7 /end CHARACTERISTIC
/begin CHARACTERISTIC K_LANK_DIAG_CFG "Freigabe d. elektrischen Diag. NKAT [A2L-ref]" VALUE 0x75754 RL_VAL_UB 0 CM_0000 0 255 /end CHARACTERISTIC
/begin CHARACTERISTIC K_LANK_DIAG_GND_T "Zeitschwelle-NKAT fuer GND [A2L-ref]" VALUE 0x75760 RL_VAL_UW 0 CM_0025 0 655.35 /end CHARACTERISTIC
/begin CHARACTERISTIC K_LANK_DIAG_MAX_T "Zeitschwelle-NKAT fuer UBATT [A2L-ref]" VALUE 0x7575E RL_VAL_UW 0 CM_0025 0 655.35 /end CHARACTERISTIC
/begin CHARACTERISTIC K_LANK_DIAG_OL_MAGER_CNT "max. Anzahl der MAGERSPRUENGE - OL-Diag. [A2L-ref]" VALUE 0x75774 RL_VAL_UW 0 CM_0000 0 65535 /end CHARACTERISTIC
/begin CHARACTERISTIC K_LANK_DIAG_OL_MAGER_T "Zeit fuer MAGERSPRUNG - OL-Diag. [EST]" VALUE 0x75772 RL_VAL_UW 0 CM_0027 0 65535 /end CHARACTERISTIC
/begin CHARACTERISTIC K_LANK_DIAG_OL_ML_MIN "min. Luftmassendurchsatz f. best. Zeit [EST]" VALUE 0x7576E RL_VAL_SW 0 CM_0102 -3276.8 3276.7 /end CHARACTERISTIC
/begin CHARACTERISTIC K_LANK_DIAG_OL_ML_STABIL_T "min. Zeitschwelle f. Luftmassendurchsatz [EST]" VALUE 0x75770 RL_VAL_UW 0 CM_0027 0 65535 /end CHARACTERISTIC
/begin CHARACTERISTIC K_LANK_DIAG_OL_N_MAX "max. n-Schwelle f. OL-Diagnose [A2L-ref]" VALUE 0x75766 RL_VAL_SW 0 CM_0002 -32768 32767 /end CHARACTERISTIC
/begin CHARACTERISTIC K_LANK_DIAG_OL_T "Zeitschwelle-NKAT fuer OL [A2L-ref]" VALUE 0x75762 RL_VAL_UW 0 CM_0027 0 65535 /end CHARACTERISTIC
/begin CHARACTERISTIC K_LANK_DIAG_SONDTEMP "min. Sondentemperatur [A2L-ref]" VALUE 0x7575A RL_VAL_SW 0 CM_0006 -3550 3003.5 /end CHARACTERISTIC
/begin CHARACTERISTIC K_LANK_DIAG_STAB_T "Zeitschwelle f. stab. Zustand [A2L-ref]" VALUE 0x7575C RL_VAL_UW 0 CM_0025 0 655.35 /end CHARACTERISTIC
/begin CHARACTERISTIC K_LANK_DIAG_TKAT "KAT-Temperaturschwelle [A2L-ref]" VALUE 0x75758 RL_VAL_SW 0 CM_0006 -3550 3003.5 /end CHARACTERISTIC
/begin CHARACTERISTIC K_LANK_DIAG_UMAX "MAX. NKAT-Sondenspannung [A2L-ref]" VALUE 0x75768 RL_VAL_UW 0 CM_0163 0 319995.1172 /end CHARACTERISTIC
/begin CHARACTERISTIC K_LANK_DIAG_UMIN "MIN. NKAT-Sondenspannung [A2L-ref]" VALUE 0x7576A RL_VAL_UW 0 CM_0163 0 319995.1172 /end CHARACTERISTIC
/begin CHARACTERISTIC K_LANK_DIAG_VK_REG_T "Aktivzeit VKAT-Regler [A2L-ref]" VALUE 0x75756 RL_VAL_UW 0 CM_0025 0 655.35 /end CHARACTERISTIC
/begin CHARACTERISTIC K_LANK_OBD_SLOPE_CNT_IO "Anzahl i.O. Slope-Diagnosen im DCY [EST]" VALUE 0x757A0 RL_VAL_UB 0 CM_0000 0 255 /end CHARACTERISTIC
/begin CHARACTERISTIC K_LANK_OBD_SLOPE_F_MAX "Wichtung d. Bezugswertes f. MAX-Schwelle - SLOPE-SA-Diag. [EST]" VALUE 0x7579A RL_VAL_UW 0 CM_0091 0 6399.902344 /end CHARACTERISTIC
/begin CHARACTERISTIC K_LANK_OBD_SLOPE_F_MIN "Wichtung d. Bezugswertes f. MIN-Schwelle - SLOPE-SA-Diag. [EST]" VALUE 0x7579C RL_VAL_UW 0 CM_0091 0 6399.902344 /end CHARACTERISTIC
/begin CHARACTERISTIC K_LANK_OBD_SLOPE_HYS "Hysterese fuer [EST]" VALUE 0x7579E RL_VAL_SW 0 CM_0163 -160000 159995.1172 /end CHARACTERISTIC
/begin CHARACTERISTIC K_LANK_OBD_S_CFG "0 inaktiv 1 aktiv Freigabe d. NKAT - Schwingungspr. [A2L-ref]" VALUE 0x75776 RL_VAL_UW 0 CM_0000 0 65535 /end CHARACTERISTIC
/begin CHARACTERISTIC K_LANK_OBD_S_SA_ML_SUM "min. aufsummierte Luftmassen-str. fuer SA-Diag. [EST]" VALUE 0x7578C RL_VAL_UW 0 CM_0168 0 65535 /end CHARACTERISTIC
/begin CHARACTERISTIC K_LANK_OBD_S_SA_T_MIN_MODE6 "Min. Abfallszeit des NKAT -Signals in SA f. MODE 6 [A2L-ref]" VALUE 0x757B6 RL_VAL_UW 0 CM_0152 0 6553500 /end CHARACTERISTIC
/begin CHARACTERISTIC K_LANK_OBD_S_SA_T_MODE6_FALSE "fehlerhafte Abfallszeit des NKAT-Signals in SA f. MODE 6 [A2L-ref]" VALUE 0x757B8 RL_VAL_UW 0 CM_0152 0 6553500 /end CHARACTERISTIC
/begin CHARACTERISTIC K_LANK_OBD_S_USF_SA "Fettschwelle fuer Aktivierung SA-Diag. [A2L-ref]" VALUE 0x75778 RL_VAL_UW 0 CM_0163 0 319995.1172 /end CHARACTERISTIC
/begin CHARACTERISTIC K_LANK_OBD_S_USF_SLOPE_MAX "Max. Fettschwelle fuer Freigabe d. SLOPE-Diag. [EST]" VALUE 0x757A4 RL_VAL_UW 0 CM_0163 0 319995.1172 /end CHARACTERISTIC
/begin CHARACTERISTIC K_LAVK_ATIC42_SPI_DIAG_CNT "Fehlerschwelle f. ATIC42-SPI-Diag. [EST]" VALUE 0x7596A RL_VAL_UW 0 CM_0000 0 65535 /end CHARACTERISTIC
/begin CHARACTERISTIC K_LAVK_OBD_ACT_EXD_N_SOLL "Prueflauf - angeforderte Dreh-zahl [A2L-ref]" VALUE 0x75954 RL_VAL_SW 0 CM_0002 -32768 32767 /end CHARACTERISTIC
/begin CHARACTERISTIC K_LAVK_OBD_ACT_LAM_IST_F "LA-Schwelle f. FETT-Fehler [A2L-ref]" VALUE 0x75942 RL_VAL_UW 0 CM_0236 0 3.999938965 /end CHARACTERISTIC
/begin CHARACTERISTIC K_LAVK_OBD_ACT_LAM_IST_M "LA-Schwelle f. MAGER-Fehler [A2L-ref]" VALUE 0x75940 RL_VAL_UW 0 CM_0236 0 3.999938965 /end CHARACTERISTIC
/begin CHARACTERISTIC K_LAVK_OBD_ACT_LAM_SOLL_F "SOLL-Lambda - FETT-Diagnose [verified]" VALUE 0x7593E RL_VAL_UW 0 CM_0236 0 3.999938965 /end CHARACTERISTIC
/begin CHARACTERISTIC K_LAVK_OBD_ACT_LAM_SOLL_M "SOLL-Lambda - MAGER-Diagnose [verified]" VALUE 0x7593C RL_VAL_UW 0 CM_0236 0 3.999938965 /end CHARACTERISTIC
/begin CHARACTERISTIC K_LAVK_OBD_ACT_LANK_F "NKAT-Schwelle f. FETT-Fehler [A2L-ref]" VALUE 0x7594A RL_VAL_UW 0 CM_0163 0 319995.1172 /end CHARACTERISTIC
/begin CHARACTERISTIC K_LAVK_OBD_ACT_LANK_M "NKAT-Schwelle f. M AGER-Fehler [A2L-ref]" VALUE 0x75948 RL_VAL_UW 0 CM_0163 0 319995.1172 /end CHARACTERISTIC
/begin CHARACTERISTIC K_LAVK_OBD_ACT_NK_M_CNT "NKAT Fehlerzaehler - MA-GER-Diagnose [A2L-ref]" VALUE 0x7594E RL_VAL_UW 0 CM_0000 0 65535 /end CHARACTERISTIC
/begin CHARACTERISTIC K_LAVK_OBD_ACT_VK_F_CNT "VKAT Fehlerzaehler - FETT-Diagnose [A2L-ref]" VALUE 0x75950 RL_VAL_UW 0 CM_0000 0 65535 /end CHARACTERISTIC
/begin CHARACTERISTIC K_LAVK_OBD_ACT_VK_M_CNT "VKAT Fehlerzaehler - MAGER-Diagnose [A2L-ref]" VALUE 0x7594C RL_VAL_UW 0 CM_0000 0 65535 /end CHARACTERISTIC
/begin CHARACTERISTIC K_LAVK_OBD_DYN_KAT_EXD_N_SOLL "Prueflauf - angeforderte Drehzahl [A2L-ref]" VALUE 0x76282 RL_VAL_SW 0 CM_0002 -32768 32767 /end CHARACTERISTIC
/begin CHARACTERISTIC K_LAVK_OBD_DYN_KAT_EXD_RF_MIN "min. relative F?llung fuer Ansteuerung dyn. Diag. u. KAT-Diag. [A2L-ref]" VALUE 0x76288 RL_VAL_SW 0 CM_0003 -3.2768 3.2767 /end CHARACTERISTIC
/begin CHARACTERISTIC K_LAVK_OBD_DYN_KAT_EXD_T "Prueflauf Freigabezeit [A2L-ref]" VALUE 0x76284 RL_VAL_UW 0 CM_0025 0 655.35 /end CHARACTERISTIC
/begin CHARACTERISTIC K_LAVK_OBD_DYN_LAM_REG_MIN "min. Regelabweichung bei dyn. LA -Diagnose [A2L-ref]" VALUE 0x7627A RL_VAL_UW 0 CM_0237 0 1.999969482 /end CHARACTERISTIC
/begin CHARACTERISTIC K_LAVK_OBD_DYN_NORM_CNT "Anzahl gueltiger MW f. Diagnosewert Dynamische Diagnose der stetigen Lambdasonde Seite 217 von 629 [A2L-ref]" VALUE 0x76278 RL_VAL_UW 0 CM_0000 0 65535 /end CHARACTERISTIC
/begin CHARACTERISTIC K_LAVK_OBD_DYN_TE_VOL_SUM "Min. TE-Volumenstrom in Motorlauf [A2L-ref]" VALUE 0x7629E RL_VAL_UW 0 CM_0402 0 2184.5 /end CHARACTERISTIC
/begin CHARACTERISTIC K_LAVK_OBD_DYN_WERT_MODE6 "Diagnoseschwelle fuer MODE6 [EST]" VALUE 0x762A4 RL_VAL_UW 0 CM_0236 0 3.999938965 /end CHARACTERISTIC
/begin CHARACTERISTIC K_LAVK_OBD_PLAU_CFG "Freigabe OBD-Plausibilitaet [A2L-ref]" VALUE 0x758D2 RL_VAL_UW 0 CM_0000 0 65535 /end CHARACTERISTIC
/begin CHARACTERISTIC K_LAVK_OBD_PLAU_IP_N_MAX "max. Drehzahl f. IP-/VM-Verdacht bei Plausi-Diag. [A2L-ref]" VALUE 0x75908 RL_VAL_SW 0 CM_0002 -32768 32767 /end CHARACTERISTIC
/begin CHARACTERISTIC K_LAVK_OBD_PLAU_IP_N_MIN "min. Drehzahl f. IP-/VM-Verdacht bei Plausi-Diag. [A2L-ref]" VALUE 0x7590A RL_VAL_SW 0 CM_0002 -32768 32767 /end CHARACTERISTIC
/begin CHARACTERISTIC K_LAVK_OBD_PLAU_IP_REG_MAX "max. Regelabweichung bei IP/VM-Openload-Verdacht [A2L-ref]" VALUE 0x75906 RL_VAL_UW 0 CM_0237 0 1.999969482 /end CHARACTERISTIC
/begin CHARACTERISTIC K_LAVK_OBD_PLAU_IP_REG_MIN "min. Regelabweichung bei IP/VM-Openload-Verdacht [A2L-ref]" VALUE 0x75904 RL_VAL_UW 0 CM_0237 0 1.999969482 /end CHARACTERISTIC
/begin CHARACTERISTIC K_LAVK_OBD_PLAU_IP_STABIL_T "min. Zeit auf Erkennung DYNAMIK [A2L-ref]" VALUE 0x75902 RL_VAL_UW 0 CM_0152 0 6553500 /end CHARACTERISTIC
/begin CHARACTERISTIC K_LAVK_OBD_PLAU_ML_SUM "min. aufsummierte Luftmassenstr. nach SA_WE [A2L-ref]" VALUE 0x75900 RL_VAL_UW 0 CM_0168 0 65535 /end CHARACTERISTIC
/begin CHARACTERISTIC K_LAVK_OBD_PLAU_UN_OSZI_OFF "Ausschaltzeit des ATIC42-Oszi f. UN-OL-Diag. [A2L-ref]" VALUE 0x758FE RL_VAL_UW 0 CM_0023 0 6553.5 /end CHARACTERISTIC
/begin CHARACTERISTIC K_LAVK_OBD_SA_CFG "0 OBD-SA inaktiv 1 OBD-SA aktiv Freigabe OBD-SA-Pruefung [A2L-ref]" VALUE 0x7590C RL_VAL_UW 0 CM_0000 0 65535 /end CHARACTERISTIC
/begin CHARACTERISTIC K_LAVK_OBD_SA_CNT "SA-Diag.-Fehlerzaehler [A2L-ref]" VALUE 0x7590E RL_VAL_UW 0 CM_0000 0 65535 /end CHARACTERISTIC
/begin CHARACTERISTIC K_LAVK_OBD_SA_DIAG_OL "VKAT-Lambda MAGER-Schwelle f. OPELNLOAD-Diag. [verified]" VALUE 0x758C6 RL_VAL_UW 0 CM_0163 0 319995.1172 /end CHARACTERISTIC
/begin CHARACTERISTIC K_LAVK_OBD_SA_ML_SUM "min. aufsummierte Luftmassenstr. im ZUST_SA [A2L-ref]" VALUE 0x75914 RL_VAL_UW 0 CM_0168 0 65535 /end CHARACTERISTIC
/begin CHARACTERISTIC K_LAVK_OBD_SA_SCHW "SA-Diag.-Schwelle AD-Wert [A2L-ref]" VALUE 0x75912 RL_VAL_UW 0 CM_0163 0 319995.1172 /end CHARACTERISTIC
/begin CHARACTERISTIC K_LAVK_OBD_SA_T "Verzoegerungszeit OBD -SA-Pruefung [A2L-ref]" VALUE 0x75910 RL_VAL_UW 0 CM_0023 0 6553.5 /end CHARACTERISTIC
/begin CHARACTERISTIC K_LAVK_OBD_TL_CFG "Freigabe OBD-TL/VL-Diagnose [A2L-ref]" VALUE 0x7591A RL_VAL_UW 0 CM_0000 0 65535 /end CHARACTERISTIC
/begin CHARACTERISTIC K_LAVK_OBD_TL_CNT "TL/VL-Diag.-Fehlerzaehler [A2L-ref]" VALUE 0x7591C RL_VAL_UW 0 CM_0000 0 65535 /end CHARACTERISTIC
/begin CHARACTERISTIC K_LAVK_OBD_TL_ML_SUM "min. aufsummierte Luftmassenstr. nach SA_WE [A2L-ref]" VALUE 0x75920 RL_VAL_UW 0 CM_0168 0 65535 /end CHARACTERISTIC
/begin CHARACTERISTIC K_LAVK_OBD_TL_SCHW_MAX "VKAT-Lambda MAGER-Schwelle f. OPELNLOAD-Diag. [A2L-ref]" VALUE 0x75922 RL_VAL_UW 0 CM_0163 0 319995.1172 /end CHARACTERISTIC
/begin CHARACTERISTIC K_LAVK_OBD_TL_SCHW_MIN "VKAT-Lambda MAGER-Schwelle f. OPELNLOAD-Diag. [A2L-ref]" VALUE 0x75924 RL_VAL_UW 0 CM_0163 0 319995.1172 /end CHARACTERISTIC
/begin CHARACTERISTIC K_LAVK_OBD_TL_T "Verzoegerungszeit OBD-TL/VL-Diagnose [A2L-ref]" VALUE 0x7591E RL_VAL_UW 0 CM_0023 0 6553.5 /end CHARACTERISTIC
/begin CHARACTERISTIC K_LAVK_OBD_TMOT "min. TMOT-Schwelle f. OBD-PLAUSI [A2L-ref]" VALUE 0x758D4 RL_VAL_SW 0 CM_0006 -3550 3003.5 /end CHARACTERISTIC
/begin CHARACTERISTIC K_LAVK_OBD_VK_TEMP "min. Sondentemperatur fuer Freigabe [A2L-ref]" VALUE 0x75918 RL_VAL_SW 0 CM_0151 -32768 32767 /end CHARACTERISTIC
/begin CHARACTERISTIC K_LA_OBD_DYN_CNT_INC "Counter increments fuer rf_dyn_la_cnt [verified]" VALUE 0x758CE RL_VAL_UB 0 CM_0000 0 255 /end CHARACTERISTIC
/begin CHARACTERISTIC K_LA_OBD_DYN_DELTA_CNT "Anzahl der dyn Triggers bis status gesetzt wird [verified]" VALUE 0x758CC RL_VAL_UW 0 CM_0000 0 65535 /end CHARACTERISTIC
/begin CHARACTERISTIC K_LA_OBD_DYN_DELTA_PUMP_RF "rf Differnez fuer Dynamikerkennung gegen Pumpen [verified]" VALUE 0x758CA RL_VAL_SW 0 CM_0003 -3.2768 3.2767 /end CHARACTERISTIC
/begin CHARACTERISTIC K_LA_OBD_DYN_DELTA_RF "rf Differnez fuer Dynamikerkennung [verified]" VALUE 0x758C8 RL_VAL_SW 0 CM_0003 -3.2768 3.2767 /end CHARACTERISTIC
/begin CHARACTERISTIC K_LA_OBD_DYN_RF_T "Sperrzeit fuer Ruecknahme rf-Dynamik [verified]" VALUE 0x758D0 RL_VAL_UW 0 CM_0025 0 655.35 /end CHARACTERISTIC
/begin CHARACTERISTIC K_LSHNK_DIAG_R_TAU "Zeitkonstante zur Mittelung NKAT [A2L-ref]" VALUE 0x75B58 RL_VAL_UB 0 CM_0277 0.01003921569 2.56 /end CHARACTERISTIC
/begin CHARACTERISTIC K_LSHNK_DIAG_TAUP_T "Zeitschwelle ab Taupunktueberschr. [A2L-ref]" VALUE 0x75B5A RL_VAL_UW 0 CM_0025 0 655.35 /end CHARACTERISTIC
/begin CHARACTERISTIC K_LSRVK_OBD_REF_CNT "Schwelle LA- Ri-GAIN- Ermittlungen f. Referen z- stromdiagnose [A2L-ref]" VALUE 0x75CA6 RL_VAL_UW 0 CM_0000 0 65535 /end CHARACTERISTIC
/begin CHARACTERISTIC K_LSRVK_OBD_REF_GAIN_MAX "max. GAIN -Ri-Schwelle - Referenzstromdiag. [A2L-ref]" VALUE 0x75CA4 RL_VAL_UW 0 CM_0016 0 63.99902344 /end CHARACTERISTIC
/begin CHARACTERISTIC K_LSRVK_OBD_REF_OFFS_CNT "Schwelle LA-Ri-OFFSET-Ermittlungen f. Referenzwiderstandsdiagnose [A2L-ref]" VALUE 0x75CAC RL_VAL_UW 0 CM_0000 0 65535 /end CHARACTERISTIC
/begin CHARACTERISTIC K_LSRVK_OBD_REF_OFFS_MAX "max. OFFSET -Ri- Schwelle - Referenzstromdiag. [A2L-ref]" VALUE 0x75CA8 RL_VAL_SW 0 CM_0163 -160000 159995.1172 /end CHARACTERISTIC
/begin CHARACTERISTIC K_LSRVK_OBD_REF_OFFS_MIN "min. OFFSET-Ri-Schwelle - Referenzstromdiag. [A2L-ref]" VALUE 0x75CAA RL_VAL_SW 0 CM_0163 -160000 159995.1172 /end CHARACTERISTIC
/begin CHARACTERISTIC K_MSKIBSDIAG "Test AK disable Diagnose [A2L-ref]" VALUE 0x70930 RL_VAL_UB 0 CM_0000 0 255 /end CHARACTERISTIC
/begin CHARACTERISTIC K_MVAC_P_OBD_LL_TIME_MIN "Mindestzeit fuer Uebernahme von mvac_p_obd_pdiff_roh bei B_ZUST_LL [A2L-ref]" VALUE 0x75F22 RL_VAL_UW 0 CM_0025 0 655.35 /end CHARACTERISTIC
/begin CHARACTERISTIC K_MVAC_P_OBD_SA_TIME_MIN "Mindestzeit fuer Uebernahme von mvac_p_obd_pdiff_roh bei B_SA [A2L-ref]" VALUE 0x75F20 RL_VAL_UW 0 CM_0020 0 327.675 /end CHARACTERISTIC
/begin CHARACTERISTIC K_O2_OBD_CFG "Freigabe O2-Beladung [A2L-ref]" VALUE 0x7622A RL_VAL_UW 0 CM_0000 0 65535 /end CHARACTERISTIC
/begin CHARACTERISTIC K_O2_OBD_DYN_CNT_INC "Counter increments fuer rf_dyn_o2_cnt [verified]" VALUE 0x76298 RL_VAL_UB 0 CM_0000 0 255 /end CHARACTERISTIC
/begin CHARACTERISTIC K_O2_OBD_DYN_DELTA_CNT "Anzahl der dyn Triggers bis status gesetzt wird [verified]" VALUE 0x76296 RL_VAL_UW 0 CM_0000 0 65535 /end CHARACTERISTIC
/begin CHARACTERISTIC K_O2_OBD_DYN_DELTA_PUMP_RF "rf Differnez fuer Dynamikerkennung gegen Pumpen [verified]" VALUE 0x76294 RL_VAL_SW 0 CM_0003 -3.2768 3.2767 /end CHARACTERISTIC
/begin CHARACTERISTIC K_O2_OBD_DYN_RF_T "Sperrzeit fuer Ruecknahme rf-Dynamik [verified]" VALUE 0x7629A RL_VAL_UW 0 CM_0025 0 655.35 /end CHARACTERISTIC
/begin CHARACTERISTIC K_O2_OBD_ML_MIN "min. aufsummierte Luftmassenstr. nach SA_WE [A2L-ref]" VALUE 0x76260 RL_VAL_UW 0 CM_0168 0 65535 /end CHARACTERISTIC
/begin CHARACTERISTIC K_O2_OBD_N_MAX "max. Drehzahl f. O2-Beladung [A2L-ref]" VALUE 0x7623A RL_VAL_SW 0 CM_0002 -32768 32767 /end CHARACTERISTIC
/begin CHARACTERISTIC K_O2_OBD_RF_MAX "max. relative F???llung f. O2-Beladung [A2L-ref]" VALUE 0x76230 RL_VAL_SW 0 CM_0003 -3.2768 3.2767 /end CHARACTERISTIC
/begin CHARACTERISTIC K_O2_OBD_RF_MIN_HYS "Hysterese f.die min. RF-Schwelle [A2L-ref]" VALUE 0x76232 RL_VAL_SW 0 CM_0003 -3.2768 3.2767 /end CHARACTERISTIC
/begin CHARACTERISTIC K_O2_OBD_SA_ML_MAX "max. aufsummierte Luftmassenstr. in SA [A2L-ref]" VALUE 0x76262 RL_VAL_UW 0 CM_0168 0 65535 /end CHARACTERISTIC
/begin CHARACTERISTIC K_O2_OBD_TEV_MAX "max. Konzentration aus AKF [EST]" VALUE 0x7629C RL_VAL_UW 0 CM_0236 0 3.999938965 /end CHARACTERISTIC
/begin CHARACTERISTIC K_O2_OBD_TKAT_HYS "min. KAT-Temperatur f. O2-Beladung [A2L-ref]" VALUE 0x76236 RL_VAL_SW 0 CM_0159 -3276.8 3276.7 /end CHARACTERISTIC
/begin CHARACTERISTIC K_O2_OBD_TKAT_MAX "max. KAT-Temperatur f. O2-Beladung [A2L-ref]" VALUE 0x76238 RL_VAL_SW 0 CM_0006 -3550 3003.5 /end CHARACTERISTIC
/begin CHARACTERISTIC K_O2_OBD_TKAT_MIN "min. KAT-Temperatur f. O2-Beladung [A2L-ref]" VALUE 0x76234 RL_VAL_SW 0 CM_0006 -3550 3003.5 /end CHARACTERISTIC
/begin CHARACTERISTIC K_O2_OBD_TMOT "min. TMOT-Schwelle f. O2-Beladung [verified]" VALUE 0x7622E RL_VAL_SW 0 CM_0006 -3550 3003.5 /end CHARACTERISTIC
/begin CHARACTERISTIC K_O2_OBD_T_ML "Verzoegerungszeit - O2-Beladung [A2L-ref]" VALUE 0x76280 RL_VAL_UW 0 CM_0177 0 65535 /end CHARACTERISTIC
/begin CHARACTERISTIC K_O2_OBD_V_MAX "max. Fahrzeuggeschwindigkeit [A2L-ref]" VALUE 0x76268 RL_VAL_SW 0 CM_0010 -2048 2047.9375 /end CHARACTERISTIC
/begin CHARACTERISTIC K_O2_OBD_V_MIN "min. Fahrzeuggeschwindigkeit [A2L-ref]" VALUE 0x76266 RL_VAL_SW 0 CM_0010 -2048 2047.9375 /end CHARACTERISTIC
/begin CHARACTERISTIC K_O2_OBD_WE_ML_MIN "min. aufsum. Luftmassenstr. nach SA_WE f. lange SA [A2L-ref]" VALUE 0x76264 RL_VAL_UW 0 CM_0168 0 65535 /end CHARACTERISTIC
/begin CHARACTERISTIC K_OZ_PM_CC_CBS_MSG_TEST "CC-und CBS-Meldungen-Testkonstante [A2L-ref]" VALUE 0x702F2 RL_VAL_UW 0 CM_0000 0 65535 /end CHARACTERISTIC
/begin CHARACTERISTIC K_PKSR_ADAP_DIAG_T "Zeit im Adationsanschlag bis Fehlereintrag [EST]" VALUE 0x76E74 RL_VAL_UW 0 CM_0027 0 65535 /end CHARACTERISTIC
/begin CHARACTERISTIC K_PKSR_EXD_DELTA_P_VL_FE "Schwelle Druckabfall Vorlauf im Fertigungsmode [verified]" VALUE 0x76E66 RL_VAL_SW 0 CM_0142 -32.768 32.767 /end CHARACTERISTIC
/begin CHARACTERISTIC K_PKSR_EXD_EKP1_TV_MAX "Max. TV fuer EKP1 ohne EKP2 [EST]" VALUE 0x76E68 RL_VAL_SW 0 CM_0091 -3200 3199.902344 /end CHARACTERISTIC
/begin CHARACTERISTIC K_PKSR_EXD_NMAX "N-MAX bei Prueflauf7 [verified]" VALUE 0x76E70 RL_VAL_SW 0 CM_0002 -32768 32767 /end CHARACTERISTIC
/begin CHARACTERISTIC K_PKSR_EXD_TV_65 "TV bei fuer Ermittlung Druc k-abfall [EST]" VALUE 0x76E76 RL_VAL_SW 0 CM_0091 -3200 3199.902344 /end CHARACTERISTIC
/begin CHARACTERISTIC K_PUMG_MAX_E2 "Max. Umgebungsdruck [A2L-ref]" VALUE 0x7B898 RL_VAL_SW 0 CM_0022 -2048 2047.9375 /end CHARACTERISTIC
/begin CHARACTERISTIC K_PUMG_MAX_NEG_GRAD_E2 "Gradientschwelle Ebene2 [A2L-ref]" VALUE 0x7B89A RL_VAL_SW 0 CM_0222 -20480 20479.375 /end CHARACTERISTIC
/begin CHARACTERISTIC K_PUMG_MAX_POS_GRAD_E2 "Gradientschwelle Ebene2 [A2L-ref]" VALUE 0x7B89C RL_VAL_SW 0 CM_0222 -20480 20479.375 /end CHARACTERISTIC
/begin CHARACTERISTIC K_PUMG_MIN_E2 "Min. Umgebungsdruck [A2L-ref]" VALUE 0x7B896 RL_VAL_SW 0 CM_0022 -2048 2047.9375 /end CHARACTERISTIC
/begin CHARACTERISTIC K_PUMG_OBD_ABW "max. zulaessige Abweichung von pumg zu pumg-Filterwert [A2L-ref]" VALUE 0x77EA8 RL_VAL_SW 0 CM_0022 -2048 2047.9375 /end CHARACTERISTIC
/begin CHARACTERISTIC K_PUMG_OBD_PUMG_TAU "Zeitkonstante fuer pumg -Filterwert Gradienten-Check [A2L-ref]" VALUE 0x77EA2 RL_VAL_UW 0 CM_0324 0.1 6553.5 /end CHARACTERISTIC
/begin CHARACTERISTIC K_PUMG_OBD_TIME_ML_MIN "Mindest-time_ml f?r Gradient - bzw. Modell?berw. [A2L-ref]" VALUE 0x77EA4 RL_VAL_UL 0 CM_0025 0 42949672.95 /end CHARACTERISTIC
/begin CHARACTERISTIC K_SCHALTER_GETR_DIAG_MAX "Short-to-UB Schwelle [A2L-ref]" VALUE 0x784C0 RL_VAL_SW 0 CM_0087 -32768 32767 /end CHARACTERISTIC
/begin CHARACTERISTIC K_SCHALTER_GETR_DIAG_MIN "Short-to-GND Schwelle [A2L-ref]" VALUE 0x784BE RL_VAL_SW 0 CM_0087 -32768 32767 /end CHARACTERISTIC
/begin CHARACTERISTIC K_SCHALTER_GETR_DIAG_N_VERH_TAU "Filterkonstante fuer gang_n_verh [A2L-ref]" VALUE 0x784C2 RL_VAL_UB 0 CM_0306 0.1003921569 25.6 /end CHARACTERISTIC
/begin CHARACTERISTIC K_SLS_OBDH_ASV_LI_OPE "Max. Abweichungsintg. -grenze ASV-Diag links haengt offen [A2L-ref]" VALUE 0x788E0 RL_VAL_SW 0 CM_0414 -2 1.999938965 /end CHARACTERISTIC
/begin CHARACTERISTIC K_SLS_OBDH_ASV_PL_RE_OPE "Max. Abweichungsintg.-grenze ASV-Diag rechts haengt offen im PL [A2L-ref]" VALUE 0x788DC RL_VAL_SW 0 CM_0414 -2 1.999938965 /end CHARACTERISTIC
/begin CHARACTERISTIC K_SLS_OBDH_ASV_RE_OPE "Max. Abweichungsintg. -grenze ASV-Diag rechts haengt offen [A2L-ref]" VALUE 0x788DA RL_VAL_SW 0 CM_0414 -2 1.999938965 /end CHARACTERISTIC
/begin CHARACTERISTIC K_SLS_OBDH_HFM_MAX "max. Luftmassenintegral fuer plausibles SLS [A2L-ref]" VALUE 0x78904 RL_VAL_SW 0 CM_0415 -262.144 262.136 /end CHARACTERISTIC
/begin CHARACTERISTIC K_SLS_OBDH_HYD_ABBRUCH_AD_MAX "max-AD-Wert fuer Feuchtigkeitsabbruch [A2L-ref]" VALUE 0x788FC RL_VAL_SW 0 CM_0087 -32768 32767 /end CHARACTERISTIC
/begin CHARACTERISTIC K_SLS_OBDH_HYD_ABBRUCH_ML_MAX "ML-Schwelle fuer Feuchtigkeitserkennung Mini-HFM [A2L-ref]" VALUE 0x788FA RL_VAL_SW 0 CM_0415 -262.144 262.136 /end CHARACTERISTIC
/begin CHARACTERISTIC K_SLS_OBDH_ML_TMOT "Schwelle ML-Plausi fuer ASV kleben zu [A2L-ref]" VALUE 0x788FE RL_VAL_SW 0 CM_0006 -3550 3003.5 /end CHARACTERISTIC
/begin CHARACTERISTIC K_SLS_OBDH_T_SLV_INT_START "Delay fuer start Diagnose SLV [A2L-ref]" VALUE 0x788E4 RL_VAL_UW 0 CM_0025 0 655.35 /end CHARACTERISTIC
/begin CHARACTERISTIC K_SLS_OBD_ML_MDL_DIFF_MAX "Saturation Gradient Luftmasse Motor [A2L-ref]" VALUE 0x788D6 RL_VAL_SW 0 CM_0416 -3276.8 3276.7 /end CHARACTERISTIC
/begin CHARACTERISTIC K_SLS_OBD_ML_MDL_WICHT "Wichtungsfaktor fuer Dynamik [A2L-ref]" VALUE 0x788D8 RL_VAL_UW 0 CM_0016 0 63.99902344 /end CHARACTERISTIC
/begin CHARACTERISTIC K_SL_ML_HFM_DIAG_MAX "Diagnoseschelle Max [EST]" VALUE 0x786E8 RL_VAL_SW 0 CM_0102 -3276.8 3276.7 /end CHARACTERISTIC
/begin CHARACTERISTIC K_SL_ML_HFM_DIAG_MIN "Diagnoseschelle Min [EST]" VALUE 0x786EA RL_VAL_SW 0 CM_0102 -3276.8 3276.7 /end CHARACTERISTIC
/begin CHARACTERISTIC K_TD_DIAG_CFG "Aktivierung der Fehlerarten. [A2L-ref]" VALUE 0x78BEE RL_VAL_UB 0 CM_0000 0 255 /end CHARACTERISTIC
/begin CHARACTERISTIC K_VAN_TV_MCS_E2 "max. Ventil Tastverhaeltnis [A2L-ref]" VALUE 0x7A41C RL_VAL_SW 0 CM_0091 -3200 3199.902344 /end CHARACTERISTIC
/begin CHARACTERISTIC K_WF_IST_PLAU_MAX "max. plausibler WF-Wert [EST]" VALUE 0x7B154 RL_VAL_UW 0 CM_0232 0 2047.96875 /end CHARACTERISTIC
/begin CHARACTERISTIC cfg.sg_mode "Steuergeraete Mode [EST]" VALUE 0x78B48 RL_VAL_UB 0 CM_0000 0 255 /end CHARACTERISTIC
/begin CHARACTERISTIC K_CAN_ALIVE_ERR_MAX "0 Schwelle Aliveerror [A2L-ref]" VALUE 0x7054D RL_VAL_UB 0 CM_0348 0 255 /end CHARACTERISTIC
/begin CHARACTERISTIC K_ERREPEAT "EBSD Fehler repeat [A2L-ref]" VALUE 0x741D9 RL_VAL_UB 0 CM_0000 0 255 /end CHARACTERISTIC
/begin CHARACTERISTIC K_IBUNPLADEL "EBSD Fehler repeat [EST]" VALUE 0x741DA RL_VAL_UB 0 CM_0000 0 255 /end CHARACTERISTIC
/begin CHARACTERISTIC K_LAM_DIAG_LAA_T "Diagnosezeit - LA-Adaptionanschlag [verified]" VALUE 0x7498A RL_VAL_UW 0 CM_0023 0 6553.5 /end CHARACTERISTIC
/begin CHARACTERISTIC K_LANK_OBD_S_SA_WE_T "max. SCHUBDAUER fuer Schaltvorgang [EST]" VALUE 0x7578A RL_VAL_UW 0 CM_0023 0 6553.5 /end CHARACTERISTIC
/begin CHARACTERISTIC K_LANK_OBD_S_VL_T "Wartezeit VL - OBD-S-Diag. [EST]" VALUE 0x75784 RL_VAL_UW 0 CM_0025 0 655.35 /end CHARACTERISTIC
/begin CHARACTERISTIC K_LAVK_OBD_ACT_F_T "FETT-Verzoegerungszeit - aktive Plausi-Diag. [A2L-ref]" VALUE 0x7593A RL_VAL_UW 0 CM_0023 0 6553.5 /end CHARACTERISTIC
/begin CHARACTERISTIC K_LAVK_OBD_ACT_NK_F_CNT "NKAT Fehlerzaehler - FETT-Diagnose [EST]" VALUE 0x75952 RL_VAL_UW 0 CM_0000 0 65535 /end CHARACTERISTIC
/begin CHARACTERISTIC K_LAVK_OBD_DYN_CFG "0 inaktiv 1 aktiv Freigabe dynamische Sonden -VKAT- Diagnose [A2L-ref]" VALUE 0x7626A RL_VAL_UW 0 CM_0000 0 65535 /end CHARACTERISTIC
/begin CHARACTERISTIC K_LAVK_OBD_DYN_KAT_EXD_RF_MAX "max. relative F?llung fuer Ansteuer ung dyn. Diag. u. KAT-Diag. [EST]" VALUE 0x76286 RL_VAL_SW 0 CM_0003 -3.2768 3.2767 /end CHARACTERISTIC
/begin CHARACTERISTIC K_LSHNK_DIAG_CFG "0 inaktiv 1 aktiv Freigabe d. elektrischen Diag. LSH-NKAT [EST]" VALUE 0x75B4C RL_VAL_UB 0 CM_0000 0 255 /end CHARACTERISTIC
/begin CHARACTERISTIC K_O2_OBD_DYN_DELTA_RF "rf Differnez fuer Dynamikerkennung [verified]" VALUE 0x76292 RL_VAL_SW 0 CM_0003 -3.2768 3.2767 /end CHARACTERISTIC
/begin CHARACTERISTIC K_PKS_OBD_SOLL_DYN_TAU "Filterkonstante fuer Kraf t-stoffpumpen-Solldruck [verified]" VALUE 0x76DD6 RL_VAL_UB 0 CM_0277 0.01003921569 2.56 /end CHARACTERISTIC
/begin CHARACTERISTIC K_PUMG_OBD_ML_MS "Zeitdauer von ZUST_ML nach ZUST_MS_A f?r Init [EST]" VALUE 0x77EAF RL_VAL_UB 0 CM_0380 0 4.250000001 /end CHARACTERISTIC
/begin CHARACTERISTIC K_SLEEPWAIT "[EST]" VALUE 0x741DE RL_VAL_UB 0 CM_0000 0 255 /end CHARACTERISTIC
/begin CHARACTERISTIC KL_LSHVK_DIAG_TIME_ML "Verzoegerungszeit nach Startende [verified]" CURVE 0x75DD4 RL_CUR_SW_UW 0 CM_0247 0 655.35 /begin AXIS_DESCR STD_AXIS NO_INPUT_QUANTITY CM_0006 4 -3550 3003.5 /end AXIS_DESCR /end CHARACTERISTIC
/begin CHARACTERISTIC KF_KAT_OBD_TEMP_F "Kompensationsfaktor - Temperatureinfluss [EST]" MAP 0x76580 RL_MAP_SW_SW_UW 0 CM_0245 0 63.99902344 /begin AXIS_DESCR STD_AXIS NO_INPUT_QUANTITY CM_0243 7 -3276.8 3276.7 /end AXIS_DESCR /begin AXIS_DESCR STD_AXIS NO_INPUT_QUANTITY CM_0006 5 -3550 3003.5 /end AXIS_DESCR /end CHARACTERISTIC
/begin CHARACTERISTIC KF_FPLAU_OBD_AQ_DELTA_ML_MIN "Min. erlaubte Abwe i-chung [EST]" MAP 0x7264E RL_MAP_SW_SW_SW 0 CM_0311 -327.68 327.67 /begin AXIS_DESCR STD_AXIS NO_INPUT_QUANTITY CM_0002 8 -32768 32767 /end AXIS_DESCR /begin AXIS_DESCR STD_AXIS NO_INPUT_QUANTITY CM_0282 8 -3.2768 3.2767 /end AXIS_DESCR /end CHARACTERISTIC
/begin CHARACTERISTIC KF_FPLAU_OBD_PSAU_DELTA_ML_MAX "Max. erlaubte Abwe i-chung [EST]" MAP 0x72834 RL_MAP_SW_SW_SW 0 CM_0311 -327.68 327.67 /begin AXIS_DESCR STD_AXIS NO_INPUT_QUANTITY CM_0002 8 -32768 32767 /end AXIS_DESCR /begin AXIS_DESCR STD_AXIS NO_INPUT_QUANTITY CM_0282 8 -3.2768 3.2767 /end AXIS_DESCR /end CHARACTERISTIC
/begin CHARACTERISTIC KL_SLS_OBDH_ASV_LAM_LEAK_MAX "Schwelle fuer Erkennung auf Leckage [EST]" CURVE 0x78862 RL_CUR_SW_SW 0 CM_0259 -2 1.999938965 /begin AXIS_DESCR STD_AXIS NO_INPUT_QUANTITY CM_0255 4 -3276.8 3276.7 /end AXIS_DESCR /end CHARACTERISTIC
/begin CHARACTERISTIC K_VAN_EXD_I_MAX_E "Pr?flauf Ventilstrom max. Spr. [verified]" VALUE 0x7A380 RL_VAL_SW 0 CM_0434 -32768 32767 /end CHARACTERISTIC
/begin CHARACTERISTIC K_VAN_EXD_I_MAX_A "Pr?flauf Ventilstrom max. Spr. [verified]" VALUE 0x7A382 RL_VAL_SW 0 CM_0434 -32768 32767 /end CHARACTERISTIC
/begin CHARACTERISTIC K_VAN_EXD_I_MIN_E "Pr?flauf Ventilstrom min. Spr. [verified]" VALUE 0x7A384 RL_VAL_SW 0 CM_0434 -32768 32767 /end CHARACTERISTIC
/begin CHARACTERISTIC K_VAN_EXD_I_MIN_A "Pr?flauf Ventilstrom min. Spr. [verified]" VALUE 0x7A386 RL_VAL_SW 0 CM_0434 -32768 32767 /end CHARACTERISTIC
/begin CHARACTERISTIC K_VAN_SPR_OFFSET_E2 "KW-Zahnflanke zu max Spre i-zung [verified]" VALUE 0x7A408 RL_VAL_SW 0 CM_0436 -3276.8 3276.7 /end CHARACTERISTIC
/begin CHARACTERISTIC K_PUMG_OBD_FPLAU_FREIGABE "Prozent [EST]" VALUE 0x77E90 RL_VAL_SW 0 CM_0311 -327.68 327.67 /end CHARACTERISTIC
/begin CHARACTERISTIC K_PUMG_OBD_PSAU_MDL_ABW "Unter Grenze Umgebungsdruck [verified]" VALUE 0x77E92 RL_VAL_SW 0 CM_0291 -2048 2047.9375 /end CHARACTERISTIC
/begin CHARACTERISTIC K_PUMG_OBD_MODEL_DELTA_MAX "max. zulaessige pumg -Modellwertabweichung [verified]" VALUE 0x77EAA RL_VAL_SW 0 CM_0291 -2048 2047.9375 /end CHARACTERISTIC
/begin CHARACTERISTIC K_PUMG_OBD_MIN_MESS "Mindestanzahl Modellwerte bei VL fuer Integralbildung [verified]" VALUE 0x77EAC RL_VAL_UW 0 CM_0000 0 65535 /end CHARACTERISTIC
/begin CHARACTERISTIC K_PUMG_OBD_CFG "0x00 pumg_obd aus 0x01 pumg_obd an ELSE undef Schalter Funktion - Ausgang [verified]" VALUE 0x77EAE RL_VAL_UB 0 CM_0000 0 255 /end CHARACTERISTIC
/begin CHARACTERISTIC K_PUMG_OBD_PSAU_DELAY "Psau-Model-Vergl. Ausreichend lang im i.O. Bereich [verified]" VALUE 0x77EB0 RL_VAL_UB 0 CM_0301 0 25.5 /end CHARACTERISTIC
/begin CHARACTERISTIC K_PUMG_OBD_TUMG_MIN "Mindest-tumg fuer pumg -Modellbewertung [verified]" VALUE 0x77EB2 RL_VAL_SW 0 CM_0256 -3550 3003.5 /end CHARACTERISTIC
/begin CHARACTERISTIC K_PUMG_OBD_ML_DELTA_TAU "Filterkonstant [verified]" VALUE 0x77EB5 RL_VAL_UB 0 CM_0306 0.1003921569 25.6 /end CHARACTERISTIC
/begin CHARACTERISTIC K_PUMG_OBD_TIME_VL_MIN "Mindestdauer von B_ZUST_VL f?r pumg_modell_freigabe [verified]" VALUE 0x77EB6 RL_VAL_UW 0 CM_0027 0 65535 /end CHARACTERISTIC
/begin CHARACTERISTIC K_PUMG_OBD_TIME_MS_MIN "Mindestdauer von B_ZUST_MS_A f?r pumg_modell_freigabe [verified]" VALUE 0x77EB8 RL_VAL_UW 0 CM_0247 0 655.35 /end CHARACTERISTIC
/begin CHARACTERISTIC K_PUMG_OBD_ML_DELTA_MIN_DIFF "Mindestabw. Zwischen ml_delta_mw_psau und ml_delta_mw_aq [verified]" VALUE 0x77EBA RL_VAL_SW 0 CM_0091 -3200 3199.902344 /end CHARACTERISTIC
/begin CHARACTERISTIC K_PUMG_OBD_LLS_MAX "Maximal endrosselte LLS -Position [EST]" VALUE 0x77EBC RL_VAL_SW 0 CM_0276 -3276.8 3276.7 /end CHARACTERISTIC
/begin CHARACTERISTIC K_SK_EGAS_OFF "0 DK2 DK1 LLS2 LLS1 [verified] (axes fixed/not stored)" VAL_BLK 0x7853E RL_BLK_UB 0 CM_0000 0 255 NUMBER 16 /end CHARACTERISTIC
/begin CHARACTERISTIC K_SK_MD_BEGR_EGAS "0 PSAU PSAU DK2 DK1 LLS2 LLS1 [verified] (axes fixed/not stored)" VAL_BLK 0x7854E RL_BLK_UB 0 CM_0000 0 255 NUMBER 64 /end CHARACTERISTIC
/begin CHARACTERISTIC K_SK_MD_BEGR_TI "0 B2 B1 Z2 Z1 [verified] (axes fixed/not stored)" VAL_BLK 0x7858E RL_BLK_UB 0 CM_0000 0 255 NUMBER 16 /end CHARACTERISTIC
/begin CHARACTERISTIC K_SK_TI_OFF_EGAS "0 TI2 TI1 DK2 DK1 LLS2 LLS1 [verified] (axes fixed/not stored)" VAL_BLK 0x7859E RL_BLK_UB 0 CM_0000 0 255 NUMBER 64 /end CHARACTERISTIC
/begin CHARACTERISTIC K_SK_MD_BEGR_SMG "0 CANErr CANSk STAT SABR [verified] (axes fixed/not stored)" VAL_BLK 0x785DE RL_BLK_UB 0 CM_0000 0 255 NUMBER 16 /end CHARACTERISTIC
/begin CHARACTERISTIC K_SK_MD_BEGR_MD "0 SollIst Mdmin EtaRf LLR [verified] (axes fixed/not stored)" VAL_BLK 0x785EE RL_BLK_UB 0 CM_0000 0 255 NUMBER 16 /end CHARACTERISTIC
/begin CHARACTERISTIC K_SK_MD_BEGR_GEMISCH "0 VAN KATS FPLAU LAVK PKS [verified] (axes fixed/not stored)" VAL_BLK 0x785FE RL_BLK_UB 0 CM_0000 0 255 NUMBER 32 /end CHARACTERISTIC
/begin CHARACTERISTIC K_SK_LAM_EINGR "0 | x | 0 alle an | 1 LA | 2 LAA | 3 LA+LAA | 4 Mager | 5 LA+Mager | 6 LAA+Mager | 7 LA+LAA+Mager | Gemisch Boff Zoff DK LLS [verified] (axes fixed/not stored)" VAL_BLK 0x7861E RL_BLK_UB 0 CM_0000 0 255 NUMBER 32 /end CHARACTERISTIC
/begin CHARACTERISTIC K_SK_MD_BEGR_PWG "0 pwg_mode [verified] (axes fixed/not stored)" VAL_BLK 0x7863E RL_BLK_UB 0 CM_0000 0 255 NUMBER 6 /end CHARACTERISTIC
/begin CHARACTERISTIC K_SK_MD_BEGR_MVAC "0 ELUP MVAC [verified] (axes fixed/not stored)" VAL_BLK 0x78644 RL_BLK_UB 0 CM_0000 0 255 NUMBER 4 /end CHARACTERISTIC
/begin CHARACTERISTIC K_SK_MVAC_KH "0 | x | 0 aktiv | 1 gesperrt | ELUP MVAC [verified] (axes fixed/not stored)" VAL_BLK 0x78648 RL_BLK_UB 0 CM_0000 0 255 NUMBER 4 /end CHARACTERISTIC
/begin CHARACTERISTIC K_TE_OBD_AUSS_TAU "Filterzeitkonstante fur auss_lp_int_sum [verified]" VALUE 0x79332 RL_VAL_UB 0 CM_0277 0.01003921569 2.56 /end CHARACTERISTIC
/begin CHARACTERISTIC K_TE_OBD_ML_TAU "Filterzeitkonstante fur ml_hfm_roh [verified]" VALUE 0x79333 RL_VAL_UB 0 CM_0277 0.01003921569 2.56 /end CHARACTERISTIC
/begin CHARACTERISTIC K_TE_OBD_OK "Gesamt-Anzahl noetiger o.K. Reaktionen [EST]" VALUE 0x79340 RL_VAL_UB 0 CM_0000 0 255 /end CHARACTERISTIC
/begin CHARACTERISTIC K_TE_OBD_T_ML_MIN "Mindest-Motorlaufzeit [EST]" VALUE 0x79352 RL_VAL_UW 0 CM_0247 0 655.35 /end CHARACTERISTIC
/begin CHARACTERISTIC K_SLS_OBDH_T_HFM_DIA "Diagnosezeit fuer Mini-HFM [EST]" VALUE 0x788D2 RL_VAL_UW 0 CM_0247 0 655.35 /end CHARACTERISTIC
/begin CHARACTERISTIC K_SLS_OBDH_T_ML_PLAUSI "Max. Diagnosezeit fuer Luftmassenplausi [EST]" VALUE 0x788D4 RL_VAL_UW 0 CM_0247 0 655.35 /end CHARACTERISTIC
/begin CHARACTERISTIC K_SLS_OBDH_ASV_TAU "Filterkonstante fuer lam_ist und ml_ges der ASV Diag. [EST]" VALUE 0x788F5 RL_VAL_UB 0 CM_0306 0.1003921569 25.6 /end CHARACTERISTIC
/begin CHARACTERISTIC K_SLS_OBDH_DYN_DELTA_RF "Dynamikschwelle RF [verified]" VALUE 0x78914 RL_VAL_SW 0 CM_0282 -3.2768 3.2767 /end CHARACTERISTIC
/begin CHARACTERISTIC K_SLS_OBDH_DYN_RF_T "Zeit nach Dyn.abbr. durch rf, bevor die Diag weiterlaeuft [verified]" VALUE 0x78916 RL_VAL_UW 0 CM_0247 0 655.35 /end CHARACTERISTIC
/begin CHARACTERISTIC K_FST_CAN_FEHLER "min. Dauer CAN -Fehler (65535s = aus) [verified]" VALUE 0x728D8 RL_VAL_UW 0 CM_0027 0 65535 /end CHARACTERISTIC
/begin CHARACTERISTIC K_LAVK_OBD_DYN_INT_PER_MAX "max. Fl?chenintegral f?r Periode [verified]" VALUE 0x7626C RL_VAL_SW 0 CM_0455 -210.0512821 210.0448718 /end CHARACTERISTIC
/begin CHARACTERISTIC K_LAVK_OBD_DYN_INT_PER_MIN "min. Fl?chenintegral f?r Periode [verified]" VALUE 0x7626E RL_VAL_SW 0 CM_0455 -210.0512821 210.0448718 /end CHARACTERISTIC
/begin CHARACTERISTIC K_LAVK_OBD_DYN_INT_MAX "Offset fuer max. Fl?chenintegral [verified]" VALUE 0x76270 RL_VAL_SW 0 CM_0455 -210.0512821 210.0448718 /end CHARACTERISTIC
/begin CHARACTERISTIC K_LAVK_OBD_DYN_INT_MIN "Offset fuer min. Fl?chenintegral [verified]" VALUE 0x76272 RL_VAL_SW 0 CM_0455 -210.0512821 210.0448718 /end CHARACTERISTIC
/begin CHARACTERISTIC K_LAVK_OBD_DYN_INT_PER_STABIL "Anzahl zu verwerfender INTEGRAL - Messungen (stabiler Zustand) [verified]" VALUE 0x76274 RL_VAL_UW 0 CM_0000 0 65535 /end CHARACTERISTIC
/begin CHARACTERISTIC K_LAVK_OBD_DYN_INT_CNT "Anzahl gueltiger Perioden f. MW [verified]" VALUE 0x76276 RL_VAL_UW 0 CM_0000 0 65535 /end CHARACTERISTIC
/begin CHARACTERISTIC K_LAVK_OBD_DYN_LAM_REG_MAX "max. Regelabweichung bei dyn. LA -Diagnose [verified]" VALUE 0x7627C RL_VAL_UW 0 CM_0307 0 1.999969482 /end CHARACTERISTIC
/begin CHARACTERISTIC K_LAVK_OBD_DYN_KAT_EXD_FETT_LAM_SOLL "LAM-SOLL-OFFSET-um NKAT -Signal nach FETT vor Diagnose zu bringen [EST]" VALUE 0x7628A RL_VAL_SW 0 CM_0456 -2 1.999938965 /end CHARACTERISTIC
/begin CHARACTERISTIC K_LAVK_OBD_DYN_KAT_EXD_LAM_SOLL "LAM-SOLL-OFFSET-zus?tzliche Anfettung/Abmagerung [EST]" VALUE 0x7628C RL_VAL_SW 0 CM_0457 -2 1.999938965 /end CHARACTERISTIC
/begin CHARACTERISTIC K_LAVK_OBD_DYN_KAT_EXD_LANK_FETT "FETT-Schelle f?r Freigabe KAT/ dyn.Sondendiag. bei ext. Ansteuerung [verified]" VALUE 0x7628E RL_VAL_UW 0 CM_0458 0 319995.1172 /end CHARACTERISTIC
/begin CHARACTERISTIC K_LAVK_OBD_DYN_DIFF_POS_CFG "0 no 1 yes Auswahl-nur positives Fl?chenintegral [verified]" VALUE 0x76290 RL_VAL_UW 0 CM_0000 0 65535 /end CHARACTERISTIC
/begin CHARACTERISTIC K_LAVK_OBD_ACT_FRA_F "FRAU_OUT-Schwelle f. E r- kennung FETT -Fehler (VKAT - Sonde) [verified]" VALUE 0x75944 RL_VAL_UW 0 CM_0307 0 1.999969482 /end CHARACTERISTIC
/begin CHARACTERISTIC K_LAVK_OBD_ACT_FRA_M "FRAU_OUT-Schwelle f. E r- kennung MAGER -Fehler (VKAT-Sonde) [verified]" VALUE 0x75946 RL_VAL_UW 0 CM_0307 0 1.999969482 /end CHARACTERISTIC
/begin CHARACTERISTIC K_LAVK_OBD_ACT_EXD_TIME "Prueflauf Freigabezeit [verified]" VALUE 0x75956 RL_VAL_UW 0 CM_0301 0 6553.5 /end CHARACTERISTIC
/begin CHARACTERISTIC K_LA_TRIM_DIAG_I_MAX_SCHW "Schwelle f. Anzahl I-Anteil max. Begrenzung [verified]" VALUE 0x74242 RL_VAL_UW 0 CM_0000 0 65535 /end CHARACTERISTIC
/begin CHARACTERISTIC K_LA_TRIM_DIAG_I_MIN_SCHW "Schwelle f. Anzahl I-Anteil min. Begrenzung [verified]" VALUE 0x74240 RL_VAL_UW 0 CM_0000 0 65535 /end CHARACTERISTIC
/begin CHARACTERISTIC K_LA_TRIM_DIAG_I_T "min. Zeit fuer Anschlag d. I-Aneiles [verified]" VALUE 0x74252 RL_VAL_UW 0 CM_0247 0 655.35 /end CHARACTERISTIC
/begin CHARACTERISTIC K_LA_TRIM_DIAG_I_AD_MAX_SCHW "Schwelle f. Anzahl I-Adaption max. Begrenzung [verified]" VALUE 0x74250 RL_VAL_UW 0 CM_0000 0 65535 /end CHARACTERISTIC
/begin CHARACTERISTIC K_LA_TRIM_DIAG_I_AD_MIN_SCHW "Schwelle f. Anzahl I-Adaption min. Begrenzung [verified]" VALUE 0x7424E RL_VAL_UW 0 CM_0000 0 65535 /end CHARACTERISTIC
/begin COMPU_METHOD CM_0000 "X" RAT_FUNC "%.4g" "-" COEFFS 0 1 0 0 0 1 /end COMPU_METHOD
/begin COMPU_METHOD CM_0002 "X" RAT_FUNC "%.4g" "Upm" COEFFS 0 1 0 0 0 1 /end COMPU_METHOD
/begin COMPU_METHOD CM_0003 "X*0.0001" RAT_FUNC "%.4g" "-" COEFFS 0 1 0 0 0 0.0001 /end COMPU_METHOD
/begin COMPU_METHOD CM_0006 "X*0.1-273.2" RAT_FUNC "%.4g" "?C" COEFFS 0 1 273.2 0 0 0.1 /end COMPU_METHOD
/begin COMPU_METHOD CM_0010 "X*0.0625" RAT_FUNC "%.4g" "km/h" COEFFS 0 1 0 0 0 0.0625 /end COMPU_METHOD
/begin COMPU_METHOD CM_0016 "X*0.0009765625" RAT_FUNC "%.4g" "-" COEFFS 0 1 0 0 0 0.0009765625 /end COMPU_METHOD
/begin COMPU_METHOD CM_0017 "X*0.1" RAT_FUNC "%.4g" "Nm" COEFFS 0 1 0 0 0 0.1 /end COMPU_METHOD
/begin COMPU_METHOD CM_0019 "X*0.0000610352" RAT_FUNC "%.4g" "-" COEFFS 0 1 0 0 0 6.10352e-05 /end COMPU_METHOD
/begin COMPU_METHOD CM_0020 "X*0.005" RAT_FUNC "%.4g" "s" COEFFS 0 1 0 0 0 0.005 /end COMPU_METHOD
/begin COMPU_METHOD CM_0021 "X*0.1" RAT_FUNC "%.4g" "V" COEFFS 0 1 0 0 0 0.1 /end COMPU_METHOD
/begin COMPU_METHOD CM_0022 "X*0.0625" RAT_FUNC "%.4g" "mbar" COEFFS 0 1 0 0 0 0.0625 /end COMPU_METHOD
/begin COMPU_METHOD CM_0023 "X*0.1" RAT_FUNC "%.4g" "s" COEFFS 0 1 0 0 0 0.1 /end COMPU_METHOD
/begin COMPU_METHOD CM_0025 "X*0.01" RAT_FUNC "%.4g" "s" COEFFS 0 1 0 0 0 0.01 /end COMPU_METHOD
/begin COMPU_METHOD CM_0026 "X*0.78125" RAT_FUNC "%.4g" "%" COEFFS 0 1 0 0 0 0.78125 /end COMPU_METHOD
/begin COMPU_METHOD CM_0027 "X" RAT_FUNC "%.4g" "s" COEFFS 0 1 0 0 0 1 /end COMPU_METHOD
/begin COMPU_METHOD CM_0028 "X*0.1" RAT_FUNC "%.4g" "?KW" COEFFS 0 1 0 0 0 0.1 /end COMPU_METHOD
/begin COMPU_METHOD CM_0042 "X*0.025" RAT_FUNC "%.4g" "m/(s*s)" COEFFS 0 1 0 0 0 0.025 /end COMPU_METHOD
/begin COMPU_METHOD CM_0044 "X*0.01" RAT_FUNC "%.4g" "%" COEFFS 0 1 0 0 0 0.01 /end COMPU_METHOD
/begin COMPU_METHOD CM_0051 "X*0.0000305176" RAT_FUNC "%.4g" "-" COEFFS 0 1 0 0 0 3.05176e-05 /end COMPU_METHOD
/begin COMPU_METHOD CM_0064 "X*0.001" RAT_FUNC "%.4g" "s" COEFFS 0 1 0 0 0 0.001 /end COMPU_METHOD
/begin COMPU_METHOD CM_0081 "X*10" RAT_FUNC "%.4g" "Upm/s" COEFFS 0 1 0 0 0 10 /end COMPU_METHOD
/begin COMPU_METHOD CM_0082 "X" RAT_FUNC "%.4g" "km" COEFFS 0 1 0 0 0 1 /end COMPU_METHOD
/begin COMPU_METHOD CM_0083 "X*100.0" RAT_FUNC "%.4g" "Upm/s" COEFFS 0 1 0 0 0 100 /end COMPU_METHOD
/begin COMPU_METHOD CM_0087 "X" RAT_FUNC "%.4g" "digit" COEFFS 0 1 0 0 0 1 /end COMPU_METHOD
/begin COMPU_METHOD CM_0091 "X*0.09765625" RAT_FUNC "%.4g" "%" COEFFS 0 1 0 0 0 0.09765625 /end COMPU_METHOD
/begin COMPU_METHOD CM_0102 "X*0.1" RAT_FUNC "%.4g" "kg/h" COEFFS 0 1 0 0 0 0.1 /end COMPU_METHOD
/begin COMPU_METHOD CM_0104 "X*0.1" RAT_FUNC "%.4g" "mg" COEFFS 0 1 0 0 0 0.1 /end COMPU_METHOD
/begin COMPU_METHOD CM_0106 "X" RAT_FUNC "%.4g" "raw" COEFFS 0 1 0 0 0 1 /end COMPU_METHOD
/begin COMPU_METHOD CM_0108 "X" RAT_FUNC "%.4g" "min" COEFFS 0 1 0 0 0 1 /end COMPU_METHOD
/begin COMPU_METHOD CM_0123 "X*0.29296875" RAT_FUNC "%.4g" "mm" COEFFS 0 1 0 0 0 0.29296875 /end COMPU_METHOD
/begin COMPU_METHOD CM_0124 "X" RAT_FUNC "%.4g" "Kelvin" COEFFS 0 1 0 0 0 1 /end COMPU_METHOD
/begin COMPU_METHOD CM_0125 "X*0.296735905" RAT_FUNC "%.4g" "mm" COEFFS 0 1 0 0 0 0.296735905 /end COMPU_METHOD
/begin COMPU_METHOD CM_0126 "X*12.5" RAT_FUNC "%.4g" "%" COEFFS 0 1 0 0 0 12.5 /end COMPU_METHOD
/begin COMPU_METHOD CM_0127 "X*0.05" RAT_FUNC "%.4g" "s" COEFFS 0 1 0 0 0 0.05 /end COMPU_METHOD
/begin COMPU_METHOD CM_0128 "X*0.08" RAT_FUNC "%.4g" "A" COEFFS 0 1 0 0 0 0.08 /end COMPU_METHOD
/begin COMPU_METHOD CM_0129 "X*0.02" RAT_FUNC "%.4g" "A" COEFFS 0 1 0 0 0 0.02 /end COMPU_METHOD
/begin COMPU_METHOD CM_0130 "X*0.00625" RAT_FUNC "%.4g" "s" COEFFS 0 1 0 0 0 0.00625 /end COMPU_METHOD
/begin COMPU_METHOD CM_0131 "X*0.0196" RAT_FUNC "%.4g" "V" COEFFS 0 1 0 0 0 0.0196 /end COMPU_METHOD
/begin COMPU_METHOD CM_0132 "X*0.064+6.0" RAT_FUNC "%.4g" "V" COEFFS 0 1 -6 0 0 0.064 /end COMPU_METHOD
/begin COMPU_METHOD CM_0133 "X*5.12" RAT_FUNC "%.4g" "-" COEFFS 0 1 0 0 0 5.12 /end COMPU_METHOD
/begin COMPU_METHOD CM_0134 "X*0.04" RAT_FUNC "%.4g" "A" COEFFS 0 1 0 0 0 0.04 /end COMPU_METHOD
/begin COMPU_METHOD CM_0135 "X*256.0" RAT_FUNC "%.4g" "s" COEFFS 0 1 0 0 0 256 /end COMPU_METHOD
/begin COMPU_METHOD CM_0136 "X*0.0125" RAT_FUNC "%.4g" "s" COEFFS 0 1 0 0 0 0.0125 /end COMPU_METHOD
/begin COMPU_METHOD CM_0137 "X*0.002+0.01" RAT_FUNC "%.4g" "s" COEFFS 0 1 -0.01 0 0 0.002 /end COMPU_METHOD
/begin COMPU_METHOD CM_0138 "X*16.0" RAT_FUNC "%.4g" "s" COEFFS 0 1 0 0 0 16 /end COMPU_METHOD
/begin COMPU_METHOD CM_0142 "X*0.001" RAT_FUNC "%.4g" "bar" COEFFS 0 1 0 0 0 0.001 /end COMPU_METHOD
/begin COMPU_METHOD CM_0150 "X" RAT_FUNC "%.4g" "%" COEFFS 0 1 0 0 0 1 /end COMPU_METHOD
/begin COMPU_METHOD CM_0151 "X" RAT_FUNC "%.4g" "?C" COEFFS 0 1 0 0 0 1 /end COMPU_METHOD
/begin COMPU_METHOD CM_0152 "X*100.0" RAT_FUNC "%.4g" "ms" COEFFS 0 1 0 0 0 100 /end COMPU_METHOD
/begin COMPU_METHOD CM_0153 "X*3.125" RAT_FUNC "%.4g" "bar/s" COEFFS 0 1 0 0 0 3.125 /end COMPU_METHOD
/begin COMPU_METHOD CM_0154 "X*0.0625" RAT_FUNC "%.4g" "mbar/s" COEFFS 0 1 0 0 0 0.0625 /end COMPU_METHOD
/begin COMPU_METHOD CM_0155 "X*0.0000305176" RAT_FUNC "%.4g" "%" COEFFS 0 1 0 0 0 3.05176e-05 /end COMPU_METHOD
/begin COMPU_METHOD CM_0159 "X*0.1" RAT_FUNC "%.4g" "?C" COEFFS 0 1 0 0 0 0.1 /end COMPU_METHOD
/begin COMPU_METHOD CM_0161 "X*0.125" RAT_FUNC "%.4g" "l/h" COEFFS 0 1 0 0 0 0.125 /end COMPU_METHOD
/begin COMPU_METHOD CM_0163 "X*4.8828125" RAT_FUNC "%.4g" "mV" COEFFS 0 1 0 0 0 4.8828125 /end COMPU_METHOD
/begin COMPU_METHOD CM_0164 "X*0.00390625" RAT_FUNC "%.4g" "-" COEFFS 0 1 0 0 0 0.00390625 /end COMPU_METHOD
/begin COMPU_METHOD CM_0168 "X" RAT_FUNC "%.4g" "mg" COEFFS 0 1 0 0 0 1 /end COMPU_METHOD
/begin COMPU_METHOD CM_0170 "X*0.015625" RAT_FUNC "%.4g" "mg/ASP" COEFFS 0 1 0 0 0 0.015625 /end COMPU_METHOD
/begin COMPU_METHOD CM_0174 "X*0.1" RAT_FUNC "%.4g" "Ohm" COEFFS 0 1 0 0 0 0.1 /end COMPU_METHOD
/begin COMPU_METHOD CM_0177 "X" RAT_FUNC "%.4g" "sec" COEFFS 0 1 0 0 0 1 /end COMPU_METHOD
/begin COMPU_METHOD CM_0191 "X*0.0942" RAT_FUNC "%.4g" "V" COEFFS 0 1 0 0 0 0.0942 /end COMPU_METHOD
/begin COMPU_METHOD CM_0192 "X*0.5" RAT_FUNC "%.4g" "l" COEFFS 0 1 0 0 0 0.5 /end COMPU_METHOD
/begin COMPU_METHOD CM_0207 "X" RAT_FUNC "%.4g" "kHz" COEFFS 0 1 0 0 0 1 /end COMPU_METHOD
/begin COMPU_METHOD CM_0208 "X" RAT_FUNC "%.4g" "y-Koordinate" COEFFS 0 1 0 0 0 1 /end COMPU_METHOD
/begin COMPU_METHOD CM_0209 "X*0.0625" RAT_FUNC "%.4g" "-" COEFFS 0 1 0 0 0 0.0625 /end COMPU_METHOD
/begin COMPU_METHOD CM_0219 "X*0.09765625" RAT_FUNC "%.4g" "%/100ms" COEFFS 0 1 0 0 0 0.09765625 /end COMPU_METHOD
/begin COMPU_METHOD CM_0220 "X*0.04395" RAT_FUNC "%.4g" "Grad" COEFFS 0 1 0 0 0 0.04395 /end COMPU_METHOD
/begin COMPU_METHOD CM_0221 "X*0.5" RAT_FUNC "%.4g" "Nm" COEFFS 0 1 0 0 0 0.5 /end COMPU_METHOD
/begin COMPU_METHOD CM_0222 "X*0.625" RAT_FUNC "%.4g" "mbar/s" COEFFS 0 1 0 0 0 0.625 /end COMPU_METHOD
/begin COMPU_METHOD CM_0228 "X" RAT_FUNC "%.4g" "mA" COEFFS 0 1 0 0 0 1 /end COMPU_METHOD
/begin COMPU_METHOD CM_0232 "X*0.03125" RAT_FUNC "%.4g" "mg" COEFFS 0 1 0 0 0 0.03125 /end COMPU_METHOD
/begin COMPU_METHOD CM_0235 "X" RAT_FUNC "%.4g" "rpm" COEFFS 0 1 0 0 0 1 /end COMPU_METHOD
/begin COMPU_METHOD CM_0236 "X*0.00006103515625" RAT_FUNC "%.4g" "-" COEFFS 0 1 0 0 0 6.103515625e-05 /end COMPU_METHOD
/begin COMPU_METHOD CM_0237 "X*0.000030517578125" RAT_FUNC "%.4g" "-" COEFFS 0 1 0 0 0 3.051757812e-05 /end COMPU_METHOD
/begin COMPU_METHOD CM_0240 "X/1000" RAT_FUNC "%.4g" "bar" COEFFS 0 1000 0 0 0 1 /end COMPU_METHOD
/begin COMPU_METHOD CM_0243 "X/10" RAT_FUNC "%.4g" "?C" COEFFS 0 10 0 0 0 1 /end COMPU_METHOD
/begin COMPU_METHOD CM_0245 "X*32/32768" RAT_FUNC "%.4g" "-" COEFFS 0 1024 0 0 0 1 /end COMPU_METHOD
/begin COMPU_METHOD CM_0247 "X/100" RAT_FUNC "%.4g" "s" COEFFS 0 100 0 0 0 1 /end COMPU_METHOD
/begin COMPU_METHOD CM_0252 "X/8" RAT_FUNC "%.4g" "l/h" COEFFS 0 8 0 0 0 1 /end COMPU_METHOD
/begin COMPU_METHOD CM_0253 "X*0.1" RAT_FUNC "%.4g" "A" COEFFS 0 1 0 0 0 0.1 /end COMPU_METHOD
/begin COMPU_METHOD CM_0254 "(X*100)/1024" RAT_FUNC "%.4g" "%" COEFFS 0 256 0 0 0 25 /end COMPU_METHOD
/begin COMPU_METHOD CM_0255 "X/10" RAT_FUNC "%.4g" "kg/h" COEFFS 0 10 0 0 0 1 /end COMPU_METHOD
/begin COMPU_METHOD CM_0256 "(X-2732)/10" RAT_FUNC "%.4g" "?C" COEFFS 0 10 2732 0 0 1 /end COMPU_METHOD
/begin COMPU_METHOD CM_0259 "X/16384" RAT_FUNC "%.4g" "-" COEFFS 0 16384 0 0 0 1 /end COMPU_METHOD
/begin COMPU_METHOD CM_0260 "X/16" RAT_FUNC "%.4g" "km/h" COEFFS 0 16 0 0 0 1 /end COMPU_METHOD
/begin COMPU_METHOD CM_0276 "X/10" RAT_FUNC "%.4g" "%" COEFFS 0 10 0 0 0 1 /end COMPU_METHOD
/begin COMPU_METHOD CM_0277 "2.56/X" RAT_FUNC "%.4g" "s" COEFFS 0 0 -2.56 0 -1 0 /end COMPU_METHOD
/begin COMPU_METHOD CM_0280 "X/10" RAT_FUNC "%.4g" "?KW" COEFFS 0 10 0 0 0 1 /end COMPU_METHOD
/begin COMPU_METHOD CM_0282 "X/10000" RAT_FUNC "%.4g" "-" COEFFS 0 10000 0 0 0 1 /end COMPU_METHOD
/begin COMPU_METHOD CM_0286 "655.35/X" RAT_FUNC "%.4g" "s" COEFFS 0 0 -655.35 0 -1 0 /end COMPU_METHOD
/begin COMPU_METHOD CM_0291 "X/16" RAT_FUNC "%.4g" "mbar" COEFFS 0 16 0 0 0 1 /end COMPU_METHOD
/begin COMPU_METHOD CM_0292 "X" RAT_FUNC "%.4g" "KW tooth" COEFFS 0 1 0 0 0 1 /end COMPU_METHOD
/begin COMPU_METHOD CM_0297 "X/10" RAT_FUNC "%.4g" "V" COEFFS 0 10 0 0 0 1 /end COMPU_METHOD
/begin COMPU_METHOD CM_0301 "X/10" RAT_FUNC "%.4g" "s" COEFFS 0 10 0 0 0 1 /end COMPU_METHOD
/begin COMPU_METHOD CM_0302 "X/1024" RAT_FUNC "%.4g" "NT_F" COEFFS 0 1024 0 0 0 1 /end COMPU_METHOD
/begin COMPU_METHOD CM_0303 "X/40-273.15" RAT_FUNC "%.4g" "?C" COEFFS 0 40 10926 0 0 1 /end COMPU_METHOD
/begin COMPU_METHOD CM_0306 "25.6/X" RAT_FUNC "%.4g" "s" COEFFS 0 0 -25.6 0 -1 0 /end COMPU_METHOD
/begin COMPU_METHOD CM_0307 "X/32768" RAT_FUNC "%.4g" "-" COEFFS 0 32768 0 0 0 1 /end COMPU_METHOD
/begin COMPU_METHOD CM_0311 "X/100" RAT_FUNC "%.4g" "%" COEFFS 0 100 0 0 0 1 /end COMPU_METHOD
/begin COMPU_METHOD CM_0312 "X/327.68" RAT_FUNC "%.4g" "%" COEFFS 0 1 0 0 0 0.003051757812 /end COMPU_METHOD
/begin COMPU_METHOD CM_0315 "X/1000" RAT_FUNC "%.4g" "-" COEFFS 0 1000 0 0 0 1 /end COMPU_METHOD
/begin COMPU_METHOD CM_0324 "6553.5/X" RAT_FUNC "%.4g" "s" COEFFS 0 0 -6553.5 0 -1 0 /end COMPU_METHOD
/begin COMPU_METHOD CM_0348 "X" RAT_FUNC "%.4g" "0" COEFFS 0 1 0 0 0 1 /end COMPU_METHOD
/begin COMPU_METHOD CM_0380 "X*0.01666666667" RAT_FUNC "%.4g" "min" COEFFS 0 1 0 0 0 0.01666666667 /end COMPU_METHOD
/begin COMPU_METHOD CM_0393 "X*0.5-40" RAT_FUNC "%.4g" "?C" COEFFS 0 1 40 0 0 0.5 /end COMPU_METHOD
/begin COMPU_METHOD CM_0402 "X*0.03333333333" RAT_FUNC "%.4g" "l" COEFFS 0 1 0 0 0 0.03333333333 /end COMPU_METHOD
/begin COMPU_METHOD CM_0414 "X*6.103515625e-05" RAT_FUNC "%.4g" "-*s" COEFFS 0 1 0 0 0 6.103515625e-05 /end COMPU_METHOD
/begin COMPU_METHOD CM_0415 "X*0.008" RAT_FUNC "%.4g" "kg/h" COEFFS 0 1 0 0 0 0.008 /end COMPU_METHOD
/begin COMPU_METHOD CM_0416 "X*0.1" RAT_FUNC "%.4g" "kg/h/0.01s" COEFFS 0 1 0 0 0 0.1 /end COMPU_METHOD
/begin COMPU_METHOD CM_0434 "X" RAT_FUNC "%.4g" "[A_E]" COEFFS 0 1 0 0 0 1 /end COMPU_METHOD
/begin COMPU_METHOD CM_0436 "X/10" RAT_FUNC "%.4g" "[A_E][j]" COEFFS 0 10 0 0 0 1 /end COMPU_METHOD
/begin COMPU_METHOD CM_0455 "X/156" RAT_FUNC "%.4g" "-" COEFFS 0 156 0 0 0 1 /end COMPU_METHOD
/begin COMPU_METHOD CM_0456 "X/16384" RAT_FUNC "%.4g" "LAM_SOLL" COEFFS 0 16384 0 0 0 1 /end COMPU_METHOD
/begin COMPU_METHOD CM_0457 "X/16384" RAT_FUNC "%.4g" "_" COEFFS 0 16384 0 0 0 1 /end COMPU_METHOD
/begin COMPU_METHOD CM_0458 "X/0.2048" RAT_FUNC "%.4g" "LANK_FETT" COEFFS 0 1 0 0 0 4.8828125 /end COMPU_METHOD
/begin RECORD_LAYOUT RL_BLK_UB FNC_VALUES 1 UBYTE ROW_DIR DIRECT /end RECORD_LAYOUT
/begin RECORD_LAYOUT RL_CUR_SW_SW FNC_VALUES 4 SWORD COLUMN_DIR DIRECT AXIS_PTS_X 3 SWORD INDEX_INCR DIRECT NO_AXIS_PTS_X 1 UBYTE RESERVED 2 BYTE /end RECORD_LAYOUT
/begin RECORD_LAYOUT RL_CUR_SW_UB FNC_VALUES 4 UBYTE COLUMN_DIR DIRECT AXIS_PTS_X 3 SWORD INDEX_INCR DIRECT NO_AXIS_PTS_X 1 UBYTE RESERVED 2 BYTE /end RECORD_LAYOUT
/begin RECORD_LAYOUT RL_CUR_SW_UW FNC_VALUES 4 UWORD COLUMN_DIR DIRECT AXIS_PTS_X 3 SWORD INDEX_INCR DIRECT NO_AXIS_PTS_X 1 UBYTE RESERVED 2 BYTE /end RECORD_LAYOUT
/begin RECORD_LAYOUT RL_CUR_UW_SW FNC_VALUES 4 SWORD COLUMN_DIR DIRECT AXIS_PTS_X 3 UWORD INDEX_INCR DIRECT NO_AXIS_PTS_X 1 UBYTE RESERVED 2 BYTE /end RECORD_LAYOUT
/begin RECORD_LAYOUT RL_CUR_UW_UW FNC_VALUES 4 UWORD COLUMN_DIR DIRECT AXIS_PTS_X 3 UWORD INDEX_INCR DIRECT NO_AXIS_PTS_X 1 UBYTE RESERVED 2 BYTE /end RECORD_LAYOUT
/begin RECORD_LAYOUT RL_MAP_SW_SW_SW FNC_VALUES 5 SWORD COLUMN_DIR DIRECT AXIS_PTS_X 3 SWORD INDEX_INCR DIRECT AXIS_PTS_Y 4 SWORD INDEX_INCR DIRECT NO_AXIS_PTS_X 1 UBYTE NO_AXIS_PTS_Y 2 UBYTE /end RECORD_LAYOUT
/begin RECORD_LAYOUT RL_MAP_SW_SW_UW FNC_VALUES 5 UWORD COLUMN_DIR DIRECT AXIS_PTS_X 3 SWORD INDEX_INCR DIRECT AXIS_PTS_Y 4 SWORD INDEX_INCR DIRECT NO_AXIS_PTS_X 1 UBYTE NO_AXIS_PTS_Y 2 UBYTE /end RECORD_LAYOUT
/begin RECORD_LAYOUT RL_MAP_SW_UW_SW FNC_VALUES 5 SWORD COLUMN_DIR DIRECT AXIS_PTS_X 3 SWORD INDEX_INCR DIRECT AXIS_PTS_Y 4 UWORD INDEX_INCR DIRECT NO_AXIS_PTS_X 1 UBYTE NO_AXIS_PTS_Y 2 UBYTE /end RECORD_LAYOUT
/begin RECORD_LAYOUT RL_MAP_UW_UW_UW FNC_VALUES 5 UWORD COLUMN_DIR DIRECT AXIS_PTS_X 3 UWORD INDEX_INCR DIRECT AXIS_PTS_Y 4 UWORD INDEX_INCR DIRECT NO_AXIS_PTS_X 1 UBYTE NO_AXIS_PTS_Y 2 UBYTE /end RECORD_LAYOUT
/begin RECORD_LAYOUT RL_VAL_SB FNC_VALUES 1 SBYTE COLUMN_DIR DIRECT /end RECORD_LAYOUT
/begin RECORD_LAYOUT RL_VAL_SW FNC_VALUES 1 SWORD COLUMN_DIR DIRECT /end RECORD_LAYOUT
/begin RECORD_LAYOUT RL_VAL_UB FNC_VALUES 1 UBYTE COLUMN_DIR DIRECT /end RECORD_LAYOUT
/begin RECORD_LAYOUT RL_VAL_UL FNC_VALUES 1 ULONG COLUMN_DIR DIRECT /end RECORD_LAYOUT
/begin RECORD_LAYOUT RL_VAL_UW FNC_VALUES 1 UWORD COLUMN_DIR DIRECT /end RECORD_LAYOUT
/begin GROUP G_Other___System___communication "Other - System & communication" ROOT
 /begin REF_CHARACTERISTIC K_VERS_DATEN__INJ_ K_VERS_NAME__INJ_ K_VERS_PROG__INJ_ K_VERS_PROZ__INJ_ K_DEBUG_READ_ADR__INJ_ K_DEBUG_RW_LENGTH__INJ_ K_DEBUG_WRITE_ADR__INJ_ K_DEBUG_WRITE_VALUE__INJ_ K_N_BEGR_FERTIGUNG K_N_BEGR_FETRAWE_WEG K_N_BEGR_TRANSPORT K_N_BEGR_WERKSTATT K_CODIER_INDEX__INJ_ K_TPU_KW_N_MIN__INJ_ K_TPU_KW_SYNC_ZAHN__INJ_ KF_OZ_TEMP_KOR KF_SCHNELLMSG_OZNIVR_MIN KL_GEN_AUSL_BEGR K_GEN_SLP_UG K_BSD_BUS_ENABLE K_BSD_KTENABLE K_DI1000DT K_DI1000STG K_DI1000TGRZ K_DI200DT K_DI200STG K_DIHIGHGRZ K_DILOWGRZ K_DIPL5 K_DIPL6 K_DIPL8 K_DKL15FIL K_DTMAXGRZI K_DUIGRZ K_DUMINTGRZ K_DUREFMAX K_DUREFMINI K_ENABSDIBS K_ENISOC0 K_ENUSOC0 K_IBTEMPMAXI K_IBTEMPMINI K_ISLEEPGRZ K_ISTARTTRIG K_S_CLERRIBS K_T1SCHWELLE K_T1SOC0 K_T2SCHWELLE K_T2SOC0 K_T3SCHWELLE K_T3SOC0 K_TMPCOM_DIV K_TMPCOM_MUL K_TNUSTART K_TNUSTARTFL K_TSLEEPRUH K_T_CLERRIBS K_T_UTIEFSET K_UTIEFAPP K_EWS_FETRAWE_WEG K_CAN_KEY_NO_MCS KL_SPGR_FREQ KL_STAT_DATA_N KL_STAT_DATA_RF KL_STAT_DATA_TDME KL_STAT_DATA_TMOT KL_STAT_DATA_TOEL KL_STAT_DATA_V K_BSD_SCHEDTAB_10of32_ K_BSD_SCHEDTAB_11of32_ K_BSD_SCHEDTAB_12of32_ K_BSD_SCHEDTAB_13of32_ K_BSD_SCHEDTAB_14of32_ K_BSD_SCHEDTAB_15of32_ K_BSD_SCHEDTAB_16of32_ K_BSD_SCHEDTAB_17of32_ K_BSD_SCHEDTAB_18of32_ K_BSD_SCHEDTAB_19of32_ K_BSD_SCHEDTAB_1of32_ K_BSD_SCHEDTAB_20of32_ K_BSD_SCHEDTAB_21of32_ K_BSD_SCHEDTAB_22of32_ K_BSD_SCHEDTAB_23of32_ K_BSD_SCHEDTAB_24of32_ K_BSD_SCHEDTAB_25of32_ K_BSD_SCHEDTAB_26of32_ K_BSD_SCHEDTAB_27of32_ K_BSD_SCHEDTAB_28of32_ K_BSD_SCHEDTAB_29of32_ K_BSD_SCHEDTAB_2of32_ K_BSD_SCHEDTAB_30of32_ K_BSD_SCHEDTAB_31of32_ K_BSD_SCHEDTAB_32of32_ K_BSD_SCHEDTAB_3of32_ K_BSD_SCHEDTAB_4of32_ K_BSD_SCHEDTAB_5of32_ K_BSD_SCHEDTAB_6of32_ K_BSD_SCHEDTAB_7of32_ K_BSD_SCHEDTAB_8of32_ K_BSD_SCHEDTAB_9of32_ K_CAN_CRASH_CTR_TOUT K_CAN_ED_TSPERR K_CAN_ED_UB_MIN K_CAN_TUMG_MCS cfg.sg_mode K_IBUNPLADEL K_SLEEPWAIT /end REF_CHARACTERISTIC
/end GROUP
/begin GROUP G_x_Diagnostics__OBD__level_2__safety_concept__tester_ "x Diagnostics (OBD, level 2, safety concept, tester)" ROOT
 /begin REF_CHARACTERISTIC K_DIAGNOSE_INDEX_HI__INJ_ K_DIAGNOSE_INDEX_LO__INJ_ K_DIAG_TR_UB_MIN__INJ_ K_EGAS_CFG_DIAG K_N_BEGR_SK_RAMPE K_N_BEGR_TI_MAX_E2 K_N_BEGR_V_FEHLER K_N_OBD_DYN_DELTA K_N_OBD_DYN_T K_N_OBD_DYN_TAU K_SK_CFG__INJ_ K_SK_CRC32__INJ_ K_SK_EGAS_OFF_TIME__INJ_ K_SK_FGR_SPERRE__INJ_ K_SK_FM_EGAS_TEST__INJ_ K_SK_FM_FAIL_ZYL_TEST__INJ_ K_SK_FM_GEMISCH_TEST__INJ_ K_SK_FM_LAM_TEST__INJ_ K_SK_FM_MD_TEST__INJ_ K_SK_FM_MVAC_TEST__INJ_ K_SK_FM_SMG_TEST__INJ_ K_SK_FRA_SPERRE__INJ_ K_SK_HW_AD_DELTA_MAX K_SK_HW_AD_ED_ZAEHLER K_SK_HW_AD_STAT K_SK_HW_AD_STAT_ZAEHLER K_SK_KH_SPERRE__INJ_ K_SK_LAM_EINGR_TI__INJ_ K_SK_LLRA_SPERRE__INJ_ K_SK_MAX_OS_ERR__INJ_ K_SK_MAX_RESETS__INJ_ K_SK_MD_BEGR_DK_OFFEN__INJ_ K_SK_MD_BEGR_MVAC_SYS__INJ_ K_SK_MD_BEGR_RESET__INJ_ K_SK_MD_TI_EINGR__INJ_ K_SK_MD_VL_SPERRE__INJ_ K_SK_PKS_NOTLAUF__INJ_ K_SK_PROZ_ERR__INJ_ K_SK_TASK_ERR__INJ_ K_SK_T_RESET_DELAY_OS__INJ_ K_SK_ZYL_OFF_MAX__INJ_ K_SCHALTER_GETR_DIAG_N_GETR_EIN_MIN K_SCHALTER_GETR_DIAG_STABIL K_SCHALTER_GETR_DIAG_T K_SCHALTER_GETR_DIAG_V_MIN K_SCHALTER_KUPP_DIAG_N K_SCHALTER_KUPP_DIAG_RF K_SCHALTER_KUPP_DIAG_T K_SCHALTER_KUPP_DIAG_V_MAX K_SCHALTER_KUPP_DIAG_V_MIN K_SCHALTER_POEL_N_DIAG K_SCHALTER_POEL_T_DIAG K_SK_E2_KOMP_ERR_MAX__INJ_ K_SK_MAX_RESETS_E2__INJ_ K_DIAG_TR_MAX_ERR__INJ_ K_ELUP_OBD_BRPGRAD_SW K_ELUP_OBD_BRPGRAD_T K_ELUP_OBD_MVACP_GRAD_SW K_ELUP_OBD_MVACP_GRAD_T K_ELUP_OBD_PSAU_SW KF_FPLAU_FRA_OUT_ABW KF_FPLAU_OBD_AQ_DELTA_ML_MAX KF_FPLAU_OBD_HFM_DELTA_ML_MAX K_FPLAU_OBD_CFG KL_LA_TRIM_I_FAK_OBD KL_LA_TRIM_P_FAK_OBD KL_KAT_OBD_LANK_LAM KF_LAM_REG_K_OBD KF_LAM_SOLL_ADD_NEG_OBD KF_LAM_SOLL_ADD_POS_OBD KF_LAM_SOLL_MS_KAT_SOLL_MIN_OBD K_LAM_DIAG_LAA_F_HYS K_LAM_DIAG_LAA_OFFS_HYS K_LAM_SOLL_MS_KAT_F_OBD K_LAVK_AD_TEST K_LAVK_OBD_ACT_CFG K_LAVK_OBD_ACT_ML_SUM K_LAVK_OBD_ACT_M_T K_LAVK_OBD_ACT_N_MAX K_LAVK_OBD_ACT_N_MIN K_LAVK_OBD_ACT_RF_MAX K_LAVK_OBD_ACT_RF_MIN K_LAVK_OBD_ACT_TKAT K_LAVK_OBD_ACT_TRIM_F K_LAVK_OBD_ACT_TRIM_M K_LAVK_OBD_PLAU_F_CNT K_LAVK_OBD_PLAU_LAM_FETT K_LAVK_OBD_PLAU_LAM_MAGER K_LAVK_OBD_PLAU_LAM_MAX K_LAVK_OBD_PLAU_LAM_MIN K_LAVK_OBD_PLAU_LANK_MAX K_LAVK_OBD_PLAU_LANK_MIN K_LAVK_OBD_PLAU_M_CNT K_LAVK_OBD_PLAU_OL_CNT K_LAVK_OBD_PLAU_RF_MAX K_LAVK_OBD_PLAU_RF_MIN K_LAVK_OBD_PLAU_T K_LAVK_OBD_PLAU_TKAT_MAX K_LAVK_OBD_PLAU_TKAT_MIN K_LAVK_OBD_PLAU_UN_SCHW K_LSHNK_DIAG_RO K_LSHNK_DIAG_RU K_LSHVK_AD_TEST K_LSHVK_DIAG_ANZ_MESS K_LSHVK_DIAG_CFG K_LSHVK_DIAG_RO K_LSHVK_DIAG_RU K_LSHVK_DIAG_R_ADAPT K_LSHVK_DIAG_R_OFFSET K_LSHVK_DIAG_R_TAU K_LSHVK_DIAG_TEMP_IST_MAX K_LSHVK_DIAG_TEMP_IST_MIN K_LSRVK_OBD_CFG K_LSRVK_OBD_ML_SUM K_LSRVK_OBD_REF_GAIN_MIN K_LSRVK_OBD_REG_T K_LSRVK_OBD_START_R K_LSRVK_OBD_TKAT_MAX K_LSRVK_OBD_TKAT_MIN K_MVAC_P_DIAG_MAX K_MVAC_P_DIAG_MIN K_MVAC_P_OBD_PDIFF_DELAY K_MVAC_P_OBD_PDIFF_ROH_TAU K_MVAC_P_OBD_PDIFF_TAU K_MVAC_P_DIAG_TIME_ML KF_KAT_OBD_TEMP_REF KF_KAT_OBD_WICHT_GESAMT KF_LAVK_OBD_DYN_WICHT_GESAMT KL_KAT_OBD_IO_VERZ KL_LAVK_OBD_DYN_GESAMT_MAX KL_LAVK_OBD_DYN_IO_VERZ KL_LAVK_OBD_DYN_RF_MIN KL_LAVK_OBD_DYN_WERT_MAX K_KAT_OBD_CFG K_KAT_OBD_M_HUB_CNT K_O2_OBD_DYN_T_VERZ K_O2_OBD_LAM_SOLL_OFFS K_O2_OBD_LAVK_AD_OFFS_MAX K_O2_OBD_LAVK_AD_OFFS_MIN K_O2_OBD_N_MIN K_O2_OBD_PUMG_MIN K_O2_OBD_RF_T_MIN K_OZDIAGNMOT K_OZDIAGNMOT2 K_OZDIAGSPG K_PKS_OBD_AY K_PKS_OBD_CFG K_PKS_OBD_FST K_PKS_OBD_LL_MAX K_PKS_OBD_LL_MIN K_PKS_OBD_PUMG_MIN K_PKS_OBD_PUMPE_VL K_PKS_OBD_Q_EKP_MAX K_PKS_OBD_Q_EKP_MIN K_PKS_OBD_Q_MAX K_PKS_OBD_Q_MIN K_PKS_OBD_SOLL_DYN_MAX K_PKS_OBD_TL_MAX K_PKS_OBD_TL_MIN K_PKS_OBD_TMOT_MIN K_PKS_OBD_UB_MIN K_PKS_OBD_VERZ K_PKS_OBD_VERZ_Q_MAX S_PM_TEST1 KL_RF_E2_PUMG_KORR KL_RF_E2_TAN_KORR KL_SLS_OBDH_ASV_DIA_T KL_SLS_OBDH_HFM_DIAG_MIN KL_SLS_OBDH_ML_MDF_DIAG KL_TE_OBD_RAMPE K_TE_OBD_LAM_FREIG K_TE_OBD_LAM_OK K_TE_OBD_LL_DELAY K_TE_OBD_LL_DELTA K_TE_OBD_LL_ZU_DELTA K_TE_OBD_LRW_ABBR K_TE_OBD_MD_GEN_ABBR K_TE_OBD_MD_KKOS_ABBR K_TE_OBD_ML_MAX K_TE_OBD_TV_MAX K_TE_OBD_TZ_ABBR K_TE_OBD_UB_ABBR KF_PUMG_OBD_P_STAU_KOMP K_PUMG_DIAG_MAX K_PUMG_DIAG_MIN KL_FPLAU_OBD_PUMG_F K_VAN_INVERT_E2 K_LAM_SOLL_MS_KAT_MAX_OBD K_LAM_SOLL_MS_KAT_MIN_OBD K_LAM_SOLL_MS_KAT_SOLL_MAX_OBD KF_PKSR_PDIAG KF_PKSR_IDIAG KL_PKS_PLAU_INC K_LA_TRIM_DIAG_I_ED_F K_LA_TRIM_DIAG_I_AD_F K_LA_TRIM_DIAG_P_SCHW K_LA_TRIM_DIAG_P_SCHW_T K_N_BEGR_DKG_ERR K_ELUP_OBD_ABS_DEL K_ELUP_OBD_DEL K_N_BEGR_DKG_ERR_NEG K_VAN_KW_SPR_MAX_E2 K_VAN_EXD_N_SOLL K_VAN_EXD_SPR_MAX_MIN_E K_VAN_EXD_SPR_MAX_MIN_A K_VAN_EXD_T_ANSCHL K_VAN_EXD_LLR_TMAX K_VAN_EXD_TMOT_MIN K_VAN_EXD_VERST_SOLL_MAX_E K_VAN_EXD_VERST_SOLL_MIN_E K_VAN_EXD_VERST_SOLL_MAX_A K_VAN_EXD_VERST_SOLL_MIN_A K_VAN_EXD_VERST_TMAX K_VAN_EXD_VERST_TOL K_VAN_EXD_VERST_TOL_START K_VAN_CFG_E2 K_VAN_ANSCHL_I_E2 K_VAN_ERR_CFG KL_FPLAU_OBD_AQ_PSAU_CSS_F KL_FPLAU_OBD_LAM_CSS_F KL_FPLAU_OBD_TE_TMOT_T K_FPLAU_OBD_TMOT_WARM K_FPLAU_OBD_KH_CFG K_FPLAU_OBD_SLP_CFG K_FPLAU_OBD_TMOT_CSS_MAX K_FPLAU_OBD_T_MIN K_FPLAU_OBD_N_MIN K_FPLAU_OBD_N_MAX K_FPLAU_OBD_RML_MIN K_FPLAU_OBD_ML_MAX K_FPLAU_OBD_TE_F K_FPLAU_OBD_AQ_RBM_F K_FPLAU_OBD_TE_C_AKF K_FPLAU_OBD_SPUELEN_INT_F K_FPLAU_OBD_LL_V_MAX K_TE_OBD_AUSS_DELTA K_TE_OBD_AUSS_DELTA_NEG K_TE_OBD_ANZ K_TE_OBD_CFG K_TE_OBD_LAM_DELTA K_TE_OBD_F_MIN K_TE_OBD_N_SOLL_ABBR K_TE_OBD_RAMPE_ABBRUCH K_TE_OBD_RAMPE_ZU K_TE_OBD_T_GEIST K_TE_OBD_T_GEIST_DC K_TE_OBD_T_LAM_REG_OFF K_TE_OBD_T_MESS_OFFEN K_TE_OBD_T_MESS_ZU K_TE_OBD_TOEL_MIN K_TE_OBD_TOEL_MIN_EXD K_PKS_PLAU_DELTA_TAU K_PKS_OBD_ABW_TAU K_PKS_OBD_ABW_TAU_QMAX K_PKS_DIAG_MIN K_PKS_DIAG_MAX K_PKS_OBD_ERSATZ K_PKS_OBD_TIME_ML_MIN K_PKS_PLAU_SCHWELLE K_PKS_PLAU_INTG_MAX K_PKS_PLAU_INTG_MIN K_PKS_DIAG_AUFBAU_MIN K_PKS_DIAG_AUFBAU_TAU K_PKS_AUFBAU_FEHLER_VERZ K_PKS_DIAG_FEHLER_SCHW K_PKS_PLAU_MAX_I K_PKS_PLAU_MIN_T_REG K_PKS_DIAG_AUFBAU_DELAY K_PKS_PLAU_QMIN_N K_PKS_PLAU_QMIN_KVA K_PKS_PLAU_MIN_RF K_PKS_PLAU_MAX_RF K_PKS_PLAU_MIN_N K_PKS_PLAU_MAX_N K_PKS_PLAU_MIN_Q_EKP K_PKS_PLAU_MAX_Q_EKP K_MVAC_P_OBD_PDIFF_POS K_MVAC_P_OBD_PDIFF_NEG K_MVAC_P_OBD_PDIFF_TMOT K_SLS_OBD_CFG K_SLS_OBDH_T_AUFHEIZ K_SLS_OBDH_N_MIN K_SLS_OBDH_N_MAX K_SLS_OBDH_ML_MIN K_SLS_OBDH_ML_MAX K_SLS_OBDH_RF_MIN K_SLS_OBD_TMOT_MIN K_SLS_OBDH_UB_MIN K_SLS_OBDH_PUMG_MIN K_SLS_OBDH_MLVERH_MIN K_SLS_OBDH_T_SA K_PSAU_DIAG_MAX K_PSAU_DIAG_MIN K_PSAU_DIAG_TIME_MS_MIN K_PSAU_DIAG_PUMG_ABW K_LA_TRIM_DIAG_CFG K_TGETR_DIAG_TUMG_MIN K_TGETR_DIAG_MIN K_TGETR_DIAG_MAX KF_KAT_OBD_INT_WICHT KL_KAT_OBD_GESAMT_MAX KL_KAT_OBD_WERT_MAX KL_O2_OBD_RF_MIN K_CAN_CHKSUM_ERR_MAX K_DIAG_TR_UB_MIN K_FPLAU_AQ_OBD_CNT K_FPLAU_HFM_OBD_CNT K_FPLAU_LAM_OBD_CNT K_FPLAU_OBD_DYN_DELTA_RF K_FPLAU_OBD_DYN_RF_T K_FPLAU_OBD_T_DELTA K_FPLAU_OBD_T_MAX K_HFM_OBD_DYN_DELTA_RF K_KAT_OBD_LANK_MW_DELTA_MAX K_KAT_OBD_LANK_MW_DIFF_MAX K_KAT_OBD_LANK_MW_HYS_CHK1 K_KAT_OBD_LANK_MW_MAX K_KAT_OBD_LANK_MW_MIN K_KAT_OBD_TABG_T_VERZ K_KAT_OBD_VERH K_KAT_OBD_VERH_SCHWELLE K_KAT_OBD_WERT_MODE6 K_KAT_OBD_ZYKL_CNT_MAX K_LAM_DIAG_CFG K_LAM_DIAG_REG_T K_LAM_SOLL_MS_KAT_OFFSET_OBD K_LANK_DIAG_CFG K_LANK_DIAG_GND_T K_LANK_DIAG_MAX_T K_LANK_DIAG_OL_MAGER_CNT K_LANK_DIAG_OL_MAGER_T K_LANK_DIAG_OL_ML_MIN K_LANK_DIAG_OL_ML_STABIL_T K_LANK_DIAG_OL_N_MAX K_LANK_DIAG_OL_T K_LANK_DIAG_SONDTEMP K_LANK_DIAG_STAB_T K_LANK_DIAG_TKAT K_LANK_DIAG_UMAX K_LANK_DIAG_UMIN K_LANK_DIAG_VK_REG_T K_LANK_OBD_SLOPE_CNT_IO K_LANK_OBD_SLOPE_F_MAX K_LANK_OBD_SLOPE_F_MIN K_LANK_OBD_SLOPE_HYS K_LANK_OBD_S_CFG K_LANK_OBD_S_SA_ML_SUM K_LANK_OBD_S_SA_T_MIN_MODE6 K_LANK_OBD_S_SA_T_MODE6_FALSE K_LANK_OBD_S_USF_SA K_LANK_OBD_S_USF_SLOPE_MAX K_LAVK_ATIC42_SPI_DIAG_CNT K_LAVK_OBD_ACT_EXD_N_SOLL K_LAVK_OBD_ACT_LAM_IST_F K_LAVK_OBD_ACT_LAM_IST_M K_LAVK_OBD_ACT_LAM_SOLL_F K_LAVK_OBD_ACT_LAM_SOLL_M K_LAVK_OBD_ACT_LANK_F K_LAVK_OBD_ACT_LANK_M K_LAVK_OBD_ACT_NK_M_CNT K_LAVK_OBD_ACT_VK_F_CNT K_LAVK_OBD_ACT_VK_M_CNT K_LAVK_OBD_DYN_KAT_EXD_N_SOLL K_LAVK_OBD_DYN_KAT_EXD_RF_MIN K_LAVK_OBD_DYN_KAT_EXD_T K_LAVK_OBD_DYN_LAM_REG_MIN K_LAVK_OBD_DYN_NORM_CNT K_LAVK_OBD_DYN_TE_VOL_SUM K_LAVK_OBD_DYN_WERT_MODE6 K_LAVK_OBD_PLAU_CFG K_LAVK_OBD_PLAU_IP_N_MAX K_LAVK_OBD_PLAU_IP_N_MIN K_LAVK_OBD_PLAU_IP_REG_MAX K_LAVK_OBD_PLAU_IP_REG_MIN K_LAVK_OBD_PLAU_IP_STABIL_T K_LAVK_OBD_PLAU_ML_SUM K_LAVK_OBD_PLAU_UN_OSZI_OFF K_LAVK_OBD_SA_CFG K_LAVK_OBD_SA_CNT K_LAVK_OBD_SA_DIAG_OL K_LAVK_OBD_SA_ML_SUM K_LAVK_OBD_SA_SCHW K_LAVK_OBD_SA_T K_LAVK_OBD_TL_CFG K_LAVK_OBD_TL_CNT K_LAVK_OBD_TL_ML_SUM K_LAVK_OBD_TL_SCHW_MAX K_LAVK_OBD_TL_SCHW_MIN K_LAVK_OBD_TL_T K_LAVK_OBD_TMOT K_LAVK_OBD_VK_TEMP K_LA_OBD_DYN_CNT_INC K_LA_OBD_DYN_DELTA_CNT K_LA_OBD_DYN_DELTA_PUMP_RF K_LA_OBD_DYN_DELTA_RF K_LA_OBD_DYN_RF_T K_LSHNK_DIAG_R_TAU K_LSHNK_DIAG_TAUP_T K_LSRVK_OBD_REF_CNT K_LSRVK_OBD_REF_GAIN_MAX K_LSRVK_OBD_REF_OFFS_CNT K_LSRVK_OBD_REF_OFFS_MAX K_LSRVK_OBD_REF_OFFS_MIN K_MSKIBSDIAG K_MVAC_P_OBD_LL_TIME_MIN K_MVAC_P_OBD_SA_TIME_MIN K_O2_OBD_CFG K_O2_OBD_DYN_CNT_INC K_O2_OBD_DYN_DELTA_CNT K_O2_OBD_DYN_DELTA_PUMP_RF K_O2_OBD_DYN_RF_T K_O2_OBD_ML_MIN K_O2_OBD_N_MAX K_O2_OBD_RF_MAX K_O2_OBD_RF_MIN_HYS K_O2_OBD_SA_ML_MAX K_O2_OBD_TEV_MAX K_O2_OBD_TKAT_HYS K_O2_OBD_TKAT_MAX K_O2_OBD_TKAT_MIN K_O2_OBD_TMOT K_O2_OBD_T_ML K_O2_OBD_V_MAX K_O2_OBD_V_MIN K_O2_OBD_WE_ML_MIN K_OZ_PM_CC_CBS_MSG_TEST K_PKSR_ADAP_DIAG_T K_PKSR_EXD_DELTA_P_VL_FE K_PKSR_EXD_EKP1_TV_MAX K_PKSR_EXD_NMAX K_PKSR_EXD_TV_65 K_PUMG_MAX_E2 K_PUMG_MAX_NEG_GRAD_E2 K_PUMG_MAX_POS_GRAD_E2 K_PUMG_MIN_E2 K_PUMG_OBD_ABW K_PUMG_OBD_PUMG_TAU K_PUMG_OBD_TIME_ML_MIN K_SCHALTER_GETR_DIAG_MAX K_SCHALTER_GETR_DIAG_MIN K_SCHALTER_GETR_DIAG_N_VERH_TAU K_SLS_OBDH_ASV_LI_OPE K_SLS_OBDH_ASV_PL_RE_OPE K_SLS_OBDH_ASV_RE_OPE K_SLS_OBDH_HFM_MAX K_SLS_OBDH_HYD_ABBRUCH_AD_MAX K_SLS_OBDH_HYD_ABBRUCH_ML_MAX K_SLS_OBDH_ML_TMOT K_SLS_OBDH_T_SLV_INT_START K_SLS_OBD_ML_MDL_DIFF_MAX K_SLS_OBD_ML_MDL_WICHT K_SL_ML_HFM_DIAG_MAX K_SL_ML_HFM_DIAG_MIN K_TD_DIAG_CFG K_VAN_TV_MCS_E2 K_WF_IST_PLAU_MAX K_CAN_ALIVE_ERR_MAX K_ERREPEAT K_LAM_DIAG_LAA_T K_LANK_OBD_S_SA_WE_T K_LANK_OBD_S_VL_T K_LAVK_OBD_ACT_F_T K_LAVK_OBD_ACT_NK_F_CNT K_LAVK_OBD_DYN_CFG K_LAVK_OBD_DYN_KAT_EXD_RF_MAX K_LSHNK_DIAG_CFG K_O2_OBD_DYN_DELTA_RF K_PKS_OBD_SOLL_DYN_TAU K_PUMG_OBD_ML_MS KL_LSHVK_DIAG_TIME_ML KF_KAT_OBD_TEMP_F KF_FPLAU_OBD_AQ_DELTA_ML_MIN KF_FPLAU_OBD_PSAU_DELTA_ML_MAX KL_SLS_OBDH_ASV_LAM_LEAK_MAX K_VAN_EXD_I_MAX_E K_VAN_EXD_I_MAX_A K_VAN_EXD_I_MIN_E K_VAN_EXD_I_MIN_A K_VAN_SPR_OFFSET_E2 K_PUMG_OBD_FPLAU_FREIGABE K_PUMG_OBD_PSAU_MDL_ABW K_PUMG_OBD_MODEL_DELTA_MAX K_PUMG_OBD_MIN_MESS K_PUMG_OBD_CFG K_PUMG_OBD_PSAU_DELAY K_PUMG_OBD_TUMG_MIN K_PUMG_OBD_ML_DELTA_TAU K_PUMG_OBD_TIME_VL_MIN K_PUMG_OBD_TIME_MS_MIN K_PUMG_OBD_ML_DELTA_MIN_DIFF K_PUMG_OBD_LLS_MAX K_SK_EGAS_OFF K_SK_MD_BEGR_EGAS K_SK_MD_BEGR_TI K_SK_TI_OFF_EGAS K_SK_MD_BEGR_SMG K_SK_MD_BEGR_MD K_SK_MD_BEGR_GEMISCH K_SK_LAM_EINGR K_SK_MD_BEGR_PWG K_SK_MD_BEGR_MVAC K_SK_MVAC_KH K_TE_OBD_AUSS_TAU K_TE_OBD_ML_TAU K_TE_OBD_OK K_TE_OBD_T_ML_MIN K_SLS_OBDH_T_HFM_DIA K_SLS_OBDH_T_ML_PLAUSI K_SLS_OBDH_ASV_TAU K_SLS_OBDH_DYN_DELTA_RF K_SLS_OBDH_DYN_RF_T K_FST_CAN_FEHLER K_LAVK_OBD_DYN_INT_PER_MAX K_LAVK_OBD_DYN_INT_PER_MIN K_LAVK_OBD_DYN_INT_MAX K_LAVK_OBD_DYN_INT_MIN K_LAVK_OBD_DYN_INT_PER_STABIL K_LAVK_OBD_DYN_INT_CNT K_LAVK_OBD_DYN_LAM_REG_MAX K_LAVK_OBD_DYN_KAT_EXD_FETT_LAM_SOLL K_LAVK_OBD_DYN_KAT_EXD_LAM_SOLL K_LAVK_OBD_DYN_KAT_EXD_LANK_FETT K_LAVK_OBD_DYN_DIFF_POS_CFG K_LAVK_OBD_ACT_FRA_F K_LAVK_OBD_ACT_FRA_M K_LAVK_OBD_ACT_EXD_TIME K_LA_TRIM_DIAG_I_MAX_SCHW K_LA_TRIM_DIAG_I_MIN_SCHW K_LA_TRIM_DIAG_I_T K_LA_TRIM_DIAG_I_AD_MAX_SCHW K_LA_TRIM_DIAG_I_AD_MIN_SCHW /end REF_CHARACTERISTIC
/end GROUP
/begin GROUP G_y_Fault_paths__K_ED_ "y Fault paths (K_ED)" ROOT
 /begin REF_CHARACTERISTIC K_ED_APPL_DATA_INJ.DEC_NACH_EINTRAG K_ED_APPL_DATA_INJ.DEC_VOR_EINTRAG K_ED_APPL_DATA_INJ.FEHLERSCHWELLE K_ED_APPL_DATA_INJ.INC_NACH_EINTRAG K_ED_APPL_DATA_INJ.INC_VOR_EINTRAG K_ED_APPL_DATA_INJ.KLASSENINDEX K_ED_APPL_DATA_INJ.OK_SCHWELLE K_ED_APPL_DATA_INJ.P_CODE_OPENLOAD K_ED_APPL_DATA_INJ.P_CODE_SH_TO_GND K_ED_APPL_DATA_INJ.P_CODE_SH_TO_UB K_ED_APPL_DATA_INJ.P_CODE_UNPLAUSIBEL K_ED_CODIERUNG.DEC_NACH_EINTRAG K_ED_CODIERUNG.DEC_VOR_EINTRAG K_ED_CODIERUNG.FEHLERSCHWELLE K_ED_CODIERUNG.INC_NACH_EINTRAG K_ED_CODIERUNG.INC_VOR_EINTRAG K_ED_CODIERUNG.KLASSENINDEX K_ED_CODIERUNG.OK_SCHWELLE K_ED_CODIERUNG.P_CODE_OPENLOAD K_ED_CODIERUNG.P_CODE_SH_TO_GND K_ED_CODIERUNG.P_CODE_SH_TO_UB K_ED_CODIERUNG.P_CODE_UNPLAUSIBEL K_ED_DK1_ENLTG.DEC_NACH_EINTRAG K_ED_DK1_ENLTG.DEC_VOR_EINTRAG K_ED_DK1_ENLTG.FEHLERSCHWELLE K_ED_DK1_ENLTG.INC_NACH_EINTRAG K_ED_DK1_ENLTG.INC_VOR_EINTRAG K_ED_DK1_ENLTG.KLASSENINDEX K_ED_DK1_ENLTG.OK_SCHWELLE K_ED_DK1_ENLTG.P_CODE_OPENLOAD K_ED_DK1_ENLTG.P_CODE_SH_TO_GND K_ED_DK1_ENLTG.P_CODE_SH_TO_UB K_ED_DK1_ENLTG.P_CODE_UNPLAUSIBEL K_ED_DK2_ENLTG.DEC_NACH_EINTRAG K_ED_DK2_ENLTG.DEC_VOR_EINTRAG K_ED_DK2_ENLTG.FEHLERSCHWELLE K_ED_DK2_ENLTG.INC_NACH_EINTRAG K_ED_DK2_ENLTG.INC_VOR_EINTRAG K_ED_DK2_ENLTG.KLASSENINDEX K_ED_DK2_ENLTG.OK_SCHWELLE K_ED_DK2_ENLTG.P_CODE_OPENLOAD K_ED_DK2_ENLTG.P_CODE_SH_TO_GND K_ED_DK2_ENLTG.P_CODE_SH_TO_UB K_ED_DK2_ENLTG.P_CODE_UNPLAUSIBEL K_ED_DMTL_DECKEL.DEC_NACH_EINTRAG K_ED_DMTL_DECKEL.DEC_VOR_EINTRAG K_ED_DMTL_DECKEL.FEHLERSCHWELLE K_ED_DMTL_DECKEL.INC_NACH_EINTRAG K_ED_DMTL_DECKEL.INC_VOR_EINTRAG K_ED_DMTL_DECKEL.KLASSENINDEX K_ED_DMTL_DECKEL.OK_SCHWELLE K_ED_DMTL_DECKEL.P_CODE_OPENLOAD K_ED_DMTL_DECKEL.P_CODE_SH_TO_GND K_ED_DMTL_DECKEL.P_CODE_SH_TO_UB K_ED_DMTL_DECKEL.P_CODE_UNPLAUSIBEL K_ED_DMTL_FEINLECK.DEC_NACH_EINTRAG K_ED_DMTL_FEINLECK.DEC_VOR_EINTRAG K_ED_DMTL_FEINLECK.FEHLERSCHWELLE K_ED_DMTL_FEINLECK.INC_NACH_EINTRAG K_ED_DMTL_FEINLECK.INC_VOR_EINTRAG K_ED_DMTL_FEINLECK.KLASSENINDEX K_ED_DMTL_FEINLECK.OK_SCHWELLE K_ED_DMTL_FEINLECK.P_CODE_OPENLOAD K_ED_DMTL_FEINLECK.P_CODE_SH_TO_GND K_ED_DMTL_FEINLECK.P_CODE_SH_TO_UB K_ED_DMTL_FEINLECK.P_CODE_UNPLAUSIBEL K_ED_DMTL_FEUCHT.DEC_NACH_EINTRAG K_ED_DMTL_FEUCHT.DEC_VOR_EINTRAG K_ED_DMTL_FEUCHT.FEHLERSCHWELLE K_ED_DMTL_FEUCHT.INC_NACH_EINTRAG K_ED_DMTL_FEUCHT.INC_VOR_EINTRAG K_ED_DMTL_FEUCHT.KLASSENINDEX K_ED_DMTL_FEUCHT.OK_SCHWELLE K_ED_DMTL_FEUCHT.P_CODE_OPENLOAD K_ED_DMTL_FEUCHT.P_CODE_SH_TO_GND K_ED_DMTL_FEUCHT.P_CODE_SH_TO_UB K_ED_DMTL_FEUCHT.P_CODE_UNPLAUSIBEL K_ED_DMTL_GROBLECK.DEC_NACH_EINTRAG K_ED_DMTL_GROBLECK.DEC_VOR_EINTRAG K_ED_DMTL_GROBLECK.FEHLERSCHWELLE K_ED_DMTL_GROBLECK.INC_NACH_EINTRAG K_ED_DMTL_GROBLECK.INC_VOR_EINTRAG K_ED_DMTL_GROBLECK.KLASSENINDEX K_ED_DMTL_GROBLECK.OK_SCHWELLE K_ED_DMTL_GROBLECK.P_CODE_OPENLOAD K_ED_DMTL_GROBLECK.P_CODE_SH_TO_GND K_ED_DMTL_GROBLECK.P_CODE_SH_TO_UB K_ED_DMTL_GROBLECK.P_CODE_UNPLAUSIBEL K_ED_DMTL_H.DEC_NACH_EINTRAG K_ED_DMTL_H.DEC_VOR_EINTRAG K_ED_DMTL_H.FEHLERSCHWELLE K_ED_DMTL_H.INC_NACH_EINTRAG K_ED_DMTL_H.INC_VOR_EINTRAG K_ED_DMTL_H.KLASSENINDEX K_ED_DMTL_H.OK_SCHWELLE K_ED_DMTL_H.P_CODE_OPENLOAD K_ED_DMTL_H.P_CODE_SH_TO_GND K_ED_DMTL_H.P_CODE_SH_TO_UB K_ED_DMTL_H.P_CODE_UNPLAUSIBEL K_ED_DMTL_P.DEC_NACH_EINTRAG K_ED_DMTL_P.DEC_VOR_EINTRAG K_ED_DMTL_P.FEHLERSCHWELLE K_ED_DMTL_P.INC_NACH_EINTRAG K_ED_DMTL_P.INC_VOR_EINTRAG K_ED_DMTL_P.KLASSENINDEX K_ED_DMTL_P.OK_SCHWELLE K_ED_DMTL_P.P_CODE_OPENLOAD K_ED_DMTL_P.P_CODE_SH_TO_GND K_ED_DMTL_P.P_CODE_SH_TO_UB K_ED_DMTL_P.P_CODE_UNPLAUSIBEL K_ED_DMTL_V.DEC_NACH_EINTRAG K_ED_DMTL_V.DEC_VOR_EINTRAG K_ED_DMTL_V.FEHLERSCHWELLE K_ED_DMTL_V.INC_NACH_EINTRAG K_ED_DMTL_V.INC_VOR_EINTRAG K_ED_DMTL_V.KLASSENINDEX K_ED_DMTL_V.OK_SCHWELLE K_ED_DMTL_V.P_CODE_OPENLOAD K_ED_DMTL_V.P_CODE_SH_TO_GND K_ED_DMTL_V.P_CODE_SH_TO_UB K_ED_DMTL_V.P_CODE_UNPLAUSIBEL K_ED_E2_INJ.DEC_NACH_EINTRAG K_ED_E2_INJ.DEC_VOR_EINTRAG K_ED_E2_INJ.FEHLERSCHWELLE K_ED_E2_INJ.INC_NACH_EINTRAG K_ED_E2_INJ.INC_VOR_EINTRAG K_ED_E2_INJ.KLASSENINDEX K_ED_E2_INJ.OK_SCHWELLE K_ED_E2_INJ.P_CODE_OPENLOAD K_ED_E2_INJ.P_CODE_SH_TO_GND K_ED_E2_INJ.P_CODE_SH_TO_UB K_ED_E2_INJ.P_CODE_UNPLAUSIBEL K_ED_EBOX_ELU.DEC_NACH_EINTRAG K_ED_EBOX_ELU.DEC_VOR_EINTRAG K_ED_EBOX_ELU.FEHLERSCHWELLE K_ED_EBOX_ELU.INC_NACH_EINTRAG K_ED_EBOX_ELU.INC_VOR_EINTRAG K_ED_EBOX_ELU.KLASSENINDEX K_ED_EBOX_ELU.OK_SCHWELLE K_ED_EBOX_ELU.P_CODE_OPENLOAD K_ED_EBOX_ELU.P_CODE_SH_TO_GND K_ED_EBOX_ELU.P_CODE_SH_TO_UB K_ED_EBOX_ELU.P_CODE_UNPLAUSIBEL K_ED_EKP_PWM.DEC_NACH_EINTRAG K_ED_EKP_PWM.DEC_VOR_EINTRAG K_ED_EKP_PWM.FEHLERSCHWELLE K_ED_EKP_PWM.INC_NACH_EINTRAG K_ED_EKP_PWM.INC_VOR_EINTRAG K_ED_EKP_PWM.KLASSENINDEX K_ED_EKP_PWM.OK_SCHWELLE K_ED_EKP_PWM.P_CODE_OPENLOAD K_ED_EKP_PWM.P_CODE_SH_TO_GND K_ED_EKP_PWM.P_CODE_SH_TO_UB K_ED_EKP_PWM.P_CODE_UNPLAUSIBEL K_ED_ELU.DEC_NACH_EINTRAG K_ED_ELU.DEC_VOR_EINTRAG K_ED_ELU.FEHLERSCHWELLE K_ED_ELU.INC_NACH_EINTRAG K_ED_ELU.INC_VOR_EINTRAG K_ED_ELU.KLASSENINDEX K_ED_ELU.OK_SCHWELLE K_ED_ELU.P_CODE_OPENLOAD K_ED_ELU.P_CODE_SH_TO_GND K_ED_ELU.P_CODE_SH_TO_UB K_ED_ELU.P_CODE_UNPLAUSIBEL K_ED_ELUP.DEC_NACH_EINTRAG K_ED_ELUP.DEC_VOR_EINTRAG K_ED_ELUP.FEHLERSCHWELLE K_ED_ELUP.INC_NACH_EINTRAG K_ED_ELUP.INC_VOR_EINTRAG K_ED_ELUP.KLASSENINDEX K_ED_ELUP.OK_SCHWELLE K_ED_ELUP.P_CODE_OPENLOAD K_ED_ELUP.P_CODE_SH_TO_GND K_ED_ELUP.P_CODE_SH_TO_UB K_ED_ELUP.P_CODE_UNPLAUSIBEL K_ED_EV1.DEC_NACH_EINTRAG K_ED_EV1.DEC_VOR_EINTRAG K_ED_EV1.FEHLERSCHWELLE K_ED_EV1.INC_NACH_EINTRAG K_ED_EV1.INC_VOR_EINTRAG K_ED_EV1.KLASSENINDEX K_ED_EV1.OK_SCHWELLE K_ED_EV1.P_CODE_OPENLOAD K_ED_EV1.P_CODE_SH_TO_GND K_ED_EV1.P_CODE_SH_TO_UB K_ED_EV1.P_CODE_UNPLAUSIBEL K_ED_EV10.DEC_NACH_EINTRAG K_ED_EV10.DEC_VOR_EINTRAG K_ED_EV10.FEHLERSCHWELLE K_ED_EV10.INC_NACH_EINTRAG K_ED_EV10.INC_VOR_EINTRAG K_ED_EV10.KLASSENINDEX K_ED_EV10.OK_SCHWELLE K_ED_EV10.P_CODE_OPENLOAD K_ED_EV10.P_CODE_SH_TO_GND K_ED_EV10.P_CODE_SH_TO_UB K_ED_EV10.P_CODE_UNPLAUSIBEL K_ED_EV2.DEC_NACH_EINTRAG K_ED_EV2.DEC_VOR_EINTRAG K_ED_EV2.FEHLERSCHWELLE K_ED_EV2.INC_NACH_EINTRAG K_ED_EV2.INC_VOR_EINTRAG K_ED_EV2.KLASSENINDEX K_ED_EV2.OK_SCHWELLE K_ED_EV2.P_CODE_OPENLOAD K_ED_EV2.P_CODE_SH_TO_GND K_ED_EV2.P_CODE_SH_TO_UB K_ED_EV2.P_CODE_UNPLAUSIBEL K_ED_EV3.DEC_NACH_EINTRAG K_ED_EV3.DEC_VOR_EINTRAG K_ED_EV3.FEHLERSCHWELLE K_ED_EV3.INC_NACH_EINTRAG K_ED_EV3.INC_VOR_EINTRAG K_ED_EV3.KLASSENINDEX K_ED_EV3.OK_SCHWELLE K_ED_EV3.P_CODE_OPENLOAD K_ED_EV3.P_CODE_SH_TO_GND K_ED_EV3.P_CODE_SH_TO_UB K_ED_EV3.P_CODE_UNPLAUSIBEL K_ED_EV4.DEC_NACH_EINTRAG K_ED_EV4.DEC_VOR_EINTRAG K_ED_EV4.FEHLERSCHWELLE K_ED_EV4.INC_NACH_EINTRAG /end REF_CHARACTERISTIC
/end GROUP
/end MODULE
/end PROJECT
