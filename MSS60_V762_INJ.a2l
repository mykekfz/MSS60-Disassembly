/* ------------------------------------------------------------------
MSS60 INJ A2L - Production calibration 7848136 (V762.01-B500.02)
Created by ZiMMie for the M5Board and Nam3Forum communities.
This project exists to make this information freely available
to everyone: to share the work, encourage collaboration, and let
others learn from it, use it and add their own knowledge.
The reference material is based on publicly available beta
program software. Ghidra was used to disassemble and analyse
the current V762 program.
This is a community effort, and every contribution matters.
Corrections, additional findings, technical knowledge and general
feedback are all very welcome. The more knowledge is shared and
the more people work together, the more can be achieved.
Completely free to use and share.
------------------------------------------------------------------ */
ASAP2_VERSION 1 60
/begin PROJECT MSS60_V762_INJ "MSS60 (S65) V762 INJ CPU - generated 04.11.2026 from the reverse-engineered XDF"
/begin HEADER "Calibration description (characteristics from the XDF; measurements = V530 RAM names transferred to V762 addresses, confidence in each long identifier). Status tag in every long identifier: verified (checked against the code) / A2L-ref (placed from the V530 A2L) / EST (estimated) / unassigned (UNK placeholder)." VERSION "V762-RE-04112026" /end HEADER
/begin MODULE INJ "MSS60 V762 INJ"
/begin MOD_COMMON "" BYTE_ORDER MSB_FIRST ALIGNMENT_BYTE 1 ALIGNMENT_WORD 2 ALIGNMENT_LONG 4 /end MOD_COMMON
/begin MOD_PAR "" ECU "MSS60-INJ" SUPPLIER "Siemens VDO / BMW M"
 /begin MEMORY_SEGMENT DATASEG1 "Calibration data" DATA FLASH INTERN 0x70000 0x10000 -1 -1 -1 -1 -1 /end MEMORY_SEGMENT
 /begin MEMORY_SEGMENT CODESEG1 "Program" CODE FLASH INTERN 0x10000 0x60000 -1 -1 -1 -1 -1 /end MEMORY_SEGMENT
/end MOD_PAR
/begin AXIS_PTS GAX_0732C "Group axis (4 points) shared by group curves/maps" 0x7732C NO_INPUT_QUANTITY RL_AXP_SW 0 CM_0024 4 -3276.8 3276.7 /end AXIS_PTS
/begin AXIS_PTS GAX_080B0 "Group axis (12 points) shared by group curves/maps" 0x780B0 NO_INPUT_QUANTITY RL_AXP_SW 0 CM_0028 12 -3276.8 3276.7 /end AXIS_PTS
/begin AXIS_PTS GAX_094FC "Group axis (10 points) shared by group curves/maps" 0x794FC NO_INPUT_QUANTITY RL_AXP_SW 0 CM_0235 10 -32768 32767 /end AXIS_PTS
/begin AXIS_PTS GAX_09512 "Group axis (4 points) shared by group curves/maps" 0x79512 NO_INPUT_QUANTITY RL_AXP_SW 0 CM_0003 4 -3.2768 3.2767 /end AXIS_PTS
/begin AXIS_PTS GAX_0615E "Group axis (7 points) shared by group curves/maps" 0x7615E NO_INPUT_QUANTITY RL_AXP_SB 0 CM_0015 7 -128 127 /end AXIS_PTS
/begin CHARACTERISTIC KL_N_BEGR_GANG "Gear-dependent rev limit [verified]" CURVE 0x76050 RL_CUR_SW_SW 0 CM_0002 -32768 32767 /begin AXIS_DESCR STD_AXIS NO_INPUT_QUANTITY CM_0015 8 -32768 32767 /end AXIS_DESCR /end CHARACTERISTIC
/begin CHARACTERISTIC KL_N_BEGR_GANG_DELTA_NEG "Gear-dependent negative limit of rev-limiter ramp [verified]" CURVE 0x76118 RL_CUR_SW_UW 0 CM_0081 0 655350 /begin AXIS_DESCR STD_AXIS NO_INPUT_QUANTITY CM_0002 4 -32768 32767 /end AXIS_DESCR /end CHARACTERISTIC
/begin CHARACTERISTIC KL_N_BEGR_HAGETR_HEISS "Rev limit with hot rear-axle differential oil [verified]" CURVE 0x760F6 RL_CUR_SW_SW 0 CM_0002 -32768 32767 /begin AXIS_DESCR STD_AXIS NO_INPUT_QUANTITY CM_0006 8 -3550 3003.5 /end AXIS_DESCR /end CHARACTERISTIC
/begin CHARACTERISTIC KL_N_BEGR_SK "Maximum engine speed with safety-concept fault [verified]" CURVE 0x76072 RL_CUR_UB_SW 0 CM_0002 -32768 32767 /begin AXIS_DESCR STD_AXIS NO_INPUT_QUANTITY CM_0000 6 0 255 /end AXIS_DESCR /end CHARACTERISTIC
/begin CHARACTERISTIC KL_N_BEGR_TGETR_HEISS "Rev limit with hot gearbox oil [verified]" CURVE 0x760D4 RL_CUR_SW_SW 0 CM_0002 -32768 32767 /begin AXIS_DESCR STD_AXIS NO_INPUT_QUANTITY CM_0006 8 -3550 3003.5 /end AXIS_DESCR /end CHARACTERISTIC
/begin CHARACTERISTIC KL_SA_N_TMOT_DKG "Engine-speed offset on torque intervention [verified]" CURVE 0x78368 RL_CUR_SW_SW 0 CM_0002 -32768 32767 /begin AXIS_DESCR STD_AXIS NO_INPUT_QUANTITY CM_0002 4 -32768 32767 /end AXIS_DESCR /end CHARACTERISTIC
/begin CHARACTERISTIC KL_N_BEGR_TI_OFFSET_GANG "Gear-dependent engine-speed offset on torque intervention [verified]" CURVE 0x7612A RL_CUR_SW_SW 0 CM_0002 -32768 32767 /begin AXIS_DESCR STD_AXIS NO_INPUT_QUANTITY CM_0015 8 -32768 32767 /end AXIS_DESCR /end CHARACTERISTIC
/begin CHARACTERISTIC KL_N_BEGR_TMOT_HEISS "Rev limit with hot coolant [verified]" CURVE 0x760BA RL_CUR_SW_SW 0 CM_0002 -32768 32767 /begin AXIS_DESCR STD_AXIS NO_INPUT_QUANTITY CM_0006 6 -3550 3003.5 /end AXIS_DESCR /end CHARACTERISTIC
/begin CHARACTERISTIC KL_N_BEGR_TOEL_HEISS "Rev limit with hot oil [verified]" CURVE 0x760A0 RL_CUR_SW_SW 0 CM_0002 -32768 32767 /begin AXIS_DESCR STD_AXIS NO_INPUT_QUANTITY CM_0006 6 -3550 3003.5 /end AXIS_DESCR /end CHARACTERISTIC
/begin CHARACTERISTIC KL_N_BEGR_TOEL_KALT "Rev limit with cold oil [verified]" CURVE 0x76086 RL_CUR_SW_SW 0 CM_0002 -32768 32767 /begin AXIS_DESCR STD_AXIS NO_INPUT_QUANTITY CM_0006 6 -3550 3003.5 /end AXIS_DESCR /end CHARACTERISTIC
/begin CHARACTERISTIC K_N_MAX_FF_RESET "Source: PSB MS_S60 program 754 [verified]" VALUE 0x7601E RL_VAL_UB 0 CM_0000 0 255 /end CHARACTERISTIC
/begin CHARACTERISTIC KL_V_MAX_GANG_BEGRENZT "Maximum vehicle speed (Vmax) [verified]" CURVE 0x7B116 RL_CUR_SW_SW 0 CM_0010 -2048 2047.9375 /begin AXIS_DESCR STD_AXIS NO_INPUT_QUANTITY CM_0015 8 -32768 32767 /end AXIS_DESCR /end CHARACTERISTIC
/begin CHARACTERISTIC KL_V_MAX_GANG_CABRIO "Maximum vehicle speed, raised, Convertible [verified]" CURVE 0x7B0F4 RL_CUR_SW_SW 0 CM_0010 -2048 2047.9375 /begin AXIS_DESCR STD_AXIS NO_INPUT_QUANTITY CM_0015 8 -32768 32767 /end AXIS_DESCR /end CHARACTERISTIC
/begin CHARACTERISTIC KL_V_MAX_GANG_COUPE "Maximum vehicle speed, raised, Coupe [verified]" CURVE 0x7B0D2 RL_CUR_SW_SW 0 CM_0010 -2048 2047.9375 /begin AXIS_DESCR STD_AXIS NO_INPUT_QUANTITY CM_0015 8 -32768 32767 /end AXIS_DESCR /end CHARACTERISTIC
/begin CHARACTERISTIC KL_V_MAX_GANG_LIMOUSINE "Maximum vehicle speed, raised, Saloon [verified]" CURVE 0x7B08E RL_CUR_SW_SW 0 CM_0010 -2048 2047.9375 /begin AXIS_DESCR STD_AXIS NO_INPUT_QUANTITY CM_0015 8 -32768 32767 /end AXIS_DESCR /end CHARACTERISTIC
/begin CHARACTERISTIC KL_V_MAX_GANG_TOURING "Maximum vehicle speed, raised, Touring [verified]" CURVE 0x7B0B0 RL_CUR_SW_SW 0 CM_0010 -2048 2047.9375 /begin AXIS_DESCR STD_AXIS NO_INPUT_QUANTITY CM_0015 8 -32768 32767 /end AXIS_DESCR /end CHARACTERISTIC
/begin CHARACTERISTIC KL_V_MAX_SK "Maximum vehicle speed with safety-concept fault [verified]" CURVE 0x7B138 RL_CUR_UB_SW 0 CM_0010 -2048 2047.9375 /begin AXIS_DESCR STD_AXIS NO_INPUT_QUANTITY CM_0000 6 0 255 /end AXIS_DESCR /end CHARACTERISTIC
/begin CHARACTERISTIC K_V_RAD_TOL_CFG "Source: PSB MS_S60 program 754 [verified]" VALUE 0x7B064 RL_VAL_UB 0 CM_0000 0 255 /end CHARACTERISTIC
/begin CHARACTERISTIC KL_OZ_LGMW_OFFSET "Linearisation curve, instrument cluster display [verified]" CURVE 0x70354 RL_CUR_UB_UB 0 CM_0123 0 74.70703125 /begin AXIS_DESCR STD_AXIS NO_INPUT_QUANTITY CM_0123 8 0 74.70703125 /end AXIS_DESCR /end CHARACTERISTIC
/begin CHARACTERISTIC KL_DWF_SHLI_SEG "Remaining segments [verified]" CURVE 0x70A78 RL_CUR_SW_UB 0 CM_0000 0 255 /begin AXIS_DESCR STD_AXIS NO_INPUT_QUANTITY CM_0002 4 -32768 32767 /end AXIS_DESCR /end CHARACTERISTIC
/begin CHARACTERISTIC KL_DWF_SHLI_V_DIFF "Maximum wheel slip [verified]" CURVE 0x70A5E RL_CUR_SW_SW 0 CM_0010 -2048 2047.9375 /begin AXIS_DESCR STD_AXIS NO_INPUT_QUANTITY CM_0015 6 -32768 32767 /end AXIS_DESCR /end CHARACTERISTIC
/begin CHARACTERISTIC KF_TI_GRUND_F "Weighting factor on fuel mass per cylinder (main fuel trim map) [verified]" MAP 0x797A2 RL_MAP_SW_SW_UW 0 CM_0016 0 63.99902344 /begin AXIS_DESCR STD_AXIS NO_INPUT_QUANTITY CM_0002 10 -32768 32767 /end AXIS_DESCR /begin AXIS_DESCR STD_AXIS NO_INPUT_QUANTITY CM_0003 10 -3.2768 3.2767 /end AXIS_DESCR /end CHARACTERISTIC
/begin CHARACTERISTIC KF_TI_LAA_OFFS_WICHT_F "Correction factor - lambda adaptation offset [verified]" MAP 0x79770 RL_MAP_SW_SW_UW 0 CM_0016 0 63.99902344 /begin AXIS_DESCR STD_AXIS NO_INPUT_QUANTITY CM_0002 4 -32768 32767 /end AXIS_DESCR /begin AXIS_DESCR STD_AXIS NO_INPUT_QUANTITY CM_0139 4 -1024 1023.96875 /end AXIS_DESCR /end CHARACTERISTIC
/begin CHARACTERISTIC KF_TI_MKS_START "Start base map, injection with clutch closed [verified]" MAP 0x79CB4 RL_MAP_SW_SW_UW 0 CM_0140 0 1023.984375 /begin AXIS_DESCR STD_AXIS NO_INPUT_QUANTITY CM_0006 8 -3550 3003.5 /end AXIS_DESCR
 /begin AXIS_DESCR STD_AXIS NO_INPUT_QUANTITY CM_0060 3 -546.1333344 546.1166678 /end AXIS_DESCR
/end CHARACTERISTIC
/begin CHARACTERISTIC KF_TI_MKS_START_MSA "Start injection base map for auto start-stop start [verified]" MAP 0x79CFC RL_MAP_SW_SW_UW 0 CM_0140 0 1023.984375 /begin AXIS_DESCR STD_AXIS NO_INPUT_QUANTITY CM_0006 6 -3550 3003.5 /end AXIS_DESCR
 /begin AXIS_DESCR STD_AXIS NO_INPUT_QUANTITY CM_0060 3 -546.1333344 546.1166678 /end AXIS_DESCR
/end CHARACTERISTIC
/begin CHARACTERISTIC KF_TI_NS_PUMG_TAN_F "Post-start ambient correction [verified]" MAP 0x79894 RL_MAP_SW_SW_UW 0 CM_0016 0 63.99902344 /begin AXIS_DESCR STD_AXIS NO_INPUT_QUANTITY CM_0006 6 -3550 3003.5 /end AXIS_DESCR /begin AXIS_DESCR STD_AXIS NO_INPUT_QUANTITY CM_0022 6 -2048 2047.9375 /end AXIS_DESCR /end CHARACTERISTIC
/begin CHARACTERISTIC KF_TI_PHI_ENDE_GRUND "End-of-injection angle from base map [verified]" MAP 0x796AA RL_MAP_SW_SW_SW 0 CM_0028 -3276.8 3276.7 /begin AXIS_DESCR STD_AXIS NO_INPUT_QUANTITY CM_0002 10 -32768 32767 /end AXIS_DESCR /begin AXIS_DESCR STD_AXIS NO_INPUT_QUANTITY CM_0003 8 -3.2768 3.2767 /end AXIS_DESCR /end CHARACTERISTIC
/begin CHARACTERISTIC KF_TI_PHI_ENDE_OFFS "End-of-injection angle offset [verified]" MAP 0x795E4 RL_MAP_SW_SW_SW 0 CM_0028 -3276.8 3276.7 /begin AXIS_DESCR STD_AXIS NO_INPUT_QUANTITY CM_0002 10 -32768 32767 /end AXIS_DESCR /begin AXIS_DESCR STD_AXIS NO_INPUT_QUANTITY CM_0003 8 -3.2768 3.2767 /end AXIS_DESCR /end CHARACTERISTIC
/begin CHARACTERISTIC KF_TI_SOLL_MIN "Minimum injection time [verified]" MAP 0x795A8 RL_MAP_SW_SW_UW 0 CM_0141 0 65.535 /begin AXIS_DESCR STD_AXIS NO_INPUT_QUANTITY CM_0021 5 -3276.8 3276.7 /end AXIS_DESCR /begin AXIS_DESCR STD_AXIS NO_INPUT_QUANTITY CM_0142 4 -32.768 32.767 /end AXIS_DESCR /end CHARACTERISTIC
/begin CHARACTERISTIC KF_TI_SOLL_UB_OFFS "Battery-voltage-dependent injection offset (dead time) [verified]" MAP 0x7953C RL_MAP_SW_SW_UW 0 CM_0141 0 65.535 /begin AXIS_DESCR STD_AXIS NO_INPUT_QUANTITY CM_0021 5 -3276.8 3276.7 /end AXIS_DESCR /begin AXIS_DESCR STD_AXIS NO_INPUT_QUANTITY CM_0142 8 -32.768 32.767 /end AXIS_DESCR /end CHARACTERISTIC
/begin CHARACTERISTIC KF_TI_START_N_F "Engine-speed factor during start [verified]" MAP 0x79DE2 RL_MAP_SW_SW_UW 0 CM_0016 0 63.99902344 /begin AXIS_DESCR STD_AXIS NO_INPUT_QUANTITY CM_0006 8 -3550 3003.5 /end AXIS_DESCR /begin AXIS_DESCR STD_AXIS NO_INPUT_QUANTITY CM_0002 5 -32768 32767 /end AXIS_DESCR /end CHARACTERISTIC
/begin CHARACTERISTIC KF_TI_WL_KORR_F "Correction - injection warm-up factor [verified]" MAP 0x79B0E RL_MAP_SW_SW_UW 0 CM_0016 0 63.99902344 /begin AXIS_DESCR STD_AXIS NO_INPUT_QUANTITY CM_0006 8 -3550 3003.5 /end AXIS_DESCR /begin AXIS_DESCR STD_AXIS NO_INPUT_QUANTITY CM_0006 8 -3550 3003.5 /end AXIS_DESCR /end CHARACTERISTIC
/begin CHARACTERISTIC KF_TI_WL_KORR_F_KH "Injection warm-up correction factor during catalyst heating [verified]" MAP 0x79EF0 RL_MAP_SW_SW_UW 0 CM_0016 0 63.99902344 /begin AXIS_DESCR STD_AXIS NO_INPUT_QUANTITY CM_0006 8 -3550 3003.5 /end AXIS_DESCR /begin AXIS_DESCR STD_AXIS NO_INPUT_QUANTITY CM_0025 8 -327.68 327.67 /end AXIS_DESCR /end CHARACTERISTIC
/begin CHARACTERISTIC KF_TI_WL_KORR_HOEHE_F "Correction - injection warm-up factor [verified]" MAP 0x79C52 RL_MAP_SW_SW_UW 0 CM_0016 0 63.99902344 /begin AXIS_DESCR STD_AXIS NO_INPUT_QUANTITY CM_0022 6 -2048 2047.9375 /end AXIS_DESCR /begin AXIS_DESCR STD_AXIS NO_INPUT_QUANTITY CM_0006 6 -3550 3003.5 /end AXIS_DESCR /end CHARACTERISTIC
/begin CHARACTERISTIC KF_TI_WL_OFFS "Injection warm-up offset [verified]" MAP 0x79A6C RL_MAP_SW_SW_SW 0 CM_0016 -32 31.99902344 /begin AXIS_DESCR STD_AXIS NO_INPUT_QUANTITY CM_0002 8 -32768 32767 /end AXIS_DESCR /begin AXIS_DESCR STD_AXIS NO_INPUT_QUANTITY CM_0003 8 -3.2768 3.2767 /end AXIS_DESCR /end CHARACTERISTIC
/begin CHARACTERISTIC KF_TI_WL_OFFS_KH "Injection warm-up offset during catalyst heating [verified]" MAP 0x79E4E RL_MAP_SW_SW_SW 0 CM_0016 -32 31.99902344 /begin AXIS_DESCR STD_AXIS NO_INPUT_QUANTITY CM_0002 8 -32768 32767 /end AXIS_DESCR /begin AXIS_DESCR STD_AXIS NO_INPUT_QUANTITY CM_0012 8 -3276.8 3276.7 /end AXIS_DESCR /end CHARACTERISTIC
/begin CHARACTERISTIC KL_TI_NS_VERLUSTE "Fuel quantity losses [verified]" CURVE 0x7634A RL_CUR_SW_UW 0 CM_0016 0 63.99902344 /begin AXIS_DESCR STD_AXIS NO_INPUT_QUANTITY CM_0106 7 -32768 32767 /end AXIS_DESCR /end CHARACTERISTIC
/begin CHARACTERISTIC KL_TI_PHI_ENDE_ES "Intake valve closing angle [verified]" CURVE 0x794A8 RL_CUR_SW_SW 0 CM_0028 -3276.8 3276.7 /begin AXIS_DESCR STD_AXIS NO_INPUT_QUANTITY CM_0002 3 -32768 32767 /end AXIS_DESCR /end CHARACTERISTIC
/begin CHARACTERISTIC KL_TI_PHI_ENDE_F "Warm-up-dependent factor for ti_phi_ende_offs [verified]" CURVE 0x794CC RL_CUR_SW_UW 0 CM_0016 0 63.99902344 /begin AXIS_DESCR STD_AXIS NO_INPUT_QUANTITY CM_0006 7 -3550 3003.5 /end AXIS_DESCR /end CHARACTERISTIC
/begin CHARACTERISTIC KL_TI_PHI_ENDE_GRAD "Gradient for rate limit of ti_ende [verified]" CURVE 0x7943C RL_CUR_SW_SW 0 CM_0028 -3276.8 3276.7 /begin AXIS_DESCR STD_AXIS NO_INPUT_QUANTITY CM_0028 3 -3276.8 3276.7 /end AXIS_DESCR /end CHARACTERISTIC
/begin CHARACTERISTIC KL_TI_PHI_ENDE_START "End of injection during start [verified]" CURVE 0x7941E RL_CUR_SW_SW 0 CM_0028 -3276.8 3276.7 /begin AXIS_DESCR STD_AXIS NO_INPUT_QUANTITY CM_0006 7 -3550 3003.5 /end AXIS_DESCR /end CHARACTERISTIC
/begin CHARACTERISTIC KL_TI_PHI_EV_WURZEL "Square-root representation of flow velocity [verified]" CURVE 0x7944A RL_CUR_UW_SW 0 CM_0143 -3276.8 3276.7 /begin AXIS_DESCR STD_AXIS NO_INPUT_QUANTITY CM_0144 10 0 1638.375 /end AXIS_DESCR /end CHARACTERISTIC
/begin CHARACTERISTIC KL_TI_SOLL_LIN_OFFS "Linearisation compensation [verified]" CURVE 0x79404 RL_CUR_UW_SW 0 CM_0141 -32.768 32.767 /begin AXIS_DESCR STD_AXIS NO_INPUT_QUANTITY CM_0141 6 0 65.535 /end AXIS_DESCR /end CHARACTERISTIC
/begin CHARACTERISTIC KL_TI_SOLL_QSTAT_F "Proportional injector valve parameter [verified]" CURVE 0x793E2 RL_CUR_SW_UW 0 CM_0145 0 63.99902344 /begin AXIS_DESCR STD_AXIS NO_INPUT_QUANTITY CM_0142 8 -32.768 32.767 /end AXIS_DESCR /end CHARACTERISTIC
/begin CHARACTERISTIC KL_TI_SOLL_RHO_F "Fuel-density compensation factor [verified]" CURVE 0x793D0 RL_CUR_SW_UW 0 CM_0037 0 511.9921875 /begin AXIS_DESCR STD_AXIS NO_INPUT_QUANTITY CM_0006 4 -3550 3003.5 /end AXIS_DESCR /end CHARACTERISTIC
/begin CHARACTERISTIC KL_TI_SOLL_UB_OFFS_T_KORR_F "Fuel-temperature factor [verified]" CURVE 0x79474 RL_CUR_SW_UW 0 CM_0016 0 63.99902344 /begin AXIS_DESCR STD_AXIS NO_INPUT_QUANTITY CM_0006 6 -3550 3003.5 /end AXIS_DESCR /end CHARACTERISTIC
/begin CHARACTERISTIC KL_TI_START_PUMG_F "Ambient-pressure weighting during start [verified]" CURVE 0x794B6 RL_CUR_SW_UW 0 CM_0016 0 63.99902344 /begin AXIS_DESCR STD_AXIS NO_INPUT_QUANTITY CM_0022 5 -2048 2047.9375 /end AXIS_DESCR /end CHARACTERISTIC
/begin CHARACTERISTIC K_TI_GA "Base adaptation factor [verified]" VALUE 0x793B2 RL_VAL_UW 0 CM_0037 0 511.9921875 /end CHARACTERISTIC
/begin CHARACTERISTIC K_TI_GRUND_STOECH "Stoichiometric factor [verified]" VALUE 0x793B4 RL_VAL_UW 0 CM_0037 0 511.9921875 /end CHARACTERISTIC
/begin CHARACTERISTIC K_TI_MAX_OFFS "Offset for maximum injection time [verified]" VALUE 0x793B6 RL_VAL_SW 0 CM_0141 -32.768 32.767 /end CHARACTERISTIC
/begin CHARACTERISTIC K_TI_MIN_MAX_HYS "Hysteresis for MIN/MAX injection time [ms] [verified]" VALUE 0x793B8 RL_VAL_UW 0 CM_0141 0 65.535 /end CHARACTERISTIC
/begin CHARACTERISTIC K_TI_PHI_ENDE_A_SAUG "Mean intake-runner cross-section [mm2] [verified]" VALUE 0x793BE RL_VAL_UW 0 CM_0146 0 6553.5 /end CHARACTERISTIC
/begin CHARACTERISTIC K_TI_PHI_ENDE_A_ZYL "Cylinder (bore) area [mm2] [verified]" VALUE 0x793BA RL_VAL_UW 0 CM_0146 0 6553.5 /end CHARACTERISTIC
/begin CHARACTERISTIC K_TI_PHI_ENDE_ROH_KST "Fuel density [kg/dm3] [verified]" VALUE 0x793C0 RL_VAL_UW 0 CM_0147 0 655.35 /end CHARACTERISTIC
/begin CHARACTERISTIC K_TI_PHI_ENDE_S_ESV_EV "Distance from injector to intake valve [m] [verified]" VALUE 0x793C2 RL_VAL_UW 0 CM_0148 0 3.999941832 /end CHARACTERISTIC
/begin CHARACTERISTIC K_TI_PHI_ENDE_S_HUB "Piston stroke [mm] [verified]" VALUE 0x793BC RL_VAL_UW 0 CM_0149 0 6553.5 /end CHARACTERISTIC
/begin CHARACTERISTIC KL_KATS_LAM_I "Integral share, catalyst protection [verified]" CURVE 0x74170 RL_CUR_SW_SW 0 CM_0019 -2.000001434 1.999940398 /begin AXIS_DESCR STD_AXIS NO_INPUT_QUANTITY CM_0024 4 -3276.8 3276.7 /end AXIS_DESCR /end CHARACTERISTIC
/begin CHARACTERISTIC KL_KATS_MDL_LAM_OFFS "Lambda offset for catalyst protection - catalyst exhaust temperature [verified]" CURVE 0x77336 RL_GRP_SW_R 0 CM_0019 -2.000001434 1.999940398
 /begin AXIS_DESCR COM_AXIS NO_INPUT_QUANTITY CM_0024 4 -3276.8 3276.7 AXIS_PTS_REF GAX_0732C /end AXIS_DESCR
/end CHARACTERISTIC
/begin CHARACTERISTIC KL_KATS_NKAT_LAM_OFFS "Lambda offset for catalyst protection - post-cat temperature [verified]" CURVE 0x7413A RL_CUR_SW_SW 0 CM_0019 -2.000001434 1.999940398 /begin AXIS_DESCR STD_AXIS NO_INPUT_QUANTITY CM_0024 4 -3276.8 3276.7 /end AXIS_DESCR /end CHARACTERISTIC
/begin CHARACTERISTIC KL_KATS_VKAT_LAM_OFFS "Lambda offset for catalyst protection - pre-cat temperature [verified]" CURVE 0x74182 RL_CUR_SW_SW 0 CM_0019 -2.000001434 1.999940398 /begin AXIS_DESCR STD_AXIS NO_INPUT_QUANTITY CM_0024 4 -3276.8 3276.7 /end AXIS_DESCR /end CHARACTERISTIC
/begin CHARACTERISTIC K_KATS_T_MAX "Maximum catalyst temperature [?C] [verified]" VALUE 0x74130 RL_VAL_SW 0 CM_0006 -3550 3003.5 /end CHARACTERISTIC
/begin CHARACTERISTIC K_KATS_T_MAX_PST "Maximum catalyst temperature for test bench [?C] [verified]" VALUE 0x74132 RL_VAL_SW 0 CM_0006 -3550 3003.5 /end CHARACTERISTIC
/begin CHARACTERISTIC KF_PKSR_PSOLL_QSOLL_TV "Duty cycle vs absolute target pressure and volume flow [verified]" MAP 0x76F70 RL_MAP_SW_SW_SW 0 CM_0091 -3200 3199.902344 /begin AXIS_DESCR STD_AXIS NO_INPUT_QUANTITY CM_0161 10 -4096 4095.875 /end AXIS_DESCR /begin AXIS_DESCR STD_AXIS NO_INPUT_QUANTITY CM_0142 8 -32.768 32.767 /end AXIS_DESCR /end CHARACTERISTIC
/begin CHARACTERISTIC KF_PKSR_RF_N_PSOLL "Target fuel pressure (relative) vs engine load and speed [verified]" MAP 0x7720A RL_MAP_SW_SW_SW 0 CM_0142 -32.768 32.767 /begin AXIS_DESCR STD_AXIS NO_INPUT_QUANTITY CM_0003 6 -3.2768 3.2767 /end AXIS_DESCR /begin AXIS_DESCR STD_AXIS NO_INPUT_QUANTITY CM_0002 8 -32768 32767 /end AXIS_DESCR /end CHARACTERISTIC
/begin CHARACTERISTIC KL_PKSR_100P_DAUER_TMOT "Duration of 100% run with cold engine [verified]" CURVE 0x76ED6 RL_CUR_SW_UW 0 CM_0025 0 655.35 /begin AXIS_DESCR STD_AXIS NO_INPUT_QUANTITY CM_0006 6 -3550 3003.5 /end AXIS_DESCR /end CHARACTERISTIC
/begin CHARACTERISTIC KL_PKSR_TKSM_PSOLL "Target fuel pressure vs temperature [verified]" CURVE 0x76EBA RL_CUR_SW_SW 0 CM_0142 -32.768 32.767 /begin AXIS_DESCR STD_AXIS NO_INPUT_QUANTITY CM_0006 4 -3550 3003.5 /end AXIS_DESCR /end CHARACTERISTIC
/begin CHARACTERISTIC KL_PKSR_TV_HARDWARE "Correction curve duty cycle for Helbako A-sample [verified]" CURVE 0x76ECC RL_CUR_SW_SW 0 CM_0091 -3200 3199.902344 /begin AXIS_DESCR STD_AXIS NO_INPUT_QUANTITY CM_0091 2 -3200 3199.902344 /end AXIS_DESCR /end CHARACTERISTIC
/begin CHARACTERISTIC K_PKSR_PERIOD "Period of the fuel-pump PWM [ms] [verified]" VALUE 0x76DF8 RL_VAL_UW 0 CM_0141 0 65.535 /end CHARACTERISTIC
/begin CHARACTERISTIC KF_LA_TRIM_AD_WICHT "Weighting factor on lam_trim_ad [verified]" MAP 0x74846 RL_MAP_SW_SW_UW 0 CM_0016 0 63.99902344 /begin AXIS_DESCR STD_AXIS NO_INPUT_QUANTITY CM_0002 8 -32768 32767 /end AXIS_DESCR /begin AXIS_DESCR STD_AXIS NO_INPUT_QUANTITY CM_0003 8 -3.2768 3.2767 /end AXIS_DESCR /end CHARACTERISTIC
/begin CHARACTERISTIC KF_LA_TRIM_I "Integral share - trim control [verified]" MAP 0x7451C RL_MAP_SW_SW_UW 0 CM_0162 0 819.1875 /begin AXIS_DESCR STD_AXIS NO_INPUT_QUANTITY CM_0002 8 -32768 32767 /end AXIS_DESCR /begin AXIS_DESCR STD_AXIS NO_INPUT_QUANTITY CM_0003 8 -3.2768 3.2767 /end AXIS_DESCR /end CHARACTERISTIC
/begin CHARACTERISTIC KF_LA_TRIM_I_DLY "Hold time for integral share [verified]" MAP 0x74702 RL_MAP_SW_SW_UW 0 CM_0025 0 655.35 /begin AXIS_DESCR STD_AXIS NO_INPUT_QUANTITY CM_0002 8 -32768 32767 /end AXIS_DESCR /begin AXIS_DESCR STD_AXIS NO_INPUT_QUANTITY CM_0003 8 -3.2768 3.2767 /end AXIS_DESCR /end CHARACTERISTIC
/begin CHARACTERISTIC KF_LA_TRIM_P "P share - trim control [verified]" MAP 0x7447A RL_MAP_SW_SW_UW 0 CM_0019 0 3.999941832 /begin AXIS_DESCR STD_AXIS NO_INPUT_QUANTITY CM_0002 8 -32768 32767 /end AXIS_DESCR /begin AXIS_DESCR STD_AXIS NO_INPUT_QUANTITY CM_0003 8 -3.2768 3.2767 /end AXIS_DESCR /end CHARACTERISTIC
/begin CHARACTERISTIC KF_LA_TRIM_P_ABR "Ramp-down time, P share [verified]" MAP 0x747A4 RL_MAP_SW_SW_UW 0 CM_0025 0 655.35 /begin AXIS_DESCR STD_AXIS NO_INPUT_QUANTITY CM_0002 8 -32768 32767 /end AXIS_DESCR /begin AXIS_DESCR STD_AXIS NO_INPUT_QUANTITY CM_0003 8 -3.2768 3.2767 /end AXIS_DESCR /end CHARACTERISTIC
/begin CHARACTERISTIC KF_LA_TRIM_P_DLY "Hold time for P share [verified]" MAP 0x745BE RL_MAP_SW_SW_UW 0 CM_0025 0 655.35 /begin AXIS_DESCR STD_AXIS NO_INPUT_QUANTITY CM_0002 8 -32768 32767 /end AXIS_DESCR /begin AXIS_DESCR STD_AXIS NO_INPUT_QUANTITY CM_0003 8 -3.2768 3.2767 /end AXIS_DESCR /end CHARACTERISTIC
/begin CHARACTERISTIC KF_LA_TRIM_P_WAIT "Wait time for further P share [verified]" MAP 0x74660 RL_MAP_SW_SW_UW 0 CM_0025 0 655.35 /begin AXIS_DESCR STD_AXIS NO_INPUT_QUANTITY CM_0002 8 -32768 32767 /end AXIS_DESCR /begin AXIS_DESCR STD_AXIS NO_INPUT_QUANTITY CM_0003 8 -3.2768 3.2767 /end AXIS_DESCR /end CHARACTERISTIC
/begin CHARACTERISTIC KF_LA_TRIM_USN_SOLL "Post-cat target voltage, trim control [verified]" MAP 0x743D8 RL_MAP_SW_SW_UW 0 CM_0163 0 319995.1172 /begin AXIS_DESCR STD_AXIS NO_INPUT_QUANTITY CM_0002 8 -32768 32767 /end AXIS_DESCR /begin AXIS_DESCR STD_AXIS NO_INPUT_QUANTITY CM_0003 8 -3.2768 3.2767 /end AXIS_DESCR /end CHARACTERISTIC
/begin CHARACTERISTIC KL_LA_TRIM_RF_MIN "Minimum relative charge - lambda trim [verified]" CURVE 0x7433E RL_CUR_SW_SW 0 CM_0003 -3.2768 3.2767 /begin AXIS_DESCR STD_AXIS NO_INPUT_QUANTITY CM_0002 8 -32768 32767 /end AXIS_DESCR /end CHARACTERISTIC
/begin CHARACTERISTIC K_LA_TRIM_FKT_CFG "Selection of trim-control function [verified]" VALUE 0x741FE RL_VAL_UW 0 CM_0000 0 65535 /end CHARACTERISTIC
/begin CHARACTERISTIC K_LA_TRIM_I_GMW_DLY "Delay time after entering the integral mean-value band [s] [verified]" VALUE 0x74218 RL_VAL_UW 0 CM_0027 0 65535 /end CHARACTERISTIC
/begin CHARACTERISTIC K_LA_TRIM_I_GMW_MAX "Maximum averaged integral share of trim control [verified]" VALUE 0x74222 RL_VAL_SW 0 CM_0019 -2.000001434 1.999940398 /end CHARACTERISTIC
/begin CHARACTERISTIC K_LA_TRIM_I_GMW_MIN "Minimum averaged integral share of trim control [verified]" VALUE 0x74224 RL_VAL_SW 0 CM_0019 -2.000001434 1.999940398 /end CHARACTERISTIC
/begin CHARACTERISTIC K_LA_TRIM_I_GMW_TAU "Time constant, averaged integral share [s] [verified]" VALUE 0x74232 RL_VAL_UB 0 CM_0027 0 255 /end CHARACTERISTIC
/begin CHARACTERISTIC K_LA_TRIM_US_EINGESCHW "Hysteresis voltage detection, signal settled [mV] [verified]" VALUE 0x7420E RL_VAL_UW 0 CM_0163 0 319995.1172 /end CHARACTERISTIC
/begin CHARACTERISTIC KF_LANK_US_TAU_L "Slow filter constant, post-cat sensor signal [verified]" MAP 0x7584C RL_MAP_SW_SW_UW 0 CM_0009 0 256.9999982 /begin AXIS_DESCR STD_AXIS NO_INPUT_QUANTITY CM_0002 4 -32768 32767 /end AXIS_DESCR /begin AXIS_DESCR STD_AXIS NO_INPUT_QUANTITY CM_0003 4 -3.2768 3.2767 /end AXIS_DESCR /end CHARACTERISTIC
/begin CHARACTERISTIC K_LANK_FETT "Rich threshold for post-cat signal [mV] [verified]" VALUE 0x75742 RL_VAL_UW 0 CM_0163 0 319995.1172 /end CHARACTERISTIC
/begin CHARACTERISTIC K_LANK_MAGER "Lean threshold for post-cat signal [mV] [verified]" VALUE 0x75744 RL_VAL_UW 0 CM_0163 0 319995.1172 /end CHARACTERISTIC
/begin CHARACTERISTIC K_LANK_T_AUS "Switch-off monitoring time, post-cat signal [s] [verified]" VALUE 0x75748 RL_VAL_UW 0 CM_0025 0 655.35 /end CHARACTERISTIC
/begin CHARACTERISTIC K_LANK_T_EIN "Switch-on monitoring time, post-cat signal [s] [verified]" VALUE 0x75746 RL_VAL_UW 0 CM_0025 0 655.35 /end CHARACTERISTIC
/begin CHARACTERISTIC K_LANK_USF "Rich threshold for forbidden band [mV] [verified]" VALUE 0x7573E RL_VAL_UW 0 CM_0163 0 319995.1172 /end CHARACTERISTIC
/begin CHARACTERISTIC K_LANK_USM "Lean threshold for forbidden band [mV] [verified]" VALUE 0x75740 RL_VAL_UW 0 CM_0163 0 319995.1172 /end CHARACTERISTIC
/begin CHARACTERISTIC K_LANK_US_FILT_OB "Filter band - upper threshold [mV] [verified]" VALUE 0x75738 RL_VAL_UW 0 CM_0163 0 319995.1172 /end CHARACTERISTIC
/begin CHARACTERISTIC K_LANK_US_FILT_T "Settling time - post-cat signal [ms] [verified]" VALUE 0x7573A RL_VAL_UW 0 CM_0052 0 655350 /end CHARACTERISTIC
/begin CHARACTERISTIC K_LANK_US_FILT_UNT "Filter band - lower threshold [mV] [verified]" VALUE 0x75736 RL_VAL_UW 0 CM_0163 0 319995.1172 /end CHARACTERISTIC
/begin CHARACTERISTIC K_LANK_US_TAU "Time constant, post-cat signal [s] [verified]" VALUE 0x7573C RL_VAL_UB 0 CM_0027 0 255 /end CHARACTERISTIC
/begin CHARACTERISTIC K_LANK_US_TAU_S "Fast filter constant, post-cat signal [verified]" VALUE 0x75734 RL_VAL_UW 0 CM_0009 0 256.9999982 /end CHARACTERISTIC
/begin CHARACTERISTIC KF_LAM_REG_K "Controller gain [verified]" MAP 0x74AE6 RL_MAP_SW_SW_SW 0 CM_0164 -128 127.9960938
 /begin AXIS_DESCR STD_AXIS NO_INPUT_QUANTITY CM_0019 7 -2.000001434 1.999940398 /end AXIS_DESCR
 /begin AXIS_DESCR STD_AXIS NO_INPUT_QUANTITY CM_0016 3 -32 31.99902344 /end AXIS_DESCR
/end CHARACTERISTIC
/begin CHARACTERISTIC KF_LAM_REG_KORR_F "Correction factor for controller gain [verified]" MAP 0x74B66 RL_MAP_SW_SW_UW 0 CM_0016 0 63.99902344
 /begin AXIS_DESCR STD_AXIS NO_INPUT_QUANTITY CM_0019 4 -2.000001434 1.999940398 /end AXIS_DESCR
 /begin AXIS_DESCR STD_AXIS NO_INPUT_QUANTITY CM_0006 4 -3550 3003.5 /end AXIS_DESCR
/end CHARACTERISTIC
/begin CHARACTERISTIC KF_LAM_REG_WF_MKS_REL_MAX "Maximum relative intervention - wall-film model [verified]" MAP 0x74BCA RL_MAP_SW_SW_UW 0 CM_0016 0 63.99902344 /begin AXIS_DESCR STD_AXIS NO_INPUT_QUANTITY CM_0002 6 -32768 32767 /end AXIS_DESCR /begin AXIS_DESCR STD_AXIS NO_INPUT_QUANTITY CM_0003 6 -3.2768 3.2767 /end AXIS_DESCR /end CHARACTERISTIC
/begin CHARACTERISTIC KF_LAM_REG_WF_VERZ_F "Delay factor - wall-film intervention [verified]" MAP 0x74C2C RL_MAP_SW_SW_UW 0 CM_0165 0 127.9980469 /begin AXIS_DESCR STD_AXIS NO_INPUT_QUANTITY CM_0002 6 -32768 32767 /end AXIS_DESCR /begin AXIS_DESCR STD_AXIS NO_INPUT_QUANTITY CM_0003 6 -3.2768 3.2767 /end AXIS_DESCR /end CHARACTERISTIC
/begin CHARACTERISTIC KF_LAM_SOLL_AUSS_KATS "Catalyst-protection lambda from safety-concept manager [verified]" MAP 0x751C0 RL_MAP_SW_SW_UW 0 CM_0019 0 3.999941832 /begin AXIS_DESCR STD_AXIS NO_INPUT_QUANTITY CM_0002 6 -32768 32767 /end AXIS_DESCR /begin AXIS_DESCR STD_AXIS NO_INPUT_QUANTITY CM_0003 6 -3.2768 3.2767 /end AXIS_DESCR /end CHARACTERISTIC
/begin CHARACTERISTIC KF_LAM_SOLL_AUSS_OFFS "X: Engine speed (n) [rpm] | Y: Relative charge (cylinder fill) (rf) | Value: Lambda value (lam_soll_auss_offs) [verified]" MAP 0x75222 RL_MAP_SW_SW_UW 0 CM_0019 0 3.999941832 /begin AXIS_DESCR STD_AXIS NO_INPUT_QUANTITY CM_0002 6 -32768 32767 /end AXIS_DESCR /begin AXIS_DESCR STD_AXIS NO_INPUT_QUANTITY CM_0003 6 -3.2768 3.2767 /end AXIS_DESCR /end CHARACTERISTIC
/begin CHARACTERISTIC KF_LAM_SOLL_GRUND_PST "Target lambda - normal operation, test bench [verified]" MAP 0x7500C RL_MAP_SW_SW_UW 0 CM_0019 0 3.999941832 /begin AXIS_DESCR STD_AXIS NO_INPUT_QUANTITY CM_0002 12 -32768 32767 /end AXIS_DESCR /begin AXIS_DESCR STD_AXIS NO_INPUT_QUANTITY CM_0003 12 -3.2768 3.2767 /end AXIS_DESCR /end CHARACTERISTIC
/begin CHARACTERISTIC KF_LAM_SOLL_GRUND "Target lambda - normal operation [verified]" MAP 0x74EBA RL_MAP_SW_SW_UW 0 CM_0019 0 3.999941832 /begin AXIS_DESCR STD_AXIS NO_INPUT_QUANTITY CM_0002 12 -32768 32767 /end AXIS_DESCR /begin AXIS_DESCR STD_AXIS NO_INPUT_QUANTITY CM_0003 12 -3.2768 3.2767 /end AXIS_DESCR /end CHARACTERISTIC
/begin CHARACTERISTIC KF_LAM_SOLL_KR_KATS_OFFS "Ignition-angle offset from knock control [verified]" MAP 0x7515E RL_MAP_SW_SW_SW 0 CM_0028 -3276.8 3276.7 /begin AXIS_DESCR STD_AXIS NO_INPUT_QUANTITY CM_0002 6 -32768 32767 /end AXIS_DESCR /begin AXIS_DESCR STD_AXIS NO_INPUT_QUANTITY CM_0003 6 -3.2768 3.2767 /end AXIS_DESCR /end CHARACTERISTIC
/begin CHARACTERISTIC KF_LAM_SOLL_MS_KAT_SOLL_MAX "X: Engine speed (n) [rpm] | Y: Relative charge (cylinder fill) (rf) | Value: lam_soll_ms_kat_soll_max [%] [verified]" MAP 0x75284 RL_MAP_SW_SW_SW 0 CM_0013 -3276.8 3276.7 /begin AXIS_DESCR STD_AXIS NO_INPUT_QUANTITY CM_0002 8 -32768 32767 /end AXIS_DESCR /begin AXIS_DESCR STD_AXIS NO_INPUT_QUANTITY CM_0003 8 -3.2768 3.2767 /end AXIS_DESCR /end CHARACTERISTIC
/begin CHARACTERISTIC KF_LAM_SOLL_MS_KAT_SOLL_MIN "X: Engine speed (n) [rpm] | Y: Relative charge (cylinder fill) (rf) | Value: lam_soll_ms_kat_soll_min [%] [verified]" MAP 0x75326 RL_MAP_SW_SW_SW 0 CM_0013 -3276.8 3276.7 /begin AXIS_DESCR STD_AXIS NO_INPUT_QUANTITY CM_0002 8 -32768 32767 /end AXIS_DESCR /begin AXIS_DESCR STD_AXIS NO_INPUT_QUANTITY CM_0003 8 -3.2768 3.2767 /end AXIS_DESCR /end CHARACTERISTIC
/begin CHARACTERISTIC KF_LAM_SOLL_TAU1_ABG "Time constant of exhaust system and sensor [verified]" MAP 0x74E74 RL_MAP_SW_SW_UW 0 CM_0166 0 2097.12 /begin AXIS_DESCR STD_AXIS NO_INPUT_QUANTITY CM_0002 6 -32768 32767 /end AXIS_DESCR /begin AXIS_DESCR STD_AXIS NO_INPUT_QUANTITY CM_0003 4 -3.2768 3.2767 /end AXIS_DESCR /end CHARACTERISTIC
/begin CHARACTERISTIC KF_LAM_SOLL_WL "Target lambda - warm-up operation [verified]" MAP 0x74DD2 RL_MAP_SW_SW_UW 0 CM_0019 0 3.999941832 /begin AXIS_DESCR STD_AXIS NO_INPUT_QUANTITY CM_0002 8 -32768 32767 /end AXIS_DESCR /begin AXIS_DESCR STD_AXIS NO_INPUT_QUANTITY CM_0003 8 -3.2768 3.2767 /end AXIS_DESCR /end CHARACTERISTIC
/begin CHARACTERISTIC KF_LAM_SOLL_WL_F "Correction factor for warm-up state (target lambda) [verified]" MAP 0x75632 RL_MAP_SW_SW_UW 0 CM_0016 0 63.99902344 /begin AXIS_DESCR STD_AXIS NO_INPUT_QUANTITY CM_0006 8 -3550 3003.5 /end AXIS_DESCR /begin AXIS_DESCR STD_AXIS NO_INPUT_QUANTITY CM_0022 4 -2048 2047.9375 /end AXIS_DESCR /end CHARACTERISTIC
/begin CHARACTERISTIC KF_LAVK_FILT_T1 "Filter constant, actual lambda value [verified]" MAP 0x74B98 RL_MAP_SW_SW_UW 0 CM_0166 0 2097.12
 /begin AXIS_DESCR STD_AXIS NO_INPUT_QUANTITY CM_0019 4 -2.000001434 1.999940398 /end AXIS_DESCR
 /begin AXIS_DESCR STD_AXIS NO_INPUT_QUANTITY CM_0002 4 -32768 32767 /end AXIS_DESCR
/end CHARACTERISTIC
/begin CHARACTERISTIC KL_LAM_IST "Actual lambda [verified]" CURVE 0x749C2 RL_CUR_SW_UW 0 CM_0019 0 3.999941832
 /begin AXIS_DESCR STD_AXIS NO_INPUT_QUANTITY CM_0167 24 -10.00000061 9.999695439 /end AXIS_DESCR
/end CHARACTERISTIC
/begin CHARACTERISTIC KL_LAM_REG_RESET_SA_ML_SUM "X: Engine speed (n) [rpm] | Value: Default mass [mg] [verified]" CURVE 0x74AAA RL_CUR_SW_UW 0 CM_0168 0 65535 /begin AXIS_DESCR STD_AXIS NO_INPUT_QUANTITY CM_0002 8 -32768 32767 /end AXIS_DESCR /end CHARACTERISTIC
/begin CHARACTERISTIC KL_LAM_REG_T_SA_VERZ "Wait time for lambda controller after start [verified]" CURVE 0x74A88 RL_CUR_SW_UW 0 CM_0064 0 65.535 /begin AXIS_DESCR STD_AXIS NO_INPUT_QUANTITY CM_0002 8 -32768 32767 /end AXIS_DESCR /end CHARACTERISTIC
/begin CHARACTERISTIC KL_LAM_SOLL_ADD_KAT_ALT_F "Weighting factor over catalyst ageing [verified]" CURVE 0x74D2A RL_CUR_UW_UW 0 CM_0016 0 63.99902344 /begin AXIS_DESCR STD_AXIS NO_INPUT_QUANTITY CM_0019 6 0 3.999941832 /end AXIS_DESCR /end CHARACTERISTIC
/begin CHARACTERISTIC KL_LAM_SOLL_AUSS_F "Correction factor for safety-concept state [verified]" CURVE 0x74D44 RL_CUR_SW_UW 0 CM_0016 0 63.99902344 /begin AXIS_DESCR STD_AXIS NO_INPUT_QUANTITY CM_0006 8 -3550 3003.5 /end AXIS_DESCR /end CHARACTERISTIC
/begin CHARACTERISTIC KL_LAM_SOLL_START "Target lambda at start [verified]" CURVE 0x74CEE RL_CUR_SW_UW 0 CM_0019 0 3.999941832 /begin AXIS_DESCR STD_AXIS NO_INPUT_QUANTITY CM_0006 6 -3550 3003.5 /end AXIS_DESCR /end CHARACTERISTIC
/begin CHARACTERISTIC KL_LAM_SOLL_VL "Target lambda - full load [verified]" CURVE 0x74D08 RL_CUR_SW_UW 0 CM_0019 0 3.999941832 /begin AXIS_DESCR STD_AXIS NO_INPUT_QUANTITY CM_0002 8 -32768 32767 /end AXIS_DESCR /end CHARACTERISTIC
/begin CHARACTERISTIC KL_LAVK_IST_F "Lambda sensor adaptation factor [verified]" CURVE 0x7499E RL_CUR_UW_UW 0 CM_0016 0 63.99902344 /begin AXIS_DESCR STD_AXIS NO_INPUT_QUANTITY CM_0000 2 0 65535 /end AXIS_DESCR /end CHARACTERISTIC
/begin CHARACTERISTIC KL_LAVK_IST_OFFS "Lambda sensor adaptation offset [verified]" CURVE 0x74994 RL_CUR_UW_SW 0 CM_0163 -160000 159995.1172 /begin AXIS_DESCR STD_AXIS NO_INPUT_QUANTITY CM_0000 2 0 65535 /end AXIS_DESCR /end CHARACTERISTIC
/begin CHARACTERISTIC KL_LAVK_P_KORR_F_FETT "Correction factor RICH - sensor pressure dependence [verified]" CURVE 0x74A24 RL_CUR_SW_UW 0 CM_0016 0 63.99902344 /begin AXIS_DESCR STD_AXIS NO_INPUT_QUANTITY CM_0022 12 -2048 2047.9375 /end AXIS_DESCR /end CHARACTERISTIC
/begin CHARACTERISTIC KL_LAVK_P_KORR_F_MAGER "Correction factor LEAN - sensor pressure dependence [verified]" CURVE 0x74A56 RL_CUR_SW_UW 0 CM_0016 0 63.99902344 /begin AXIS_DESCR STD_AXIS NO_INPUT_QUANTITY CM_0022 12 -2048 2047.9375 /end AXIS_DESCR /end CHARACTERISTIC
/begin CHARACTERISTIC KL_LAVK_T_KORR_F "Correction factor - sensor temperature dependence [verified]" CURVE 0x749A8 RL_CUR_SW_UW 0 CM_0016 0 63.99902344 /begin AXIS_DESCR STD_AXIS NO_INPUT_QUANTITY CM_0151 6 -32768 32767 /end AXIS_DESCR /end CHARACTERISTIC
/begin CHARACTERISTIC K_LAA_CFG "Source: PSB MS_S60 program 754 [verified]" VALUE 0x74944 RL_VAL_UW 0 CM_0000 0 65535 /end CHARACTERISTIC
/begin CHARACTERISTIC K_LAA_F_N_MAX "Maximum engine speed for factor lambda adaptation [Upm] [verified]" VALUE 0x74952 RL_VAL_SW 0 CM_0002 -32768 32767 /end CHARACTERISTIC
/begin CHARACTERISTIC K_LAA_F_N_MIN "Minimum engine speed for factor lambda adaptation [Upm] [verified]" VALUE 0x74950 RL_VAL_SW 0 CM_0002 -32768 32767 /end CHARACTERISTIC
/begin CHARACTERISTIC K_LAA_F_RF_MAX "Maximum relative charge for factor lambda adaptation [verified]" VALUE 0x7495A RL_VAL_SW 0 CM_0003 -3.2768 3.2767 /end CHARACTERISTIC
/begin CHARACTERISTIC K_LAA_F_RF_MIN "Minimum relative charge for factor lambda adaptation [verified]" VALUE 0x74958 RL_VAL_SW 0 CM_0003 -3.2768 3.2767 /end CHARACTERISTIC
/begin CHARACTERISTIC K_LAA_F_TE_N_MAX "Maximum engine speed for purge lambda adaptation [Upm] [verified]" VALUE 0x7494E RL_VAL_SW 0 CM_0002 -32768 32767 /end CHARACTERISTIC
/begin CHARACTERISTIC K_LAA_F_TE_RF_MAX "Maximum relative charge for purge lambda adaptation [verified]" VALUE 0x74956 RL_VAL_SW 0 CM_0003 -3.2768 3.2767 /end CHARACTERISTIC
/begin CHARACTERISTIC K_LAA_F_T_ADAPT "Adaptation period for factor adaptation [ms] [verified]" VALUE 0x7495E RL_VAL_UW 0 CM_0169 0 65535 /end CHARACTERISTIC
/begin CHARACTERISTIC K_LAA_OFFS_N_MAX "Maximum engine speed for offset lambda adaptation [Upm] [verified]" VALUE 0x74954 RL_VAL_SW 0 CM_0002 -32768 32767 /end CHARACTERISTIC
/begin CHARACTERISTIC K_LAA_OFFS_RF_MAX "Maximum relative charge for offset lambda adaptation [verified]" VALUE 0x7495C RL_VAL_SW 0 CM_0003 -3.2768 3.2767 /end CHARACTERISTIC
/begin CHARACTERISTIC K_LAA_PKS_MAX "Maximum fuel-pressure threshold for lambda adaptation [bar] [verified]" VALUE 0x7494C RL_VAL_SW 0 CM_0142 -32.768 32.767 /end CHARACTERISTIC
/begin CHARACTERISTIC K_LAA_RESET_CFG "Source: PSB MS_S60 program 754 [verified]" VALUE 0x74946 RL_VAL_UW 0 CM_0000 0 65535 /end CHARACTERISTIC
/begin CHARACTERISTIC K_LAA_TAN_MAX "Maximum intake-air-temperature threshold for lambda adaptation [?C] [verified]" VALUE 0x74948 RL_VAL_SW 0 CM_0006 -3550 3003.5 /end CHARACTERISTIC
/begin CHARACTERISTIC K_LAA_TMOT_MIN "Minimum engine-temperature threshold for lambda adaptation [?C] [verified]" VALUE 0x7494A RL_VAL_SW 0 CM_0006 -3550 3003.5 /end CHARACTERISTIC
/begin CHARACTERISTIC K_LAM_REG_DELTA_MAX "Maximum control error [verified]" VALUE 0x74934 RL_VAL_SW 0 CM_0019 -2.000001434 1.999940398 /end CHARACTERISTIC
/begin CHARACTERISTIC K_LAM_REG_DELTA_MIN "Minimum control error [verified]" VALUE 0x74932 RL_VAL_SW 0 CM_0019 -2.000001434 1.999940398 /end CHARACTERISTIC
/begin CHARACTERISTIC K_LAM_REG_DELTA_STAT_MAX "Control error for steady state [verified]" VALUE 0x74936 RL_VAL_UW 0 CM_0019 0 3.999941832 /end CHARACTERISTIC
/begin CHARACTERISTIC K_LAM_REG_DELTA_STAT_MAX_TE "Control error for steady state during purge [verified]" VALUE 0x74938 RL_VAL_UW 0 CM_0019 0 3.999941832 /end CHARACTERISTIC
/begin CHARACTERISTIC K_LAM_REG_DELTA_STAT_TRIM "Control error for steady state - trim control [verified]" VALUE 0x7493A RL_VAL_UW 0 CM_0019 0 3.999941832 /end CHARACTERISTIC
/begin CHARACTERISTIC K_LAM_REG_F_MAX "Control error for steady state [verified]" VALUE 0x7493E RL_VAL_UW 0 CM_0051 0 1.999970916 /end CHARACTERISTIC
/begin CHARACTERISTIC K_LAM_REG_F_MIN "Control error for steady state [verified]" VALUE 0x7493C RL_VAL_UW 0 CM_0051 0 1.999970916 /end CHARACTERISTIC
/begin CHARACTERISTIC K_LAM_REG_IST_MW_MAX "Maximum actual lambda value [verified]" VALUE 0x7492C RL_VAL_UW 0 CM_0019 0 3.999941832 /end CHARACTERISTIC
/begin CHARACTERISTIC K_LAM_REG_IST_MW_MIN "Minimum actual lambda value [verified]" VALUE 0x7492A RL_VAL_UW 0 CM_0019 0 3.999941832 /end CHARACTERISTIC
/begin CHARACTERISTIC K_LAM_REG_RESET_SA_TMOT_MIN "Minimum engine-temperature threshold for lambda adaptation [?C] [verified]" VALUE 0x74942 RL_VAL_SW 0 CM_0006 -3550 3003.5 /end CHARACTERISTIC
/begin CHARACTERISTIC K_LAM_REG_SOLL_MAX "Maximum target lambda value [verified]" VALUE 0x74930 RL_VAL_UW 0 CM_0019 0 3.999941832 /end CHARACTERISTIC
/begin CHARACTERISTIC K_LAM_REG_SOLL_MIN "Minimum target lambda value [verified]" VALUE 0x7492E RL_VAL_UW 0 CM_0019 0 3.999941832 /end CHARACTERISTIC
/begin CHARACTERISTIC K_LAM_REG_TN_TU_F "Tuning factor, integral time [verified]" VALUE 0x74941 RL_VAL_UB 0 CM_0037 0 1.9921875 /end CHARACTERISTIC
/begin CHARACTERISTIC K_LAM_REG_TV_TU_F "Tuning factor, derivative time [verified]" VALUE 0x74940 RL_VAL_UB 0 CM_0037 0 1.9921875 /end CHARACTERISTIC
/begin CHARACTERISTIC K_LAM_REG_T_SLP_VERZ "Wait time for lambda controller after active secondary-air pump [s] [verified]" VALUE 0x7498E RL_VAL_UW 0 CM_0064 0 65.535 /end CHARACTERISTIC
/begin CHARACTERISTIC K_LAM_SOLL_KONV_CFG "Source: PSB MS_S60 program 754 [verified]" VALUE 0x74C90 RL_VAL_UW 0 CM_0000 0 65535 /end CHARACTERISTIC
/begin CHARACTERISTIC K_LAVK_AD_GAIN_CNT_MIN "Minimum counter for sensor gain adaptation [verified]" VALUE 0x748FC RL_VAL_UW 0 CM_0000 0 65535 /end CHARACTERISTIC
/begin CHARACTERISTIC K_LAVK_AD_MAX "Maximum A/D value of sensor signal [mV] [verified]" VALUE 0x748EC RL_VAL_UW 0 CM_0163 0 319995.1172 /end CHARACTERISTIC
/begin CHARACTERISTIC K_LAVK_AD_MIN "Minimum A/D value of sensor signal [mV] [verified]" VALUE 0x748EA RL_VAL_UW 0 CM_0163 0 319995.1172 /end CHARACTERISTIC
/begin CHARACTERISTIC K_LAVK_AD_OFFS_CNT "Counter for sensor offset adaptation [verified]" VALUE 0x748F8 RL_VAL_UW 0 CM_0000 0 65535 /end CHARACTERISTIC
/begin CHARACTERISTIC K_LAVK_AD_OFFS_CNT_MIN "Minimum counter for sensor offset adaptation [verified]" VALUE 0x748F4 RL_VAL_UW 0 CM_0000 0 65535 /end CHARACTERISTIC
/begin CHARACTERISTIC K_LAVK_AD_OFFS_CNT_MIN_MS "Minimum counter for MS sensor offset adaptation [verified]" VALUE 0x748F6 RL_VAL_UW 0 CM_0000 0 65535 /end CHARACTERISTIC
/begin CHARACTERISTIC K_LAVK_AD_OFFS_CNT_MS "Counter for MS sensor offset adaptation [verified]" VALUE 0x748FA RL_VAL_UW 0 CM_0000 0 65535 /end CHARACTERISTIC
/begin CHARACTERISTIC K_LAVK_ATIC42_ICP_ENABLE_B1 "ATIC42 ICP feed [verified]" VALUE 0x7595A RL_VAL_UB 0 CM_0000 0 255 /end CHARACTERISTIC
/begin CHARACTERISTIC K_LAVK_ATIC42_ICP_ENABLE_B2 "ATIC42 ICP feed [verified]" VALUE 0x7595B RL_VAL_UB 0 CM_0000 0 255 /end CHARACTERISTIC
/begin CHARACTERISTIC K_LAVK_ATIC42_ICP_VALUE_B1 "ATIC42 ICP value [verified]" VALUE 0x75962 RL_VAL_UB 0 CM_0171 5.15 1318.4 /end CHARACTERISTIC
/begin CHARACTERISTIC K_LAVK_ATIC42_ICP_VALUE_B2 "ATIC42 ICP value [verified]" VALUE 0x75963 RL_VAL_UB 0 CM_0171 5.15 1318.4 /end CHARACTERISTIC
/begin CHARACTERISTIC K_LAVK_ATIC42_IP_OFFSET_MEAS_B1 "ATIC42 pump-current offset measurement [verified]" VALUE 0x75958 RL_VAL_UB 0 CM_0000 0 255 /end CHARACTERISTIC
/begin CHARACTERISTIC K_LAVK_ATIC42_IP_OFFSET_MEAS_B2 "ATIC42 pump-current offset measurement [verified]" VALUE 0x75959 RL_VAL_UB 0 CM_0000 0 255 /end CHARACTERISTIC
/begin CHARACTERISTIC K_LAVK_ATIC42_PIN_CFG_B1 "ATIC42 pin enable [verified]" VALUE 0x75968 RL_VAL_UB 0 CM_0000 0 255 /end CHARACTERISTIC
/begin CHARACTERISTIC K_LAVK_ATIC42_PIN_CFG_B2 "ATIC42 pin enable [verified]" VALUE 0x75969 RL_VAL_UB 0 CM_0000 0 255 /end CHARACTERISTIC
/begin CHARACTERISTIC K_LAVK_ATIC42_PROTEC_TIME_B1 "ATIC42 time the sensor is disconnected after a fault [verified]" VALUE 0x75964 RL_VAL_UB 0 CM_0172 0.8 26.3 /end CHARACTERISTIC
/begin CHARACTERISTIC K_LAVK_ATIC42_PROTEC_TIME_B2 "ATIC42 time the sensor is disconnected after a fault [verified]" VALUE 0x75965 RL_VAL_UB 0 CM_0172 0.8 26.3 /end CHARACTERISTIC
/begin CHARACTERISTIC K_LAVK_ATIC42_RI_CALIB_B1 "ATIC42 internal-resistance calibration [verified]" VALUE 0x7595C RL_VAL_UB 0 CM_0000 0 255 /end CHARACTERISTIC
/begin CHARACTERISTIC K_LAVK_ATIC42_RI_CALIB_B2 "ATIC42 internal-resistance calibration [verified]" VALUE 0x7595D RL_VAL_UB 0 CM_0000 0 255 /end CHARACTERISTIC
/begin CHARACTERISTIC K_LAVK_ATIC42_RI_MEAS_FREQ_B1 "ATIC42 oscillator frequency for internal-resistance measurement [verified]" VALUE 0x75966 RL_VAL_UB 0 CM_0173 1.9531 33.0631 /end CHARACTERISTIC
/begin CHARACTERISTIC K_LAVK_ATIC42_RI_MEAS_FREQ_B2 "ATIC42 oscillator frequency for internal-resistance measurement [verified]" VALUE 0x75967 RL_VAL_UB 0 CM_0173 1.9531 33.0631 /end CHARACTERISTIC
/begin CHARACTERISTIC K_LAVK_ATIC42_RI_OSCI_B1 "ATIC42 internal-resistance oscillator [verified]" VALUE 0x7595E RL_VAL_UB 0 CM_0000 0 255 /end CHARACTERISTIC
/begin CHARACTERISTIC K_LAVK_ATIC42_RI_OSCI_B2 "ATIC42 internal-resistance oscillator [verified]" VALUE 0x7595F RL_VAL_UB 0 CM_0000 0 255 /end CHARACTERISTIC
/begin CHARACTERISTIC K_LAVK_ATIC42_SENSOR_B1 "ATIC42 lambda sensor [verified]" VALUE 0x75960 RL_VAL_UB 0 CM_0000 0 255 /end CHARACTERISTIC
/begin CHARACTERISTIC K_LAVK_ATIC42_SENSOR_B2 "ATIC42 lambda sensor [verified]" VALUE 0x75961 RL_VAL_UB 0 CM_0000 0 255 /end CHARACTERISTIC
/begin CHARACTERISTIC K_LAVK_FILT_CFG "Source: PSB MS_S60 program 754 [verified]" VALUE 0x74984 RL_VAL_UW 0 CM_0000 0 65535 /end CHARACTERISTIC
/begin CHARACTERISTIC K_LAVK_GAIN_LAM_SCHW "Switching threshold for signal gain [verified]" VALUE 0x748F2 RL_VAL_UW 0 CM_0019 0 3.999941832 /end CHARACTERISTIC
/begin CHARACTERISTIC K_LAVK_R7 "Resistor R7 [Ohm] [verified]" VALUE 0x748F0 RL_VAL_UW 0 CM_0174 0 6553.5 /end CHARACTERISTIC
/begin CHARACTERISTIC K_LAVK_US_REF "Reference voltage lambda = 1.0 [mV] [verified]" VALUE 0x748EE RL_VAL_UW 0 CM_0163 0 319995.1172 /end CHARACTERISTIC
/begin CHARACTERISTIC KF_LSHNK_TA_MAX "Maximum duty cycle [verified]" MAP 0x75BD6 RL_MAP_SW_SW_UW 0 CM_0175 0 799.9877897 /begin AXIS_DESCR STD_AXIS NO_INPUT_QUANTITY CM_0002 6 -32768 32767 /end AXIS_DESCR /begin AXIS_DESCR STD_AXIS NO_INPUT_QUANTITY CM_0003 6 -3.2768 3.2767 /end AXIS_DESCR /end CHARACTERISTIC
/begin CHARACTERISTIC KL_LSHNK_RF_AUS "Relative-charge threshold - switch-off condition [verified]" CURVE 0x75B72 RL_CUR_SW_SW 0 CM_0003 -3.2768 3.2767 /begin AXIS_DESCR STD_AXIS NO_INPUT_QUANTITY CM_0002 5 -32768 32767 /end AXIS_DESCR /end CHARACTERISTIC
/begin CHARACTERISTIC KL_LSHNK_SOND_TEMP "Post-cat sensor temperature [verified]" CURVE 0x75B9A RL_CUR_UW_SW 0 CM_0006 -3550 3003.5 /begin AXIS_DESCR STD_AXIS NO_INPUT_QUANTITY CM_0174 8 0 6553.5 /end AXIS_DESCR /end CHARACTERISTIC
/begin CHARACTERISTIC KL_LSHNK_TA "Duty cycle [verified]" CURVE 0x75B88 RL_CUR_SW_UW 0 CM_0175 0 799.9877897 /begin AXIS_DESCR STD_AXIS NO_INPUT_QUANTITY CM_0021 4 -3276.8 3276.7 /end AXIS_DESCR /end CHARACTERISTIC
/begin CHARACTERISTIC KL_LSHNK_T_EIN "Delay time, post-cat [verified]" CURVE 0x75B64 RL_CUR_SW_UW 0 CM_0177 0 65535 /begin AXIS_DESCR STD_AXIS NO_INPUT_QUANTITY CM_0006 3 -3550 3003.5 /end AXIS_DESCR /end CHARACTERISTIC
/begin CHARACTERISTIC KL_LSHNK_UB_KORR "Battery-voltage correction factor for heater control [verified]" CURVE 0x75BBC RL_CUR_SW_UW 0 CM_0016 0 63.99902344 /begin AXIS_DESCR STD_AXIS NO_INPUT_QUANTITY CM_0021 6 -3276.8 3276.7 /end AXIS_DESCR /end CHARACTERISTIC
/begin CHARACTERISTIC K_LSHNK_AKTIV_T "Sensor heating time [s] [verified]" VALUE 0x75B62 RL_VAL_UW 0 CM_0025 0 655.35 /end CHARACTERISTIC
/begin CHARACTERISTIC KF_OZDREHKOR "Engine-speed level correction (oil level) [verified]" MAP 0x76A7C RL_MAP_SW_UW_SW 0 CM_0187 -4800 4799.853516 /begin AXIS_DESCR STD_AXIS NO_INPUT_QUANTITY CM_0002 16 -32768 32767 /end AXIS_DESCR /begin AXIS_DESCR STD_AXIS NO_INPUT_QUANTITY CM_0123 3 0 19199.70703 /end AXIS_DESCR /end CHARACTERISTIC
/begin CHARACTERISTIC KF_OZDREHKOR_EINFAHR "Engine-speed level correction (oil level) [verified]" MAP 0x769F4 RL_MAP_SW_UW_SW 0 CM_0187 -4800 4799.853516 /begin AXIS_DESCR STD_AXIS NO_INPUT_QUANTITY CM_0002 16 -32768 32767 /end AXIS_DESCR /begin AXIS_DESCR STD_AXIS NO_INPUT_QUANTITY CM_0123 3 0 19199.70703 /end AXIS_DESCR /end CHARACTERISTIC
/begin CHARACTERISTIC KF_OZKORRNIV "Oil-level correction vs start time and temperature [verified]" MAP 0x76B04 RL_MAP_UW_SW_SW 0 CM_0123 -9600 9599.707031 /begin AXIS_DESCR STD_AXIS NO_INPUT_QUANTITY CM_0159 6 0 6553.5 /end AXIS_DESCR /begin AXIS_DESCR STD_AXIS NO_INPUT_QUANTITY CM_0025 6 -327.68 327.67 /end AXIS_DESCR /end CHARACTERISTIC
/begin CHARACTERISTIC KF_OZKORRORI "X: Oz_tkorrori [?C] | Y: Tn_abstellm [min] [verified]" MAP 0x769C2 RL_MAP_SW_SW_SW 0 CM_0123 -9600 9599.707031 /begin AXIS_DESCR STD_AXIS NO_INPUT_QUANTITY CM_0159 4 -3276.8 3276.7 /end AXIS_DESCR /begin AXIS_DESCR STD_AXIS NO_INPUT_QUANTITY CM_0108 4 -32768 32767 /end AXIS_DESCR /end CHARACTERISTIC
/begin CHARACTERISTIC KF_OZZEIT "Combination of engine-off time and start time [verified]" MAP 0x76B66 RL_MAP_UW_UW_UW 0 CM_0025 0 655.35 /begin AXIS_DESCR STD_AXIS NO_INPUT_QUANTITY CM_0025 6 0 655.35 /end AXIS_DESCR /begin AXIS_DESCR STD_AXIS NO_INPUT_QUANTITY CM_0108 4 0 65535 /end AXIS_DESCR /end CHARACTERISTIC
/begin CHARACTERISTIC KL_OZBEFKL "Fill curve (oil) [verified]" CURVE 0x70557 RL_CUR_UB_UB 0 CM_0188 0 25.5 /begin AXIS_DESCR STD_AXIS NO_INPUT_QUANTITY CM_0123 6 0 74.70703125 /end AXIS_DESCR /end CHARACTERISTIC
/begin CHARACTERISTIC KL_OZKRZMW2 "X: Oz_dkm [%] [verified]" CURVE 0x7690E RL_CUR_UW_UB 0 CM_0000 0 255 /begin AXIS_DESCR STD_AXIS NO_INPUT_QUANTITY CM_0189 4 0 9.999848026 /end AXIS_DESCR /end CHARACTERISTIC
/begin CHARACTERISTIC KL_OZLBNIV "X: Oz_lbmw [verified]" CURVE 0x7692A RL_CUR_SB_SB 0 CM_0123 -37.5 37.20703125 /begin AXIS_DESCR STD_AXIS NO_INPUT_QUANTITY CM_0160 8 -2 1.984375 /end AXIS_DESCR /end CHARACTERISTIC
/begin CHARACTERISTIC KL_OZLN "X: Oz_pzdivp [verified]" CURVE 0x768F4 RL_CUR_UW_SW 0 CM_0051 -1.000000717 0.9999701992 /begin AXIS_DESCR STD_AXIS NO_INPUT_QUANTITY CM_0051 6 0 1.999970916 /end AXIS_DESCR /end CHARACTERISTIC
/begin CHARACTERISTIC KL_OZPERMKL "Scaling curve, permittivity (oil quality) [verified]" CURVE 0x76816 RL_CUR_UW_UW 0 CM_0190 0 5.999906195 /begin AXIS_DESCR STD_AXIS NO_INPUT_QUANTITY CM_0000 2 0 65535 /end AXIS_DESCR /end CHARACTERISTIC
/begin CHARACTERISTIC KL_OZQBNIV "X: Oz_qbmw [verified]" CURVE 0x7698E RL_CUR_SB_SB 0 CM_0123 -37.5 37.20703125 /begin AXIS_DESCR STD_AXIS NO_INPUT_QUANTITY CM_0160 8 -2 1.984375 /end AXIS_DESCR /end CHARACTERISTIC
/begin CHARACTERISTIC KL_OZSTNIV "Correction of incline effects for oil-quality sensor package [verified]" CURVE 0x769A0 RL_CUR_SW_SW 0 CM_0123 -9600 9599.707031 /begin AXIS_DESCR STD_AXIS NO_INPUT_QUANTITY CM_0165 8 -64 63.99804688 /end AXIS_DESCR /end CHARACTERISTIC
/begin CHARACTERISTIC KL_PERREFTKOR "X: NO_INPUT_QUANTITY [?C] [verified]" CURVE 0x76842 RL_CUR_SW_SW 0 CM_0000 -32768 32767 /begin AXIS_DESCR STD_AXIS NO_INPUT_QUANTITY CM_0159 6 -3276.8 3276.7 /end AXIS_DESCR /end CHARACTERISTIC
/begin CHARACTERISTIC KL_TKTOENIV "Conversion to oil level [verified]" CURVE 0x76876 RL_CUR_UW_UW 0 CM_0023 0 6553.5 /begin AXIS_DESCR STD_AXIS NO_INPUT_QUANTITY CM_0023 8 0 6553.5 /end AXIS_DESCR /end CHARACTERISTIC
/begin CHARACTERISTIC KL_TVTOEL "[verified]" CURVE 0x76820 RL_CUR_UW_SW 0 CM_0159 -3276.8 3276.7 /begin AXIS_DESCR STD_AXIS NO_INPUT_QUANTITY CM_0023 8 0 6553.5 /end AXIS_DESCR /end CHARACTERISTIC
/begin CHARACTERISTIC KL_PABG_STAT_ML "Base map, relative exhaust back-pressure [verified]" CURVE 0x76BAE RL_CUR_SW_SW 0 CM_0022 -2048 2047.9375 /begin AXIS_DESCR STD_AXIS NO_INPUT_QUANTITY CM_0102 8 -3276.8 3276.7 /end AXIS_DESCR /end CHARACTERISTIC
/begin CHARACTERISTIC K_PABG_STAT_TAU "Filter time constant, exhaust back-pressure [s] [verified]" VALUE 0x76BAC RL_VAL_UB 0 CM_0027 0 255 /end CHARACTERISTIC
/begin CHARACTERISTIC KL_PKS_TAU_MODELL "Time constant for duty cycle in reverse interpolation [verified]" CURVE 0x76DBC RL_CUR_SW_UW 0 CM_0027 0 65535 /begin AXIS_DESCR STD_AXIS NO_INPUT_QUANTITY CM_0161 5 -4096 4095.875 /end AXIS_DESCR /end CHARACTERISTIC
/begin CHARACTERISTIC K_PKS_STEIGUNG "Fuel-pressure sensor slope [bar/V] [verified]" VALUE 0x76D20 RL_VAL_SW 0 CM_0193 -6.5536 6.5534 /end CHARACTERISTIC
/begin CHARACTERISTIC KF_PSAU_LLS_NOTL "Model map for idle-valve rail pressure [EST]" MAP 0x77DA6 RL_MAP_SW_SW_UW 0 CM_0016 0 63.99902344 /begin AXIS_DESCR STD_AXIS NO_INPUT_QUANTITY CM_0002 12 -32768 32767 /end AXIS_DESCR /begin AXIS_DESCR STD_AXIS NO_INPUT_QUANTITY CM_0003 8 -3.2768 3.2767 /end AXIS_DESCR /end CHARACTERISTIC
/begin CHARACTERISTIC KF_PSAU_SR "Model map for intake manifold pressure [verified]" MAP 0x77BD2 RL_MAP_SW_SW_SW 0 CM_0016 -32 31.99902344 /begin AXIS_DESCR STD_AXIS NO_INPUT_QUANTITY CM_0002 8 -32768 32767 /end AXIS_DESCR /begin AXIS_DESCR STD_AXIS NO_INPUT_QUANTITY CM_0012 12 -3276.8 3276.7 /end AXIS_DESCR /end CHARACTERISTIC
/begin CHARACTERISTIC KF_PSAU_LLS "Model map for intake manifold pressure [EST]" MAP 0x77CBC RL_MAP_SW_SW_UW 0 CM_0016 0 63.99902344 /begin AXIS_DESCR STD_AXIS NO_INPUT_QUANTITY CM_0002 12 -32768 32767 /end AXIS_DESCR /begin AXIS_DESCR STD_AXIS NO_INPUT_QUANTITY CM_0003 8 -3.2768 3.2767 /end AXIS_DESCR /end CHARACTERISTIC
/begin CHARACTERISTIC KL_RG_UES_A_MEAN "Valve cross-section after LOT [verified]" CURVE 0x780CA RL_GRP_UW_R 0 CM_0206 0 65.535
 /begin AXIS_DESCR COM_AXIS NO_INPUT_QUANTITY CM_0028 12 -3276.8 3276.7 AXIS_PTS_REF GAX_080B0 /end AXIS_DESCR
/end CHARACTERISTIC
/begin CHARACTERISTIC KF_RF_PT_PUMG_WICHT "Weighting over ambient pressure [verified]" MAP 0x78278 RL_MAP_SW_SW_UW 0 CM_0016 0 63.99902344 /begin AXIS_DESCR STD_AXIS NO_INPUT_QUANTITY CM_0002 6 -32768 32767 /end AXIS_DESCR /begin AXIS_DESCR STD_AXIS NO_INPUT_QUANTITY CM_0003 6 -3.2768 3.2767 /end AXIS_DESCR /end CHARACTERISTIC
/begin CHARACTERISTIC KL_RF_PT_PUMG_KORR "Correction factor depending on air pressure [verified]" CURVE 0x78256 RL_CUR_SW_UW 0 CM_0016 0 63.99902344 /begin AXIS_DESCR STD_AXIS NO_INPUT_QUANTITY CM_0022 8 -2048 2047.9375 /end AXIS_DESCR /end CHARACTERISTIC
/begin CHARACTERISTIC KL_RF_PT_TANZYL_KORR "X: Temperature in Celsius (temperatur) [?C] | Value: Factor (rf_tan_korr) [verified]" CURVE 0x78234 RL_CUR_SW_UW 0 CM_0016 0 63.99902344 /begin AXIS_DESCR STD_AXIS NO_INPUT_QUANTITY CM_0006 8 -3550 3003.5 /end AXIS_DESCR /end CHARACTERISTIC
/begin CHARACTERISTIC KL_RF_PT_TAN_KORR "X: Temperature in Celsius (temperatur) [?C] | Value: Factor (rf_tan_korr) [verified]" CURVE 0x78212 RL_CUR_SW_UW 0 CM_0016 0 63.99902344 /begin AXIS_DESCR STD_AXIS NO_INPUT_QUANTITY CM_0006 8 -3550 3003.5 /end AXIS_DESCR /end CHARACTERISTIC
/begin CHARACTERISTIC KF_SA_N_DYN_DKG "Gradient-dependent offset for overrun-resume speed, DKG [verified]" MAP 0x78462 RL_MAP_SW_SW_SW 0 CM_0002 -32768 32767 /begin AXIS_DESCR STD_AXIS NO_INPUT_QUANTITY CM_0067 4 -32768 32767 /end AXIS_DESCR /begin AXIS_DESCR STD_AXIS NO_INPUT_QUANTITY CM_0015 6 -32768 32767 /end AXIS_DESCR /end CHARACTERISTIC
/begin CHARACTERISTIC KF_SA_T_TRIG_MAX "Intake manifold pressure delta (dwell time) [verified]" MAP 0x7841C RL_MAP_SW_SW_UW 0 CM_0020 0 327.675 /begin AXIS_DESCR STD_AXIS NO_INPUT_QUANTITY CM_0006 4 -3550 3003.5 /end AXIS_DESCR /begin AXIS_DESCR STD_AXIS NO_INPUT_QUANTITY CM_0002 6 -32768 32767 /end AXIS_DESCR /end CHARACTERISTIC
/begin CHARACTERISTIC KL_SA_N_DYN "Engine-speed-gradient-dependent offset for overrun-resume speed calculation [verified]" CURVE 0x7837A RL_CUR_SW_SW 0 CM_0002 -32768 32767 /begin AXIS_DESCR STD_AXIS NO_INPUT_QUANTITY CM_0067 4 -32768 32767 /end AXIS_DESCR /end CHARACTERISTIC
/begin CHARACTERISTIC KL_SA_N_GANG_DKG "Gear-dependent offset for fuel-resume speed calculation [verified]" CURVE 0x7832C RL_CUR_SW_SW 0 CM_0002 -32768 32767 /begin AXIS_DESCR STD_AXIS NO_INPUT_QUANTITY CM_0000 10 -32768 32767 /end AXIS_DESCR /end CHARACTERISTIC
/begin CHARACTERISTIC KL_SA_N_HYS_GANG "Gear-dependent hysteresis of fuel cut-off speed [verified]" CURVE 0x7838C RL_CUR_SW_SW 0 CM_0002 -32768 32767 /begin AXIS_DESCR STD_AXIS NO_INPUT_QUANTITY CM_0000 10 -32768 32767 /end AXIS_DESCR /end CHARACTERISTIC
/begin CHARACTERISTIC KL_SA_N_TMOT "Engine-temperature-dependent offset for resume calculation [verified]" CURVE 0x78356 RL_CUR_SW_SW 0 CM_0002 -32768 32767 /begin AXIS_DESCR STD_AXIS NO_INPUT_QUANTITY CM_0006 4 -3550 3003.5 /end AXIS_DESCR /end CHARACTERISTIC
/begin CHARACTERISTIC KL_SLP_DAUER_TMOT_START "Secondary-air-pump delay depending on start engine temperature [verified]" CURVE 0x78848 RL_CUR_SW_UW 0 CM_0025 0 655.35 /begin AXIS_DESCR STD_AXIS NO_INPUT_QUANTITY CM_0006 6 -3550 3003.5 /end AXIS_DESCR /end CHARACTERISTIC
/begin CHARACTERISTIC KL_DMTL_FST_ERS_RE "Substitute value for right sender fault [verified]" CURVE 0x709CE RL_CUR_UB_UB 0 CM_0192 0 127.5 /begin AXIS_DESCR STD_AXIS NO_INPUT_QUANTITY CM_0192 4 0 127.5 /end AXIS_DESCR /end CHARACTERISTIC
/begin CHARACTERISTIC KL_DMTL_FST_MAX_STAND "Maximum fill level for diagnoses at standstill [verified]" CURVE 0x709B6 RL_CUR_SW_UB 0 CM_0192 0 127.5 /begin AXIS_DESCR STD_AXIS NO_INPUT_QUANTITY CM_0042 4 -819.2 819.175 /end AXIS_DESCR /end CHARACTERISTIC
/begin CHARACTERISTIC KL_DMTL_HOEHE_KORR "Correction factor for tank-leak (DMTL) coarse/stable vs ambient pressure [verified]" CURVE 0x709D8 RL_CUR_SW_UB 0 CM_0037 0 1.9921875 /begin AXIS_DESCR STD_AXIS NO_INPUT_QUANTITY CM_0022 3 -2048 2047.9375 /end AXIS_DESCR /end CHARACTERISTIC
/begin CHARACTERISTIC KL_DMTL_I_REF_KORR "Reference-current correction for fine leak vs fill level [verified]" CURVE 0x709E4 RL_CUR_UB_UB 0 CM_0037 0 1.9921875 /begin AXIS_DESCR STD_AXIS NO_INPUT_QUANTITY CM_0192 3 0 127.5 /end AXIS_DESCR /end CHARACTERISTIC
/begin CHARACTERISTIC KL_DMTL_KORR_FAKT "Pump-current correction factor vs voltage [verified]" CURVE 0x709EC RL_CUR_UW_UW 0 CM_0016 0 63.99902344 /begin AXIS_DESCR STD_AXIS NO_INPUT_QUANTITY CM_0210 5 0 102.3984375 /end AXIS_DESCR /end CHARACTERISTIC
/begin CHARACTERISTIC KF_TANZYL_RATIO "Air mass flow factor for intake-cylinder temperature model [verified]" MAP 0x78B8C RL_MAP_SW_SW_UW 0 CM_0019 0 3.999941832 /begin AXIS_DESCR STD_AXIS NO_INPUT_QUANTITY CM_0002 6 -32768 32767 /end AXIS_DESCR /begin AXIS_DESCR STD_AXIS NO_INPUT_QUANTITY CM_0003 6 -3.2768 3.2767 /end AXIS_DESCR /end CHARACTERISTIC
/begin CHARACTERISTIC KL_TANZYL_ABREG "Ramp-down over time [verified]" CURVE 0x78B72 RL_CUR_UW_UW 0 CM_0019 0 3.999941832 /begin AXIS_DESCR STD_AXIS NO_INPUT_QUANTITY CM_0060 6 0 1092.250002 /end AXIS_DESCR /end CHARACTERISTIC
/begin CHARACTERISTIC KL_TANZYL_ML_GES_TAU "Air mass flow to time constant [verified]" CURVE 0x78B58 RL_CUR_SW_UW 0 CM_0027 0 65535 /begin AXIS_DESCR STD_AXIS NO_INPUT_QUANTITY CM_0102 6 -3276.8 3276.7 /end AXIS_DESCR /end CHARACTERISTIC
/begin CHARACTERISTIC KL_TKSM_ABREG "Ramp-down over time [verified]" CURVE 0x7A2EE RL_CUR_UW_UW 0 CM_0019 0 3.999941832 /begin AXIS_DESCR STD_AXIS NO_INPUT_QUANTITY CM_0060 6 0 1092.250002 /end AXIS_DESCR /end CHARACTERISTIC
/begin CHARACTERISTIC KL_TKSM_MR_ABREG "Ramp-down over engine-bay temperature [verified]" CURVE 0x7A308 RL_CUR_UW_UW 0 CM_0019 0 3.999941832 /begin AXIS_DESCR STD_AXIS NO_INPUT_QUANTITY CM_0060 6 0 1092.250002 /end AXIS_DESCR /end CHARACTERISTIC
/begin CHARACTERISTIC KL_TKSM_MR_TUMG_KAL "Weighting of difference tm - tumg [verified]" CURVE 0x7A322 RL_CUR_SW_UW 0 CM_0019 0 3.999941832 /begin AXIS_DESCR STD_AXIS NO_INPUT_QUANTITY CM_0006 6 -3550 3003.5 /end AXIS_DESCR /end CHARACTERISTIC
/begin CHARACTERISTIC KL_TKSM_Q_MOT_RATIO "Fuel consumption factor for fuel-temperature model [verified]" CURVE 0x7A2D4 RL_CUR_SW_UW 0 CM_0019 0 3.999941832 /begin AXIS_DESCR STD_AXIS NO_INPUT_QUANTITY CM_0161 6 -4096 4095.875 /end AXIS_DESCR /end CHARACTERISTIC
/begin CHARACTERISTIC KL_TKSM_Q_MOT_TAU "Fuel consumption to time constant [verified]" CURVE 0x7A2BA RL_CUR_SW_UW 0 CM_0027 0 65535 /begin AXIS_DESCR STD_AXIS NO_INPUT_QUANTITY CM_0161 6 -4096 4095.875 /end AXIS_DESCR /end CHARACTERISTIC
/begin CHARACTERISTIC KF_VAN_KH_LL_SOLL_A "Catalyst-heating map at idle (exhaust VANOS) [verified]" MAP 0x7A7AA RL_MAP_SW_SW_SW 0 CM_0028 -3276.8 3276.7 /begin AXIS_DESCR STD_AXIS NO_INPUT_QUANTITY CM_0002 6 -32768 32767 /end AXIS_DESCR /begin AXIS_DESCR STD_AXIS NO_INPUT_QUANTITY CM_0003 8 -3.2768 3.2767 /end AXIS_DESCR /end CHARACTERISTIC
/begin CHARACTERISTIC KF_VAN_KH_SOLL_E "Catalyst-heating map, VANOS target [verified]" MAP 0x7A828 RL_MAP_SW_SW_SW 0 CM_0028 -3276.8 3276.7 /begin AXIS_DESCR STD_AXIS NO_INPUT_QUANTITY CM_0002 16 -32768 32767 /end AXIS_DESCR
 /begin AXIS_DESCR STD_AXIS NO_INPUT_QUANTITY CM_0005 12 -199.9999992 199.9938957 /end AXIS_DESCR
/end CHARACTERISTIC
/begin CHARACTERISTIC KF_VAN_SOLL_A "Base map, VANOS target [verified]" MAP 0x7A9E2 RL_MAP_SW_SW_SW 0 CM_0028 -3276.8 3276.7 /begin AXIS_DESCR STD_AXIS NO_INPUT_QUANTITY CM_0002 16 -32768 32767 /end AXIS_DESCR
 /begin AXIS_DESCR STD_AXIS NO_INPUT_QUANTITY CM_0005 12 -199.9999992 199.9938957 /end AXIS_DESCR
/end CHARACTERISTIC
/begin CHARACTERISTIC KF_VAN_SOLL_DMAX_A "Rate limit of target value [verified]" MAP 0x7AE52 RL_MAP_SW_SW_SW 0 CM_0223 -3276.8 3276.7 /begin AXIS_DESCR STD_AXIS NO_INPUT_QUANTITY CM_0002 6 -32768 32767 /end AXIS_DESCR
 /begin AXIS_DESCR STD_AXIS NO_INPUT_QUANTITY CM_0005 6 -199.9999992 199.9938957 /end AXIS_DESCR
/end CHARACTERISTIC
/begin CHARACTERISTIC KF_VAN_SOLL_DMAX_E "Rate limit of target value [verified]" MAP 0x7AEB4 RL_MAP_SW_SW_SW 0 CM_0223 -3276.8 3276.7 /begin AXIS_DESCR STD_AXIS NO_INPUT_QUANTITY CM_0002 6 -32768 32767 /end AXIS_DESCR
 /begin AXIS_DESCR STD_AXIS NO_INPUT_QUANTITY CM_0005 6 -199.9999992 199.9938957 /end AXIS_DESCR
/end CHARACTERISTIC
/begin CHARACTERISTIC KF_VAN_SOLL_E "Base map, VANOS target [verified]" MAP 0x7AB9C RL_MAP_SW_SW_SW 0 CM_0028 -3276.8 3276.7 /begin AXIS_DESCR STD_AXIS NO_INPUT_QUANTITY CM_0002 16 -32768 32767 /end AXIS_DESCR
 /begin AXIS_DESCR STD_AXIS NO_INPUT_QUANTITY CM_0005 12 -199.9999992 199.9938957 /end AXIS_DESCR
/end CHARACTERISTIC
/begin CHARACTERISTIC KF_VAN_VST_VOL_MAX "Maximum valve flow [verified]" MAP 0x7AFDA RL_MAP_SW_SW_SW 0 CM_0224 -196.608 196.602 /begin AXIS_DESCR STD_AXIS NO_INPUT_QUANTITY CM_0002 6 -32768 32767 /end AXIS_DESCR /begin AXIS_DESCR STD_AXIS NO_INPUT_QUANTITY CM_0006 6 -3550 3003.5 /end AXIS_DESCR /end CHARACTERISTIC
/begin CHARACTERISTIC KF_VAN_XD_TAU "Filter time constant, control error [verified]" MAP 0x7B03C RL_MAP_SW_SW_SW 0 CM_0027 -32768 32767 /begin AXIS_DESCR STD_AXIS NO_INPUT_QUANTITY CM_0002 3 -32768 32767 /end AXIS_DESCR /begin AXIS_DESCR STD_AXIS NO_INPUT_QUANTITY CM_0006 4 -3550 3003.5 /end AXIS_DESCR /end CHARACTERISTIC
/begin CHARACTERISTIC KL_VAN_DSV_HOLD_TV "Hold duty cycle, pressure-accumulator valve [verified]" CURVE 0x7A348 RL_CUR_SW_SW 0 CM_0175 -399.9999984 399.9877913 /begin AXIS_DESCR STD_AXIS NO_INPUT_QUANTITY CM_0021 3 -3276.8 3276.7 /end AXIS_DESCR /end CHARACTERISTIC
/begin CHARACTERISTIC KL_VAN_DSV_PEAK_TV "Peak duty cycle, pressure-accumulator valve [verified]" CURVE 0x7A356 RL_CUR_SW_SW 0 CM_0175 -399.9999984 399.9877913 /begin AXIS_DESCR STD_AXIS NO_INPUT_QUANTITY CM_0021 3 -3276.8 3276.7 /end AXIS_DESCR /end CHARACTERISTIC
/begin CHARACTERISTIC KL_VAN_KI_FAKT "Weighting of control error for valve quality [verified]" CURVE 0x7A4E6 RL_CUR_SW_UB 0 CM_0037 0 1.9921875 /begin AXIS_DESCR STD_AXIS NO_INPUT_QUANTITY CM_0006 4 -3550 3003.5 /end AXIS_DESCR /end CHARACTERISTIC
/begin CHARACTERISTIC KL_VAN_FREQU_ML "Valve PWM frequency, engine running [verified]" CURVE 0x7A44A RL_CUR_SW_UW 0 CM_0225 0 65535 /begin AXIS_DESCR STD_AXIS NO_INPUT_QUANTITY CM_0006 4 -3550 3003.5 /end AXIS_DESCR /end CHARACTERISTIC
/begin CHARACTERISTIC KL_VAN_IST_DIFF_ASP_ZUL "Permitted oscillation range within 1 working cycle [verified]" CURVE 0x7A45C RL_CUR_SW_SW 0 CM_0028 -3276.8 3276.7 /begin AXIS_DESCR STD_AXIS NO_INPUT_QUANTITY CM_0002 8 -32768 32767 /end AXIS_DESCR /end CHARACTERISTIC
/begin CHARACTERISTIC KL_VAN_KI_A "Controller I factor [verified]" CURVE 0x7A47E RL_CUR_SW_SW 0 CM_0226 -399.9999984 399.9877913 /begin AXIS_DESCR STD_AXIS NO_INPUT_QUANTITY CM_0028 7 -3276.8 3276.7 /end AXIS_DESCR /end CHARACTERISTIC
/begin CHARACTERISTIC KL_VAN_KI_E "Controller I factor [verified]" CURVE 0x7A49C RL_CUR_SW_SW 0 CM_0226 -399.9999984 399.9877913 /begin AXIS_DESCR STD_AXIS NO_INPUT_QUANTITY CM_0028 7 -3276.8 3276.7 /end AXIS_DESCR /end CHARACTERISTIC
/begin CHARACTERISTIC KL_VAN_KP_A "Controller P factor [verified]" CURVE 0x7A4BA RL_CUR_SW_SW 0 CM_0227 -1280 1279.960938 /begin AXIS_DESCR STD_AXIS NO_INPUT_QUANTITY CM_0002 5 -32768 32767 /end AXIS_DESCR /end CHARACTERISTIC
/begin CHARACTERISTIC KL_VAN_KP_E "Controller P factor [verified]" CURVE 0x7A4D0 RL_CUR_SW_SW 0 CM_0227 -1280 1279.960938 /begin AXIS_DESCR STD_AXIS NO_INPUT_QUANTITY CM_0002 5 -32768 32767 /end AXIS_DESCR /end CHARACTERISTIC
/begin CHARACTERISTIC KL_VAN_KP_FAKT "Controller correction factor [verified]" CURVE 0x7A4F4 RL_CUR_SW_UB 0 CM_0037 0 1.9921875 /begin AXIS_DESCR STD_AXIS NO_INPUT_QUANTITY CM_0006 4 -3550 3003.5 /end AXIS_DESCR /end CHARACTERISTIC
/begin CHARACTERISTIC KL_VAN_SOLL_DMAX_WL_A "Rate limit in overlap during warm-up [verified]" CURVE 0x7A52E RL_CUR_SW_SW 0 CM_0223 -3276.8 3276.7 /begin AXIS_DESCR STD_AXIS NO_INPUT_QUANTITY CM_0006 4 -3550 3003.5 /end AXIS_DESCR /end CHARACTERISTIC
/begin CHARACTERISTIC KL_VAN_SOLL_DMAX_WL_E "Rate limit in overlap during warm-up [verified]" CURVE 0x7A540 RL_CUR_SW_SW 0 CM_0223 -3276.8 3276.7 /begin AXIS_DESCR STD_AXIS NO_INPUT_QUANTITY CM_0006 4 -3550 3003.5 /end AXIS_DESCR /end CHARACTERISTIC
/begin CHARACTERISTIC KL_VAN_T_DRUCK_E "Pressure detection time without fault entry [verified]" CURVE 0x7A552 RL_CUR_SW_UW 0 CM_0023 0 6553.5 /begin AXIS_DESCR STD_AXIS NO_INPUT_QUANTITY CM_0006 4 -3550 3003.5 /end AXIS_DESCR /end CHARACTERISTIC
/begin CHARACTERISTIC KL_VAN_T_START_DLY "Controller enable after engine start [verified]" CURVE 0x7A57E RL_CUR_SW_UW 0 CM_0025 0 655.35 /begin AXIS_DESCR STD_AXIS NO_INPUT_QUANTITY CM_0006 8 -3550 3003.5 /end AXIS_DESCR /end CHARACTERISTIC
/begin CHARACTERISTIC KL_VAN_VST_I "Current for relative valve opening [verified]" CURVE 0x7A5B2 RL_CUR_SW_SW 0 CM_0228 -32768 32767 /begin AXIS_DESCR STD_AXIS NO_INPUT_QUANTITY CM_0091 15 -3200 3199.902344 /end AXIS_DESCR /end CHARACTERISTIC
/begin CHARACTERISTIC K_VAN_DSV_ABFALL_DLY "Drop-out time, pressure-accumulator valve [s] [verified]" VALUE 0x7A340 RL_VAL_UB 0 CM_0023 0 25.5 /end CHARACTERISTIC
/begin CHARACTERISTIC K_VAN_DSV_CFG "Source: PSB MS_S60 program 754 [verified]" VALUE 0x7A341 RL_VAL_UB 0 CM_0000 0 255 /end CHARACTERISTIC
/begin CHARACTERISTIC K_VAN_DSV_N_AUS "Switch-off threshold, pressure-accumulator valve during start [Upm] [verified]" VALUE 0x7A342 RL_VAL_SW 0 CM_0002 -32768 32767 /end CHARACTERISTIC
/begin CHARACTERISTIC K_VAN_DSV_N_EIN "Switch-on threshold, pressure-accumulator valve during start [Upm] [verified]" VALUE 0x7A344 RL_VAL_SW 0 CM_0002 -32768 32767 /end CHARACTERISTIC
/begin CHARACTERISTIC K_VAN_DSV_PEAK_TIME "Pull-in time, pressure-accumulator valve [verified]" VALUE 0x7A346 RL_VAL_UB 0 CM_0023 0 25.5 /end CHARACTERISTIC
/begin CHARACTERISTIC K_VAN_INVERT_A1 "Normalisation: de-energised = maximum spread [verified]" VALUE 0x7A3B1 RL_VAL_UB 0 CM_0000 0 255 /end CHARACTERISTIC
/begin CHARACTERISTIC K_VAN_INVERT_A2 "Normalisation: de-energised = maximum spread [verified]" VALUE 0x7A3B3 RL_VAL_UB 0 CM_0000 0 255 /end CHARACTERISTIC
/begin CHARACTERISTIC K_VAN_INVERT_E1 "Normalisation: de-energised = maximum spread [verified]" VALUE 0x7A3B0 RL_VAL_UB 0 CM_0000 0 255 /end CHARACTERISTIC
/begin CHARACTERISTIC K_VAN_I_I_MAX "Controller integral share, maximum [mA] [verified]" VALUE 0x7A3A8 RL_VAL_SW 0 CM_0228 -32768 32767 /end CHARACTERISTIC
/begin CHARACTERISTIC K_VAN_I_I_MIN "Controller integral share, minimum [mA] [verified]" VALUE 0x7A3AA RL_VAL_SW 0 CM_0228 -32768 32767 /end CHARACTERISTIC
/begin CHARACTERISTIC K_VAN_I_MAX "Valve current, maximum [mA] [verified]" VALUE 0x7A3AC RL_VAL_SW 0 CM_0228 -32768 32767 /end CHARACTERISTIC
/begin CHARACTERISTIC K_VAN_R20 "Coil resistance at 20 deg C [Ohm] [verified]" VALUE 0x7A3D4 RL_VAL_SW 0 CM_0229 -32.768 32.767 /end CHARACTERISTIC
/begin CHARACTERISTIC K_VAN_R_TK "Temperature coefficient of coil resistance [10exp-3] [verified]" VALUE 0x7A3D6 RL_VAL_SW 0 CM_0230 -327.68 327.67 /end CHARACTERISTIC
/begin CHARACTERISTIC K_VAN_SMG_MD_ABBR "Abort desired torque, SMG shift [%] [verified]" VALUE 0x7A3DA RL_VAL_SW 0 CM_0013 -3276.8 3276.7 /end CHARACTERISTIC
/begin CHARACTERISTIC K_VAN_SMG_MD_MIN "Minimum desired torque, SMG shift [%] [verified]" VALUE 0x7A3D8 RL_VAL_SW 0 CM_0013 -3276.8 3276.7 /end CHARACTERISTIC
/begin CHARACTERISTIC K_VAN_SMG_N_ABBR "Abort target speed, SMG shift [Upm] [verified]" VALUE 0x7A3DE RL_VAL_SW 0 CM_0002 -32768 32767 /end CHARACTERISTIC
/begin CHARACTERISTIC K_VAN_SMG_N_MIN "Minimum target speed, SMG shift [Upm] [verified]" VALUE 0x7A3DC RL_VAL_SW 0 CM_0002 -32768 32767 /end CHARACTERISTIC
/begin CHARACTERISTIC K_VAN_START_I_MAX_AUSLASS "Valve current during start [mA] [verified]" VALUE 0x7A3AE RL_VAL_SW 0 CM_0228 -32768 32767 /end CHARACTERISTIC
/begin CHARACTERISTIC K_VAN_XD_EINGEREGELT "Maximum control error for B_VAN_EINGEREGELT (settled) [?KW] [verified]" VALUE 0x7A444 RL_VAL_SW 0 CM_0028 -3276.8 3276.7 /end CHARACTERISTIC
/begin CHARACTERISTIC K_VAN_XD_REG_MIN "Minimum control error for unfiltered control [?KW] [verified]" VALUE 0x7A448 RL_VAL_SW 0 CM_0028 -3276.8 3276.7 /end CHARACTERISTIC
/begin CHARACTERISTIC K_VAN_XD_SK "Deviation, small spread, limp-home program [?KW] [verified]" VALUE 0x7A446 RL_VAL_SW 0 CM_0028 -3276.8 3276.7 /end CHARACTERISTIC
/begin CHARACTERISTIC KF_WF_ASP_NEG "Number of working cycles for wall-film decay [verified]" MAP 0x7B276 RL_MAP_SW_SW_UW 0 CM_0231 0 65535 /begin AXIS_DESCR STD_AXIS NO_INPUT_QUANTITY CM_0006 6 -3550 3003.5 /end AXIS_DESCR /begin AXIS_DESCR STD_AXIS NO_INPUT_QUANTITY CM_0002 5 -32768 32767 /end AXIS_DESCR /end CHARACTERISTIC
/begin CHARACTERISTIC KF_WF_ASP_POS "Number of working cycles for wall-film build-up [verified]" MAP 0x7B31E RL_MAP_SW_SW_UW 0 CM_0231 0 65535 /begin AXIS_DESCR STD_AXIS NO_INPUT_QUANTITY CM_0006 6 -3550 3003.5 /end AXIS_DESCR /begin AXIS_DESCR STD_AXIS NO_INPUT_QUANTITY CM_0002 5 -32768 32767 /end AXIS_DESCR /end CHARACTERISTIC
/begin CHARACTERISTIC KF_WF_MKS_AKTIV_NEG "Activation threshold for negative wall film [verified]" MAP 0x7B222 RL_MAP_SW_SW_UW 0 CM_0232 0 2047.96875 /begin AXIS_DESCR STD_AXIS NO_INPUT_QUANTITY CM_0006 6 -3550 3003.5 /end AXIS_DESCR /begin AXIS_DESCR STD_AXIS NO_INPUT_QUANTITY CM_0002 5 -32768 32767 /end AXIS_DESCR /end CHARACTERISTIC
/begin CHARACTERISTIC KF_WF_MKS_AKTIV_POS "Activation threshold for positive wall film [verified]" MAP 0x7B2CA RL_MAP_SW_SW_UW 0 CM_0232 0 2047.96875 /begin AXIS_DESCR STD_AXIS NO_INPUT_QUANTITY CM_0006 6 -3550 3003.5 /end AXIS_DESCR /begin AXIS_DESCR STD_AXIS NO_INPUT_QUANTITY CM_0002 5 -32768 32767 /end AXIS_DESCR /end CHARACTERISTIC
/begin CHARACTERISTIC KF_WF_MKS_BEGR_NEG "Minimum wall-film fuel mass [verified]" MAP 0x7B596 RL_MAP_SW_SW_UW 0 CM_0016 0 63.99902344 /begin AXIS_DESCR STD_AXIS NO_INPUT_QUANTITY CM_0006 7 -3550 3003.5 /end AXIS_DESCR /begin AXIS_DESCR STD_AXIS NO_INPUT_QUANTITY CM_0000 4 -32768 32767 /end AXIS_DESCR /end CHARACTERISTIC
/begin CHARACTERISTIC KF_WF_MKS_BEGR_POS "Maximum wall-film fuel mass [verified]" MAP 0x7B546 RL_MAP_SW_SW_UW 0 CM_0016 0 63.99902344 /begin AXIS_DESCR STD_AXIS NO_INPUT_QUANTITY CM_0006 7 -3550 3003.5 /end AXIS_DESCR /begin AXIS_DESCR STD_AXIS NO_INPUT_QUANTITY CM_0000 4 -32768 32767 /end AXIS_DESCR /end CHARACTERISTIC
/begin CHARACTERISTIC KF_WF_SOLL_F_SA "Wall-film weighting factor over fuel-cut duration [verified]" MAP 0x7B5E6 RL_MAP_SW_SW_UW 0 CM_0016 0 63.99902344 /begin AXIS_DESCR STD_AXIS NO_INPUT_QUANTITY CM_0002 7 -32768 32767 /end AXIS_DESCR /begin AXIS_DESCR STD_AXIS NO_INPUT_QUANTITY CM_0025 4 -327.68 327.67 /end AXIS_DESCR /end CHARACTERISTIC
/begin CHARACTERISTIC KF_WF_SOLL_F_VAN "Wall-film correction factor, valve overlap [verified]" MAP 0x7B372 RL_MAP_SW_SW_UW 0 CM_0016 0 63.99902344 /begin AXIS_DESCR STD_AXIS NO_INPUT_QUANTITY CM_0028 8 -3276.8 3276.7 /end AXIS_DESCR /begin AXIS_DESCR STD_AXIS NO_INPUT_QUANTITY CM_0006 8 -3550 3003.5 /end AXIS_DESCR /end CHARACTERISTIC
/begin CHARACTERISTIC KL_WF_ASP_NEG_START "Number of working cycles for wall-film decay (sequential start) [verified]" CURVE 0x7B1BE RL_CUR_SW_UW 0 CM_0231 0 65535 /begin AXIS_DESCR STD_AXIS NO_INPUT_QUANTITY CM_0006 6 -3550 3003.5 /end AXIS_DESCR /end CHARACTERISTIC
/begin CHARACTERISTIC KL_WF_ASP_POS_START "Number of working cycles for wall-film build-up (sequential start) [verified]" CURVE 0x7B1A4 RL_CUR_SW_UW 0 CM_0231 0 65535 /begin AXIS_DESCR STD_AXIS NO_INPUT_QUANTITY CM_0006 6 -3550 3003.5 /end AXIS_DESCR /end CHARACTERISTIC
/begin CHARACTERISTIC KL_WF_DMKS_T1_MS "Evaporation time constant with engine stopped [verified]" CURVE 0x7B156 RL_CUR_SW_UW 0 CM_0027 0 65535 /begin AXIS_DESCR STD_AXIS NO_INPUT_QUANTITY CM_0006 5 -3550 3003.5 /end AXIS_DESCR /end CHARACTERISTIC
/begin CHARACTERISTIC KL_WF_MKS_BEGR_NEG_WICHT "Weighting factor for negative wall-film fuel-mass limit [verified]" CURVE 0x7B1D8 RL_CUR_SW_UW 0 CM_0016 0 63.99902344 /begin AXIS_DESCR STD_AXIS NO_INPUT_QUANTITY CM_0006 7 -3550 3003.5 /end AXIS_DESCR /end CHARACTERISTIC
/begin CHARACTERISTIC KL_WF_SOLL_F_PUMG "Wall-film correction factor for altitude/ambient pressure [verified]" CURVE 0x7B1F6 RL_CUR_SW_UW 0 CM_0016 0 63.99902344 /begin AXIS_DESCR STD_AXIS NO_INPUT_QUANTITY CM_0022 5 -2048 2047.9375 /end AXIS_DESCR /end CHARACTERISTIC
/begin CHARACTERISTIC KL_WF_SOLL_F_TI_PHI_ENDE "Wall-film correction factor, end of injection [verified]" CURVE 0x7B16C RL_CUR_SW_UW 0 CM_0016 0 63.99902344 /begin AXIS_DESCR STD_AXIS NO_INPUT_QUANTITY CM_0028 5 -3276.8 3276.7 /end AXIS_DESCR /end CHARACTERISTIC
/begin CHARACTERISTIC K_WF_MKS_TI_CFG "Inclusion of wall-film fuel mass [verified]" VALUE 0x7B14C RL_VAL_UB 0 CM_0000 0 255 /end CHARACTERISTIC
/begin CHARACTERISTIC K_WF_SOLL_START_PSAU "Calibrated intake-pressure value during start [mbar] [verified]" VALUE 0x7B14E RL_VAL_SW 0 CM_0022 -2048 2047.9375 /end CHARACTERISTIC
/begin CHARACTERISTIC K_WF_SOLL_START_PSAU_CFG "Switch for real or calibrated intake pressure [verified]" VALUE 0x7B14D RL_VAL_UB 0 CM_0000 0 255 /end CHARACTERISTIC
/begin CHARACTERISTIC KL_ZUST_MD_TL_VL "Relative torque for transition part load to full load [verified]" CURVE 0x7B658 RL_CUR_SW_SW 0 CM_0013 -3276.8 3276.7 /begin AXIS_DESCR STD_AXIS NO_INPUT_QUANTITY CM_0002 6 -32768 32767 /end AXIS_DESCR /end CHARACTERISTIC
/begin CHARACTERISTIC KL_TI_NS_TIME_F "Post-start standing-time correction [verified]" CURVE 0x7948E RL_CUR_UW_UW 0 CM_0016 0 63.99902344 /begin AXIS_DESCR STD_AXIS NO_INPUT_QUANTITY CM_0233 6 0 1092.25 /end AXIS_DESCR /end CHARACTERISTIC
/begin CHARACTERISTIC KL_TI_TU_F_WICHT "Dynamic weighting factor, uniform-distribution feed-forward [verified]" CURVE 0x794EA RL_CUR_UW_UW 0 CM_0016 0 63.99902344 /begin AXIS_DESCR STD_AXIS NO_INPUT_QUANTITY CM_0016 4 0 63.99902344 /end AXIS_DESCR /end CHARACTERISTIC
/begin CHARACTERISTIC KL_TI_WL_ABR_F "Warm-up fade-out factor [verified]" CURVE 0x7951C RL_CUR_UW_UW 0 CM_0016 0 63.99902344 /begin AXIS_DESCR STD_AXIS NO_INPUT_QUANTITY CM_0025 4 0 655.35 /end AXIS_DESCR /end CHARACTERISTIC
/begin CHARACTERISTIC KF_TI_NS_F "Post-start base factor [verified]" MAP 0x798F6 RL_MAP_SW_SW_UW 0 CM_0016 0 63.99902344 /begin AXIS_DESCR STD_AXIS NO_INPUT_QUANTITY CM_0006 10 -3550 3003.5 /end AXIS_DESCR /begin AXIS_DESCR STD_AXIS NO_INPUT_QUANTITY CM_0234 10 -32768 32767 /end AXIS_DESCR /end CHARACTERISTIC
/begin CHARACTERISTIC KF_TI_NS_MSA_F "Post-start base factor, MSA (auto start-stop) start [verified]" MAP 0x799E8 RL_MAP_SW_SW_UW 0 CM_0016 0 63.99902344 /begin AXIS_DESCR STD_AXIS NO_INPUT_QUANTITY CM_0006 5 -3550 3003.5 /end AXIS_DESCR /begin AXIS_DESCR STD_AXIS NO_INPUT_QUANTITY CM_0234 10 -32768 32767 /end AXIS_DESCR /end CHARACTERISTIC
/begin CHARACTERISTIC KF_TI_WL_HOEHE_OFFS "Warm-up offset, fuel/altitude influence [verified]" MAP 0x79BB0 RL_MAP_SW_SW_SW 0 CM_0016 -32 31.99902344 /begin AXIS_DESCR STD_AXIS NO_INPUT_QUANTITY CM_0235 8 -32768 32767 /end AXIS_DESCR /begin AXIS_DESCR STD_AXIS NO_INPUT_QUANTITY CM_0003 8 -3.2768 3.2767 /end AXIS_DESCR /end CHARACTERISTIC
/begin CHARACTERISTIC KF_TI_START_F "Start fade-out factor [verified]" MAP 0x79D34 RL_MAP_SW_SW_UW 0 CM_0016 0 63.99902344 /begin AXIS_DESCR STD_AXIS NO_INPUT_QUANTITY CM_0006 5 -3550 3003.5 /end AXIS_DESCR /begin AXIS_DESCR STD_AXIS NO_INPUT_QUANTITY CM_0234 10 -32768 32767 /end AXIS_DESCR /end CHARACTERISTIC
/begin CHARACTERISTIC KF_WF_MKS_START_MAX "Max. required wall-film fuel mass during start [verified]" MAP 0x7B414 RL_MAP_SW_SW_UW 0 CM_0232 0 2047.96875
 /begin AXIS_DESCR STD_AXIS NO_INPUT_QUANTITY CM_0233 3 -546.1333333 546.1166667 /end AXIS_DESCR
 /begin AXIS_DESCR STD_AXIS NO_INPUT_QUANTITY CM_0006 7 -3550 3003.5 /end AXIS_DESCR
/end CHARACTERISTIC
/begin CHARACTERISTIC KF_WF_SOLL_GRUND "Target base wall-film mass [verified]" MAP 0x7B454 RL_MAP_SW_SW_UW 0 CM_0232 0 2047.96875 /begin AXIS_DESCR STD_AXIS NO_INPUT_QUANTITY CM_0022 10 -2048 2047.9375 /end AXIS_DESCR /begin AXIS_DESCR STD_AXIS NO_INPUT_QUANTITY CM_0006 10 -3550 3003.5 /end AXIS_DESCR /end CHARACTERISTIC
/begin CHARACTERISTIC KL_WF_SOLL_F_LAM "Wall-film correction factor, lambda [verified]" CURVE 0x7B182 RL_CUR_UW_UW 0 CM_0016 0 63.99902344 /begin AXIS_DESCR STD_AXIS NO_INPUT_QUANTITY CM_0236 8 0 3.999938965 /end AXIS_DESCR /end CHARACTERISTIC
/begin CHARACTERISTIC K_WF_MKS_AUS_HYS "Hysteresis factor for wall-film deactivation [verified]" VALUE 0x7B150 RL_VAL_UW 0 CM_0016 0 63.99902344 /end CHARACTERISTIC
/begin CHARACTERISTIC K_WF_ASP_START "Number of intake strokes in START [verified]" VALUE 0x7B152 RL_VAL_UW 0 CM_0000 0 65535 /end CHARACTERISTIC
/begin CHARACTERISTIC KL_LAM_SOLL_MS_KAT_MAX "Catalyst filled with max. oxygen mass [verified]" CURVE 0x74D66 RL_CUR_UW_SW 0 CM_0104 -3276.8 3276.7 /begin AXIS_DESCR STD_AXIS NO_INPUT_QUANTITY CM_0236 6 0 3.999938965 /end AXIS_DESCR /end CHARACTERISTIC
/begin CHARACTERISTIC KL_LAM_SOLL_MS_KAT_SOLL_HYS "Relative hysteresis on max. oxygen mass [verified]" CURVE 0x74D80 RL_CUR_UW_SW 0 CM_0013 -3276.8 3276.7 /begin AXIS_DESCR STD_AXIS NO_INPUT_QUANTITY CM_0236 6 0 3.999938965 /end AXIS_DESCR /end CHARACTERISTIC
/begin CHARACTERISTIC KL_LAM_SOLL_MS_KAT_INIT_MSA "Oxygen mass after MSA start [verified]" CURVE 0x74CD4 RL_CUR_UW_UW 0 CM_0237 0 1.999969482 /begin AXIS_DESCR STD_AXIS NO_INPUT_QUANTITY CM_0233 6 0 1092.25 /end AXIS_DESCR /end CHARACTERISTIC
/begin CHARACTERISTIC KL_LAM_SOLL_VL_GRAD "Gradient limit when leaving full load (per segment) [verified]" CURVE 0x74D9A RL_CUR_SW_UW 0 CM_0236 0 3.999938965 /begin AXIS_DESCR STD_AXIS NO_INPUT_QUANTITY CM_0235 6 -32768 32767 /end AXIS_DESCR /end CHARACTERISTIC
/begin CHARACTERISTIC KL_LA_TRIM_RF_MAX "Max. relative charge - lambda trim [verified]" CURVE 0x74360 RL_CUR_SW_SW 0 CM_0003 -3.2768 3.2767 /begin AXIS_DESCR STD_AXIS NO_INPUT_QUANTITY CM_0235 8 -32768 32767 /end AXIS_DESCR /end CHARACTERISTIC
/begin CHARACTERISTIC KL_LA_TRIM_I_GMW_RF_MIN "Min. relative charge - I-share mean value [verified]" CURVE 0x74382 RL_CUR_SW_SW 0 CM_0003 -3.2768 3.2767 /begin AXIS_DESCR STD_AXIS NO_INPUT_QUANTITY CM_0235 8 -32768 32767 /end AXIS_DESCR /end CHARACTERISTIC
/begin CHARACTERISTIC KL_LA_TRIM_I_GMW_RF_MAX "Max. relative charge - I-share mean value [verified]" CURVE 0x743A4 RL_CUR_SW_SW 0 CM_0003 -3.2768 3.2767 /begin AXIS_DESCR STD_AXIS NO_INPUT_QUANTITY CM_0235 8 -32768 32767 /end AXIS_DESCR /end CHARACTERISTIC
/begin CHARACTERISTIC KL_LA_TRIM_USN_OFFSET_KM "Mileage-dependent post-cat target voltage offset [verified]" CURVE 0x743C6 RL_CUR_UW_SW 0 CM_0000 -32768 32767 /begin AXIS_DESCR STD_AXIS NO_INPUT_QUANTITY CM_0238 4 0 131070 /end AXIS_DESCR /end CHARACTERISTIC
/begin CHARACTERISTIC KL_LA_TRIM_DELTA_P_ZW_ML "Lambda delta factor vs. air mass (forced adaptation) [verified]" CURVE 0x742AE RL_CUR_SW_UW 0 CM_0239 0 0.9999847412 /begin AXIS_DESCR STD_AXIS NO_INPUT_QUANTITY CM_0102 6 -3276.8 3276.7 /end AXIS_DESCR /end CHARACTERISTIC
/begin CHARACTERISTIC KL_LA_TRIM_DELTA_P_ZW_KAT "Lambda delta factor vs. catalyst aging (forced adaptation) [verified]" CURVE 0x742C8 RL_CUR_UW_UB 0 CM_0164 0 0.99609375 /begin AXIS_DESCR STD_AXIS NO_INPUT_QUANTITY CM_0236 6 0 3.999938965 /end AXIS_DESCR /end CHARACTERISTIC
/begin CHARACTERISTIC KL_LA_TRIM_DELTA_P_ZW_US_DIFF "Forced-adaptation raw I-share vs. post-cat voltage error [verified]" CURVE 0x74274 RL_CUR_SW_SW 0 CM_0236 -2 1.999938965 /begin AXIS_DESCR STD_AXIS NO_INPUT_QUANTITY CM_0163 14 -160000 159995.1172 /end AXIS_DESCR /end CHARACTERISTIC
/begin CHARACTERISTIC KL_LA_TRIM_AD_ZW_AD_STEP "Steps for forced adaptation [verified]" CURVE 0x742DC RL_CUR_SW_SW 0 CM_0236 -2 1.999938965 /begin AXIS_DESCR STD_AXIS NO_INPUT_QUANTITY CM_0236 7 -2 1.999938965 /end AXIS_DESCR /end CHARACTERISTIC
/begin CHARACTERISTIC GKF_TI_TU_F_ZYL1 "Cylinder-individual fuel tuning factor (uniform-distribution feed-forward), cylinder index 0 [verified]" MAP 0x79F92 RL_GRP_UW_C 0 CM_0016 0 63.99902344
 /begin AXIS_DESCR COM_AXIS NO_INPUT_QUANTITY CM_0235 10 -32768 32767 AXIS_PTS_REF GAX_094FC /end AXIS_DESCR
 /begin AXIS_DESCR COM_AXIS NO_INPUT_QUANTITY CM_0003 4 -3.2768 3.2767 AXIS_PTS_REF GAX_09512 /end AXIS_DESCR
/end CHARACTERISTIC
/begin CHARACTERISTIC GKF_TI_TU_F_ZYL2 "Cylinder-individual fuel tuning factor (uniform-distribution feed-forward), cylinder index 1 [verified]" MAP 0x79FE2 RL_GRP_UW_C 0 CM_0016 0 63.99902344
 /begin AXIS_DESCR COM_AXIS NO_INPUT_QUANTITY CM_0235 10 -32768 32767 AXIS_PTS_REF GAX_094FC /end AXIS_DESCR
 /begin AXIS_DESCR COM_AXIS NO_INPUT_QUANTITY CM_0003 4 -3.2768 3.2767 AXIS_PTS_REF GAX_09512 /end AXIS_DESCR
/end CHARACTERISTIC
/begin CHARACTERISTIC GKF_TI_TU_F_ZYL3 "Cylinder-individual fuel tuning factor (uniform-distribution feed-forward), cylinder index 2 [verified]" MAP 0x7A032 RL_GRP_UW_C 0 CM_0016 0 63.99902344
 /begin AXIS_DESCR COM_AXIS NO_INPUT_QUANTITY CM_0235 10 -32768 32767 AXIS_PTS_REF GAX_094FC /end AXIS_DESCR
 /begin AXIS_DESCR COM_AXIS NO_INPUT_QUANTITY CM_0003 4 -3.2768 3.2767 AXIS_PTS_REF GAX_09512 /end AXIS_DESCR
/end CHARACTERISTIC
/begin CHARACTERISTIC GKF_TI_TU_F_ZYL4 "Cylinder-individual fuel tuning factor (uniform-distribution feed-forward), cylinder index 3 [verified]" MAP 0x7A082 RL_GRP_UW_C 0 CM_0016 0 63.99902344
 /begin AXIS_DESCR COM_AXIS NO_INPUT_QUANTITY CM_0235 10 -32768 32767 AXIS_PTS_REF GAX_094FC /end AXIS_DESCR
 /begin AXIS_DESCR COM_AXIS NO_INPUT_QUANTITY CM_0003 4 -3.2768 3.2767 AXIS_PTS_REF GAX_09512 /end AXIS_DESCR
/end CHARACTERISTIC
/begin CHARACTERISTIC GKF_TI_TU_F_ZYL5 "Cylinder-individual fuel tuning factor (uniform-distribution feed-forward), cylinder index 4 [verified]" MAP 0x7A0D2 RL_GRP_UW_C 0 CM_0016 0 63.99902344
 /begin AXIS_DESCR COM_AXIS NO_INPUT_QUANTITY CM_0235 10 -32768 32767 AXIS_PTS_REF GAX_094FC /end AXIS_DESCR
 /begin AXIS_DESCR COM_AXIS NO_INPUT_QUANTITY CM_0003 4 -3.2768 3.2767 AXIS_PTS_REF GAX_09512 /end AXIS_DESCR
/end CHARACTERISTIC
/begin CHARACTERISTIC GKF_TI_TU_F_ZYL6 "Cylinder-individual fuel tuning factor (uniform-distribution feed-forward), cylinder index 5 [verified]" MAP 0x7A122 RL_GRP_UW_C 0 CM_0016 0 63.99902344
 /begin AXIS_DESCR COM_AXIS NO_INPUT_QUANTITY CM_0235 10 -32768 32767 AXIS_PTS_REF GAX_094FC /end AXIS_DESCR
 /begin AXIS_DESCR COM_AXIS NO_INPUT_QUANTITY CM_0003 4 -3.2768 3.2767 AXIS_PTS_REF GAX_09512 /end AXIS_DESCR
/end CHARACTERISTIC
/begin CHARACTERISTIC GKF_TI_TU_F_ZYL7 "Cylinder-individual fuel tuning factor (uniform-distribution feed-forward), cylinder index 6 [verified]" MAP 0x7A172 RL_GRP_UW_C 0 CM_0016 0 63.99902344
 /begin AXIS_DESCR COM_AXIS NO_INPUT_QUANTITY CM_0235 10 -32768 32767 AXIS_PTS_REF GAX_094FC /end AXIS_DESCR
 /begin AXIS_DESCR COM_AXIS NO_INPUT_QUANTITY CM_0003 4 -3.2768 3.2767 AXIS_PTS_REF GAX_09512 /end AXIS_DESCR
/end CHARACTERISTIC
/begin CHARACTERISTIC GKF_TI_TU_F_ZYL8 "Cylinder-individual fuel tuning factor (uniform-distribution feed-forward), cylinder index 7 [verified]" MAP 0x7A1C2 RL_GRP_UW_C 0 CM_0016 0 63.99902344
 /begin AXIS_DESCR COM_AXIS NO_INPUT_QUANTITY CM_0235 10 -32768 32767 AXIS_PTS_REF GAX_094FC /end AXIS_DESCR
 /begin AXIS_DESCR COM_AXIS NO_INPUT_QUANTITY CM_0003 4 -3.2768 3.2767 AXIS_PTS_REF GAX_09512 /end AXIS_DESCR
/end CHARACTERISTIC
/begin CHARACTERISTIC GKF_TI_TU_F_ZYL9 "Cylinder-individual fuel tuning factor (uniform-distribution feed-forward), cylinder index 8 [verified]" MAP 0x7A212 RL_GRP_UW_C 0 CM_0016 0 63.99902344
 /begin AXIS_DESCR COM_AXIS NO_INPUT_QUANTITY CM_0235 10 -32768 32767 AXIS_PTS_REF GAX_094FC /end AXIS_DESCR
 /begin AXIS_DESCR COM_AXIS NO_INPUT_QUANTITY CM_0003 4 -3.2768 3.2767 AXIS_PTS_REF GAX_09512 /end AXIS_DESCR
/end CHARACTERISTIC
/begin CHARACTERISTIC GKF_TI_TU_F_ZYL10 "Cylinder-individual fuel tuning factor (uniform-distribution feed-forward), cylinder index 9 [verified]" MAP 0x7A262 RL_GRP_UW_C 0 CM_0016 0 63.99902344
 /begin AXIS_DESCR COM_AXIS NO_INPUT_QUANTITY CM_0235 10 -32768 32767 AXIS_PTS_REF GAX_094FC /end AXIS_DESCR
 /begin AXIS_DESCR COM_AXIS NO_INPUT_QUANTITY CM_0003 4 -3.2768 3.2767 AXIS_PTS_REF GAX_09512 /end AXIS_DESCR
/end CHARACTERISTIC
/begin CHARACTERISTIC KF_TI_START_F_GTS "Start fade-out factor, GTS variant [verified]" MAP 0x79DB8 RL_MAP_SW_SW_UW 0 CM_0016 0 63.99902344 /begin AXIS_DESCR STD_AXIS NO_INPUT_QUANTITY CM_0006 2 -3550 3003.5 /end AXIS_DESCR /begin AXIS_DESCR STD_AXIS NO_INPUT_QUANTITY CM_0234 6 -32768 32767 /end AXIS_DESCR /end CHARACTERISTIC
/begin CHARACTERISTIC KL_TI_MKS_START_OFFS_GTS "Start fuel-mass offset, GTS variant [verified]" CURVE 0x7952E RL_CUR_SW_SW 0 CM_0000 -32768 32767 /begin AXIS_DESCR STD_AXIS NO_INPUT_QUANTITY CM_0006 3 -3550 3003.5 /end AXIS_DESCR /end CHARACTERISTIC
/begin CHARACTERISTIC KL_WF_MKS_START_MAX_OFFS_GTS "Wall-film start max offset, GTS variant [verified]" CURVE 0x7B20C RL_CUR_SW_SW 0 CM_0000 -32768 32767 /begin AXIS_DESCR STD_AXIS NO_INPUT_QUANTITY CM_0006 5 -3550 3003.5 /end AXIS_DESCR /end CHARACTERISTIC
/begin CHARACTERISTIC KF_LAM_SOLL_WL_TMOT_MAX "Engine-temperature threshold for warm-up lambda state [verified]" MAP 0x74DB4 RL_MAP_SW_SW_SW 0 CM_0006 -3550 3003.5 /begin AXIS_DESCR STD_AXIS NO_INPUT_QUANTITY CM_0006 4 -3550 3003.5 /end AXIS_DESCR /begin AXIS_DESCR STD_AXIS NO_INPUT_QUANTITY CM_0022 2 -2048 2047.9375 /end AXIS_DESCR /end CHARACTERISTIC
/begin CHARACTERISTIC KF_LAM_SOLL_KH_OSL_F "Weighting of warm cat-heating lambda offset [verified]" MAP 0x7568C RL_MAP_SW_SW_UW 0 CM_0016 0 63.99902344 /begin AXIS_DESCR STD_AXIS NO_INPUT_QUANTITY CM_0006 4 -3550 3003.5 /end AXIS_DESCR /begin AXIS_DESCR STD_AXIS NO_INPUT_QUANTITY CM_0025 6 -327.68 327.67 /end AXIS_DESCR /end CHARACTERISTIC
/begin CHARACTERISTIC KF_LAM_SOLL_KH_OSL "Lambda offset - cat heating, warm engine [verified]" MAP 0x756D2 RL_MAP_SW_SW_SW 0 CM_0236 -2 1.999938965 /begin AXIS_DESCR STD_AXIS NO_INPUT_QUANTITY CM_0235 6 -32768 32767 /end AXIS_DESCR /begin AXIS_DESCR STD_AXIS NO_INPUT_QUANTITY CM_0003 6 -3.2768 3.2767 /end AXIS_DESCR /end CHARACTERISTIC
/begin CHARACTERISTIC KF_LAM_SOLL_PULS_OFFS_AUSR "Pulse amplitude - O2 clearing (applied rich) [verified]" MAP 0x75590 RL_MAP_SW_SW_UW 0 CM_0236 0 3.999938965 /begin AXIS_DESCR STD_AXIS NO_INPUT_QUANTITY CM_0235 8 -32768 32767 /end AXIS_DESCR /begin AXIS_DESCR STD_AXIS NO_INPUT_QUANTITY CM_0003 8 -3.2768 3.2767 /end AXIS_DESCR /end CHARACTERISTIC
/begin CHARACTERISTIC KF_LAM_SOLL_ADD_KONV "Lambda pulse amplitude (normal operation) [verified]" MAP 0x754EE RL_MAP_SW_SW_UW 0 CM_0236 0 3.999938965 /begin AXIS_DESCR STD_AXIS NO_INPUT_QUANTITY CM_0235 8 -32768 32767 /end AXIS_DESCR /begin AXIS_DESCR STD_AXIS NO_INPUT_QUANTITY CM_0003 8 -3.2768 3.2767 /end AXIS_DESCR /end CHARACTERISTIC
/begin CHARACTERISTIC K_TI_NMIN_KL50OFF "Injection enable speed threshold when starter (KL50) is off [verified]" VALUE 0x793C8 RL_VAL_SW 0 CM_0235 -32768 32767 /end CHARACTERISTIC
/begin CHARACTERISTIC K_TI_OFF_CFG "Injection cut-off cylinder mask (bitmask) [verified]" VALUE 0x793CA RL_VAL_UW 0 CM_0000 0 65535 /end CHARACTERISTIC
/begin CHARACTERISTIC K_TI_PHI_ENDE_MIN "Minimum end-of-injection angle [degKW, x/10] [verified]" VALUE 0x793C6 RL_VAL_SW 0 CM_0013 -3276.8 3276.7 /end CHARACTERISTIC
/begin CHARACTERISTIC K_TI_MIN_OFF_TIME "Minimum valve off-time [us, x/1000 ms] [verified]" VALUE 0x793C4 RL_VAL_UW 0 CM_0000 0 65535 /end CHARACTERISTIC
/begin CHARACTERISTIC K_TI_RF_MAX_DLY "Delay (segments) before ti_rf_max torque limit request is withdrawn [verified]" VALUE 0x793CC RL_VAL_UW 0 CM_0234 0 65535 /end CHARACTERISTIC
/begin CHARACTERISTIC K_TI_MKS_TE_CFG "Include tank-vent fuel mass in MKS (0/1) [verified]" VALUE 0x793AC RL_VAL_UB 0 CM_0000 0 255 /end CHARACTERISTIC
/begin CHARACTERISTIC K_TI_MKS_LWV_CFG "Include LWV fuel mass in MKS (0/1) [verified]" VALUE 0x793AD RL_VAL_UB 0 CM_0000 0 255 /end CHARACTERISTIC
/begin CHARACTERISTIC K_TI_NS_CFG "Post-start base: 0 ti_mks_start, 1 ti_mks_grund, 2 ti_mks_roh [verified]" VALUE 0x793AE RL_VAL_UB 0 CM_0000 0 255 /end CHARACTERISTIC
/begin CHARACTERISTIC K_TI_MKS_START_CFG "Include START/post-start fuel mass in MKS (0/1) [verified]" VALUE 0x793AF RL_VAL_UB 0 CM_0000 0 255 /end CHARACTERISTIC
/begin CHARACTERISTIC K_LAM_SOLL_MAX "Max. limit of target lambda [verified]" VALUE 0x74CB4 RL_VAL_UW 0 CM_0236 0 3.999938965 /end CHARACTERISTIC
/begin CHARACTERISTIC K_LAM_SOLL_MIN "Min. limit of target lambda [verified]" VALUE 0x74CB6 RL_VAL_UW 0 CM_0236 0 3.999938965 /end CHARACTERISTIC
/begin CHARACTERISTIC K_LAM_SOLL_FILT_F "Filter factor for lam_soll_filt (x/128) [verified]" VALUE 0x74CAA RL_VAL_UW 0 CM_0164 0 255.9960938 /end CHARACTERISTIC
/begin CHARACTERISTIC K_LAM_SOLL_WL_TMOT_HYS "TMOT hysteresis for warm-up state detection [degC x/10] [verified]" VALUE 0x74C96 RL_VAL_SW 0 CM_0013 -3276.8 3276.7 /end CHARACTERISTIC
/begin CHARACTERISTIC K_LAM_SOLL_KATH_T_ML_MAX "Max. time in state SL (former cat heating) [s] [verified]" VALUE 0x74C94 RL_VAL_UW 0 CM_0000 0 65535 /end CHARACTERISTIC
/begin CHARACTERISTIC K_LAM_SOLL_KATH_DELTA_POS "Pos. lambda rate limit in SL [1/s] [verified]" VALUE 0x74C98 RL_VAL_SW 0 CM_0236 -2 1.999938965 /end CHARACTERISTIC
/begin CHARACTERISTIC K_LAM_SOLL_KATH_DELTA_NEG "Neg. lambda rate limit in SL [1/s] [verified]" VALUE 0x74C9A RL_VAL_SW 0 CM_0236 -2 1.999938965 /end CHARACTERISTIC
/begin CHARACTERISTIC K_LAM_SOLL_WL_DELTA_POS "Pos. lambda rate limit in warm-up [1/s] [verified]" VALUE 0x74C9C RL_VAL_SW 0 CM_0236 -2 1.999938965 /end CHARACTERISTIC
/begin CHARACTERISTIC K_LAM_SOLL_WL_DELTA_NEG "Neg. lambda rate limit in warm-up [1/s] [verified]" VALUE 0x74C9E RL_VAL_SW 0 CM_0236 -2 1.999938965 /end CHARACTERISTIC
/begin CHARACTERISTIC K_LAM_SOLL_MS_KAT_MIN "Cat filled with min. O2 mass [verified]" VALUE 0x74CA2 RL_VAL_SW 0 CM_0104 -3276.8 3276.7 /end CHARACTERISTIC
/begin CHARACTERISTIC K_LAM_SOLL_FETT_ERK "Rich detection for MS_KAT adaptation [verified]" VALUE 0x74CA0 RL_VAL_UW 0 CM_0236 0 3.999938965 /end CHARACTERISTIC
/begin CHARACTERISTIC K_LAM_SOLL_O2_ANT "Oxygen fraction of air (x/128) [verified]" VALUE 0x74CAC RL_VAL_UW 0 CM_0164 0 255.9960938 /end CHARACTERISTIC
/begin CHARACTERISTIC K_LAM_SOLL_PULS_O2_HYST "Min. |lambda-1| for O2 mass gradient calculation [verified]" VALUE 0x74CAE RL_VAL_UW 0 CM_0236 0 3.999938965 /end CHARACTERISTIC
/begin CHARACTERISTIC K_LAM_SOLL_PULS_TMOT "Min. TMOT to enable pulse generator [verified]" VALUE 0x74CCA RL_VAL_SW 0 CM_0006 -3550 3003.5 /end CHARACTERISTIC
/begin CHARACTERISTIC K_LAM_SOLL_PULS_AUSR_TMOT_MIN "TMOT threshold for cat O2 clearing after start [verified]" VALUE 0x74CD0 RL_VAL_SW 0 CM_0006 -3550 3003.5 /end CHARACTERISTIC
/begin CHARACTERISTIC K_LAM_SOLL_PULS_AUSR_SL_T "Delay after start end (O2 clearing) [verified]" VALUE 0x74CC2 RL_VAL_UW 0 CM_0025 0 655.35 /end CHARACTERISTIC
/begin CHARACTERISTIC K_LAM_SOLL_PULS_LANK_MAX "O2 clearing - max. threshold for post-cat guidance [verified]" VALUE 0x74CBE RL_VAL_SW 0 CM_0000 -32768 32767 /end CHARACTERISTIC
/begin CHARACTERISTIC K_LAM_SOLL_PULS_LANK_MIN "O2 clearing - min. threshold for post-cat guidance [verified]" VALUE 0x74CC0 RL_VAL_SW 0 CM_0000 -32768 32767 /end CHARACTERISTIC
/begin CHARACTERISTIC K_LAM_SOLL_T_MSA_STOP_MIN "MSA standing-time threshold for special init [s] [verified]" VALUE 0x74CD2 RL_VAL_UW 0 CM_0000 0 65535 /end CHARACTERISTIC
/begin CHARACTERISTIC K_LAM_SOLL_T_SA_SLP_MIN "Min. time in SA/SLP-ON for adaptation [verified]" VALUE 0x74CA6 RL_VAL_UW 0 CM_0025 0 655.35 /end CHARACTERISTIC
/begin CHARACTERISTIC K_LAM_SOLL_T_FETT_MIN "Min. time rich for adaptation [verified]" VALUE 0x74CA8 RL_VAL_UW 0 CM_0025 0 655.35 /end CHARACTERISTIC
/begin CHARACTERISTIC K_LAM_SOLL_ADD_KONV_GRAD "Pulse amplitude rate limit [verified]" VALUE 0x74CB2 RL_VAL_UW 0 CM_0236 0 3.999938965 /end CHARACTERISTIC
/begin CHARACTERISTIC K_LAM_SOLL_KR_KATS "Knock-retard to lambda factor [1/degKW] [verified]" VALUE 0x74CB0 RL_VAL_UW 0 CM_0016 0 63.99902344 /end CHARACTERISTIC
/begin CHARACTERISTIC K_LAM_SOLL_OFFS_MCS "Target lambda offset (MCS) [verified]" VALUE 0x74C92 RL_VAL_SW 0 CM_0236 -2 1.999938965 /end CHARACTERISTIC
/begin CHARACTERISTIC K_LAM_SOLL_PULS_AUSR_CFG "O2 clearing function enable (0 inactive, 1 active) [verified]" VALUE 0x74CB8 RL_VAL_UW 0 CM_0000 0 65535 /end CHARACTERISTIC
/begin CHARACTERISTIC K_LAM_SOLL_PULS_AUSR_SL_CFG "O2 clearing after secondary-air operation enable [verified]" VALUE 0x74CBA RL_VAL_UW 0 CM_0000 0 65535 /end CHARACTERISTIC
/begin CHARACTERISTIC K_LAM_SOLL_PULS_LANK_CFG "O2 clearing guided by post-cat probe signal [verified]" VALUE 0x74CBC RL_VAL_UW 0 CM_0000 0 65535 /end CHARACTERISTIC
/begin CHARACTERISTIC K_LAM_SOLL_FILT_INIT_CFG "Target filter initialisation (0 lam_ist_mw, 1 lam_soll) [verified]" VALUE 0x74CC8 RL_VAL_UB 0 CM_0000 0 255 /end CHARACTERISTIC
/begin CHARACTERISTIC K_PKS_MDL_CFG "0x1 mit Offset 0x2 ohne Offset 0x4 Kennfeld ELSE ungueltig Konfiguration Kraftstof f- druckmodell [verified]" VALUE 0x76CFD RL_VAL_UB 0 CM_0000 0 255 /end CHARACTERISTIC
/begin CHARACTERISTIC K_PKSR_START_RL_PKS_REL_MAX "Schwelle Kraftstoffdruck, relativ fuer Startverzoegerung [verified]" VALUE 0x76DF6 RL_VAL_SW 0 CM_0240 -32.768 32.767 /end CHARACTERISTIC
/begin CHARACTERISTIC KL_PKSR_P_FAKTOR "P-factor vs pressure deviation (map over volume flow in V762) [verified]" MAP 0x76EF0 RL_MAP_SW_SW_UW 0 CM_0251 0 3124.952316 /begin AXIS_DESCR STD_AXIS NO_INPUT_QUANTITY CM_0142 7 -32.768 32.767 /end AXIS_DESCR /begin AXIS_DESCR STD_AXIS NO_INPUT_QUANTITY CM_0252 3 -4096 4095.875 /end AXIS_DESCR /end CHARACTERISTIC
/begin CHARACTERISTIC KL_PKSR_I_FAKTOR "I-factor vs pressure deviation (map over volume flow in V762) [verified]" MAP 0x76F30 RL_MAP_SW_SW_UW 0 CM_0000 0 65535 /begin AXIS_DESCR STD_AXIS NO_INPUT_QUANTITY CM_0142 7 -32.768 32.767 /end AXIS_DESCR /begin AXIS_DESCR STD_AXIS NO_INPUT_QUANTITY CM_0252 3 -4096 4095.875 /end AXIS_DESCR /end CHARACTERISTIC
/begin CHARACTERISTIC KL_PKSR_QSSP_PKS "Volume flow of jet pumps vs pressure [verified]" CURVE 0x76E8E RL_CUR_SW_SW 0 CM_0252 -4096 4095.875 /begin AXIS_DESCR STD_AXIS NO_INPUT_QUANTITY CM_0142 5 -32.768 32.767 /end AXIS_DESCR /end CHARACTERISTIC
/begin CHARACTERISTIC KL_PKSR_QDR "Delivery volume overshoot [verified]" CURVE 0x76EA4 RL_CUR_SW_SW 0 CM_0252 -4096 4095.875 /begin AXIS_DESCR STD_AXIS NO_INPUT_QUANTITY CM_0252 5 -4096 4095.875 /end AXIS_DESCR /end CHARACTERISTIC
/begin CHARACTERISTIC K_PKSR_PSOLL_MECH "bar 0 3 x/1000 Kraftstoffsolldruck des m e-chanischen Druckreglers [verified]" VALUE 0x76DD8 RL_VAL_SW 0 CM_0240 -32.768 32.767 /end CHARACTERISTIC
/begin CHARACTERISTIC K_PKSR_P_SSP_SA "bar 0 3 x/1000 Kraftstoffdruck an SSPs bei SA [verified]" VALUE 0x76DDA RL_VAL_SW 0 CM_0240 -32.768 32.767 /end CHARACTERISTIC
/begin CHARACTERISTIC K_PKSR_I_ANTEIL_MIN "% -50p 1 (X*100)/1024 I-Anteil Min-Wert [verified]" VALUE 0x76DDE RL_VAL_SW 0 CM_0254 -3200 3199.902344 /end CHARACTERISTIC
/begin CHARACTERISTIC K_PKSR_I_ANTEIL_MAX "% -50p 1 (X*100)/1024 I-Anteil Max-Wert [verified]" VALUE 0x76DE0 RL_VAL_SW 0 CM_0254 -3200 3199.902344 /end CHARACTERISTIC
/begin CHARACTERISTIC K_PKSR_TMIN_EKP2 "s 0p 2 X/100 Mindesteinschaltzeit d. EKP2 [verified]" VALUE 0x76DE2 RL_VAL_SW 0 CM_0247 -327.68 327.67 /end CHARACTERISTIC
/begin CHARACTERISTIC K_PKSR_N_EKP2 "Upm 0p 0 x Einschaltschwelle Motordreh-zahl f. EKP2 [verified]" VALUE 0x76DE4 RL_VAL_SW 0 CM_0002 -32768 32767 /end CHARACTERISTIC
/begin CHARACTERISTIC K_PKSR_N_HYS_EKP2 "Upm 0p 0 x Hysterese Motordrehzahl f. Ein-/Ausschalten der EKP2 [verified]" VALUE 0x76DE6 RL_VAL_SW 0 CM_0002 -32768 32767 /end CHARACTERISTIC
/begin CHARACTERISTIC K_PKSR_MLSOLL_EKP2 "kg/h -100p 1 x/10 Einschaltschwelle Fuellung s-vorgabe f. EKP2 [verified]" VALUE 0x76DE8 RL_VAL_SW 0 CM_0255 -3276.8 3276.7 /end CHARACTERISTIC
/begin CHARACTERISTIC K_PKSR_MLSOLL_HYS_EKP2 "kg/h -100p 1 x/10 Hysterese Fuellungsvorgabe f. Ein-/Ausschalten der EKP2 [verified]" VALUE 0x76DEA RL_VAL_SW 0 CM_0255 -3276.8 3276.7 /end CHARACTERISTIC
/begin CHARACTERISTIC K_PKSR_MAX_TV_GEREGELT "% -100p 1 (x*100)/1024 Max. TV fuer geregelten B e-trieb [verified]" VALUE 0x76E18 RL_VAL_SW 0 CM_0254 -3200 3199.902344 /end CHARACTERISTIC
/begin CHARACTERISTIC K_PKSR_START_RL_TMOT_MAX "Schwelle tmot im Zustand START fuer Startverzoeg e- rung [verified]" VALUE 0x76DF4 RL_VAL_SW 0 CM_0256 -3550 3003.5 /end CHARACTERISTIC
/begin CHARACTERISTIC K_LA_TRIM_TABG_NKAT "min. NKAT-Abgastemperatur [verified]" VALUE 0x74202 RL_VAL_SW 0 CM_0258 -3550 3003.5 /end CHARACTERISTIC
/begin CHARACTERISTIC K_LA_TRIM_TAN_MIN "min. TAN-Schwelle [verified]" VALUE 0x74246 RL_VAL_SW 0 CM_0258 -3550 3003.5 /end CHARACTERISTIC
/begin CHARACTERISTIC K_LA_TRIM_TAN_MAX "max. TAN-Schwelle [verified]" VALUE 0x74248 RL_VAL_SW 0 CM_0258 -3550 3003.5 /end CHARACTERISTIC
/begin CHARACTERISTIC K_LA_TRIM_TE_C_AKF_MAX "max. Konzentration aus AKF [verified]" VALUE 0x74204 RL_VAL_UW 0 CM_0259 0 3.999938965 /end CHARACTERISTIC
/begin CHARACTERISTIC K_LA_TRIM_LAM_DELTA_MAX "LA-Regelabweichung - Freigabe Trimmregelung [verified]" VALUE 0x74206 RL_VAL_SW 0 CM_0259 -2 1.999938965 /end CHARACTERISTIC
/begin CHARACTERISTIC K_LA_TRIM_V_SCHWELLE "max. Geschwindigkeitsschwelle [verified]" VALUE 0x7424A RL_VAL_SW 0 CM_0260 -2048 2047.9375 /end CHARACTERISTIC
/begin CHARACTERISTIC K_LA_TRIM_P_MAX "-2p max. P-Anteil der Trimmregelung [verified]" VALUE 0x74208 RL_VAL_SW 0 CM_0259 -2 1.999938965 /end CHARACTERISTIC
/begin CHARACTERISTIC K_LA_TRIM_P_MIN "-2p min. P-Anteil der Trimmregelung [verified]" VALUE 0x7420A RL_VAL_SW 0 CM_0259 -2 1.999938965 /end CHARACTERISTIC
/begin CHARACTERISTIC K_LA_TRIM_I_MAX "-2p max. I-Anteil der Trimmregelung [verified]" VALUE 0x7421E RL_VAL_SW 0 CM_0259 -2 1.999938965 /end CHARACTERISTIC
/begin CHARACTERISTIC K_LA_TRIM_I_MIN "-2p min. I-Anteil der Trimmregelung [verified]" VALUE 0x74220 RL_VAL_SW 0 CM_0259 -2 1.999938965 /end CHARACTERISTIC
/begin CHARACTERISTIC K_LA_TRIM_US_SOLL_GRAD "AEBG. d. SOLL-Spannung [verified]" VALUE 0x7420C RL_VAL_UW 0 CM_0261 0 319995.1172 /end CHARACTERISTIC
/begin CHARACTERISTIC K_LA_TRIM_US_O2_MAX "Hysterese f. Freigabe O2-Beladung (obere Schwelle) [verified]" VALUE 0x74210 RL_VAL_UW 0 CM_0262 0 319995.1172 /end CHARACTERISTIC
/begin CHARACTERISTIC K_LA_TRIM_US_O2_MIN "Hysterese f. Freigabe O2-Beladung (untere Schwelle) [verified]" VALUE 0x74212 RL_VAL_UW 0 CM_0262 0 319995.1172 /end CHARACTERISTIC
/begin CHARACTERISTIC K_LA_TRIM_DLY_T "Verz.-Zeit nach Abbruch Trimmregelung [verified]" VALUE 0x7421A RL_VAL_UW 0 CM_0025 0 655.35 /end CHARACTERISTIC
/begin CHARACTERISTIC K_LA_TRIM_DYN_T "Verz.-Zeit nach begr. Dyn [verified]" VALUE 0x7421C RL_VAL_UW 0 CM_0025 0 655.35 /end CHARACTERISTIC
/begin CHARACTERISTIC K_LA_TRIM_I_ML_ADAPT "Mindestluftmasse fuer erneute Adaption [verified]" VALUE 0x7425C RL_VAL_SL 0 CM_0000 -2147483648 2147483647 /end CHARACTERISTIC
/begin CHARACTERISTIC K_LA_TRIM_AD_ZW_ML_INT_MIN "Luftmasse f?r Zwangsadaption [verified]" VALUE 0x74260 RL_VAL_SL 0 CM_0263 -596523.2356 596523.2353 /end CHARACTERISTIC
/begin CHARACTERISTIC K_LA_TRIM_AD_ZW_ML_INT_FREIG "Init-Luftmasse f?r Zwangsadaption [verified]" VALUE 0x74264 RL_VAL_SL 0 CM_0263 -596523.2356 596523.2353 /end CHARACTERISTIC
/begin CHARACTERISTIC K_LA_TRIM_I_AD_F "Uebernahme I-Anteil in AD-Wert [verified]" VALUE 0x74234 RL_VAL_UW 0 CM_0013 0 6553.5 /end CHARACTERISTIC
/begin CHARACTERISTIC K_LA_TRIM_I_AD_MAX "-2p max. I-Adaptionsanteil [verified]" VALUE 0x7422A RL_VAL_SW 0 CM_0259 -2 1.999938965 /end CHARACTERISTIC
/begin CHARACTERISTIC K_LA_TRIM_I_AD_MIN "-2p min. I-Adaptionsanteil [verified]" VALUE 0x7422C RL_VAL_SW 0 CM_0259 -2 1.999938965 /end CHARACTERISTIC
/begin CHARACTERISTIC K_LA_TRIM_I_AD_MAX_BEGR "-2p max. Begrenzung I-Adaptionsanteil [verified]" VALUE 0x74226 RL_VAL_SW 0 CM_0259 -2 1.999938965 /end CHARACTERISTIC
/begin CHARACTERISTIC K_LA_TRIM_I_AD_MIN_BEGR "-2p min. Begrenzung I-Adaptionsanteil [verified]" VALUE 0x74228 RL_VAL_SW 0 CM_0259 -2 1.999938965 /end CHARACTERISTIC
/begin CHARACTERISTIC K_LA_TRIM_I_AD_HYS "-2p Hysterese fuer I-ADAPT-Diagnose [verified]" VALUE 0x7422E RL_VAL_SW 0 CM_0259 -2 1.999938965 /end CHARACTERISTIC
/begin CHARACTERISTIC K_LA_TRIM_ZW_C_AKF_MAX "Schwelle f?r Zwangsadaption [verified]" VALUE 0x74268 RL_VAL_UW 0 CM_0259 0 3.999938965 /end CHARACTERISTIC
/begin CHARACTERISTIC K_LA_TRIM_ZW_P_MAX "Schwelle f?r Integrator [verified]" VALUE 0x7426A RL_VAL_SW 0 CM_0259 -2 1.999938965 /end CHARACTERISTIC
/begin CHARACTERISTIC K_LA_TRIM_ZW_P_MAX_HYS "Hysterese zur Schwelle f?r Integrator [verified]" VALUE 0x7426C RL_VAL_SW 0 CM_0259 -2 1.999938965 /end CHARACTERISTIC
/begin CHARACTERISTIC K_LA_TRIM_ZW_I_AD_MAX_SCHW "Maxwert Zwangsadaption [verified]" VALUE 0x7426E RL_VAL_SW 0 CM_0259 -2 1.999938965 /end CHARACTERISTIC
/begin CHARACTERISTIC K_LA_TRIM_ZW_I_AD_MIN_SCHW "Minwert Zwangsadaption [verified]" VALUE 0x74270 RL_VAL_SW 0 CM_0259 -2 1.999938965 /end CHARACTERISTIC
/begin CHARACTERISTIC K_LA_TRIM_ZW_I_AD_GRAD_PASSIV "Gradient ?nderungsbegrenzung [verified]" VALUE 0x74272 RL_VAL_UW 0 CM_0264 0 3.999938965 /end CHARACTERISTIC
/begin CHARACTERISTIC KF_VAN_KH_SOLL_A "VANOS cat-heating target map, intake [degKW x/10] [verified]" MAP 0x7A5F0 RL_MAP_SW_SW_SW 0 CM_0013 -3276.8 3276.7 /begin AXIS_DESCR STD_AXIS NO_INPUT_QUANTITY CM_0235 16 -32768 32767 /end AXIS_DESCR /begin AXIS_DESCR STD_AXIS NO_INPUT_QUANTITY CM_0003 12 -3.2768 3.2767 /end AXIS_DESCR /end CHARACTERISTIC
/begin CHARACTERISTIC KF_VAN_KH_SOLL_DMAX_A "VANOS cat-heating rate limit, intake [degKW/10ms] [verified]" MAP 0x7AF16 RL_MAP_SW_SW_SW 0 CM_0000 -32768 32767 /begin AXIS_DESCR STD_AXIS NO_INPUT_QUANTITY CM_0235 6 -32768 32767 /end AXIS_DESCR /begin AXIS_DESCR STD_AXIS NO_INPUT_QUANTITY CM_0003 6 -3.2768 3.2767 /end AXIS_DESCR /end CHARACTERISTIC
/begin CHARACTERISTIC KF_VAN_KH_SOLL_DMAX_E "VANOS cat-heating rate limit, exhaust [degKW/10ms] [verified]" MAP 0x7AF78 RL_MAP_SW_SW_SW 0 CM_0000 -32768 32767 /begin AXIS_DESCR STD_AXIS NO_INPUT_QUANTITY CM_0235 6 -32768 32767 /end AXIS_DESCR /begin AXIS_DESCR STD_AXIS NO_INPUT_QUANTITY CM_0003 6 -3.2768 3.2767 /end AXIS_DESCR /end CHARACTERISTIC
/begin CHARACTERISTIC KF_VAN_SOLL_BEGR_A "VANOS min. limit cold start, intake [degKW x/10] [verified]" MAP 0x7AD56 RL_MAP_SW_SW_SW 0 CM_0013 -3276.8 3276.7 /begin AXIS_DESCR STD_AXIS NO_INPUT_QUANTITY CM_0235 8 -32768 32767 /end AXIS_DESCR /begin AXIS_DESCR STD_AXIS NO_INPUT_QUANTITY CM_0003 6 -3.2768 3.2767 /end AXIS_DESCR /end CHARACTERISTIC
/begin CHARACTERISTIC KF_VAN_SOLL_BEGR_E "VANOS min. limit cold start, exhaust [degKW x/10] [verified]" MAP 0x7ADD4 RL_MAP_SW_SW_SW 0 CM_0013 -3276.8 3276.7 /begin AXIS_DESCR STD_AXIS NO_INPUT_QUANTITY CM_0235 8 -32768 32767 /end AXIS_DESCR /begin AXIS_DESCR STD_AXIS NO_INPUT_QUANTITY CM_0003 6 -3.2768 3.2767 /end AXIS_DESCR /end CHARACTERISTIC
/begin CHARACTERISTIC KL_VAN_T_SOLL_BEGR "Duration of cold-start min. limit vs start temperature [verified]" CURVE 0x7A564 RL_CUR_SW_SW 0 CM_0025 -327.68 327.67 /begin AXIS_DESCR STD_AXIS NO_INPUT_QUANTITY CM_0006 6 -3550 3003.5 /end AXIS_DESCR /end CHARACTERISTIC
/begin CHARACTERISTIC KL_VAN_UNL_N "Lock pin engagement speed vs oil temperature [verified]" CURVE 0x7A5A0 RL_CUR_SW_SW 0 CM_0235 -32768 32767 /begin AXIS_DESCR STD_AXIS NO_INPUT_QUANTITY CM_0006 4 -3550 3003.5 /end AXIS_DESCR /end CHARACTERISTIC
/begin CHARACTERISTIC K_N_BEGR_SLC_CFG "0 Aus 1 Ein 2 Reset SLC-Konfigschalter [verified]" VALUE 0x7603D RL_VAL_UB 0 CM_0000 0 255 /end CHARACTERISTIC
/begin CHARACTERISTIC K_N_BEGR_SLC_NINKR "SLC-nSchwelle [verified]" VALUE 0x7603E RL_VAL_SW 0 CM_0235 -32768 32767 /end CHARACTERISTIC
/begin CHARACTERISTIC K_N_BEGR_SLC_NMAX "Nmax bei SLC [verified]" VALUE 0x76040 RL_VAL_SW 0 CM_0235 -32768 32767 /end CHARACTERISTIC
/begin CHARACTERISTIC K_N_BEGR_SLC_VINKR "SLC-vSchwelle [verified]" VALUE 0x76042 RL_VAL_SW 0 CM_0260 -2048 2047.9375 /end CHARACTERISTIC
/begin CHARACTERISTIC K_N_BEGR_SLC_WDRHLT "SLC-Faktor [verified]" VALUE 0x76044 RL_VAL_UW 0 CM_0245 0 63.99902344 /end CHARACTERISTIC
/begin CHARACTERISTIC K_N_BEGR_SLC_SINKR "SLC-Dekrement [verified]" VALUE 0x76046 RL_VAL_SW 0 CM_0266 -32.768 32.767 /end CHARACTERISTIC
/begin CHARACTERISTIC K_N_BEGR_SLC_CNT "SLC-Ausl?seschwelle [verified]" VALUE 0x76048 RL_VAL_UL 0 CM_0267 0 429496.7295 /end CHARACTERISTIC
/begin CHARACTERISTIC K_N_BEGR_SLC_DELTA_UP "SLC-Abregelrampe Up [verified]" VALUE 0x7604C RL_VAL_UW 0 CM_0268 0 655350 /end CHARACTERISTIC
/begin CHARACTERISTIC K_N_BEGR_SLC_DELTA_DN "SLC-Abregelrampe Down [verified]" VALUE 0x7604E RL_VAL_UW 0 CM_0268 0 655350 /end CHARACTERISTIC
/begin CHARACTERISTIC K_N_BEGR_EGAS_HYS "Hysterese fuer N -Begrenzung ueber Egas [verified]" VALUE 0x76016 RL_VAL_SW 0 CM_0235 -32768 32767 /end CHARACTERISTIC
/begin CHARACTERISTIC K_N_BEGR_TI_HYS "Hysterese fuer N -Begrenzung ueber TI [verified]" VALUE 0x76018 RL_VAL_SW 0 CM_0235 -32768 32767 /end CHARACTERISTIC
/begin CHARACTERISTIC K_N_BEGR_CFG "Konfiguration Begrenzer [verified]" VALUE 0x7602C RL_VAL_UW 0 CM_0000 0 65535 /end CHARACTERISTIC
/begin CHARACTERISTIC KL_LAM_REG_TI_IST_MIN "Min. target injection time vs speed [ms x/1000] [verified]" CURVE 0x74ACC RL_CUR_SW_UW 0 CM_0000 0 65535 /begin AXIS_DESCR STD_AXIS NO_INPUT_QUANTITY CM_0235 6 -32768 32767 /end AXIS_DESCR /end CHARACTERISTIC
/begin CHARACTERISTIC K_KATS_LAM_MIN "Lambda min fuer Katschutz [verified]" VALUE 0x74122 RL_VAL_UW 0 CM_0259 0 3.999938965 /end CHARACTERISTIC
/begin CHARACTERISTIC K_KATS_LAM_GRAD_NEG "Aenderungsbegr. neg [verified]" VALUE 0x74124 RL_VAL_UW 0 CM_0273 0 39.99938965 /end CHARACTERISTIC
/begin CHARACTERISTIC K_KATS_LAM_GRAD_POS "Aenderungsbegr. pos [verified]" VALUE 0x74126 RL_VAL_UW 0 CM_0273 0 39.99938965 /end CHARACTERISTIC
/begin CHARACTERISTIC K_KATS_I_MAX "Max I-Anteil [verified]" VALUE 0x74128 RL_VAL_SW 0 CM_0259 -2 1.999938965 /end CHARACTERISTIC
/begin CHARACTERISTIC K_KATS_I_MIN "Min I-Anteil [verified]" VALUE 0x7412A RL_VAL_SW 0 CM_0259 -2 1.999938965 /end CHARACTERISTIC
/begin CHARACTERISTIC K_KATS_TABG_LW_KORR_MAX "max. zuendwinkelkorr. Abgastemperatur- Ladungswechsel [verified]" VALUE 0x7412C RL_VAL_SW 0 CM_0258 -3550 3003.5 /end CHARACTERISTIC
/begin CHARACTERISTIC K_KATS_T_LAM_MIN "Fehlerzeit in der kats_lam_soll gleich K_KATS_LAM_MIN [verified]" VALUE 0x74134 RL_VAL_UW 0 CM_0023 0 6553.5 /end CHARACTERISTIC
/begin CHARACTERISTIC K_KATS_TKAT_MESS_MAX "Maximale Kattemperatur fuer Diagnose [verified]" VALUE 0x74136 RL_VAL_SW 0 CM_0258 -3550 3003.5 /end CHARACTERISTIC
/begin CHARACTERISTIC K_LSHNK_UB_MAX "max. UB-Spannung [verified]" VALUE 0x75B50 RL_VAL_SW 0 CM_0021 -3276.8 3276.7 /end CHARACTERISTIC
/begin CHARACTERISTIC K_LSHNK_T_MSA_MAX "Max. Sondenheizdauer bei MSA [EST]" VALUE 0x75B4D RL_VAL_UB 0 CM_0027 0 255 /end CHARACTERISTIC
/begin CHARACTERISTIC K_LSHNK_TKAT_MAX "max. KAT-Temperatur [EST]" VALUE 0x75B54 RL_VAL_SW 0 CM_0258 -3550 3003.5 /end CHARACTERISTIC
/begin CHARACTERISTIC K_LSHNK_TAUP "Taupunkttemperatur [EST]" VALUE 0x75B4E RL_VAL_SW 0 CM_0258 -3550 3003.5 /end CHARACTERISTIC
/begin CHARACTERISTIC K_LSHNK_TABG_MSA_MIN "Min.Nachkattemperatur f?r Sondenheizung bei MSA [EST]" VALUE 0x75B56 RL_VAL_SW 0 CM_0258 -3550 3003.5 /end CHARACTERISTIC
/begin CHARACTERISTIC K_LSHNK_RF_HYS "Hysterese f. RF-Schwelle [EST]" VALUE 0x75B52 RL_VAL_SW 0 CM_0003 -3.2768 3.2767 /end CHARACTERISTIC
/begin CHARACTERISTIC K_N_BEGR_TGETR_AEBGR_UP "?nderungsbegrenzung Drehzahlbegr. nach o ben, Tgetr [verified]" VALUE 0x7602E RL_VAL_UW 0 CM_0081 0 655350 /end CHARACTERISTIC
/begin CHARACTERISTIC K_N_BEGR_TGETR_AEBGR_DOWN "?nderungsbegrenzung Drehzahlbegr. nach un ten, Tgetr [verified]" VALUE 0x76030 RL_VAL_UW 0 CM_0081 0 655350 /end CHARACTERISTIC
/begin CHARACTERISTIC K_N_BEGR_HAGETR_AEBGR_UP "?nderungsbegrenzung Drehzahlbegr. nach o ben, HAgetr [verified]" VALUE 0x76032 RL_VAL_UW 0 CM_0081 0 655350 /end CHARACTERISTIC
/begin CHARACTERISTIC K_N_BEGR_HAGETR_AEBGR_DOWN "?nderungsbegrenzung Drehzahlbegr. nach un ten, HAgetr [verified]" VALUE 0x76034 RL_VAL_UW 0 CM_0081 0 655350 /end CHARACTERISTIC
/begin CHARACTERISTIC K_N_BEGR_GANG_DELTA_POS "pos. Be grenzung Abregelrampe [verified]" VALUE 0x76036 RL_VAL_UW 0 CM_0081 0 655350 /end CHARACTERISTIC
/begin CHARACTERISTIC K_VAN_KH_LL_CFG "0x0 aus 0x1 aktiv ELSE undef. Spezielles Katheizen im Leer- lauf [verified]" VALUE 0x7A3B4 RL_VAL_UB 0 CM_0000 0 255 /end CHARACTERISTIC
/begin CHARACTERISTIC K_VAN_KH_LL_T_NS "Max. time_ml f?r LL Katheizen [verified]" VALUE 0x7A3B6 RL_VAL_UW 0 CM_0247 0 655.35 /end CHARACTERISTIC
/begin CHARACTERISTIC K_VAN_KH_LL_V "LL Katheizen v_hinten Obe r-grenze [verified]" VALUE 0x7A3B8 RL_VAL_SW 0 CM_0260 -2048 2047.9375 /end CHARACTERISTIC
/begin CHARACTERISTIC K_VAN_KH_LL_V_HYS "LL Katheizen v_hinten Obe r-grenze Hysterese [verified]" VALUE 0x7A3BA RL_VAL_SW 0 CM_0260 -2048 2047.9375 /end CHARACTERISTIC
/begin CHARACTERISTIC K_VAN_KH_LL_PUMG "LL Katheizen pu mg-Obergrenze [verified]" VALUE 0x7A3BC RL_VAL_SW 0 CM_0291 -2048 2047.9375 /end CHARACTERISTIC
/begin CHARACTERISTIC K_VAN_KH_LL_PUMG_HYS "LL Katheizen pumg -Obergrenze Hysterese [verified]" VALUE 0x7A3BE RL_VAL_SW 0 CM_0291 -2048 2047.9375 /end CHARACTERISTIC
/begin CHARACTERISTIC K_VAN_KH_LL_TMOT_MAX "LL Katheizen tm ot_start Obe r-grenze [verified]" VALUE 0x7A3C0 RL_VAL_SW 0 CM_0256 -3550 3003.5 /end CHARACTERISTIC
/begin CHARACTERISTIC K_VAN_KH_LL_TMOT_MIN "LL Katheizen tmot_start Unte r-grenze [verified]" VALUE 0x7A3C2 RL_VAL_SW 0 CM_0256 -3550 3003.5 /end CHARACTERISTIC
/begin CHARACTERISTIC K_VAN_KH_LL_TUMG_MAX "LL Katheizen tumg_start Obe r-grenze [EST]" VALUE 0x7A3C4 RL_VAL_SW 0 CM_0256 -3550 3003.5 /end CHARACTERISTIC
/begin CHARACTERISTIC K_VAN_KH_LL_TUMG_MIN "LL Katheizen tumg_start U n-tergrenze [EST]" VALUE 0x7A3C6 RL_VAL_SW 0 CM_0256 -3550 3003.5 /end CHARACTERISTIC
/begin CHARACTERISTIC K_VAN_KW_SPR_MAX_E1 "KW-Zahn bei max Spreizung [verified]" VALUE 0x7A3C8 RL_VAL_SB 0 CM_0292 -128 127 /end CHARACTERISTIC
/begin CHARACTERISTIC K_VAN_KW_SPR_MAX_A1 "KW-Zahn bei max Spreizung [verified]" VALUE 0x7A3C9 RL_VAL_SB 0 CM_0292 -128 127 /end CHARACTERISTIC
/begin CHARACTERISTIC K_VAN_KW_SPR_MAX_A2 "KW-Zahn bei max Spreizung [verified]" VALUE 0x7A3CB RL_VAL_SB 0 CM_0292 -128 127 /end CHARACTERISTIC
/begin CHARACTERISTIC K_VAN_KP_XD_KORR_E "Korrektur van_i_p bei xd<0 [verified]" VALUE 0x7A3CC RL_VAL_UB 0 CM_0269 0 1.9921875 /end CHARACTERISTIC
/begin CHARACTERISTIC K_VAN_KP_XD_KORR_A "Korrektur van_i_p bei xd<0 [verified]" VALUE 0x7A3CD RL_VAL_UB 0 CM_0269 0 1.9921875 /end CHARACTERISTIC
/begin CHARACTERISTIC K_VAN_N_OFF "VanosRegler Abschaltdrehzahl [verified]" VALUE 0x7A3CE RL_VAL_SW 0 CM_0002 -32768 32767 /end CHARACTERISTIC
/begin CHARACTERISTIC K_VAN_N_ON "VanosRegler Einschaltdrehzahl [verified]" VALUE 0x7A3D0 RL_VAL_SW 0 CM_0002 -32768 32767 /end CHARACTERISTIC
/begin CHARACTERISTIC K_VAN_RAD_MIN "min. Anzahl NW-Zaehne [verified]" VALUE 0x7A3D2 RL_VAL_UB 0 CM_0293 0 255 /end CHARACTERISTIC
/begin CHARACTERISTIC K_VAN_RAD_MAX "max. Anzahl NW-Zaehne [verified]" VALUE 0x7A3D3 RL_VAL_UB 0 CM_0293 0 255 /end CHARACTERISTIC
/begin CHARACTERISTIC K_VAN_FREQU_STAND "PWM-Frequenz Ventile Motor steht [verified]" VALUE 0x7A3A2 RL_VAL_UW 0 CM_0294 15.2590219 1000000 /end CHARACTERISTIC
/begin CHARACTERISTIC K_VAN_FREQU_ANSCHL "PWM-Frequenz Ventile am Anschlag [verified]" VALUE 0x7A3A4 RL_VAL_UW 0 CM_0294 15.2590219 1000000 /end CHARACTERISTIC
/begin CHARACTERISTIC K_VAN_FREQU_SPUEL_MIN "Min. PWM -Frequenz Ventile sp?len [verified]" VALUE 0x7A3A6 RL_VAL_UW 0 CM_0294 15.2590219 1000000 /end CHARACTERISTIC
/begin CHARACTERISTIC K_VAN_ANSCHL_TIME_ML "Motorlaufzeit fuer Anschl_anf in SA [verified]" VALUE 0x7A378 RL_VAL_UW 0 CM_0247 0 655.35 /end CHARACTERISTIC
/begin CHARACTERISTIC K_VAN_CFG_E1 "0x0 Flueg 0x1 Hochdr 0x2 MCS ELSE undef. Konfig Vanos Steller/Geberrad [verified]" VALUE 0x7A37B RL_VAL_UB 0 CM_0000 0 255 /end CHARACTERISTIC
/begin CHARACTERISTIC K_VAN_CFG_A1 "0x0 Flueg 0x1 Hochdr 0x2 MCS ELSE undef. Konfig Vanos Steller/Geberrad [verified]" VALUE 0x7A37C RL_VAL_UB 0 CM_0000 0 255 /end CHARACTERISTIC
/begin CHARACTERISTIC K_VAN_CFG_A2 "0x0 Flueg 0x1 Hochdr 0x2 MCS ELSE undef. Konfig Vanos Steller/Geberrad [verified]" VALUE 0x7A37E RL_VAL_UB 0 CM_0000 0 255 /end CHARACTERISTIC
/begin CHARACTERISTIC K_VAN_ANSCHL_I_E1 "Ventilstrom am Anschlag max. Spr. [verified]" VALUE 0x7A36A RL_VAL_SW 0 CM_0228 -32768 32767 /end CHARACTERISTIC
/begin CHARACTERISTIC K_VAN_ANSCHL_I_A1 "Ventilstrom am Anschlag max. Spr. [verified]" VALUE 0x7A36C RL_VAL_SW 0 CM_0228 -32768 32767 /end CHARACTERISTIC
/begin CHARACTERISTIC K_VAN_ANSCHL_I_A2 "Ventilstrom am Anschlag max. Spr. [verified]" VALUE 0x7A370 RL_VAL_SW 0 CM_0228 -32768 32767 /end CHARACTERISTIC
/begin CHARACTERISTIC K_VAN_ANSCHL_I_RAMPE "Strom-Rampe zum A nschlag anfahren [verified]" VALUE 0x7A372 RL_VAL_SW 0 CM_0295 -32768 32767 /end CHARACTERISTIC
/begin CHARACTERISTIC K_VAN_ANSCHL_I_START_MAX "Max. Strom Beginn A nschlag anfahren [verified]" VALUE 0x7A374 RL_VAL_SW 0 CM_0228 -32768 32767 /end CHARACTERISTIC
/begin CHARACTERISTIC K_VAN_ANSCHL_T "Dauer Anschlag lernen [verified]" VALUE 0x7A376 RL_VAL_UB 0 CM_0247 0 2.55 /end CHARACTERISTIC
/begin CHARACTERISTIC K_PKS_OFFSET "Offset Kraftstoffdrucksensor [verified]" VALUE 0x76D22 RL_VAL_SW 0 CM_0240 -32.768 32.767 /end CHARACTERISTIC
/begin CHARACTERISTIC K_PKS_TAU "Filterkonstante f. Kraftstof f-druck [verified]" VALUE 0x76D24 RL_VAL_UB 0 CM_0065 0.005019607843 1.28 /end CHARACTERISTIC
/begin CHARACTERISTIC K_PKS_TAU_EKP100 "Filterkonstante f. Kraftstof f-druck bei 100% [verified]" VALUE 0x76D25 RL_VAL_UB 0 CM_0065 0.005019607843 1.28 /end CHARACTERISTIC
/begin CHARACTERISTIC K_PKS_ERSATZ "Ersatzwert Kraftstoffdruck [verified]" VALUE 0x76D2E RL_VAL_SW 0 CM_0240 -32.768 32.767 /end CHARACTERISTIC
/begin CHARACTERISTIC K_PKSR_CFG "pksr_cfg.equ Konfiguration Kraftstoffdruc k-regelung [verified]" VALUE 0x76DEC RL_VAL_UB 0 CM_0316 0 255 /end CHARACTERISTIC
/begin CHARACTERISTIC K_PKSR_EKP_100_PSOLL_RAMPE "Delta fuer Rampe nach EKP_100Prozent auf Sollwert [verified]" VALUE 0x76DED RL_VAL_UB 0 CM_0317 0 25.5 /end CHARACTERISTIC
/begin CHARACTERISTIC K_PKSR_T_VORLAUF "Vorlaufzeit der EKP bei KL15 EIN [verified]" VALUE 0x76DEE RL_VAL_UW 0 CM_0247 0 655.35 /end CHARACTERISTIC
/begin CHARACTERISTIC K_PKSR_T_ABST "Nachlauf nach KLA [verified]" VALUE 0x76DF0 RL_VAL_UW 0 CM_0247 0 655.35 /end CHARACTERISTIC
/begin CHARACTERISTIC K_PKSR_START_RL_T_DELAY "Verzoegerungszeit Startrelais [verified]" VALUE 0x76DF2 RL_VAL_UW 0 CM_0247 0 655.35 /end CHARACTERISTIC
/begin CHARACTERISTIC K_PKSR_ADAP_RESET "& 0x1 0x0 kein Reset 0x1 Reset aktiv Reset der Adaption [verified]" VALUE 0x76E0E RL_VAL_UB 0 CM_0000 0 255 /end CHARACTERISTIC
/begin CHARACTERISTIC K_PKSR_ADAP_OFF_MAX "Max Adaptionsoffset [verified]" VALUE 0x76E10 RL_VAL_SW 0 CM_0271 -100 99.99694824 /end CHARACTERISTIC
/begin CHARACTERISTIC K_PKSR_ADAP_OFF_MIN "Min Adaptionsoffset [verified]" VALUE 0x76E12 RL_VAL_SW 0 CM_0271 -100 99.99694824 /end CHARACTERISTIC
/begin CHARACTERISTIC K_PKSR_ADAP_FAK_MIN "Min Adaptionsfaktor [verified]" VALUE 0x76E14 RL_VAL_UW 0 CM_0282 0 6.5535 /end CHARACTERISTIC
/begin CHARACTERISTIC K_PKSR_ADAP_FAK_MAX "Max Adaptionsfaktor [verified]" VALUE 0x76E16 RL_VAL_UW 0 CM_0282 0 6.5535 /end CHARACTERISTIC
/begin CHARACTERISTIC K_LAVK_AD_GAIN_ML_SUM_SA_MIN "min. aufsummierte Luftmas-senstr. in SA [verified]" VALUE 0x74914 RL_VAL_UW 0 CM_0168 0 65535 /end CHARACTERISTIC
/begin CHARACTERISTIC K_PSAU_STEIGUNG "Steigung des Drucksensors [verified]" VALUE 0x77BB8 RL_VAL_UW 0 CM_0333 0 819.1875 /end CHARACTERISTIC
/begin CHARACTERISTIC K_PSAU_OFFSET "Offset des Drucksensors [verified]" VALUE 0x77BBA RL_VAL_SW 0 CM_0291 -2048 2047.9375 /end CHARACTERISTIC
/begin CHARACTERISTIC K_PSAU_ADAPT_MAX "Maximaler Adaptionswert fuer PSAUx [verified]" VALUE 0x77BC0 RL_VAL_SW 0 CM_0291 -2048 2047.9375 /end CHARACTERISTIC
/begin CHARACTERISTIC K_PSAU_ADAPT_MIN "Minimaler Adaptionswert fuer PSAUx [verified]" VALUE 0x77BC2 RL_VAL_SW 0 CM_0291 -2048 2047.9375 /end CHARACTERISTIC
/begin CHARACTERISTIC K_PSAU_TAU "Filterkonstante PSAU nur im Zeitraster, nicht im Segment [verified]" VALUE 0x77BC4 RL_VAL_UB 0 CM_0065 0.005019607843 1.28 /end CHARACTERISTIC
/begin CHARACTERISTIC K_PSAU_SENSOR_CFG "0x0 absolut 0x1 differenz ELSE ungueltig Psau Ersatzwertaktivierung [verified]" VALUE 0x77BC5 RL_VAL_UB 0 CM_0000 0 255 /end CHARACTERISTIC
/begin CHARACTERISTIC K_PSAU_CFG "0x0 Modell 0x1 Messwert ELSE ungueltig Psau Konfigbyte [verified]" VALUE 0x77BC6 RL_VAL_UB 0 CM_0000 0 255 /end CHARACTERISTIC
/begin CHARACTERISTIC K_PSAU_WF_DLY "Verzoegerungszeit fuer psau_wf [verified]" VALUE 0x77BC7 RL_VAL_UB 0 CM_0052 0 2550 /end CHARACTERISTIC
/begin CHARACTERISTIC K_PSAU_RF_MAX "MAX psau_rf [verified]" VALUE 0x77BC8 RL_VAL_SW 0 CM_0282 -3.2768 3.2767 /end CHARACTERISTIC
/begin CHARACTERISTIC K_PSAU_RF_MIN "MAX psau_rf [verified]" VALUE 0x77BCA RL_VAL_SW 0 CM_0282 -3.2768 3.2767 /end CHARACTERISTIC
/begin CHARACTERISTIC K_PSAU_SR_REF "psau_sr Referenzdruck [verified]" VALUE 0x77BCC RL_VAL_SW 0 CM_0291 -2048 2047.9375 /end CHARACTERISTIC
/begin CHARACTERISTIC K_PSAU_SR_CFG "0x0 Referenzdruck 0x1 Umgebungs- druck ELSE undef psau_sr Referenzdruck [verified]" VALUE 0x77BCE RL_VAL_UB 0 CM_0000 0 255 /end CHARACTERISTIC
/begin CHARACTERISTIC K_LANK_N_MAX "obere n-Schwelle als Ausschaltbedingung [verified]" VALUE 0x7574A RL_VAL_SW 0 CM_0002 -32768 32767 /end CHARACTERISTIC
/begin CHARACTERISTIC K_LANK_N_MIN "untere n -Schwelle als Ausschaltbedi n-gung [verified]" VALUE 0x7574C RL_VAL_SW 0 CM_0002 -32768 32767 /end CHARACTERISTIC
/begin CHARACTERISTIC K_LANK_RF_MAX "obere rf -Schwelle als Ausschaltbedin-gung [verified]" VALUE 0x7574E RL_VAL_SW 0 CM_0282 -3.2768 3.2767 /end CHARACTERISTIC
/begin CHARACTERISTIC K_LANK_RF_MIN "untere rf -Schwelle als Ausschaltbedi n-gung [verified]" VALUE 0x75750 RL_VAL_SW 0 CM_0282 -3.2768 3.2767 /end CHARACTERISTIC
/begin CHARACTERISTIC K_LANK_TKAT_SCHW "Kattemperaturschwelle als Einschaltb e-dingung [verified]" VALUE 0x75752 RL_VAL_SW 0 CM_0256 -3550 3003.5 /end CHARACTERISTIC
/begin CHARACTERISTIC K_LA_TRIM_CFG "0x0 inaktiv 0x1 aktiv 0x2 RESET Freigabe Trimmregelung [verified]" VALUE 0x741FC RL_VAL_UW 0 CM_0000 0 65535 /end CHARACTERISTIC
/begin CHARACTERISTIC K_LA_TRIM_P_ANZ_MAX "max. Anzahl der P-Anteil Triggerungen [verified]" VALUE 0x741FA RL_VAL_UW 0 CM_0000 0 65535 /end CHARACTERISTIC
/begin CHARACTERISTIC K_LA_TRIM_US_EINGER "Hys.-Spannung f. I-Regler-STOP [verified]" VALUE 0x74238 RL_VAL_UW 0 CM_0262 0 319995.1172 /end CHARACTERISTIC
/begin CHARACTERISTIC K_LAVK_US_LUFT_REF "Referenzspannung LUFT [verified]" VALUE 0x74920 RL_VAL_UW 0 CM_0262 0 319995.1172 /end CHARACTERISTIC
/begin CHARACTERISTIC K_RS_HSG_CFG "0 aus 1 ein Konfiguration [verified]" VALUE 0x782DC RL_VAL_UB 0 CM_0000 0 255 /end CHARACTERISTIC
/begin CHARACTERISTIC K_RS_HSG_N_MIN "nMot-Schwelle Vorb [verified]" VALUE 0x782DE RL_VAL_SW 0 CM_0002 -32768 32767 /end CHARACTERISTIC
/begin CHARACTERISTIC K_RS_HSG_N_GETR_MIN "nGetr-Schwelle Aktiv [verified]" VALUE 0x782E0 RL_VAL_SW 0 CM_0002 -32768 32767 /end CHARACTERISTIC
/begin CHARACTERISTIC K_RS_HSG_V_MAX "v-Schwelle Vorb [verified]" VALUE 0x782E2 RL_VAL_SW 0 CM_0260 -2048 2047.9375 /end CHARACTERISTIC
/begin CHARACTERISTIC K_RS_HSG_V_VORNE_AUS "v-Schwelle Inaktiv [verified]" VALUE 0x782E4 RL_VAL_SW 0 CM_0260 -2048 2047.9375 /end CHARACTERISTIC
/begin CHARACTERISTIC K_RS_HSG_MD_REL_MIN "Md-Schwelle Vorb [verified]" VALUE 0x782E6 RL_VAL_SW 0 CM_0276 -3276.8 3276.7 /end CHARACTERISTIC
/begin CHARACTERISTIC K_RS_HSG_MD_REL_AUS "Md-Schwelle Inaktiv [verified]" VALUE 0x782E8 RL_VAL_SW 0 CM_0276 -3276.8 3276.7 /end CHARACTERISTIC
/begin CHARACTERISTIC K_RS_HSG_VORB_T_AN "An-Schwelle Vorb [verified]" VALUE 0x782EA RL_VAL_UB 0 CM_0247 0 2.55 /end CHARACTERISTIC
/begin CHARACTERISTIC K_RS_HSG_VORB_T_AUS "Aus-Schwelle Vorb [verified]" VALUE 0x782EB RL_VAL_UB 0 CM_0247 0 2.55 /end CHARACTERISTIC
/begin CHARACTERISTIC K_RS_HSG_T_AUS "Aus-Schwelle Vorb [verified]" VALUE 0x782EC RL_VAL_UB 0 CM_0247 0 2.55 /end CHARACTERISTIC
/begin CHARACTERISTIC K_RS_TIME_MAX "Aus-Schwelle Vorb [verified]" VALUE 0x782EE RL_VAL_UW 0 CM_0247 0 655.35 /end CHARACTERISTIC
/begin CHARACTERISTIC KL_SA_N_GANG "gangabhaengiger Offset fuer WE -drehzalberechnung [verified]" CURVE 0x78302 RL_CUR_SW_SW 0 CM_0002 -32768 32767 /begin AXIS_DESCR STD_AXIS NO_INPUT_QUANTITY CM_0000 10 -32768 32767 /end AXIS_DESCR /end CHARACTERISTIC
/begin CHARACTERISTIC KL_SA_N_HYS_GANG_DKG "gangabh. Hyst. SA-Drehzahl [verified]" CURVE 0x783B6 RL_CUR_SW_SW 0 CM_0002 -32768 32767 /begin AXIS_DESCR STD_AXIS NO_INPUT_QUANTITY CM_0000 10 -32768 32767 /end AXIS_DESCR /end CHARACTERISTIC
/begin CHARACTERISTIC KL_SA_N_KKOS_GANG "KKOS-Offset SA-Drehzahl [verified]" CURVE 0x783E0 RL_CUR_SW_SW 0 CM_0002 -32768 32767 /begin AXIS_DESCR STD_AXIS NO_INPUT_QUANTITY CM_0000 7 -32768 32767 /end AXIS_DESCR /end CHARACTERISTIC
/begin CHARACTERISTIC KL_SA_N_KKOS_GANG_DKG "KKOS-Offset SA-Drehzahl-DKG [verified]" CURVE 0x783FE RL_CUR_SW_SW 0 CM_0002 -32768 32767 /begin AXIS_DESCR STD_AXIS NO_INPUT_QUANTITY CM_0000 7 -32768 32767 /end AXIS_DESCR /end CHARACTERISTIC
/begin CHARACTERISTIC KL_N_BEGR_TI_OFFSET "N-Offset auf Momenteneingriff [verified]" CURVE 0x76176 RL_CUR_SW_SW 0 CM_0002 -32768 32767 /begin AXIS_DESCR STD_AXIS NO_INPUT_QUANTITY CM_0002 4 -32768 32767 /end AXIS_DESCR /end CHARACTERISTIC
/begin CHARACTERISTIC KL_OZTEMPKL "F?r die ?ltemperatur-Berechnung QLT [EST]" CURVE 0x7685C RL_CUR_UW_SW 0 CM_0243 -3276.8 3276.7 /begin AXIS_DESCR STD_AXIS NO_INPUT_QUANTITY CM_0000 6 0 65535 /end AXIS_DESCR /end CHARACTERISTIC
/begin CHARACTERISTIC K_BNSMAX "Bordnetz Instabil Schwelle [A2L-ref]" VALUE 0x77036 RL_VAL_UB 0 CM_0000 0 255 /end CHARACTERISTIC
/begin CHARACTERISTIC K_KGE_LL_T_DELAY "Delayzeit fuer Diagnose-Start im LL [A2L-ref]" VALUE 0x7414C RL_VAL_UW 0 CM_0025 0 655.35 /end CHARACTERISTIC
/begin CHARACTERISTIC K_KGE_SEG_IDX_INTG_2of2_ "Segmentindex fuer das Abweichungsintegral [EST]" VALUE 0x7415E RL_VAL_UB 0 CM_0000 0 255 /end CHARACTERISTIC
/begin CHARACTERISTIC K_LAA_F_GRAD "LAA-F-Gradient [verified]" VALUE 0x7497C RL_VAL_UW 0 CM_0237 0 1.999969482 /end CHARACTERISTIC
/begin CHARACTERISTIC K_LAA_F_MAX "max. Adaptionsfaktor [verified]" VALUE 0x74968 RL_VAL_UW 0 CM_0237 0 1.999969482 /end CHARACTERISTIC
/begin CHARACTERISTIC K_LAA_F_MCS_B1 "MCS-INIT Adaptionsfaktor [A2L-ref]" VALUE 0x74964 RL_VAL_UW 0 CM_0237 0 1.999969482 /end CHARACTERISTIC
/begin CHARACTERISTIC K_LAA_F_MCS_B2 "MCS-INIT Adaptionsfaktor [A2L-ref]" VALUE 0x74966 RL_VAL_UW 0 CM_0237 0 1.999969482 /end CHARACTERISTIC
/begin CHARACTERISTIC K_LAA_F_MIN "min. Adaptionsfaktor [verified]" VALUE 0x7496A RL_VAL_UW 0 CM_0237 0 1.999969482 /end CHARACTERISTIC
/begin CHARACTERISTIC K_LAA_F_TE_GRAD "LAA-F-Gradient [verified]" VALUE 0x7497E RL_VAL_UW 0 CM_0237 0 1.999969482 /end CHARACTERISTIC
/begin CHARACTERISTIC K_LAA_F_TE_MAX "max. Offset auf LAA-Faktor ueber TE [verified]" VALUE 0x7496C RL_VAL_SW 0 CM_0237 -0.9999999998 0.9999694823 /end CHARACTERISTIC
/begin CHARACTERISTIC K_LAA_F_TE_MIN "min. Offset auf LAA-Faktor ueber TE [verified]" VALUE 0x7496E RL_VAL_SW 0 CM_0237 -0.9999999998 0.9999694823 /end CHARACTERISTIC
/begin CHARACTERISTIC K_LAA_F_TE_RAMPE "Abregelwert fuer laa_f_te [verified]" VALUE 0x74982 RL_VAL_UW 0 CM_0237 0 1.999969482 /end CHARACTERISTIC
/begin CHARACTERISTIC K_LAA_F_TE_T_ADAPT "Adaptionszeitraum f. F-TE-Adaption [verified]" VALUE 0x74960 RL_VAL_UW 0 CM_0169 0 65535 /end CHARACTERISTIC
/begin CHARACTERISTIC K_LAA_LAM_REG_F_DELTA "Regelabweichung f. stationaere LAA [verified]" VALUE 0x74980 RL_VAL_UW 0 CM_0237 0 1.999969482 /end CHARACTERISTIC
/begin CHARACTERISTIC K_LAA_OFFS_GRAD "LAA-OFFEST-Gradient [verified]" VALUE 0x7497A RL_VAL_SW 0 CM_0170 -512 511.984375 /end CHARACTERISTIC
/begin CHARACTERISTIC K_LAA_OFFS_MAX "max. Offset-Adaption [verified]" VALUE 0x74974 RL_VAL_SW 0 CM_0170 -512 511.984375 /end CHARACTERISTIC
/begin CHARACTERISTIC K_LAA_OFFS_MCS_B1 "MCS-INIT Offset-Adaption [A2L-ref]" VALUE 0x74970 RL_VAL_SW 0 CM_0170 -512 511.984375 /end CHARACTERISTIC
/begin CHARACTERISTIC K_LAA_OFFS_MCS_B2 "MCS-INIT Offset-Adaption [A2L-ref]" VALUE 0x74972 RL_VAL_SW 0 CM_0170 -512 511.984375 /end CHARACTERISTIC
/begin CHARACTERISTIC K_LAA_OFFS_MIN "min. Offset-Adaption Stetiger Lambdaregler und Lambdaadaption Seite 125 von 198 [verified]" VALUE 0x74976 RL_VAL_SW 0 CM_0170 -512 511.984375 /end CHARACTERISTIC
/begin CHARACTERISTIC K_LAA_OFFS_T_ADAPT "Adaptionszeitraum f. OFFS-Adaption [verified]" VALUE 0x74962 RL_VAL_UW 0 CM_0169 0 65535 /end CHARACTERISTIC
/begin CHARACTERISTIC K_LAA_TI_IST_MIN "min. SOLL-TI [verified]" VALUE 0x74978 RL_VAL_UW 0 CM_0141 0 65.535 /end CHARACTERISTIC
/begin CHARACTERISTIC K_LAM_REG_CFG "0 keine RESET- Anforderung 1 LA-RESET- Anforderung Freigabe Lambdaregler [verified]" VALUE 0x7491E RL_VAL_UW 0 CM_0000 0 65535 /end CHARACTERISTIC
/begin CHARACTERISTIC K_LAM_REG_RESET_CFG "0 keine RESET- Anforderung 1 LA-RESET- Anforderung RESET Lambdaregler [verified]" VALUE 0x74924 RL_VAL_UW 0 CM_0348 0 65535 /end CHARACTERISTIC
/begin CHARACTERISTIC K_LAM_REG_T_SA_VERZ "Wartezeit LA-Regler nach SA [verified]" VALUE 0x7498C RL_VAL_UW 0 CM_0064 0 65.535 /end CHARACTERISTIC
/begin CHARACTERISTIC K_LAVK_AD_GAIN_CNT "Zaehler fuer GAIN-Sondenadapt. [verified]" VALUE 0x748FE RL_VAL_UW 0 CM_0348 0 65535 /end CHARACTERISTIC
/begin CHARACTERISTIC K_LAVK_AD_GAIN_T "MIN-Zeit zwischen zwei GAIN-Adapt. [verified]" VALUE 0x74902 RL_VAL_UW 0 CM_0025 0 655.35 /end CHARACTERISTIC
/begin CHARACTERISTIC K_LAVK_AD_OFFS_MAX "MAX-Schwelle f. Offset-Sondenadaption [verified]" VALUE 0x74908 RL_VAL_UW 0 CM_0163 0 319995.1172 /end CHARACTERISTIC
/begin CHARACTERISTIC K_LAVK_AD_OFFS_MIN "MIN-Schwelle f. Offset-Sondenadaption [verified]" VALUE 0x7490A RL_VAL_UW 0 CM_0163 0 319995.1172 /end CHARACTERISTIC
/begin CHARACTERISTIC K_LAVK_AD_OFFS_NV_MAX "max. Grenze fuer OFFEST-Sonden-Adapt. [verified]" VALUE 0x74916 RL_VAL_SW 0 CM_0163 -160000 159995.1172 /end CHARACTERISTIC
/begin CHARACTERISTIC K_LAVK_AD_OFFS_NV_MIN "min. Grenze fuer OFFEST-Sonden-Adapt. [verified]" VALUE 0x74918 RL_VAL_SW 0 CM_0163 -160000 159995.1172 /end CHARACTERISTIC
/begin CHARACTERISTIC K_LAVK_AD_OFFS_T "MIN-Zeit zwischen zwei OFF-SET-Adapt. [verified]" VALUE 0x74900 RL_VAL_UW 0 CM_0025 0 655.35 /end CHARACTERISTIC
/begin CHARACTERISTIC K_LAVK_AD_OFFS_T1 "Filterkoeffizient - OFFSET-Sondenadapt. [verified]" VALUE 0x74904 RL_VAL_UW 0 CM_0401 0 655350 /end CHARACTERISTIC
/begin CHARACTERISTIC K_LAVK_AD_RESET "0 ADAPTION 1 RESET RESET d. Sondenadaption [verified]" VALUE 0x74922 RL_VAL_UW 0 CM_0348 0 65535 /end CHARACTERISTIC
/begin CHARACTERISTIC K_LA_TRIM_DYN_DELTA_RF "RF-Delta fur Freigabe Trimmregelung [verified]" VALUE 0x74214 RL_VAL_SW 0 CM_0003 -3.2768 3.2767 /end CHARACTERISTIC
/begin CHARACTERISTIC K_LA_TRIM_DYN_RF_T "Sperrzeit f?r Trimmregelung nach rf-Dynamik [verified]" VALUE 0x74216 RL_VAL_UW 0 CM_0025 0 655.35 /end CHARACTERISTIC
/begin CHARACTERISTIC K_LA_TRIM_I_AD_MCS "-2p I-Adaptionsanteil - MCS- Popel-Groesse fuer CFG- RESET [verified]" VALUE 0x74256 RL_VAL_SW 0 CM_0236 -2 1.999938965 /end CHARACTERISTIC
/begin CHARACTERISTIC K_LA_TRIM_P_US_OFFSET "OFFSET fuer Verhinderung P-Anteil Toggeln [verified]" VALUE 0x7423C RL_VAL_UW 0 CM_0163 0 319995.1172 /end CHARACTERISTIC
/begin CHARACTERISTIC K_LBATTMAXM "maximale Batterieladespannung [EST]" VALUE 0x7596C RL_VAL_SW 0 CM_0403 -128 127.9960938 /end CHARACTERISTIC
/begin CHARACTERISTIC K_MDGNHYS "Hysterese f???r Drehzahlschwelle Generator-Maximalmomentbegrenzung [A2L-ref]" VALUE 0x75B26 RL_VAL_SW 0 CM_0002 -32768 32767 /end CHARACTERISTIC
/begin CHARACTERISTIC K_MDGNMAX "Maximaldrehzahl f???r Generator-Maximalmomentbegrenzung [A2L-ref]" VALUE 0x75B28 RL_VAL_SW 0 CM_0002 -32768 32767 /end CHARACTERISTIC
/begin CHARACTERISTIC K_MDRV_P400_ONLY "P400-Sperre [A2L-ref]" VALUE 0x75EC0 RL_VAL_UW 0 CM_0000 0 65535 /end CHARACTERISTIC
/begin CHARACTERISTIC K_MDRV_P500_START "P500-Hochlauf [A2L-ref]" VALUE 0x75EC2 RL_VAL_UW 0 CM_0000 0 65535 /end CHARACTERISTIC
/begin CHARACTERISTIC K_MDRV_TBLINK "Blinkzeit [A2L-ref]" VALUE 0x75EC4 RL_VAL_UW 0 CM_0025 0 655.35 /end CHARACTERISTIC
/begin CHARACTERISTIC K_MGMAXAPP "Applikationswert Genratormaximalmoment [A2L-ref]" VALUE 0x75B2A RL_VAL_SW 0 CM_0017 -3276.8 3276.7 /end CHARACTERISTIC
/begin CHARACTERISTIC K_MSA_Kl15OFF_T_LOW "max. Lowzeit MSA-Pin bei Kl15 aus [EST]" VALUE 0x75ECA RL_VAL_UB 0 CM_0025 0 2.55 /end CHARACTERISTIC
/begin CHARACTERISTIC K_MZYL_CFG "0x2 PSAU 0x4 AQ ELSE undefiniert Schalter Fuellungsberechnung [verified]" VALUE 0x75FFE RL_VAL_UB 0 CM_0000 0 255 /end CHARACTERISTIC
/begin CHARACTERISTIC K_MZYL_START_CFG "0x2 PSAU 0x4 AQ ELSE undefiniert Schalter Fuellungsber. im Start [verified]" VALUE 0x75FFF RL_VAL_UB 0 CM_0000 0 255 /end CHARACTERISTIC
/begin CHARACTERISTIC K_N_BEGR_FZG_STEHT "N-Max-Begrenzung fuer Fertigung [verified]" VALUE 0x7602A RL_VAL_SW 0 CM_0002 -32768 32767 /end CHARACTERISTIC
/begin CHARACTERISTIC K_N_BEGR_TI_OFF_RSS "N-Offset bei Rennstartschaltung [A2L-ref]" VALUE 0x76014 RL_VAL_SW 0 CM_0002 -32768 32767 /end CHARACTERISTIC
/begin CHARACTERISTIC K_O2_LA_TRIM_CFG "Verknuepfung mit Trimmregelung [A2L-ref]" VALUE 0x7622C RL_VAL_UW 0 CM_0000 0 65535 /end CHARACTERISTIC
/begin CHARACTERISTIC K_PKSR_ADAP_DELTA_OFF "PKSR-Adaptions Offset i n-crement/decrement [A2L-ref]" VALUE 0x76DFA RL_VAL_SW 0 CM_0312 -99.99999998 99.99694823 /end CHARACTERISTIC
/begin CHARACTERISTIC K_PKSR_ADAP_FAK_ML_MIN "ml Schwelle fuer Faktor -Adaption ein [EST]" VALUE 0x76E52 RL_VAL_SW 0 CM_0102 -3276.8 3276.7 /end CHARACTERISTIC
/begin CHARACTERISTIC K_PKSR_EKP_VORL_RESET "Reset fuer EKP Vorlaufsperre [EST]" VALUE 0x76E72 RL_VAL_UW 0 CM_0380 0 1092.25 /end CHARACTERISTIC
/begin CHARACTERISTIC K_RF_DYN_TAU "Filterkonstante fuer rf_dyn [verified]" VALUE 0x78211 RL_VAL_UB 0 CM_0027 0 255 /end CHARACTERISTIC
/begin CHARACTERISTIC K_RF_HUBVOLUMEN "Hubvolumen [A2L-ref]" VALUE 0x7820C RL_VAL_UW 0 CM_0411 0 65.535 /end CHARACTERISTIC
/begin CHARACTERISTIC K_RF_LUFTDICHTE "Luftdichte [A2L-ref]" VALUE 0x7820E RL_VAL_UW 0 CM_0412 0 65.535 /end CHARACTERISTIC
/begin CHARACTERISTIC K_RF_ST_LL_RAMP "Dauer der RF Rampe von START nach LL [A2L-ref]" VALUE 0x78210 RL_VAL_UB 0 CM_0413 0 127.5 /end CHARACTERISTIC
/begin CHARACTERISTIC K_SA_MD_FW_REL_MIN "relatvie Momenentenschwelle Zugbetr. in Schubbetrieb direkt [verified]" VALUE 0x782F0 RL_VAL_SW 0 CM_0013 -3276.8 3276.7 /end CHARACTERISTIC
/begin CHARACTERISTIC K_SA_MD_HYS "absolute Drehm omenthyst. fuer Erkennung SA [verified]" VALUE 0x782F2 RL_VAL_SW 0 CM_0013 -3276.8 3276.7 /end CHARACTERISTIC
/begin CHARACTERISTIC K_SA_MD_IND_NE_MIN "absolute md -Schwelle fuer Aktivierung der SA [verified]" VALUE 0x782F6 RL_VAL_SW 0 CM_0017 -3276.8 3276.7 /end CHARACTERISTIC
/begin CHARACTERISTIC K_SA_N_HYS "allg. Hyst. SA-Drehzahl [verified]" VALUE 0x782FC RL_VAL_SW 0 CM_0002 -32768 32767 /end CHARACTERISTIC
/begin CHARACTERISTIC K_SA_TKAT_MIN "minimale Kataly satortemp. fuer Freigabe SA [verified]" VALUE 0x782F8 RL_VAL_SW 0 CM_0006 -3550 3003.5 /end CHARACTERISTIC
/begin CHARACTERISTIC K_SA_TZ_MIN_HYS "Hysterese f?r tzmin [verified]" VALUE 0x782FE RL_VAL_SW 0 CM_0384 -3276.8 3276.7 /end CHARACTERISTIC
/begin CHARACTERISTIC K_SA_WE_MD_HYS "absolute md -Schwelle fuer Erkennung WE [verified]" VALUE 0x782FA RL_VAL_SW 0 CM_0013 -3276.8 3276.7 /end CHARACTERISTIC
/begin CHARACTERISTIC K_TIME_SET_1 "- [A2L-ref]" VALUE 0x70312 RL_VAL_SW 0 CM_0000 -32768 32767 /end CHARACTERISTIC
/begin CHARACTERISTIC K_TIME_SET_2 "- [A2L-ref]" VALUE 0x70314 RL_VAL_SW 0 CM_0000 -32768 32767 /end CHARACTERISTIC
/begin CHARACTERISTIC K_TI_MAX_RESET "0 Einfluss 1 kein Einfluss Einfluss von ti_rf_max unter- druecken [verified]" VALUE 0x793AA RL_VAL_UW 0 CM_0417 0 65535 /end CHARACTERISTIC
/begin CHARACTERISTIC K_TVLOFHYST "Hysterese Generatorvollastabschaltung [A2L-ref]" VALUE 0x75B40 RL_VAL_UB 0 CM_0000 0 255 /end CHARACTERISTIC
/begin CHARACTERISTIC K_VAN_ANSCHL_HYS "Hysterese Anschlag anfahren [verified]" VALUE 0x7A368 RL_VAL_SW 0 CM_0384 -3276.8 3276.7 /end CHARACTERISTIC
/begin CHARACTERISTIC K_VAN_SMG_DAUER_MAX "max. SMG-Schaltungsdauer [verified]" VALUE 0x7A3E2 RL_VAL_UB 0 CM_0025 0 2.55 /end CHARACTERISTIC
/begin CHARACTERISTIC K_VAN_SMG_T_AUFREG "max. Aufregelzeit der Kupplung [verified]" VALUE 0x7A3E3 RL_VAL_UB 0 CM_0025 0 2.55 /end CHARACTERISTIC
/begin CHARACTERISTIC K_VAN_TV_MCS_A1 "max. Ventil Tastverhaeltnis [A2L-ref]" VALUE 0x7A41A RL_VAL_SW 0 CM_0091 -3200 3199.902344 /end CHARACTERISTIC
/begin CHARACTERISTIC K_VAN_TV_MCS_A2 "max. Ventil Tastverhaeltnis [A2L-ref]" VALUE 0x7A41E RL_VAL_SW 0 CM_0091 -3200 3199.902344 /end CHARACTERISTIC
/begin CHARACTERISTIC K_V_MAX_ANH_KM_STAND "minimaler km -Stand fuer v_max -Anhebung [verified]" VALUE 0x7B082 RL_VAL_UW 0 CM_0082 0 65535 /end CHARACTERISTIC
/begin CHARACTERISTIC K_V_MAX_ANH_MAX_CNT "Begrenzung v_max-Anhebungen per Tester [A2L-ref]" VALUE 0x7B084 RL_VAL_UB 0 CM_0000 0 255 /end CHARACTERISTIC
/begin CHARACTERISTIC K_V_MAX_FF_RESET "0 Speichern 1 Reset ELSE undef FF-Reset fuer meinen INCA-Spezl [verified]" VALUE 0x7B07E RL_VAL_UB 0 CM_0000 0 255 /end CHARACTERISTIC
/begin CHARACTERISTIC K_V_MAX_MAX "Stoll'sche v_max-Konstante [verified]" VALUE 0x7B080 RL_VAL_SW 0 CM_0010 -2048 2047.9375 /end CHARACTERISTIC
/begin CHARACTERISTIC K_V_RAD_TOL_TAU "Filterkonstante RadToleranz [A2L-ref]" VALUE 0x7B07D RL_VAL_UB 0 CM_0065 0.005019607843 1.28 /end CHARACTERISTIC
/begin CHARACTERISTIC S_LORESLL "Schalter Kennlinienausschaltzeit [A2L-ref]" VALUE 0x75B41 RL_VAL_UB 0 CM_0000 0 255 /end CHARACTERISTIC
/begin CHARACTERISTIC S_MGAPP "Schalter f???r Applikationswert Genratormaximalmoment [A2L-ref]" VALUE 0x75B42 RL_VAL_UB 0 CM_0000 0 255 /end CHARACTERISTIC
/begin CHARACTERISTIC K_DFMAX "Obere Schwelle DF Signal [EST]" VALUE 0x75B3F RL_VAL_UB 0 CM_0158 0 99.609375 /end CHARACTERISTIC
/begin CHARACTERISTIC K_LAM_REG_START_TIME "Verzoegerungszeit nach Startende [verified]" VALUE 0x74926 RL_VAL_UW 0 CM_0025 0 655.35 /end CHARACTERISTIC
/begin CHARACTERISTIC K_LAVK_AD_GAIN_GRAD "max. GAIN-Gradient [verified]" VALUE 0x74910 RL_VAL_UW 0 CM_0016 0 63.99902344 /end CHARACTERISTIC
/begin CHARACTERISTIC K_LAVK_AD_GAIN_MIN "MIN-Schwelle f. GAIN-Sondenadaption [verified]" VALUE 0x7490C RL_VAL_UW 0 CM_0163 0 319995.1172 /end CHARACTERISTIC
/begin CHARACTERISTIC K_LAVK_AD_GAIN_ML_MIN "MIN-Luftmasse pro Bank [verified]" VALUE 0x74912 RL_VAL_SW 0 CM_0102 -3276.8 3276.7 /end CHARACTERISTIC
/begin CHARACTERISTIC K_LAVK_AD_GAIN_NV_MAX "max. Grenze fuer GAIN-Sonden-Adapt. [verified]" VALUE 0x7491A RL_VAL_UW 0 CM_0016 0 63.99902344 /end CHARACTERISTIC
/begin CHARACTERISTIC K_LAVK_AD_GAIN_NV_MIN "min. Grenze fuer GAIN-Sonden-Adapt. [verified]" VALUE 0x7491C RL_VAL_UW 0 CM_0016 0 63.99902344 /end CHARACTERISTIC
/begin CHARACTERISTIC K_LAVK_AD_GAIN_T1 "Filterkoeffizient - GAIN-Sondenadapt. [verified]" VALUE 0x74906 RL_VAL_UW 0 CM_0401 0 655350 /end CHARACTERISTIC
/begin CHARACTERISTIC K_LAVK_AD_OFFS_GRAD "max. OFFEST-Gradient [verified]" VALUE 0x7490E RL_VAL_UW 0 CM_0163 0 319995.1172 /end CHARACTERISTIC
/begin CHARACTERISTIC K_NLLMIN "Motordrehzahl unterhalb derer die LLDZanh. zurueckgenommen wird. [EST]" VALUE 0x75B3C RL_VAL_SW 0 CM_0002 -32768 32767 /end CHARACTERISTIC
/begin CHARACTERISTIC K_RAM_CHK_CFG "Ramcheck Config [EST]" VALUE 0x7820A RL_VAL_UB 0 CM_0000 0 255 /end CHARACTERISTIC
/begin CHARACTERISTIC K_SA_MD_IND_NE_MAX "max. ind. Motormoment nach Eingriff fuer dire kten Ueberg. nach SA [verified]" VALUE 0x782F4 RL_VAL_SW 0 CM_0017 -3276.8 3276.7 /end CHARACTERISTIC
/begin CHARACTERISTIC K_SA_MSR_SPERRZEIT "Hysterese f?r tzmin [verified]" VALUE 0x78300 RL_VAL_UW 0 CM_0020 0 327.675 /end CHARACTERISTIC
/begin CHARACTERISTIC K_VAN_TV_MCS_E1 "max. Ventil Tastverhaeltnis [verified]" VALUE 0x7A418 RL_VAL_SW 0 CM_0091 -3200 3199.902344 /end CHARACTERISTIC
/begin CHARACTERISTIC K_VAN_UB_ERS "Ersatzwert bei Fehler [verified]" VALUE 0x7A420 RL_VAL_SW 0 CM_0021 -3276.8 3276.7 /end CHARACTERISTIC
/begin CHARACTERISTIC KL_OZ_LL_Q_OFFSET "Quer-Beschl. Korr. Niveau [verified]" CURVE 0x70372 RL_CUR_SW_SB 0 CM_0241 -37.5 37.20703125 /begin AXIS_DESCR STD_AXIS NO_INPUT_QUANTITY CM_0423 5 -8192 8191.75 /end AXIS_DESCR /end CHARACTERISTIC
/begin CHARACTERISTIC K_MDRV_CFG "0 Schalter 1 Komfort 2 Normal 3 Sport 4 Konfigmode ELSE undef Konfiguration [verified]" VALUE 0x75EAA RL_VAL_UB 0 CM_0000 0 255 /end CHARACTERISTIC
/begin CHARACTERISTIC K_MDRV_CFG_KL15 "0 Variabel 1 Komfort ELSE undef Konfiguration bei Kl15 ein [EST]" VALUE 0x75EAB RL_VAL_UB 0 CM_0000 0 255 /end CHARACTERISTIC
/begin CHARACTERISTIC K_MDRV_CFG_P400 "0 nur US 1 immer Konfiguration P400-Only [verified]" VALUE 0x75EAC RL_VAL_UB 0 CM_0000 0 255 /end CHARACTERISTIC
/begin CHARACTERISTIC K_MDRV_PTH_CNT_MAX "max. Entprellcounter [verified]" VALUE 0x75EAF RL_VAL_UB 0 CM_0000 0 255 /end CHARACTERISTIC
/begin CHARACTERISTIC K_MDRV_DSC "0 k. Aenderung 1 Aus 2 Ein 4 MDM ELSE undef Default-Konfiguration DSC [verified]" VALUE 0x75EB1 RL_VAL_UB 0 CM_0000 0 255 /end CHARACTERISTIC
/begin CHARACTERISTIC K_MDRV_MOD_SMG "0 k. Aenderung 1 Automat 2 Sequentiell ELSE undef Default-Konfiguration SMG - Mode [verified]" VALUE 0x75EB3 RL_VAL_UB 0 CM_0000 0 255 /end CHARACTERISTIC
/begin CHARACTERISTIC K_MDRV_STG_SMG "Default-Konfiguration SMG-Sufe [verified]" VALUE 0x75EB5 RL_VAL_UB 0 CM_0000 0 255 /end CHARACTERISTIC
/begin CHARACTERISTIC K_MDRV_ENG "0 k. Aenderung 1 Komfort 2 Normal 3 Sport ELSE undef Default-Konfiguration Motor [verified]" VALUE 0x75EB7 RL_VAL_UB 0 CM_0000 0 255 /end CHARACTERISTIC
/begin CHARACTERISTIC K_MDRV_EDCK "0 k. Aenderung 1 Komfort 2 Normal 10 Sport ELSE undef Default-Konfiguration EDCK [verified]" VALUE 0x75EB9 RL_VAL_UB 0 CM_0000 0 255 /end CHARACTERISTIC
/begin CHARACTERISTIC K_MDRV_ALBV "0 k. Aenderung 1 KL1 2 KL2 3 KL3 ELSE undef Default-Konfiguration ALBV [verified]" VALUE 0x75EBA RL_VAL_UB 0 CM_0000 0 255 /end CHARACTERISTIC
/begin CHARACTERISTIC K_MDRV_HUD "0 k. Aenderung 1 M-Cfg ELSE undef Default-Konfiguration HUD [verified]" VALUE 0x75EBB RL_VAL_UB 0 CM_0000 0 255 /end CHARACTERISTIC
/begin CHARACTERISTIC K_MDRV_EPAS "0 k. Aenderung 1 Normal 2 Sport ELSE undef Default-Konfiguration Servo [verified]" VALUE 0x75EBD RL_VAL_UB 0 CM_0000 0 255 /end CHARACTERISTIC
/begin CHARACTERISTIC K_MDRV_SHLI "0 k. Aenderung 1 Aus 2 Ein ELSE undef Default-Konfiguration SHLI [verified]" VALUE 0x75EBF RL_VAL_UB 0 CM_0000 0 255 /end CHARACTERISTIC
/begin CHARACTERISTIC KL_OZDREHKORI "Drehzahlkorrektur w?rend der Orientierung [EST]" CURVE 0x7694A RL_CUR_SW_SW 0 CM_0432 -4800 4799.853516 /begin AXIS_DESCR STD_AXIS NO_INPUT_QUANTITY CM_0002 8 -32768 32767 /end AXIS_DESCR /end CHARACTERISTIC
/begin CHARACTERISTIC KL_OZDREHKORI_EINFAHR "Drehzahlkorrektur w?rend der Orientierung [EST]" CURVE 0x7696C RL_CUR_SW_SW 0 CM_0432 -4800 4799.853516 /begin AXIS_DESCR STD_AXIS NO_INPUT_QUANTITY CM_0002 8 -32768 32767 /end AXIS_DESCR /end CHARACTERISTIC
/begin CHARACTERISTIC KL_N_BEGR_SLC_ABSTELL "SLC-MS-Wichtung [verified]" CURVE 0x76188 RL_CUR_UW_UW 0 CM_0245 0 63.99902344 /begin AXIS_DESCR STD_AXIS NO_INPUT_QUANTITY CM_0233 6 0 1092.25 /end AXIS_DESCR /end CHARACTERISTIC
/begin CHARACTERISTIC K_VAN_ADAPT_RESET "0x0 aus 0x1 l?schen ELSE undef. Alle Vanos-Adaptionen l?schen [verified]" VALUE 0x7A364 RL_VAL_UB 0 CM_0000 0 255 /end CHARACTERISTIC
/begin CHARACTERISTIC K_VAN_ANSCHL_DELTA "Abstand Soll-Anschlag [verified]" VALUE 0x7A366 RL_VAL_SW 0 CM_0280 -3276.8 3276.7 /end CHARACTERISTIC
/begin CHARACTERISTIC K_VAN_BEGR_AB_FAKT "Abregelzeit Min-Begrenzung [verified]" VALUE 0x7A37A RL_VAL_UB 0 CM_0433 0.6431372549 164 /end CHARACTERISTIC
/begin CHARACTERISTIC K_VAN_SMG_MD_RF "vorgest. md_rf bei SMG -Schaltung [verified]" VALUE 0x7A3E0 RL_VAL_SW 0 CM_0282 -3.2768 3.2767 /end CHARACTERISTIC
/begin CHARACTERISTIC K_VAN_SOLL_ABSTELL_E "Sollpos nach KL15 aus [verified]" VALUE 0x7A3E4 RL_VAL_SW 0 CM_0435 -3276.8 3276.7 /end CHARACTERISTIC
/begin CHARACTERISTIC K_VAN_SOLL_ABSTELL_A "Sollpos nach KL15 aus [verified]" VALUE 0x7A3E6 RL_VAL_SW 0 CM_0435 -3276.8 3276.7 /end CHARACTERISTIC
/begin CHARACTERISTIC K_VAN_SOLL_ERSATZ_E "Soll-Ersatzwert [verified]" VALUE 0x7A3E8 RL_VAL_SW 0 CM_0435 -3276.8 3276.7 /end CHARACTERISTIC
/begin CHARACTERISTIC K_VAN_SOLL_ERSATZ_A "Soll-Ersatzwert [verified]" VALUE 0x7A3EA RL_VAL_SW 0 CM_0435 -3276.8 3276.7 /end CHARACTERISTIC
/begin CHARACTERISTIC K_VAN_SOLL_MAX_E "max. Sollwert [verified]" VALUE 0x7A3EC RL_VAL_SW 0 CM_0435 -3276.8 3276.7 /end CHARACTERISTIC
/begin CHARACTERISTIC K_VAN_SOLL_MAX_A "max. Sollwert [verified]" VALUE 0x7A3EE RL_VAL_SW 0 CM_0435 -3276.8 3276.7 /end CHARACTERISTIC
/begin CHARACTERISTIC K_VAN_SOLL_MIN_E "min. Sollwert [verified]" VALUE 0x7A3F0 RL_VAL_SW 0 CM_0435 -3276.8 3276.7 /end CHARACTERISTIC
/begin CHARACTERISTIC K_VAN_SOLL_MIN_A "min. Sollwert [verified]" VALUE 0x7A3F2 RL_VAL_SW 0 CM_0435 -3276.8 3276.7 /end CHARACTERISTIC
/begin CHARACTERISTIC K_VAN_SOLL_OFFSET_E "Sollpositionsoffset [verified]" VALUE 0x7A3F4 RL_VAL_SW 0 CM_0435 -3276.8 3276.7 /end CHARACTERISTIC
/begin CHARACTERISTIC K_VAN_SOLL_OFFSET_A "Sollpositionsoffset [verified]" VALUE 0x7A3F6 RL_VAL_SW 0 CM_0435 -3276.8 3276.7 /end CHARACTERISTIC
/begin CHARACTERISTIC K_VAN_SPR_MAX_E "Maximale Spreizung am A n-schlag [verified]" VALUE 0x7A3F8 RL_VAL_SW 0 CM_0435 -3276.8 3276.7 /end CHARACTERISTIC
/begin CHARACTERISTIC K_VAN_SPR_MAX_A "Maximale Spreizung am A n-schlag [verified]" VALUE 0x7A3FA RL_VAL_SW 0 CM_0435 -3276.8 3276.7 /end CHARACTERISTIC
/begin CHARACTERISTIC K_VAN_SPR_MAX_TOL_E "Max. Abweichung Spre izung Anschlag [verified]" VALUE 0x7A3FC RL_VAL_SW 0 CM_0435 -3276.8 3276.7 /end CHARACTERISTIC
/begin CHARACTERISTIC K_VAN_SPR_MAX_TOL_A "Max. Abweichung Spre izung Anschlag [verified]" VALUE 0x7A3FE RL_VAL_SW 0 CM_0435 -3276.8 3276.7 /end CHARACTERISTIC
/begin CHARACTERISTIC K_VAN_SPR_MIN_E "Minimale Spreizung am An-schlag [verified]" VALUE 0x7A400 RL_VAL_SW 0 CM_0435 -3276.8 3276.7 /end CHARACTERISTIC
/begin CHARACTERISTIC K_VAN_SPR_MIN_A "Minimale Spreizung am An-schlag [verified]" VALUE 0x7A402 RL_VAL_SW 0 CM_0435 -3276.8 3276.7 /end CHARACTERISTIC
/begin CHARACTERISTIC K_VAN_SPR_OFFSET_E1 "KW-Zahnflanke zu max Spre i-zung [verified]" VALUE 0x7A404 RL_VAL_SW 0 CM_0436 -3276.8 3276.7 /end CHARACTERISTIC
/begin CHARACTERISTIC K_VAN_SPR_OFFSET_A1 "KW-Zahnflanke zu max Spre i-zung [verified]" VALUE 0x7A406 RL_VAL_SW 0 CM_0436 -3276.8 3276.7 /end CHARACTERISTIC
/begin CHARACTERISTIC K_VAN_SPR_OFFSET_A2 "KW-Zahnflanke zu max Spre i-zung [verified]" VALUE 0x7A40A RL_VAL_SW 0 CM_0436 -3276.8 3276.7 /end CHARACTERISTIC
/begin CHARACTERISTIC K_VAN_SPUEL_CNT_MAX "max. Anzahl Ventilspu elen je Motorlauf [verified]" VALUE 0x7A40C RL_VAL_UB 0 CM_0000 0 255 /end CHARACTERISTIC
/begin CHARACTERISTIC K_VAN_SPUEL_T "Dauer Ventilspuelen [verified]" VALUE 0x7A40D RL_VAL_UB 0 CM_0247 0 2.55 /end CHARACTERISTIC
/begin CHARACTERISTIC K_VAN_SPUEL_WAIT "Warten bis Pruefen Spuelb e-dingung [verified]" VALUE 0x7A40E RL_VAL_UB 0 CM_0247 0 2.55 /end CHARACTERISTIC
/begin CHARACTERISTIC K_VAN_SPUEL_XD "Max. gef. Regelabweichung [verified]" VALUE 0x7A410 RL_VAL_SW 0 CM_0280 -3276.8 3276.7 /end CHARACTERISTIC
/begin CHARACTERISTIC K_VAN_SZ_E "Steuerzeit Nockenwelle [verified]" VALUE 0x7A412 RL_VAL_SW 0 CM_0435 -3276.8 3276.7 /end CHARACTERISTIC
/begin CHARACTERISTIC K_VAN_SZ_A "Steuerzeit Nockenwelle [verified]" VALUE 0x7A414 RL_VAL_SW 0 CM_0435 -3276.8 3276.7 /end CHARACTERISTIC
/begin CHARACTERISTIC K_VAN_TMOT_BEGR "Temp.-Schwelle Fr?hbegre n-zung [verified]" VALUE 0x7A416 RL_VAL_SW 0 CM_0256 -3550 3003.5 /end CHARACTERISTIC
/begin CHARACTERISTIC K_VAN_UNL_I_DYN_E "max. Dynamik TV zum Entri e-geln [verified]" VALUE 0x7A422 RL_VAL_SW 0 CM_0434 -32768 32767 /end CHARACTERISTIC
/begin CHARACTERISTIC K_VAN_UNL_I_DYN_A "max. Dynamik TV zum Entri e-geln [verified]" VALUE 0x7A424 RL_VAL_SW 0 CM_0434 -32768 32767 /end CHARACTERISTIC
/begin CHARACTERISTIC K_VAN_UNL_I_OFFS_E "Unlock Start -Delta zur Mitte-llage [verified]" VALUE 0x7A426 RL_VAL_SW 0 CM_0434 -32768 32767 /end CHARACTERISTIC
/begin CHARACTERISTIC K_VAN_UNL_I_OFFS_A "Unlock Start -Delta zur Mitte-llage [verified]" VALUE 0x7A428 RL_VAL_SW 0 CM_0434 -32768 32767 /end CHARACTERISTIC
/begin CHARACTERISTIC K_VAN_UNL_OFFS_E "Abstand vom Anschl., ab dem entriegelt sein muss [verified]" VALUE 0x7A42A RL_VAL_SW 0 CM_0435 -3276.8 3276.7 /end CHARACTERISTIC
/begin CHARACTERISTIC K_VAN_UNL_OFFS_A "Abstand vom Anschl., ab dem entriegelt sein muss [verified]" VALUE 0x7A42C RL_VAL_SW 0 CM_0435 -3276.8 3276.7 /end CHARACTERISTIC
/begin CHARACTERISTIC K_VAN_UNL_START_OFFS_E "Abstand vom Anschl., ab dem Start nicht verriegelt gezaehlt [verified]" VALUE 0x7A42E RL_VAL_SW 0 CM_0435 -3276.8 3276.7 /end CHARACTERISTIC
/begin CHARACTERISTIC K_VAN_UNL_START_OFFS_A "Abstand vom Anschl., ab dem Start nicht verriegelt gezaehlt [verified]" VALUE 0x7A430 RL_VAL_SW 0 CM_0435 -3276.8 3276.7 /end CHARACTERISTIC
/begin CHARACTERISTIC K_VAN_VST_CFG "0x0 aus 0x1 aktiv ELSE undef. Vorsteuerreset bei Ueberschwinger [verified]" VALUE 0x7A432 RL_VAL_UB 0 CM_0000 0 255 /end CHARACTERISTIC
/begin CHARACTERISTIC K_VAN_VST_VOL_DYN "Dyn.-Sperre Reglerdiagnose [verified]" VALUE 0x7A434 RL_VAL_SW 0 CM_0091 -3200 3199.902344 /end CHARACTERISTIC
/begin CHARACTERISTIC K_VAN_VST_VOL_F_E "Faktor Oelvolumen zu Stellweg [verified]" VALUE 0x7A436 RL_VAL_UW 0 CM_0437 0 2.559960938 /end CHARACTERISTIC
/begin CHARACTERISTIC K_VAN_VST_VOL_F_A "Faktor Oelvolumen zu Stellweg [verified]" VALUE 0x7A438 RL_VAL_UW 0 CM_0437 0 2.559960938 /end CHARACTERISTIC
/begin CHARACTERISTIC K_VAN_XD_FILT_ED_E "Max. gef. Regelabweichung [verified]" VALUE 0x7A43A RL_VAL_SW 0 CM_0435 -3276.8 3276.7 /end CHARACTERISTIC
/begin CHARACTERISTIC K_VAN_XD_FILT_ED_A "Max. gef. Regelabweichung [verified]" VALUE 0x7A43C RL_VAL_SW 0 CM_0435 -3276.8 3276.7 /end CHARACTERISTIC
/begin CHARACTERISTIC K_VAN_XD_FILT_WAIT "Sperrzeit Filterzeitko nstante Regeldifferenz [verified]" VALUE 0x7A43E RL_VAL_UB 0 CM_0247 0 2.55 /end CHARACTERISTIC
/begin CHARACTERISTIC K_VAN_XD_TAU_DYN "Filterzeitkonstante bei Dynamik [verified]" VALUE 0x7A440 RL_VAL_UW 0 CM_0324 0.1 6553.5 /end CHARACTERISTIC
/begin CHARACTERISTIC K_VAN_XD_ABS_FILT_ED "Max. Regelabweichung: van_xd_abs_filt - |van_xd_filt| [verified]" VALUE 0x7A442 RL_VAL_SW 0 CM_0280 -3276.8 3276.7 /end CHARACTERISTIC
/begin CHARACTERISTIC KL_VAN_SOLL_BEGR_OFFS "Offset Min-Begrenzung Kaltstart [verified]" CURVE 0x7A502 RL_CUR_SW_SW 0 CM_0280 -3276.8 3276.7 /begin AXIS_DESCR STD_AXIS NO_INPUT_QUANTITY CM_0291 4 -2048 2047.9375 /end AXIS_DESCR /end CHARACTERISTIC
/begin CHARACTERISTIC KL_N_BEGR_TI_OFFSET_RS "gangabh. N -Offset bei Rennstart [verified]" CURVE 0x7614C RL_CUR_SW_SW 0 CM_0002 -32768 32767 /begin AXIS_DESCR STD_AXIS NO_INPUT_QUANTITY CM_0015 4 -32768 32767 /end AXIS_DESCR /end CHARACTERISTIC
/begin CHARACTERISTIC KL_N_BEGR_GANG_HYS "Hystherese fuer Timer [verified]" CURVE 0x76168 RL_GRP_SW_R 0 CM_0002 -32768 32767
 /begin AXIS_DESCR COM_AXIS NO_INPUT_QUANTITY CM_0015 7 -128 127 AXIS_PTS_REF GAX_0615E /end AXIS_DESCR
/end CHARACTERISTIC
/begin CHARACTERISTIC KF_N_BEGR_GANG_OFFS "Abregelung Begrenzerdrehzahl [verified]" MAP 0x761A2 RL_MAP_UW_SW_SW 0 CM_0002 -32768 32767 /begin AXIS_DESCR STD_AXIS NO_INPUT_QUANTITY CM_0301 8 0 6553.5 /end AXIS_DESCR /begin AXIS_DESCR STD_AXIS NO_INPUT_QUANTITY CM_0015 6 -32768 32767 /end AXIS_DESCR /end CHARACTERISTIC
/begin CHARACTERISTIC K_LA_TRIM_RF_HYS "Hsysterese f. relative F?llung - LA-TRIM [verified]" VALUE 0x74200 RL_VAL_SW 0 CM_0282 -3.2768 3.2767 /end CHARACTERISTIC
/begin CHARACTERISTIC K_N_BEGR_TI_HYS_RS_HS "Hysterese fuer N - Begrenzung ueber TI bei HS-RS [verified]" VALUE 0x7601A RL_VAL_SW 0 CM_0002 -32768 32767 /end CHARACTERISTIC
/begin CHARACTERISTIC K_N_BEGR_TI_HYS_RS_DKG "Hysterese fuer N - Begrenzung ueber TI bei DKG-RS [verified]" VALUE 0x7601C RL_VAL_SW 0 CM_0002 -32768 32767 /end CHARACTERISTIC
/begin CHARACTERISTIC K_KATS_LAM_P_DELTA_MAX "Gradientenschwelle fuer Uergang Einfangen - > Eingeregelt [verified]" VALUE 0x7412E RL_VAL_SW 0 CM_0259 -2 1.999938965 /end CHARACTERISTIC
/begin CHARACTERISTIC K_KATS_TABG_LW_KORR_HYS "Hysterese z uendwinkelkorr. Abgastemperatur- Ladungswechsel [verified]" VALUE 0x74138 RL_VAL_SW 0 CM_0323 -3276.8 3276.7 /end CHARACTERISTIC
/begin CHARACTERISTIC K_TI_WL_CFG "0 ohne AQ/Hoehen- Korr. 1 mit AQ/ohne Hoe- hen-Korr 2 ohne AQ/mit Hoe- hen-Korr 3 mit AQ/Hoehen- Kor [verified]" VALUE 0x793B0 RL_VAL_UB 0 CM_0000 0 255 /end CHARACTERISTIC
/begin CHARACTERISTIC KL_DMTL_FST_ERS_LI "Ersatzwert bei Ge ber Links Fehler [verified]" CURVE 0x709C4 RL_CUR_UB_UB 0 CM_0257 0 127.5 /begin AXIS_DESCR STD_AXIS NO_INPUT_QUANTITY CM_0257 4 0 127.5 /end AXIS_DESCR /end CHARACTERISTIC
/begin CHARACTERISTIC KL_DMTL_T_FEIN_MIN "Minimale Feinleck -Messdauer [verified]" CURVE 0x70A02 RL_CUR_UB_UB 0 CM_0466 0 510 /begin AXIS_DESCR STD_AXIS NO_INPUT_QUANTITY CM_0257 6 0 127.5 /end AXIS_DESCR /end CHARACTERISTIC
/begin CHARACTERISTIC KL_DMTL_T_GROB "Maximale Grobleck -Messdauer [verified]" CURVE 0x70A10 RL_CUR_UB_UB 0 CM_0027 0 255 /begin AXIS_DESCR STD_AXIS NO_INPUT_QUANTITY CM_0257 6 0 127.5 /end AXIS_DESCR /end CHARACTERISTIC
/begin CHARACTERISTIC KL_DMTL_T_STABIL "Stabilzeit fuer Feinleck ueber Fuellstand [verified]" CURVE 0x70A1E RL_CUR_UB_UB 0 CM_0027 0 255 /begin AXIS_DESCR STD_AXIS NO_INPUT_QUANTITY CM_0257 6 0 127.5 /end AXIS_DESCR /end CHARACTERISTIC
/begin CHARACTERISTIC KL_OZNFDELTA "Delta f?r die Nachf?llerken-nung [verified]" CURVE 0x7691C RL_CUR_UB_UB 0 CM_0241 0 74.70703125 /begin AXIS_DESCR STD_AXIS NO_INPUT_QUANTITY CM_0241 6 0 74.70703125 /end AXIS_DESCR /end CHARACTERISTIC
/begin CHARACTERISTIC KL_OELLEVEL_KOMBI "Linearisierungskennlinie Kombianzeige [verified]" CURVE 0x7032A RL_CUR_UB_UB 0 CM_0359 -10 15.5 /begin AXIS_DESCR STD_AXIS NO_INPUT_QUANTITY CM_0241 20 0 74.70703125 /end AXIS_DESCR /end CHARACTERISTIC
/begin CHARACTERISTIC KL_OZ_LL_L_OFFSET "Laengs-Beschl. Korr. Niveau [verified]" CURVE 0x70366 RL_CUR_SB_SB 0 CM_0241 -37.5 37.20703125 /begin AXIS_DESCR STD_AXIS NO_INPUT_QUANTITY CM_0423 5 -32 31.75 /end AXIS_DESCR /end CHARACTERISTIC
/begin COMPU_METHOD CM_0000 "X" RAT_FUNC "%.4g" "-" COEFFS 0 1 0 0 0 1 /end COMPU_METHOD
/begin COMPU_METHOD CM_0002 "X" RAT_FUNC "%.4g" "Upm" COEFFS 0 1 0 0 0 1 /end COMPU_METHOD
/begin COMPU_METHOD CM_0003 "X*0.0001" RAT_FUNC "%.4g" "-" COEFFS 0 1 0 0 0 0.0001 /end COMPU_METHOD
/begin COMPU_METHOD CM_0005 "X*0.0061035156" RAT_FUNC "%.4g" "%" COEFFS 0 1 0 0 0 0.0061035156 /end COMPU_METHOD
/begin COMPU_METHOD CM_0006 "X*0.1-273.2" RAT_FUNC "%.4g" "?C" COEFFS 0 1 273.2 0 0 0.1 /end COMPU_METHOD
/begin COMPU_METHOD CM_0009 "X*0.0039215686" RAT_FUNC "%.4g" "-" COEFFS 0 1 0 0 0 0.0039215686 /end COMPU_METHOD
/begin COMPU_METHOD CM_0010 "X*0.0625" RAT_FUNC "%.4g" "km/h" COEFFS 0 1 0 0 0 0.0625 /end COMPU_METHOD
/begin COMPU_METHOD CM_0012 "X*0.1" RAT_FUNC "%.4g" "qmm" COEFFS 0 1 0 0 0 0.1 /end COMPU_METHOD
/begin COMPU_METHOD CM_0013 "X*0.1" RAT_FUNC "%.4g" "%" COEFFS 0 1 0 0 0 0.1 /end COMPU_METHOD
/begin COMPU_METHOD CM_0015 "X" RAT_FUNC "%.4g" ".Gang" COEFFS 0 1 0 0 0 1 /end COMPU_METHOD
/begin COMPU_METHOD CM_0016 "X*0.0009765625" RAT_FUNC "%.4g" "-" COEFFS 0 1 0 0 0 0.0009765625 /end COMPU_METHOD
/begin COMPU_METHOD CM_0017 "X*0.1" RAT_FUNC "%.4g" "Nm" COEFFS 0 1 0 0 0 0.1 /end COMPU_METHOD
/begin COMPU_METHOD CM_0019 "X*0.0000610352" RAT_FUNC "%.4g" "-" COEFFS 0 1 0 0 0 6.10352e-05 /end COMPU_METHOD
/begin COMPU_METHOD CM_0020 "X*0.005" RAT_FUNC "%.4g" "s" COEFFS 0 1 0 0 0 0.005 /end COMPU_METHOD
/begin COMPU_METHOD CM_0021 "X*0.1" RAT_FUNC "%.4g" "V" COEFFS 0 1 0 0 0 0.1 /end COMPU_METHOD
/begin COMPU_METHOD CM_0022 "X*0.0625" RAT_FUNC "%.4g" "mbar" COEFFS 0 1 0 0 0 0.0625 /end COMPU_METHOD
/begin COMPU_METHOD CM_0023 "X*0.1" RAT_FUNC "%.4g" "s" COEFFS 0 1 0 0 0 0.1 /end COMPU_METHOD
/begin COMPU_METHOD CM_0024 "X*0.1" RAT_FUNC "%.4g" "Kelvin" COEFFS 0 1 0 0 0 0.1 /end COMPU_METHOD
/begin COMPU_METHOD CM_0025 "X*0.01" RAT_FUNC "%.4g" "s" COEFFS 0 1 0 0 0 0.01 /end COMPU_METHOD
/begin COMPU_METHOD CM_0027 "X" RAT_FUNC "%.4g" "s" COEFFS 0 1 0 0 0 1 /end COMPU_METHOD
/begin COMPU_METHOD CM_0028 "X*0.1" RAT_FUNC "%.4g" "?KW" COEFFS 0 1 0 0 0 0.1 /end COMPU_METHOD
/begin COMPU_METHOD CM_0037 "X*0.0078125" RAT_FUNC "%.4g" "-" COEFFS 0 1 0 0 0 0.0078125 /end COMPU_METHOD
/begin COMPU_METHOD CM_0042 "X*0.025" RAT_FUNC "%.4g" "m/(s*s)" COEFFS 0 1 0 0 0 0.025 /end COMPU_METHOD
/begin COMPU_METHOD CM_0051 "X*0.0000305176" RAT_FUNC "%.4g" "-" COEFFS 0 1 0 0 0 3.05176e-05 /end COMPU_METHOD
/begin COMPU_METHOD CM_0052 "X*10.0" RAT_FUNC "%.4g" "ms" COEFFS 0 1 0 0 0 10 /end COMPU_METHOD
/begin COMPU_METHOD CM_0060 "X*0.0166666667" RAT_FUNC "%.4g" "min" COEFFS 0 1 0 0 0 0.0166666667 /end COMPU_METHOD
/begin COMPU_METHOD CM_0064 "X*0.001" RAT_FUNC "%.4g" "s" COEFFS 0 1 0 0 0 0.001 /end COMPU_METHOD
/begin COMPU_METHOD CM_0065 "1.28/X" RAT_FUNC "%.4g" "s" COEFFS 0 0 -1.28 0 -1 0 /end COMPU_METHOD
/begin COMPU_METHOD CM_0067 "X" RAT_FUNC "%.4g" "Upm/s" COEFFS 0 1 0 0 0 1 /end COMPU_METHOD
/begin COMPU_METHOD CM_0081 "X*10" RAT_FUNC "%.4g" "Upm/s" COEFFS 0 1 0 0 0 10 /end COMPU_METHOD
/begin COMPU_METHOD CM_0082 "X" RAT_FUNC "%.4g" "km" COEFFS 0 1 0 0 0 1 /end COMPU_METHOD
/begin COMPU_METHOD CM_0091 "X*0.09765625" RAT_FUNC "%.4g" "%" COEFFS 0 1 0 0 0 0.09765625 /end COMPU_METHOD
/begin COMPU_METHOD CM_0102 "X*0.1" RAT_FUNC "%.4g" "kg/h" COEFFS 0 1 0 0 0 0.1 /end COMPU_METHOD
/begin COMPU_METHOD CM_0104 "X*0.1" RAT_FUNC "%.4g" "mg" COEFFS 0 1 0 0 0 0.1 /end COMPU_METHOD
/begin COMPU_METHOD CM_0106 "X" RAT_FUNC "%.4g" "raw" COEFFS 0 1 0 0 0 1 /end COMPU_METHOD
/begin COMPU_METHOD CM_0108 "X" RAT_FUNC "%.4g" "min" COEFFS 0 1 0 0 0 1 /end COMPU_METHOD
/begin COMPU_METHOD CM_0123 "X*0.29296875" RAT_FUNC "%.4g" "mm" COEFFS 0 1 0 0 0 0.29296875 /end COMPU_METHOD
/begin COMPU_METHOD CM_0139 "X*0.03125" RAT_FUNC "%.4g" "mg/ASP" COEFFS 0 1 0 0 0 0.03125 /end COMPU_METHOD
/begin COMPU_METHOD CM_0140 "X*0.015625" RAT_FUNC "%.4g" "mg" COEFFS 0 1 0 0 0 0.015625 /end COMPU_METHOD
/begin COMPU_METHOD CM_0141 "X*0.001" RAT_FUNC "%.4g" "ms" COEFFS 0 1 0 0 0 0.001 /end COMPU_METHOD
/begin COMPU_METHOD CM_0142 "X*0.001" RAT_FUNC "%.4g" "bar" COEFFS 0 1 0 0 0 0.001 /end COMPU_METHOD
/begin COMPU_METHOD CM_0143 "X*0.1" RAT_FUNC "%.4g" "m/s" COEFFS 0 1 0 0 0 0.1 /end COMPU_METHOD
/begin COMPU_METHOD CM_0144 "X*0.025" RAT_FUNC "%.4g" "m2/s2" COEFFS 0 1 0 0 0 0.025 /end COMPU_METHOD
/begin COMPU_METHOD CM_0145 "X*0.0009765625" RAT_FUNC "%.4g" "mg/ms" COEFFS 0 1 0 0 0 0.0009765625 /end COMPU_METHOD
/begin COMPU_METHOD CM_0146 "X*0.1" RAT_FUNC "%.4g" "mm2" COEFFS 0 1 0 0 0 0.1 /end COMPU_METHOD
/begin COMPU_METHOD CM_0147 "X*0.01" RAT_FUNC "%.4g" "kg/dm3" COEFFS 0 1 0 0 0 0.01 /end COMPU_METHOD
/begin COMPU_METHOD CM_0148 "X*0.0000610352" RAT_FUNC "%.4g" "m" COEFFS 0 1 0 0 0 6.10352e-05 /end COMPU_METHOD
/begin COMPU_METHOD CM_0149 "X*0.1" RAT_FUNC "%.4g" "mm" COEFFS 0 1 0 0 0 0.1 /end COMPU_METHOD
/begin COMPU_METHOD CM_0151 "X" RAT_FUNC "%.4g" "?C" COEFFS 0 1 0 0 0 1 /end COMPU_METHOD
/begin COMPU_METHOD CM_0158 "X*0.390625" RAT_FUNC "%.4g" "%" COEFFS 0 1 0 0 0 0.390625 /end COMPU_METHOD
/begin COMPU_METHOD CM_0159 "X*0.1" RAT_FUNC "%.4g" "?C" COEFFS 0 1 0 0 0 0.1 /end COMPU_METHOD
/begin COMPU_METHOD CM_0160 "X*0.0156250000" RAT_FUNC "%.4g" "-" COEFFS 0 1 0 0 0 0.015625 /end COMPU_METHOD
/begin COMPU_METHOD CM_0161 "X*0.125" RAT_FUNC "%.4g" "l/h" COEFFS 0 1 0 0 0 0.125 /end COMPU_METHOD
/begin COMPU_METHOD CM_0162 "X*0.0125" RAT_FUNC "%.4g" "10exp-3 -/mV" COEFFS 0 1 0 0 0 0.0125 /end COMPU_METHOD
/begin COMPU_METHOD CM_0163 "X*4.8828125" RAT_FUNC "%.4g" "mV" COEFFS 0 1 0 0 0 4.8828125 /end COMPU_METHOD
/begin COMPU_METHOD CM_0164 "X*0.00390625" RAT_FUNC "%.4g" "-" COEFFS 0 1 0 0 0 0.00390625 /end COMPU_METHOD
/begin COMPU_METHOD CM_0165 "X*0.001953125" RAT_FUNC "%.4g" "-" COEFFS 0 1 0 0 0 0.001953125 /end COMPU_METHOD
/begin COMPU_METHOD CM_0166 "X*0.032" RAT_FUNC "%.4g" "ms" COEFFS 0 1 0 0 0 0.032 /end COMPU_METHOD
/begin COMPU_METHOD CM_0167 "X*0.0003051758" RAT_FUNC "%.4g" "mA" COEFFS 0 1 0 0 0 0.0003051758 /end COMPU_METHOD
/begin COMPU_METHOD CM_0168 "X" RAT_FUNC "%.4g" "mg" COEFFS 0 1 0 0 0 1 /end COMPU_METHOD
/begin COMPU_METHOD CM_0169 "X" RAT_FUNC "%.4g" "ms" COEFFS 0 1 0 0 0 1 /end COMPU_METHOD
/begin COMPU_METHOD CM_0170 "X*0.015625" RAT_FUNC "%.4g" "mg/ASP" COEFFS 0 1 0 0 0 0.015625 /end COMPU_METHOD
/begin COMPU_METHOD CM_0171 "X*5.15+5.15" RAT_FUNC "%.4g" "uA" COEFFS 0 1 -5.15 0 0 5.15 /end COMPU_METHOD
/begin COMPU_METHOD CM_0172 "X*0.1+0.8" RAT_FUNC "%.4g" "ms" COEFFS 0 1 -0.8 0 0 0.1 /end COMPU_METHOD
/begin COMPU_METHOD CM_0173 "X*0.122+1.9531" RAT_FUNC "%.4g" "kHz" COEFFS 0 1 -1.9531 0 0 0.122 /end COMPU_METHOD
/begin COMPU_METHOD CM_0174 "X*0.1" RAT_FUNC "%.4g" "Ohm" COEFFS 0 1 0 0 0 0.1 /end COMPU_METHOD
/begin COMPU_METHOD CM_0175 "X*0.0122070312" RAT_FUNC "%.4g" "%" COEFFS 0 1 0 0 0 0.0122070312 /end COMPU_METHOD
/begin COMPU_METHOD CM_0177 "X" RAT_FUNC "%.4g" "sec" COEFFS 0 1 0 0 0 1 /end COMPU_METHOD
/begin COMPU_METHOD CM_0187 "X*0.146484375" RAT_FUNC "%.4g" "mm" COEFFS 0 1 0 0 0 0.146484375 /end COMPU_METHOD
/begin COMPU_METHOD CM_0188 "X*0.1000000000" RAT_FUNC "%.4g" "Liter" COEFFS 0 1 0 0 0 0.1 /end COMPU_METHOD
/begin COMPU_METHOD CM_0189 "X*0.0001525879" RAT_FUNC "%.4g" "%" COEFFS 0 1 0 0 0 0.0001525879 /end COMPU_METHOD
/begin COMPU_METHOD CM_0190 "X*0.0000915527" RAT_FUNC "%.4g" "-" COEFFS 0 1 0 0 0 9.15527e-05 /end COMPU_METHOD
/begin COMPU_METHOD CM_0192 "X*0.5" RAT_FUNC "%.4g" "l" COEFFS 0 1 0 0 0 0.5 /end COMPU_METHOD
/begin COMPU_METHOD CM_0193 "X*0.0002" RAT_FUNC "%.4g" "bar/V" COEFFS 0 1 0 0 0 0.0002 /end COMPU_METHOD
/begin COMPU_METHOD CM_0206 "X*0.001" RAT_FUNC "%.4g" "qcm" COEFFS 0 1 0 0 0 0.001 /end COMPU_METHOD
/begin COMPU_METHOD CM_0210 "X*0.0015625" RAT_FUNC "%.4g" "V" COEFFS 0 1 0 0 0 0.0015625 /end COMPU_METHOD
/begin COMPU_METHOD CM_0223 "X*0.1" RAT_FUNC "%.4g" "?KW/10ms" COEFFS 0 1 0 0 0 0.1 /end COMPU_METHOD
/begin COMPU_METHOD CM_0224 "X*0.006" RAT_FUNC "%.4g" "l/min" COEFFS 0 1 0 0 0 0.006 /end COMPU_METHOD
/begin COMPU_METHOD CM_0225 "X" RAT_FUNC "%.4g" "Hz" COEFFS 0 1 0 0 0 1 /end COMPU_METHOD
/begin COMPU_METHOD CM_0226 "X*0.0122070312" RAT_FUNC "%.4g" "mA/s" COEFFS 0 1 0 0 0 0.0122070312 /end COMPU_METHOD
/begin COMPU_METHOD CM_0227 "X*0.0390625" RAT_FUNC "%.4g" "mA/?KW" COEFFS 0 1 0 0 0 0.0390625 /end COMPU_METHOD
/begin COMPU_METHOD CM_0228 "X" RAT_FUNC "%.4g" "mA" COEFFS 0 1 0 0 0 1 /end COMPU_METHOD
/begin COMPU_METHOD CM_0229 "X*0.001" RAT_FUNC "%.4g" "Ohm" COEFFS 0 1 0 0 0 0.001 /end COMPU_METHOD
/begin COMPU_METHOD CM_0230 "X*0.01" RAT_FUNC "%.4g" "10exp-3" COEFFS 0 1 0 0 0 0.01 /end COMPU_METHOD
/begin COMPU_METHOD CM_0231 "X" RAT_FUNC "%.4g" "ASP" COEFFS 0 1 0 0 0 1 /end COMPU_METHOD
/begin COMPU_METHOD CM_0232 "X*0.03125" RAT_FUNC "%.4g" "mg" COEFFS 0 1 0 0 0 0.03125 /end COMPU_METHOD
/begin COMPU_METHOD CM_0233 "X/60" RAT_FUNC "%.4g" "min" COEFFS 0 60 0 0 0 1 /end COMPU_METHOD
/begin COMPU_METHOD CM_0234 "X" RAT_FUNC "%.4g" "segm" COEFFS 0 1 0 0 0 1 /end COMPU_METHOD
/begin COMPU_METHOD CM_0235 "X" RAT_FUNC "%.4g" "rpm" COEFFS 0 1 0 0 0 1 /end COMPU_METHOD
/begin COMPU_METHOD CM_0236 "X*0.00006103515625" RAT_FUNC "%.4g" "-" COEFFS 0 1 0 0 0 6.103515625e-05 /end COMPU_METHOD
/begin COMPU_METHOD CM_0237 "X*0.000030517578125" RAT_FUNC "%.4g" "-" COEFFS 0 1 0 0 0 3.051757812e-05 /end COMPU_METHOD
/begin COMPU_METHOD CM_0238 "X*2" RAT_FUNC "%.4g" "km" COEFFS 0 1 0 0 0 2 /end COMPU_METHOD
/begin COMPU_METHOD CM_0239 "X*0.0000152587890625" RAT_FUNC "%.4g" "-" COEFFS 0 1 0 0 0 1.525878906e-05 /end COMPU_METHOD
/begin COMPU_METHOD CM_0240 "X/1000" RAT_FUNC "%.4g" "bar" COEFFS 0 1000 0 0 0 1 /end COMPU_METHOD
/begin COMPU_METHOD CM_0241 "X*75/256" RAT_FUNC "%.4g" "mm" COEFFS 0 256 0 0 0 75 /end COMPU_METHOD
/begin COMPU_METHOD CM_0243 "X/10" RAT_FUNC "%.4g" "?C" COEFFS 0 10 0 0 0 1 /end COMPU_METHOD
/begin COMPU_METHOD CM_0245 "X*32/32768" RAT_FUNC "%.4g" "-" COEFFS 0 1024 0 0 0 1 /end COMPU_METHOD
/begin COMPU_METHOD CM_0247 "X/100" RAT_FUNC "%.4g" "s" COEFFS 0 100 0 0 0 1 /end COMPU_METHOD
/begin COMPU_METHOD CM_0251 "X/20.97152" RAT_FUNC "%.4g" "%/bar" COEFFS 0 1 0 0 0 0.04768371582 /end COMPU_METHOD
/begin COMPU_METHOD CM_0252 "X/8" RAT_FUNC "%.4g" "l/h" COEFFS 0 8 0 0 0 1 /end COMPU_METHOD
/begin COMPU_METHOD CM_0254 "(X*100)/1024" RAT_FUNC "%.4g" "%" COEFFS 0 256 0 0 0 25 /end COMPU_METHOD
/begin COMPU_METHOD CM_0255 "X/10" RAT_FUNC "%.4g" "kg/h" COEFFS 0 10 0 0 0 1 /end COMPU_METHOD
/begin COMPU_METHOD CM_0256 "(X-2732)/10" RAT_FUNC "%.4g" "?C" COEFFS 0 10 2732 0 0 1 /end COMPU_METHOD
/begin COMPU_METHOD CM_0257 "X/2" RAT_FUNC "%.4g" "l" COEFFS 0 2 0 0 0 1 /end COMPU_METHOD
/begin COMPU_METHOD CM_0258 "X*0.1-273.2" RAT_FUNC "%.4g" "degC" COEFFS 0 1 273.2 0 0 0.1 /end COMPU_METHOD
/begin COMPU_METHOD CM_0259 "X/16384" RAT_FUNC "%.4g" "-" COEFFS 0 16384 0 0 0 1 /end COMPU_METHOD
/begin COMPU_METHOD CM_0260 "X/16" RAT_FUNC "%.4g" "km/h" COEFFS 0 16 0 0 0 1 /end COMPU_METHOD
/begin COMPU_METHOD CM_0261 "X*5000/1024" RAT_FUNC "%.4g" "mV/10ms" COEFFS 0 128 0 0 0 625 /end COMPU_METHOD
/begin COMPU_METHOD CM_0262 "X*5000/1024" RAT_FUNC "%.4g" "mV" COEFFS 0 128 0 0 0 625 /end COMPU_METHOD
/begin COMPU_METHOD CM_0263 "X/3600" RAT_FUNC "%.4g" "g" COEFFS 0 3600 0 0 0 1 /end COMPU_METHOD
/begin COMPU_METHOD CM_0264 "X/16384" RAT_FUNC "%.4g" "-/10ms" COEFFS 0 16384 0 0 0 1 /end COMPU_METHOD
/begin COMPU_METHOD CM_0266 "X/1000" RAT_FUNC "%.4g" "Wok/s" COEFFS 0 1000 0 0 0 1 /end COMPU_METHOD
/begin COMPU_METHOD CM_0267 "X/10000" RAT_FUNC "%.4g" "Wok" COEFFS 0 10000 0 0 0 1 /end COMPU_METHOD
/begin COMPU_METHOD CM_0268 "X*10" RAT_FUNC "%.4g" "rpm/s" COEFFS 0 1 0 0 0 10 /end COMPU_METHOD
/begin COMPU_METHOD CM_0269 "X/128" RAT_FUNC "%.4g" "-" COEFFS 0 128 0 0 0 1 /end COMPU_METHOD
/begin COMPU_METHOD CM_0271 "X*100/32768" RAT_FUNC "%.4g" "%" COEFFS 0 8192 0 0 0 25 /end COMPU_METHOD
/begin COMPU_METHOD CM_0273 "X*10/16384" RAT_FUNC "%.4g" "1/s" COEFFS 0 8192 0 0 0 5 /end COMPU_METHOD
/begin COMPU_METHOD CM_0276 "X/10" RAT_FUNC "%.4g" "%" COEFFS 0 10 0 0 0 1 /end COMPU_METHOD
/begin COMPU_METHOD CM_0280 "X/10" RAT_FUNC "%.4g" "?KW" COEFFS 0 10 0 0 0 1 /end COMPU_METHOD
/begin COMPU_METHOD CM_0282 "X/10000" RAT_FUNC "%.4g" "-" COEFFS 0 10000 0 0 0 1 /end COMPU_METHOD
/begin COMPU_METHOD CM_0291 "X/16" RAT_FUNC "%.4g" "mbar" COEFFS 0 16 0 0 0 1 /end COMPU_METHOD
/begin COMPU_METHOD CM_0292 "X" RAT_FUNC "%.4g" "KW tooth" COEFFS 0 1 0 0 0 1 /end COMPU_METHOD
/begin COMPU_METHOD CM_0293 "X" RAT_FUNC "%.4g" "Zaehne/Asp" COEFFS 0 1 0 0 0 1 /end COMPU_METHOD
/begin COMPU_METHOD CM_0294 "1000000/X" RAT_FUNC "%.4g" "Hz" COEFFS 0 0 -1000000 0 -1 0 /end COMPU_METHOD
/begin COMPU_METHOD CM_0295 "X" RAT_FUNC "%.4g" "mA/10ms" COEFFS 0 1 0 0 0 1 /end COMPU_METHOD
/begin COMPU_METHOD CM_0301 "X/10" RAT_FUNC "%.4g" "s" COEFFS 0 10 0 0 0 1 /end COMPU_METHOD
/begin COMPU_METHOD CM_0312 "X/327.68" RAT_FUNC "%.4g" "%" COEFFS 0 1 0 0 0 0.003051757812 /end COMPU_METHOD
/begin COMPU_METHOD CM_0316 "X" RAT_FUNC "%.4g" "pksr_cfg.equ" COEFFS 0 1 0 0 0 1 /end COMPU_METHOD
/begin COMPU_METHOD CM_0317 "X/10" RAT_FUNC "%.4g" "bar/s" COEFFS 0 10 0 0 0 1 /end COMPU_METHOD
/begin COMPU_METHOD CM_0323 "X/10" RAT_FUNC "%.4g" "Kelvin" COEFFS 0 10 0 0 0 1 /end COMPU_METHOD
/begin COMPU_METHOD CM_0324 "6553.5/X" RAT_FUNC "%.4g" "s" COEFFS 0 0 -6553.5 0 -1 0 /end COMPU_METHOD
/begin COMPU_METHOD CM_0333 "X/80" RAT_FUNC "%.4g" "[]" COEFFS 0 80 0 0 0 1 /end COMPU_METHOD
/begin COMPU_METHOD CM_0348 "X" RAT_FUNC "%.4g" "0" COEFFS 0 1 0 0 0 1 /end COMPU_METHOD
/begin COMPU_METHOD CM_0359 "(X/10)-10" RAT_FUNC "%.4g" "Liter" COEFFS 0 10 100 0 0 1 /end COMPU_METHOD
/begin COMPU_METHOD CM_0380 "X*0.01666666667" RAT_FUNC "%.4g" "min" COEFFS 0 1 0 0 0 0.01666666667 /end COMPU_METHOD
/begin COMPU_METHOD CM_0384 "X*0.1" RAT_FUNC "%.4g" "???KW" COEFFS 0 1 0 0 0 0.1 /end COMPU_METHOD
/begin COMPU_METHOD CM_0401 "X*10" RAT_FUNC "%.4g" "-" COEFFS 0 1 0 0 0 10 /end COMPU_METHOD
/begin COMPU_METHOD CM_0403 "X*0.00390625" RAT_FUNC "%.4g" "V" COEFFS 0 1 0 0 0 0.00390625 /end COMPU_METHOD
/begin COMPU_METHOD CM_0411 "X*0.001" RAT_FUNC "%.4g" "dm**3" COEFFS 0 1 0 0 0 0.001 /end COMPU_METHOD
/begin COMPU_METHOD CM_0412 "X*0.001" RAT_FUNC "%.4g" "Kg/m**3" COEFFS 0 1 0 0 0 0.001 /end COMPU_METHOD
/begin COMPU_METHOD CM_0413 "X*0.5" RAT_FUNC "%.4g" "Segmente" COEFFS 0 1 0 0 0 0.5 /end COMPU_METHOD
/begin COMPU_METHOD CM_0417 "X" RAT_FUNC "%.4g" "[]" COEFFS 0 1 0 0 0 1 /end COMPU_METHOD
/begin COMPU_METHOD CM_0423 "X/4" RAT_FUNC "%.4g" "m/s*s" COEFFS 0 4 0 0 0 1 /end COMPU_METHOD
/begin COMPU_METHOD CM_0432 "X*75/512" RAT_FUNC "%.4g" "mm" COEFFS 0 512 0 0 0 75 /end COMPU_METHOD
/begin COMPU_METHOD CM_0433 "164/X" RAT_FUNC "%.4g" "s" COEFFS 0 0 -164 0 -1 0 /end COMPU_METHOD
/begin COMPU_METHOD CM_0434 "X" RAT_FUNC "%.4g" "[A_E]" COEFFS 0 1 0 0 0 1 /end COMPU_METHOD
/begin COMPU_METHOD CM_0435 "X/10" RAT_FUNC "%.4g" "[A_E]" COEFFS 0 10 0 0 0 1 /end COMPU_METHOD
/begin COMPU_METHOD CM_0436 "X/10" RAT_FUNC "%.4g" "[A_E][j]" COEFFS 0 10 0 0 0 1 /end COMPU_METHOD
/begin COMPU_METHOD CM_0437 "X/25600" RAT_FUNC "%.4g" "[A_E]" COEFFS 0 25600 0 0 0 1 /end COMPU_METHOD
/begin COMPU_METHOD CM_0466 "X*2" RAT_FUNC "%.4g" "s" COEFFS 0 1 0 0 0 2 /end COMPU_METHOD
/begin RECORD_LAYOUT RL_AXP_SB NO_AXIS_PTS_X 1 UBYTE RESERVED 2 BYTE AXIS_PTS_X 3 SBYTE INDEX_INCR DIRECT /end RECORD_LAYOUT
/begin RECORD_LAYOUT RL_AXP_SW NO_AXIS_PTS_X 1 UBYTE RESERVED 2 BYTE AXIS_PTS_X 3 SWORD INDEX_INCR DIRECT /end RECORD_LAYOUT
/begin RECORD_LAYOUT RL_CUR_SB_SB FNC_VALUES 4 SBYTE COLUMN_DIR DIRECT AXIS_PTS_X 3 SBYTE INDEX_INCR DIRECT NO_AXIS_PTS_X 1 UBYTE RESERVED 2 BYTE /end RECORD_LAYOUT
/begin RECORD_LAYOUT RL_CUR_SW_SB FNC_VALUES 4 SBYTE COLUMN_DIR DIRECT AXIS_PTS_X 3 SWORD INDEX_INCR DIRECT NO_AXIS_PTS_X 1 UBYTE RESERVED 2 BYTE /end RECORD_LAYOUT
/begin RECORD_LAYOUT RL_CUR_SW_SW FNC_VALUES 4 SWORD COLUMN_DIR DIRECT AXIS_PTS_X 3 SWORD INDEX_INCR DIRECT NO_AXIS_PTS_X 1 UBYTE RESERVED 2 BYTE /end RECORD_LAYOUT
/begin RECORD_LAYOUT RL_CUR_SW_UB FNC_VALUES 4 UBYTE COLUMN_DIR DIRECT AXIS_PTS_X 3 SWORD INDEX_INCR DIRECT NO_AXIS_PTS_X 1 UBYTE RESERVED 2 BYTE /end RECORD_LAYOUT
/begin RECORD_LAYOUT RL_CUR_SW_UW FNC_VALUES 4 UWORD COLUMN_DIR DIRECT AXIS_PTS_X 3 SWORD INDEX_INCR DIRECT NO_AXIS_PTS_X 1 UBYTE RESERVED 2 BYTE /end RECORD_LAYOUT
/begin RECORD_LAYOUT RL_CUR_UB_SW FNC_VALUES 4 SWORD COLUMN_DIR DIRECT AXIS_PTS_X 3 UBYTE INDEX_INCR DIRECT NO_AXIS_PTS_X 1 UBYTE RESERVED 2 BYTE /end RECORD_LAYOUT
/begin RECORD_LAYOUT RL_CUR_UB_UB FNC_VALUES 4 UBYTE COLUMN_DIR DIRECT AXIS_PTS_X 3 UBYTE INDEX_INCR DIRECT NO_AXIS_PTS_X 1 UBYTE RESERVED 2 BYTE /end RECORD_LAYOUT
/begin RECORD_LAYOUT RL_CUR_UW_SW FNC_VALUES 4 SWORD COLUMN_DIR DIRECT AXIS_PTS_X 3 UWORD INDEX_INCR DIRECT NO_AXIS_PTS_X 1 UBYTE RESERVED 2 BYTE /end RECORD_LAYOUT
/begin RECORD_LAYOUT RL_CUR_UW_UB FNC_VALUES 4 UBYTE COLUMN_DIR DIRECT AXIS_PTS_X 3 UWORD INDEX_INCR DIRECT NO_AXIS_PTS_X 1 UBYTE RESERVED 2 BYTE /end RECORD_LAYOUT
/begin RECORD_LAYOUT RL_CUR_UW_UW FNC_VALUES 4 UWORD COLUMN_DIR DIRECT AXIS_PTS_X 3 UWORD INDEX_INCR DIRECT NO_AXIS_PTS_X 1 UBYTE RESERVED 2 BYTE /end RECORD_LAYOUT
/begin RECORD_LAYOUT RL_GRP_SW_R FNC_VALUES 1 SWORD ROW_DIR DIRECT /end RECORD_LAYOUT
/begin RECORD_LAYOUT RL_GRP_UW_C FNC_VALUES 1 UWORD COLUMN_DIR DIRECT /end RECORD_LAYOUT
/begin RECORD_LAYOUT RL_GRP_UW_R FNC_VALUES 1 UWORD ROW_DIR DIRECT /end RECORD_LAYOUT
/begin RECORD_LAYOUT RL_MAP_SW_SW_SW FNC_VALUES 5 SWORD COLUMN_DIR DIRECT AXIS_PTS_X 3 SWORD INDEX_INCR DIRECT AXIS_PTS_Y 4 SWORD INDEX_INCR DIRECT NO_AXIS_PTS_X 1 UBYTE NO_AXIS_PTS_Y 2 UBYTE /end RECORD_LAYOUT
/begin RECORD_LAYOUT RL_MAP_SW_SW_UW FNC_VALUES 5 UWORD COLUMN_DIR DIRECT AXIS_PTS_X 3 SWORD INDEX_INCR DIRECT AXIS_PTS_Y 4 SWORD INDEX_INCR DIRECT NO_AXIS_PTS_X 1 UBYTE NO_AXIS_PTS_Y 2 UBYTE /end RECORD_LAYOUT
/begin RECORD_LAYOUT RL_MAP_SW_UW_SW FNC_VALUES 5 SWORD COLUMN_DIR DIRECT AXIS_PTS_X 3 SWORD INDEX_INCR DIRECT AXIS_PTS_Y 4 UWORD INDEX_INCR DIRECT NO_AXIS_PTS_X 1 UBYTE NO_AXIS_PTS_Y 2 UBYTE /end RECORD_LAYOUT
/begin RECORD_LAYOUT RL_MAP_UW_SW_SW FNC_VALUES 5 SWORD COLUMN_DIR DIRECT AXIS_PTS_X 3 UWORD INDEX_INCR DIRECT AXIS_PTS_Y 4 SWORD INDEX_INCR DIRECT NO_AXIS_PTS_X 1 UBYTE NO_AXIS_PTS_Y 2 UBYTE /end RECORD_LAYOUT
/begin RECORD_LAYOUT RL_MAP_UW_UW_UW FNC_VALUES 5 UWORD COLUMN_DIR DIRECT AXIS_PTS_X 3 UWORD INDEX_INCR DIRECT AXIS_PTS_Y 4 UWORD INDEX_INCR DIRECT NO_AXIS_PTS_X 1 UBYTE NO_AXIS_PTS_Y 2 UBYTE /end RECORD_LAYOUT
/begin RECORD_LAYOUT RL_VAL_SB FNC_VALUES 1 SBYTE COLUMN_DIR DIRECT /end RECORD_LAYOUT
/begin RECORD_LAYOUT RL_VAL_SL FNC_VALUES 1 SLONG COLUMN_DIR DIRECT /end RECORD_LAYOUT
/begin RECORD_LAYOUT RL_VAL_SW FNC_VALUES 1 SWORD COLUMN_DIR DIRECT /end RECORD_LAYOUT
/begin RECORD_LAYOUT RL_VAL_UB FNC_VALUES 1 UBYTE COLUMN_DIR DIRECT /end RECORD_LAYOUT
/begin RECORD_LAYOUT RL_VAL_UL FNC_VALUES 1 ULONG COLUMN_DIR DIRECT /end RECORD_LAYOUT
/begin RECORD_LAYOUT RL_VAL_UW FNC_VALUES 1 UWORD COLUMN_DIR DIRECT /end RECORD_LAYOUT
/begin GROUP G_1_Fuel___maps "1 Fuel - maps" ROOT
 /begin REF_CHARACTERISTIC KF_TI_GRUND_F KF_TI_LAA_OFFS_WICHT_F KF_TI_MKS_START KF_TI_MKS_START_MSA KF_TI_NS_PUMG_TAN_F KF_TI_PHI_ENDE_GRUND KF_TI_PHI_ENDE_OFFS KF_TI_SOLL_MIN KF_TI_SOLL_UB_OFFS KF_TI_START_N_F KF_TI_WL_KORR_F KF_TI_WL_KORR_F_KH KF_TI_WL_KORR_HOEHE_F KF_TI_WL_OFFS KF_TI_WL_OFFS_KH KL_TI_NS_VERLUSTE KL_TI_PHI_ENDE_ES KL_TI_PHI_ENDE_F KL_TI_PHI_ENDE_GRAD KL_TI_PHI_ENDE_START KL_TI_PHI_EV_WURZEL KL_TI_SOLL_LIN_OFFS KL_TI_SOLL_QSTAT_F KL_TI_SOLL_RHO_F KL_TI_SOLL_UB_OFFS_T_KORR_F KL_TI_START_PUMG_F KF_PKSR_PSOLL_QSOLL_TV KF_PKSR_RF_N_PSOLL KL_PKSR_100P_DAUER_TMOT KL_PKSR_TKSM_PSOLL KL_PKSR_TV_HARDWARE KL_PKS_TAU_MODELL KF_PSAU_LLS_NOTL KF_PSAU_SR KF_PSAU_LLS KL_RG_UES_A_MEAN KF_RF_PT_PUMG_WICHT KL_RF_PT_PUMG_KORR KL_RF_PT_TANZYL_KORR KL_RF_PT_TAN_KORR KF_WF_ASP_NEG KF_WF_ASP_POS KF_WF_MKS_AKTIV_NEG KF_WF_MKS_AKTIV_POS KF_WF_MKS_BEGR_NEG KF_WF_MKS_BEGR_POS KF_WF_SOLL_F_SA KF_WF_SOLL_F_VAN KL_WF_ASP_NEG_START KL_WF_ASP_POS_START KL_WF_DMKS_T1_MS KL_WF_MKS_BEGR_NEG_WICHT KL_WF_SOLL_F_PUMG KL_WF_SOLL_F_TI_PHI_ENDE KL_TI_NS_TIME_F KL_TI_TU_F_WICHT KL_TI_WL_ABR_F KF_TI_NS_F KF_TI_NS_MSA_F KF_TI_WL_HOEHE_OFFS KF_TI_START_F KF_WF_MKS_START_MAX KF_WF_SOLL_GRUND KL_WF_SOLL_F_LAM GKF_TI_TU_F_ZYL1 GKF_TI_TU_F_ZYL2 GKF_TI_TU_F_ZYL3 GKF_TI_TU_F_ZYL4 GKF_TI_TU_F_ZYL5 GKF_TI_TU_F_ZYL6 GKF_TI_TU_F_ZYL7 GKF_TI_TU_F_ZYL8 GKF_TI_TU_F_ZYL9 GKF_TI_TU_F_ZYL10 KF_TI_START_F_GTS KL_TI_MKS_START_OFFS_GTS KL_WF_MKS_START_MAX_OFFS_GTS KL_PKSR_P_FAKTOR KL_PKSR_I_FAKTOR KL_PKSR_QSSP_PKS KL_PKSR_QDR /end REF_CHARACTERISTIC
/end GROUP
/begin GROUP G_1_Fuel___settings "1 Fuel - settings" ROOT
 /begin REF_CHARACTERISTIC K_TI_GA K_TI_GRUND_STOECH K_TI_MAX_OFFS K_TI_MIN_MAX_HYS K_TI_PHI_ENDE_A_SAUG K_TI_PHI_ENDE_A_ZYL K_TI_PHI_ENDE_ROH_KST K_TI_PHI_ENDE_S_ESV_EV K_TI_PHI_ENDE_S_HUB K_PKSR_PERIOD K_PKS_STEIGUNG K_WF_MKS_TI_CFG K_WF_SOLL_START_PSAU K_WF_SOLL_START_PSAU_CFG K_WF_MKS_AUS_HYS K_WF_ASP_START K_TI_NMIN_KL50OFF K_TI_OFF_CFG K_TI_PHI_ENDE_MIN K_TI_MIN_OFF_TIME K_TI_RF_MAX_DLY K_TI_MKS_TE_CFG K_TI_MKS_LWV_CFG K_TI_NS_CFG K_TI_MKS_START_CFG K_PKS_MDL_CFG K_PKSR_START_RL_PKS_REL_MAX K_PKSR_PSOLL_MECH K_PKSR_P_SSP_SA K_PKSR_I_ANTEIL_MIN K_PKSR_I_ANTEIL_MAX K_PKSR_TMIN_EKP2 K_PKSR_N_EKP2 K_PKSR_N_HYS_EKP2 K_PKSR_MLSOLL_EKP2 K_PKSR_MLSOLL_HYS_EKP2 K_PKSR_MAX_TV_GEREGELT K_PKSR_START_RL_TMOT_MAX K_PKS_OFFSET K_PKS_TAU K_PKS_TAU_EKP100 K_PKS_ERSATZ K_PKSR_CFG K_PKSR_EKP_100_PSOLL_RAMPE K_PKSR_T_VORLAUF K_PKSR_T_ABST K_PKSR_START_RL_T_DELAY K_PKSR_ADAP_RESET K_PKSR_ADAP_OFF_MAX K_PKSR_ADAP_OFF_MIN K_PKSR_ADAP_FAK_MIN K_PKSR_ADAP_FAK_MAX K_PSAU_STEIGUNG K_PSAU_OFFSET K_PSAU_ADAPT_MAX K_PSAU_ADAPT_MIN K_PSAU_TAU K_PSAU_SENSOR_CFG K_PSAU_CFG K_PSAU_WF_DLY K_PSAU_RF_MAX K_PSAU_RF_MIN K_PSAU_SR_REF K_PSAU_SR_CFG K_BNSMAX K_MZYL_CFG K_MZYL_START_CFG K_PKSR_ADAP_DELTA_OFF K_PKSR_ADAP_FAK_ML_MIN K_PKSR_EKP_VORL_RESET K_RF_DYN_TAU K_RF_HUBVOLUMEN K_RF_LUFTDICHTE K_RF_ST_LL_RAMP K_TIME_SET_1 K_TIME_SET_2 K_TI_MAX_RESET K_RAM_CHK_CFG K_TI_WL_CFG /end REF_CHARACTERISTIC
/end GROUP
/begin GROUP G_2_Lambda___exhaust_temp___maps "2 Lambda & exhaust temp - maps" ROOT
 /begin REF_CHARACTERISTIC KL_KATS_LAM_I KL_KATS_MDL_LAM_OFFS KL_KATS_NKAT_LAM_OFFS KL_KATS_VKAT_LAM_OFFS KF_LA_TRIM_AD_WICHT KF_LA_TRIM_I KF_LA_TRIM_I_DLY KF_LA_TRIM_P KF_LA_TRIM_P_ABR KF_LA_TRIM_P_DLY KF_LA_TRIM_P_WAIT KF_LA_TRIM_USN_SOLL KL_LA_TRIM_RF_MIN KF_LANK_US_TAU_L KF_LAM_REG_K KF_LAM_REG_KORR_F KF_LAM_REG_WF_MKS_REL_MAX KF_LAM_REG_WF_VERZ_F KF_LAM_SOLL_AUSS_KATS KF_LAM_SOLL_AUSS_OFFS KF_LAM_SOLL_GRUND_PST KF_LAM_SOLL_GRUND KF_LAM_SOLL_KR_KATS_OFFS KF_LAM_SOLL_MS_KAT_SOLL_MAX KF_LAM_SOLL_MS_KAT_SOLL_MIN KF_LAM_SOLL_TAU1_ABG KF_LAM_SOLL_WL KF_LAM_SOLL_WL_F KF_LAVK_FILT_T1 KL_LAM_IST KL_LAM_REG_RESET_SA_ML_SUM KL_LAM_REG_T_SA_VERZ KL_LAM_SOLL_ADD_KAT_ALT_F KL_LAM_SOLL_AUSS_F KL_LAM_SOLL_START KL_LAM_SOLL_VL KL_LAVK_IST_F KL_LAVK_IST_OFFS KL_LAVK_P_KORR_F_FETT KL_LAVK_P_KORR_F_MAGER KL_LAVK_T_KORR_F KF_LSHNK_TA_MAX KL_LSHNK_RF_AUS KL_LSHNK_SOND_TEMP KL_LSHNK_TA KL_LSHNK_T_EIN KL_LSHNK_UB_KORR KL_PABG_STAT_ML KL_LAM_SOLL_MS_KAT_MAX KL_LAM_SOLL_MS_KAT_SOLL_HYS KL_LAM_SOLL_MS_KAT_INIT_MSA KL_LAM_SOLL_VL_GRAD KL_LA_TRIM_RF_MAX KL_LA_TRIM_I_GMW_RF_MIN KL_LA_TRIM_I_GMW_RF_MAX KL_LA_TRIM_USN_OFFSET_KM KL_LA_TRIM_DELTA_P_ZW_ML KL_LA_TRIM_DELTA_P_ZW_KAT KL_LA_TRIM_DELTA_P_ZW_US_DIFF KL_LA_TRIM_AD_ZW_AD_STEP KF_LAM_SOLL_WL_TMOT_MAX KF_LAM_SOLL_KH_OSL_F KF_LAM_SOLL_KH_OSL KF_LAM_SOLL_PULS_OFFS_AUSR KF_LAM_SOLL_ADD_KONV KL_LAM_REG_TI_IST_MIN /end REF_CHARACTERISTIC
/end GROUP
/begin GROUP G_2_Lambda___exhaust_temp___settings "2 Lambda & exhaust temp - settings" ROOT
 /begin REF_CHARACTERISTIC K_KATS_T_MAX K_KATS_T_MAX_PST K_LA_TRIM_FKT_CFG K_LA_TRIM_I_GMW_DLY K_LA_TRIM_I_GMW_MAX K_LA_TRIM_I_GMW_MIN K_LA_TRIM_I_GMW_TAU K_LA_TRIM_US_EINGESCHW K_LANK_FETT K_LANK_MAGER K_LANK_T_AUS K_LANK_T_EIN K_LANK_USF K_LANK_USM K_LANK_US_FILT_OB K_LANK_US_FILT_T K_LANK_US_FILT_UNT K_LANK_US_TAU K_LANK_US_TAU_S K_LAA_CFG K_LAA_F_N_MAX K_LAA_F_N_MIN K_LAA_F_RF_MAX K_LAA_F_RF_MIN K_LAA_F_TE_N_MAX K_LAA_F_TE_RF_MAX K_LAA_F_T_ADAPT K_LAA_OFFS_N_MAX K_LAA_OFFS_RF_MAX K_LAA_PKS_MAX K_LAA_RESET_CFG K_LAA_TAN_MAX K_LAA_TMOT_MIN K_LAM_REG_DELTA_MAX K_LAM_REG_DELTA_MIN K_LAM_REG_DELTA_STAT_MAX K_LAM_REG_DELTA_STAT_MAX_TE K_LAM_REG_DELTA_STAT_TRIM K_LAM_REG_F_MAX K_LAM_REG_F_MIN K_LAM_REG_IST_MW_MAX K_LAM_REG_IST_MW_MIN K_LAM_REG_RESET_SA_TMOT_MIN K_LAM_REG_SOLL_MAX K_LAM_REG_SOLL_MIN K_LAM_REG_TN_TU_F K_LAM_REG_TV_TU_F K_LAM_REG_T_SLP_VERZ K_LAM_SOLL_KONV_CFG K_LAVK_AD_GAIN_CNT_MIN K_LAVK_AD_MAX K_LAVK_AD_MIN K_LAVK_AD_OFFS_CNT K_LAVK_AD_OFFS_CNT_MIN K_LAVK_AD_OFFS_CNT_MIN_MS K_LAVK_AD_OFFS_CNT_MS K_LAVK_ATIC42_ICP_ENABLE_B1 K_LAVK_ATIC42_ICP_ENABLE_B2 K_LAVK_ATIC42_ICP_VALUE_B1 K_LAVK_ATIC42_ICP_VALUE_B2 K_LAVK_ATIC42_IP_OFFSET_MEAS_B1 K_LAVK_ATIC42_IP_OFFSET_MEAS_B2 K_LAVK_ATIC42_PIN_CFG_B1 K_LAVK_ATIC42_PIN_CFG_B2 K_LAVK_ATIC42_PROTEC_TIME_B1 K_LAVK_ATIC42_PROTEC_TIME_B2 K_LAVK_ATIC42_RI_CALIB_B1 K_LAVK_ATIC42_RI_CALIB_B2 K_LAVK_ATIC42_RI_MEAS_FREQ_B1 K_LAVK_ATIC42_RI_MEAS_FREQ_B2 K_LAVK_ATIC42_RI_OSCI_B1 K_LAVK_ATIC42_RI_OSCI_B2 K_LAVK_ATIC42_SENSOR_B1 K_LAVK_ATIC42_SENSOR_B2 K_LAVK_FILT_CFG K_LAVK_GAIN_LAM_SCHW K_LAVK_R7 K_LAVK_US_REF K_LSHNK_AKTIV_T K_PABG_STAT_TAU K_LAM_SOLL_MAX K_LAM_SOLL_MIN K_LAM_SOLL_FILT_F K_LAM_SOLL_WL_TMOT_HYS K_LAM_SOLL_KATH_T_ML_MAX K_LAM_SOLL_KATH_DELTA_POS K_LAM_SOLL_KATH_DELTA_NEG K_LAM_SOLL_WL_DELTA_POS K_LAM_SOLL_WL_DELTA_NEG K_LAM_SOLL_MS_KAT_MIN K_LAM_SOLL_FETT_ERK K_LAM_SOLL_O2_ANT K_LAM_SOLL_PULS_O2_HYST K_LAM_SOLL_PULS_TMOT K_LAM_SOLL_PULS_AUSR_TMOT_MIN K_LAM_SOLL_PULS_AUSR_SL_T K_LAM_SOLL_PULS_LANK_MAX K_LAM_SOLL_PULS_LANK_MIN K_LAM_SOLL_T_MSA_STOP_MIN K_LAM_SOLL_T_SA_SLP_MIN K_LAM_SOLL_T_FETT_MIN K_LAM_SOLL_ADD_KONV_GRAD K_LAM_SOLL_KR_KATS K_LAM_SOLL_OFFS_MCS K_LAM_SOLL_PULS_AUSR_CFG K_LAM_SOLL_PULS_AUSR_SL_CFG K_LAM_SOLL_PULS_LANK_CFG K_LAM_SOLL_FILT_INIT_CFG K_LA_TRIM_TABG_NKAT K_LA_TRIM_TAN_MIN K_LA_TRIM_TAN_MAX K_LA_TRIM_TE_C_AKF_MAX K_LA_TRIM_LAM_DELTA_MAX K_LA_TRIM_V_SCHWELLE K_LA_TRIM_P_MAX K_LA_TRIM_P_MIN K_LA_TRIM_I_MAX K_LA_TRIM_I_MIN K_LA_TRIM_US_SOLL_GRAD K_LA_TRIM_US_O2_MAX K_LA_TRIM_US_O2_MIN K_LA_TRIM_DLY_T K_LA_TRIM_DYN_T K_LA_TRIM_I_ML_ADAPT K_LA_TRIM_AD_ZW_ML_INT_MIN K_LA_TRIM_AD_ZW_ML_INT_FREIG K_LA_TRIM_I_AD_F K_LA_TRIM_I_AD_MAX K_LA_TRIM_I_AD_MIN K_LA_TRIM_I_AD_MAX_BEGR K_LA_TRIM_I_AD_MIN_BEGR K_LA_TRIM_I_AD_HYS K_LA_TRIM_ZW_C_AKF_MAX K_LA_TRIM_ZW_P_MAX K_LA_TRIM_ZW_P_MAX_HYS K_LA_TRIM_ZW_I_AD_MAX_SCHW K_LA_TRIM_ZW_I_AD_MIN_SCHW K_LA_TRIM_ZW_I_AD_GRAD_PASSIV K_KATS_LAM_MIN K_KATS_LAM_GRAD_NEG K_KATS_LAM_GRAD_POS K_KATS_I_MAX K_KATS_I_MIN K_KATS_TABG_LW_KORR_MAX K_KATS_T_LAM_MIN K_KATS_TKAT_MESS_MAX K_LSHNK_UB_MAX K_LSHNK_T_MSA_MAX K_LSHNK_TKAT_MAX K_LSHNK_TAUP K_LSHNK_TABG_MSA_MIN K_LSHNK_RF_HYS K_LAVK_AD_GAIN_ML_SUM_SA_MIN K_LANK_N_MAX K_LANK_N_MIN K_LANK_RF_MAX K_LANK_RF_MIN K_LANK_TKAT_SCHW K_LA_TRIM_CFG K_LA_TRIM_P_ANZ_MAX K_LA_TRIM_US_EINGER K_LAVK_US_LUFT_REF K_KGE_LL_T_DELAY K_KGE_SEG_IDX_INTG_2of2_ K_LAA_F_GRAD K_LAA_F_MAX K_LAA_F_MCS_B1 K_LAA_F_MCS_B2 K_LAA_F_MIN K_LAA_F_TE_GRAD K_LAA_F_TE_MAX K_LAA_F_TE_MIN K_LAA_F_TE_RAMPE K_LAA_F_TE_T_ADAPT K_LAA_LAM_REG_F_DELTA K_LAA_OFFS_GRAD K_LAA_OFFS_MAX K_LAA_OFFS_MCS_B1 K_LAA_OFFS_MCS_B2 K_LAA_OFFS_MIN K_LAA_OFFS_T_ADAPT K_LAA_TI_IST_MIN K_LAM_REG_CFG K_LAM_REG_RESET_CFG K_LAM_REG_T_SA_VERZ K_LAVK_AD_GAIN_CNT K_LAVK_AD_GAIN_T K_LAVK_AD_OFFS_MAX K_LAVK_AD_OFFS_MIN K_LAVK_AD_OFFS_NV_MAX K_LAVK_AD_OFFS_NV_MIN K_LAVK_AD_OFFS_T K_LAVK_AD_OFFS_T1 K_LAVK_AD_RESET K_LA_TRIM_DYN_DELTA_RF K_LA_TRIM_DYN_RF_T K_LA_TRIM_I_AD_MCS K_LA_TRIM_P_US_OFFSET K_LBATTMAXM K_O2_LA_TRIM_CFG K_TVLOFHYST S_LORESLL S_MGAPP K_DFMAX K_LAM_REG_START_TIME K_LAVK_AD_GAIN_GRAD K_LAVK_AD_GAIN_MIN K_LAVK_AD_GAIN_ML_MIN K_LAVK_AD_GAIN_NV_MAX K_LAVK_AD_GAIN_NV_MIN K_LAVK_AD_GAIN_T1 K_LAVK_AD_OFFS_GRAD K_NLLMIN K_LA_TRIM_RF_HYS K_KATS_LAM_P_DELTA_MAX K_KATS_TABG_LW_KORR_HYS /end REF_CHARACTERISTIC
/end GROUP
/begin GROUP G_5_VANOS___maps "5 VANOS - maps" ROOT
 /begin REF_CHARACTERISTIC KF_VAN_KH_LL_SOLL_A KF_VAN_KH_SOLL_E KF_VAN_SOLL_A KF_VAN_SOLL_DMAX_A KF_VAN_SOLL_DMAX_E KF_VAN_SOLL_E KF_VAN_VST_VOL_MAX KF_VAN_XD_TAU KL_VAN_DSV_HOLD_TV KL_VAN_DSV_PEAK_TV KL_VAN_KI_FAKT KL_VAN_FREQU_ML KL_VAN_IST_DIFF_ASP_ZUL KL_VAN_KI_A KL_VAN_KI_E KL_VAN_KP_A KL_VAN_KP_E KL_VAN_KP_FAKT KL_VAN_SOLL_DMAX_WL_A KL_VAN_SOLL_DMAX_WL_E KL_VAN_T_DRUCK_E KL_VAN_T_START_DLY KL_VAN_VST_I KF_VAN_KH_SOLL_A KF_VAN_KH_SOLL_DMAX_A KF_VAN_KH_SOLL_DMAX_E KF_VAN_SOLL_BEGR_A KF_VAN_SOLL_BEGR_E KL_VAN_T_SOLL_BEGR KL_VAN_UNL_N KL_VAN_SOLL_BEGR_OFFS /end REF_CHARACTERISTIC
/end GROUP
/begin GROUP G_5_VANOS___settings "5 VANOS - settings" ROOT
 /begin REF_CHARACTERISTIC K_VAN_DSV_ABFALL_DLY K_VAN_DSV_CFG K_VAN_DSV_N_AUS K_VAN_DSV_N_EIN K_VAN_DSV_PEAK_TIME K_VAN_INVERT_A1 K_VAN_INVERT_A2 K_VAN_INVERT_E1 K_VAN_I_I_MAX K_VAN_I_I_MIN K_VAN_I_MAX K_VAN_R20 K_VAN_R_TK K_VAN_SMG_MD_ABBR K_VAN_SMG_MD_MIN K_VAN_SMG_N_ABBR K_VAN_SMG_N_MIN K_VAN_START_I_MAX_AUSLASS K_VAN_XD_EINGEREGELT K_VAN_XD_REG_MIN K_VAN_XD_SK K_VAN_KH_LL_CFG K_VAN_KH_LL_T_NS K_VAN_KH_LL_V K_VAN_KH_LL_V_HYS K_VAN_KH_LL_PUMG K_VAN_KH_LL_PUMG_HYS K_VAN_KH_LL_TMOT_MAX K_VAN_KH_LL_TMOT_MIN K_VAN_KH_LL_TUMG_MAX K_VAN_KH_LL_TUMG_MIN K_VAN_KW_SPR_MAX_E1 K_VAN_KW_SPR_MAX_A1 K_VAN_KW_SPR_MAX_A2 K_VAN_KP_XD_KORR_E K_VAN_KP_XD_KORR_A K_VAN_N_OFF K_VAN_N_ON K_VAN_RAD_MIN K_VAN_RAD_MAX K_VAN_FREQU_STAND K_VAN_FREQU_ANSCHL K_VAN_FREQU_SPUEL_MIN K_VAN_ANSCHL_TIME_ML K_VAN_CFG_E1 K_VAN_CFG_A1 K_VAN_CFG_A2 K_VAN_ANSCHL_I_E1 K_VAN_ANSCHL_I_A1 K_VAN_ANSCHL_I_A2 K_VAN_ANSCHL_I_RAMPE K_VAN_ANSCHL_I_START_MAX K_VAN_ANSCHL_T K_VAN_ANSCHL_HYS K_VAN_SMG_DAUER_MAX K_VAN_SMG_T_AUFREG K_VAN_TV_MCS_A1 K_VAN_TV_MCS_A2 K_VAN_TV_MCS_E1 K_VAN_UB_ERS K_VAN_ADAPT_RESET K_VAN_ANSCHL_DELTA K_VAN_BEGR_AB_FAKT K_VAN_SMG_MD_RF K_VAN_SOLL_ABSTELL_E K_VAN_SOLL_ABSTELL_A K_VAN_SOLL_ERSATZ_E K_VAN_SOLL_ERSATZ_A K_VAN_SOLL_MAX_E K_VAN_SOLL_MAX_A K_VAN_SOLL_MIN_E K_VAN_SOLL_MIN_A K_VAN_SOLL_OFFSET_E K_VAN_SOLL_OFFSET_A K_VAN_SPR_MAX_E K_VAN_SPR_MAX_A K_VAN_SPR_MAX_TOL_E K_VAN_SPR_MAX_TOL_A K_VAN_SPR_MIN_E K_VAN_SPR_MIN_A K_VAN_SPR_OFFSET_E1 K_VAN_SPR_OFFSET_A1 K_VAN_SPR_OFFSET_A2 K_VAN_SPUEL_CNT_MAX K_VAN_SPUEL_T K_VAN_SPUEL_WAIT K_VAN_SPUEL_XD K_VAN_SZ_E K_VAN_SZ_A K_VAN_TMOT_BEGR K_VAN_UNL_I_DYN_E K_VAN_UNL_I_DYN_A K_VAN_UNL_I_OFFS_E K_VAN_UNL_I_OFFS_A K_VAN_UNL_OFFS_E K_VAN_UNL_OFFS_A K_VAN_UNL_START_OFFS_E K_VAN_UNL_START_OFFS_A K_VAN_VST_CFG K_VAN_VST_VOL_DYN K_VAN_VST_VOL_F_E K_VAN_VST_VOL_F_A K_VAN_XD_FILT_ED_E K_VAN_XD_FILT_ED_A K_VAN_XD_FILT_WAIT K_VAN_XD_TAU_DYN K_VAN_XD_ABS_FILT_ED /end REF_CHARACTERISTIC
/end GROUP
/begin GROUP G_6_Torque___throttle___maps "6 Torque & throttle - maps" ROOT
 /begin REF_CHARACTERISTIC KL_SA_N_TMOT_DKG KF_SA_N_DYN_DKG KF_SA_T_TRIG_MAX KL_SA_N_DYN KL_SA_N_GANG_DKG KL_SA_N_HYS_GANG KL_SA_N_TMOT KL_SA_N_GANG KL_SA_N_HYS_GANG_DKG KL_SA_N_KKOS_GANG KL_SA_N_KKOS_GANG_DKG /end REF_CHARACTERISTIC
/end GROUP
/begin GROUP G_6_Torque___throttle___settings "6 Torque & throttle - settings" ROOT
 /begin REF_CHARACTERISTIC K_MDGNHYS K_MDGNMAX K_MDRV_P400_ONLY K_MDRV_P500_START K_MDRV_TBLINK K_MGMAXAPP K_MSA_Kl15OFF_T_LOW K_SA_MD_FW_REL_MIN K_SA_MD_HYS K_SA_MD_IND_NE_MIN K_SA_N_HYS K_SA_TKAT_MIN K_SA_TZ_MIN_HYS K_SA_WE_MD_HYS K_SA_MD_IND_NE_MAX K_SA_MSR_SPERRZEIT K_MDRV_CFG K_MDRV_CFG_KL15 K_MDRV_CFG_P400 K_MDRV_PTH_CNT_MAX K_MDRV_DSC K_MDRV_MOD_SMG K_MDRV_STG_SMG K_MDRV_ENG K_MDRV_EDCK K_MDRV_ALBV K_MDRV_HUD K_MDRV_EPAS K_MDRV_SHLI /end REF_CHARACTERISTIC
/end GROUP
/begin GROUP G_8_Limiters___launch___maps "8 Limiters & launch - maps" ROOT
 /begin REF_CHARACTERISTIC KL_N_BEGR_GANG KL_N_BEGR_GANG_DELTA_NEG KL_N_BEGR_HAGETR_HEISS KL_N_BEGR_SK KL_N_BEGR_TGETR_HEISS KL_N_BEGR_TI_OFFSET_GANG KL_N_BEGR_TMOT_HEISS KL_N_BEGR_TOEL_HEISS KL_N_BEGR_TOEL_KALT KL_V_MAX_GANG_BEGRENZT KL_V_MAX_GANG_CABRIO KL_V_MAX_GANG_COUPE KL_V_MAX_GANG_LIMOUSINE KL_V_MAX_GANG_TOURING KL_V_MAX_SK KL_N_BEGR_TI_OFFSET KL_N_BEGR_SLC_ABSTELL KL_N_BEGR_TI_OFFSET_RS KL_N_BEGR_GANG_HYS KF_N_BEGR_GANG_OFFS /end REF_CHARACTERISTIC
/end GROUP
/begin GROUP G_8_Limiters___launch___settings "8 Limiters & launch - settings" ROOT
 /begin REF_CHARACTERISTIC K_N_MAX_FF_RESET K_V_RAD_TOL_CFG K_N_BEGR_SLC_CFG K_N_BEGR_SLC_NINKR K_N_BEGR_SLC_NMAX K_N_BEGR_SLC_VINKR K_N_BEGR_SLC_WDRHLT K_N_BEGR_SLC_SINKR K_N_BEGR_SLC_CNT K_N_BEGR_SLC_DELTA_UP K_N_BEGR_SLC_DELTA_DN K_N_BEGR_EGAS_HYS K_N_BEGR_TI_HYS K_N_BEGR_CFG K_N_BEGR_TGETR_AEBGR_UP K_N_BEGR_TGETR_AEBGR_DOWN K_N_BEGR_HAGETR_AEBGR_UP K_N_BEGR_HAGETR_AEBGR_DOWN K_N_BEGR_GANG_DELTA_POS K_RS_HSG_CFG K_RS_HSG_N_MIN K_RS_HSG_N_GETR_MIN K_RS_HSG_V_MAX K_RS_HSG_V_VORNE_AUS K_RS_HSG_MD_REL_MIN K_RS_HSG_MD_REL_AUS K_RS_HSG_VORB_T_AN K_RS_HSG_VORB_T_AUS K_RS_HSG_T_AUS K_RS_TIME_MAX K_N_BEGR_FZG_STEHT K_N_BEGR_TI_OFF_RSS K_V_MAX_ANH_KM_STAND K_V_MAX_ANH_MAX_CNT K_V_MAX_FF_RESET K_V_MAX_MAX K_V_RAD_TOL_TAU K_N_BEGR_TI_HYS_RS_HS K_N_BEGR_TI_HYS_RS_DKG /end REF_CHARACTERISTIC
/end GROUP
/begin GROUP G_9_Engine_states___sensors___maps "9 Engine states & sensors - maps" ROOT
 /begin REF_CHARACTERISTIC KL_OZ_LGMW_OFFSET KL_DWF_SHLI_SEG KL_DWF_SHLI_V_DIFF KF_OZDREHKOR KF_OZDREHKOR_EINFAHR KF_OZKORRNIV KF_OZKORRORI KF_OZZEIT KL_OZBEFKL KL_OZKRZMW2 KL_OZLBNIV KL_OZLN KL_OZPERMKL KL_OZQBNIV KL_OZSTNIV KL_PERREFTKOR KL_TKTOENIV KL_TVTOEL KL_SLP_DAUER_TMOT_START KL_DMTL_FST_ERS_RE KL_DMTL_FST_MAX_STAND KL_DMTL_HOEHE_KORR KL_DMTL_I_REF_KORR KL_DMTL_KORR_FAKT KF_TANZYL_RATIO KL_TANZYL_ABREG KL_TANZYL_ML_GES_TAU KL_TKSM_ABREG KL_TKSM_MR_ABREG KL_TKSM_MR_TUMG_KAL KL_TKSM_Q_MOT_RATIO KL_TKSM_Q_MOT_TAU KL_ZUST_MD_TL_VL KL_OZTEMPKL KL_OZ_LL_Q_OFFSET KL_OZDREHKORI KL_OZDREHKORI_EINFAHR KL_DMTL_FST_ERS_LI KL_DMTL_T_FEIN_MIN KL_DMTL_T_GROB KL_DMTL_T_STABIL KL_OZNFDELTA KL_OELLEVEL_KOMBI KL_OZ_LL_L_OFFSET /end REF_CHARACTERISTIC
/end GROUP
/end MODULE
/end PROJECT
