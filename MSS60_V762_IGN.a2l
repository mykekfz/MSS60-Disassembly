ASAP2_VERSION 1 60
/begin PROJECT MSS60_V762_IGN "MSS60 (S65) V762 IGN CPU - production calibration 7848136 (V762.01-B500.02)"
/begin HEADER "Calibration description. Measurements: V530 RAM names transferred to V762 addresses (confidence in each long identifier). Status tag in every long identifier: verified (checked against the code) / A2L-ref (placed from the V530 A2L) / EST (estimated) / unassigned (unidentified)." VERSION "V762-RE-04112026" /end HEADER
/begin MODULE IGN "MSS60 V762 IGN"
/begin MOD_COMMON "" BYTE_ORDER MSB_FIRST ALIGNMENT_BYTE 1 ALIGNMENT_WORD 2 ALIGNMENT_LONG 4 /end MOD_COMMON
/begin CHARACTERISTIC K_ED_DK1_WDK.FEHLERSCHWELLE "Fault code DK1_WDK - debounce filter threshold for setting the fault [verified]" VALUE 0x70EF8 RL_VAL_UB 0 CM_0000 0 255 /end CHARACTERISTIC
/begin CHARACTERISTIC K_ED_DK1_WDK.INC_NACH_EINTRAG "Fault code DK1_WDK - debounce filter increment after fault-memory entry [verified]" VALUE 0x70EFC RL_VAL_UB 0 CM_0000 0 255 /end CHARACTERISTIC
/begin CHARACTERISTIC K_ED_DK1_WDK.INC_VOR_EINTRAG "Fault code DK1_WDK - debounce filter increment before fault-memory entry [verified]" VALUE 0x70EFA RL_VAL_UB 0 CM_0000 0 255 /end CHARACTERISTIC
/begin CHARACTERISTIC K_ED_DK1_WDK.KLASSENINDEX "Fault code DK1_WDK - fault class selection (lamp / warning behaviour) [verified]" VALUE 0x70EFE RL_VAL_UB 0 CM_0000 0 255 /end CHARACTERISTIC
/begin CHARACTERISTIC K_ED_DK1_WDK.OK_SCHWELLE "Fault code DK1_WDK - debounce filter threshold for clearing (healing) the fault [verified]" VALUE 0x70EF9 RL_VAL_UB 0 CM_0000 0 255 /end CHARACTERISTIC
/begin CHARACTERISTIC K_ED_DK1_WDK.P_CODE_OPENLOAD "Fault code DK1_WDK - OBD P-code reported for open circuit [verified]" VALUE 0x70EF4 RL_VAL_UW 0 CM_0000 0 65535 /end CHARACTERISTIC
/begin CHARACTERISTIC K_ED_DK1_WDK.P_CODE_SH_TO_GND "Fault code DK1_WDK - OBD P-code reported for short to ground [verified]" VALUE 0x70EF2 RL_VAL_UW 0 CM_0000 0 65535 /end CHARACTERISTIC
/begin CHARACTERISTIC K_ED_DK1_WDK.P_CODE_SH_TO_UB "Fault code DK1_WDK - OBD P-code reported for short to battery voltage [verified]" VALUE 0x70EF0 RL_VAL_UW 0 CM_0000 0 65535 /end CHARACTERISTIC
/begin CHARACTERISTIC K_ED_DK1_WDK.P_CODE_UNPLAUSIBEL "Fault code DK1_WDK - OBD P-code reported for implausible signal [verified]" VALUE 0x70EF6 RL_VAL_UW 0 CM_0000 0 65535 /end CHARACTERISTIC
/begin CHARACTERISTIC K_ED_DK1_ZUST.DEC_NACH_EINTRAG "Fault code DK1_ZUST - debounce filter decrement after fault-memory entry [verified]" VALUE 0x71515 RL_VAL_UB 0 CM_0000 0 255 /end CHARACTERISTIC
/begin CHARACTERISTIC K_ED_DK1_ZUST.DEC_VOR_EINTRAG "Fault code DK1_ZUST - debounce filter decrement before fault-memory entry [verified]" VALUE 0x71513 RL_VAL_UB 0 CM_0000 0 255 /end CHARACTERISTIC
/begin CHARACTERISTIC K_ED_DK1_ZUST.FEHLERSCHWELLE "Fault code DK1_ZUST - debounce filter threshold for setting the fault [verified]" VALUE 0x71510 RL_VAL_UB 0 CM_0000 0 255 /end CHARACTERISTIC
/begin CHARACTERISTIC K_ED_DK1_ZUST.INC_NACH_EINTRAG "Fault code DK1_ZUST - debounce filter increment after fault-memory entry [verified]" VALUE 0x71514 RL_VAL_UB 0 CM_0000 0 255 /end CHARACTERISTIC
/begin CHARACTERISTIC K_ED_DK1_ZUST.INC_VOR_EINTRAG "Fault code DK1_ZUST - debounce filter increment before fault-memory entry [verified]" VALUE 0x71512 RL_VAL_UB 0 CM_0000 0 255 /end CHARACTERISTIC
/begin CHARACTERISTIC K_ED_DK1_ZUST.KLASSENINDEX "Fault code DK1_ZUST - fault class selection (lamp / warning behaviour) [verified]" VALUE 0x71516 RL_VAL_UB 0 CM_0000 0 255 /end CHARACTERISTIC
/begin CHARACTERISTIC K_ED_DK1_ZUST.OK_SCHWELLE "Fault code DK1_ZUST - debounce filter threshold for clearing (healing) the fault [verified]" VALUE 0x71511 RL_VAL_UB 0 CM_0000 0 255 /end CHARACTERISTIC
/begin CHARACTERISTIC K_ED_DK1_ZUST.P_CODE_OPENLOAD "Fault code DK1_ZUST - OBD P-code reported for open circuit [verified]" VALUE 0x7150C RL_VAL_UW 0 CM_0000 0 65535 /end CHARACTERISTIC
/begin CHARACTERISTIC K_ED_DK1_ZUST.P_CODE_SH_TO_GND "Fault code DK1_ZUST - OBD P-code reported for short to ground [verified]" VALUE 0x7150A RL_VAL_UW 0 CM_0000 0 65535 /end CHARACTERISTIC
/begin CHARACTERISTIC K_ED_DK1_ZUST.P_CODE_SH_TO_UB "Fault code DK1_ZUST - OBD P-code reported for short to battery voltage [verified]" VALUE 0x71508 RL_VAL_UW 0 CM_0000 0 65535 /end CHARACTERISTIC
/begin CHARACTERISTIC K_ED_DK1_ZUST.P_CODE_UNPLAUSIBEL "Fault code DK1_ZUST - OBD P-code reported for implausible signal [verified]" VALUE 0x7150E RL_VAL_UW 0 CM_0000 0 65535 /end CHARACTERISTIC
/begin CHARACTERISTIC K_ED_DK2_ADAPT.DEC_NACH_EINTRAG "Fault code DK2_ADAPT - debounce filter decrement after fault-memory entry [verified]" VALUE 0x70E47 RL_VAL_UB 0 CM_0000 0 255 /end CHARACTERISTIC
/begin CHARACTERISTIC K_ED_DK2_ADAPT.DEC_VOR_EINTRAG "Fault code DK2_ADAPT - debounce filter decrement before fault-memory entry [verified]" VALUE 0x70E45 RL_VAL_UB 0 CM_0000 0 255 /end CHARACTERISTIC
/begin CHARACTERISTIC K_ED_DK2_ADAPT.FEHLERSCHWELLE "Fault code DK2_ADAPT - debounce filter threshold for setting the fault [verified]" VALUE 0x70E42 RL_VAL_UB 0 CM_0000 0 255 /end CHARACTERISTIC
/begin CHARACTERISTIC K_ED_DK2_ADAPT.INC_NACH_EINTRAG "Fault code DK2_ADAPT - debounce filter increment after fault-memory entry [verified]" VALUE 0x70E46 RL_VAL_UB 0 CM_0000 0 255 /end CHARACTERISTIC
/begin CHARACTERISTIC K_ED_DK2_ADAPT.INC_VOR_EINTRAG "Fault code DK2_ADAPT - debounce filter increment before fault-memory entry [verified]" VALUE 0x70E44 RL_VAL_UB 0 CM_0000 0 255 /end CHARACTERISTIC
/begin CHARACTERISTIC K_ED_DK2_ADAPT.KLASSENINDEX "Fault code DK2_ADAPT - fault class selection (lamp / warning behaviour) [verified]" VALUE 0x70E48 RL_VAL_UB 0 CM_0000 0 255 /end CHARACTERISTIC
/begin CHARACTERISTIC K_ED_DK2_ADAPT.OK_SCHWELLE "Fault code DK2_ADAPT - debounce filter threshold for clearing (healing) the fault [verified]" VALUE 0x70E43 RL_VAL_UB 0 CM_0000 0 255 /end CHARACTERISTIC
/begin CHARACTERISTIC K_ED_DK2_ADAPT.P_CODE_OPENLOAD "Fault code DK2_ADAPT - OBD P-code reported for open circuit [verified]" VALUE 0x70E3E RL_VAL_UW 0 CM_0000 0 65535 /end CHARACTERISTIC
/begin CHARACTERISTIC K_ED_DK2_ADAPT.P_CODE_SH_TO_GND "Fault code DK2_ADAPT - OBD P-code reported for short to ground [verified]" VALUE 0x70E3C RL_VAL_UW 0 CM_0000 0 65535 /end CHARACTERISTIC
/begin CHARACTERISTIC K_ED_DK2_ADAPT.P_CODE_SH_TO_UB "Fault code DK2_ADAPT - OBD P-code reported for short to battery voltage [verified]" VALUE 0x70E3A RL_VAL_UW 0 CM_0000 0 65535 /end CHARACTERISTIC
/begin CHARACTERISTIC K_ED_DK2_ADAPT.P_CODE_UNPLAUSIBEL "Fault code DK2_ADAPT - OBD P-code reported for implausible signal [verified]" VALUE 0x70E40 RL_VAL_UW 0 CM_0000 0 65535 /end CHARACTERISTIC
/begin CHARACTERISTIC K_ED_DK2_CAN.DEC_NACH_EINTRAG "Fault code DK2_CAN - debounce filter decrement after fault-memory entry [verified]" VALUE 0x70D0F RL_VAL_UB 0 CM_0000 0 255 /end CHARACTERISTIC
/begin CHARACTERISTIC K_ED_DK2_CAN.DEC_VOR_EINTRAG "Fault code DK2_CAN - debounce filter decrement before fault-memory entry [verified]" VALUE 0x70D0D RL_VAL_UB 0 CM_0000 0 255 /end CHARACTERISTIC
/begin CHARACTERISTIC K_ED_DK2_CAN.FEHLERSCHWELLE "Fault code DK2_CAN - debounce filter threshold for setting the fault [verified]" VALUE 0x70D0A RL_VAL_UB 0 CM_0000 0 255 /end CHARACTERISTIC
/begin CHARACTERISTIC K_ED_DK2_CAN.INC_NACH_EINTRAG "Fault code DK2_CAN - debounce filter increment after fault-memory entry [verified]" VALUE 0x70D0E RL_VAL_UB 0 CM_0000 0 255 /end CHARACTERISTIC
/begin CHARACTERISTIC K_ED_DK2_CAN.INC_VOR_EINTRAG "Fault code DK2_CAN - debounce filter increment before fault-memory entry [verified]" VALUE 0x70D0C RL_VAL_UB 0 CM_0000 0 255 /end CHARACTERISTIC
/begin CHARACTERISTIC K_ED_DK2_CAN.KLASSENINDEX "Fault code DK2_CAN - fault class selection (lamp / warning behaviour) [verified]" VALUE 0x70D10 RL_VAL_UB 0 CM_0000 0 255 /end CHARACTERISTIC
/begin CHARACTERISTIC K_ED_DK2_CAN.OK_SCHWELLE "Fault code DK2_CAN - debounce filter threshold for clearing (healing) the fault [verified]" VALUE 0x70D0B RL_VAL_UB 0 CM_0000 0 255 /end CHARACTERISTIC
/begin CHARACTERISTIC K_ED_DK2_CAN.P_CODE_OPENLOAD "Fault code DK2_CAN - OBD P-code reported for open circuit [verified]" VALUE 0x70D06 RL_VAL_UW 0 CM_0000 0 65535 /end CHARACTERISTIC
/begin CHARACTERISTIC K_ED_DK2_CAN.P_CODE_SH_TO_GND "Fault code DK2_CAN - OBD P-code reported for short to ground [verified]" VALUE 0x70D04 RL_VAL_UW 0 CM_0000 0 65535 /end CHARACTERISTIC
/begin CHARACTERISTIC K_ED_DK2_CAN.P_CODE_SH_TO_UB "Fault code DK2_CAN - OBD P-code reported for short to battery voltage [verified]" VALUE 0x70D02 RL_VAL_UW 0 CM_0000 0 65535 /end CHARACTERISTIC
/begin CHARACTERISTIC K_ED_DK2_CAN.P_CODE_UNPLAUSIBEL "Fault code DK2_CAN - OBD P-code reported for implausible signal [verified]" VALUE 0x70D08 RL_VAL_UW 0 CM_0000 0 65535 /end CHARACTERISTIC
/begin CHARACTERISTIC K_ED_DK2_CMD.DEC_NACH_EINTRAG "Fault code DK2_CMD - debounce filter decrement after fault-memory entry [verified]" VALUE 0x71069 RL_VAL_UB 0 CM_0000 0 255 /end CHARACTERISTIC
/begin CHARACTERISTIC K_ED_DK2_CMD.DEC_VOR_EINTRAG "Fault code DK2_CMD - debounce filter decrement before fault-memory entry [verified]" VALUE 0x71067 RL_VAL_UB 0 CM_0000 0 255 /end CHARACTERISTIC
/begin CHARACTERISTIC K_ED_DK2_CMD.FEHLERSCHWELLE "Fault code DK2_CMD - debounce filter threshold for setting the fault [verified]" VALUE 0x71064 RL_VAL_UB 0 CM_0000 0 255 /end CHARACTERISTIC
/begin CHARACTERISTIC K_ED_DK2_CMD.INC_NACH_EINTRAG "Fault code DK2_CMD - debounce filter increment after fault-memory entry [verified]" VALUE 0x71068 RL_VAL_UB 0 CM_0000 0 255 /end CHARACTERISTIC
/begin CHARACTERISTIC K_ED_DK2_CMD.INC_VOR_EINTRAG "Fault code DK2_CMD - debounce filter increment before fault-memory entry [verified]" VALUE 0x71066 RL_VAL_UB 0 CM_0000 0 255 /end CHARACTERISTIC
/begin CHARACTERISTIC K_ED_DK2_CMD.KLASSENINDEX "Fault code DK2_CMD - fault class selection (lamp / warning behaviour) [verified]" VALUE 0x7106A RL_VAL_UB 0 CM_0000 0 255 /end CHARACTERISTIC
/begin CHARACTERISTIC K_ED_DK2_CMD.OK_SCHWELLE "Fault code DK2_CMD - debounce filter threshold for clearing (healing) the fault [verified]" VALUE 0x71065 RL_VAL_UB 0 CM_0000 0 255 /end CHARACTERISTIC
/begin CHARACTERISTIC K_ED_DK2_CMD.P_CODE_OPENLOAD "Fault code DK2_CMD - OBD P-code reported for open circuit [verified]" VALUE 0x71060 RL_VAL_UW 0 CM_0000 0 65535 /end CHARACTERISTIC
/begin CHARACTERISTIC K_ED_DK2_CMD.P_CODE_SH_TO_GND "Fault code DK2_CMD - OBD P-code reported for short to ground [verified]" VALUE 0x7105E RL_VAL_UW 0 CM_0000 0 65535 /end CHARACTERISTIC
/begin CHARACTERISTIC K_ED_DK2_CMD.P_CODE_SH_TO_UB "Fault code DK2_CMD - OBD P-code reported for short to battery voltage [verified]" VALUE 0x7105C RL_VAL_UW 0 CM_0000 0 65535 /end CHARACTERISTIC
/begin CHARACTERISTIC K_ED_DK2_CMD.P_CODE_UNPLAUSIBEL "Fault code DK2_CMD - OBD P-code reported for implausible signal [verified]" VALUE 0x71062 RL_VAL_UW 0 CM_0000 0 65535 /end CHARACTERISTIC
/begin CHARACTERISTIC K_ED_DK2_FEDERN.DEC_NACH_EINTRAG "Fault code DK2_FEDERN - debounce filter decrement after fault-memory entry [verified]" VALUE 0x70FE7 RL_VAL_UB 0 CM_0000 0 255 /end CHARACTERISTIC
/begin CHARACTERISTIC K_ED_DK2_FEDERN.DEC_VOR_EINTRAG "Fault code DK2_FEDERN - debounce filter decrement before fault-memory entry [verified]" VALUE 0x70FE5 RL_VAL_UB 0 CM_0000 0 255 /end CHARACTERISTIC
/begin CHARACTERISTIC K_ED_DK2_FEDERN.FEHLERSCHWELLE "Fault code DK2_FEDERN - debounce filter threshold for setting the fault [verified]" VALUE 0x70FE2 RL_VAL_UB 0 CM_0000 0 255 /end CHARACTERISTIC
/begin CHARACTERISTIC K_ED_DK2_FEDERN.INC_NACH_EINTRAG "Fault code DK2_FEDERN - debounce filter increment after fault-memory entry [verified]" VALUE 0x70FE6 RL_VAL_UB 0 CM_0000 0 255 /end CHARACTERISTIC
/begin CHARACTERISTIC K_ED_DK2_FEDERN.INC_VOR_EINTRAG "Fault code DK2_FEDERN - debounce filter increment before fault-memory entry [verified]" VALUE 0x70FE4 RL_VAL_UB 0 CM_0000 0 255 /end CHARACTERISTIC
/begin CHARACTERISTIC K_ED_DK2_FEDERN.KLASSENINDEX "Fault code DK2_FEDERN - fault class selection (lamp / warning behaviour) [verified]" VALUE 0x70FE8 RL_VAL_UB 0 CM_0000 0 255 /end CHARACTERISTIC
/begin CHARACTERISTIC K_ED_DK2_FEDERN.OK_SCHWELLE "Fault code DK2_FEDERN - debounce filter threshold for clearing (healing) the fault [verified]" VALUE 0x70FE3 RL_VAL_UB 0 CM_0000 0 255 /end CHARACTERISTIC
/begin CHARACTERISTIC K_ED_DK2_FEDERN.P_CODE_OPENLOAD "Fault code DK2_FEDERN - OBD P-code reported for open circuit [verified]" VALUE 0x70FDE RL_VAL_UW 0 CM_0000 0 65535 /end CHARACTERISTIC
/begin CHARACTERISTIC K_ED_DK2_FEDERN.P_CODE_SH_TO_GND "Fault code DK2_FEDERN - OBD P-code reported for short to ground [verified]" VALUE 0x70FDC RL_VAL_UW 0 CM_0000 0 65535 /end CHARACTERISTIC
/begin CHARACTERISTIC K_ED_DK2_FEDERN.P_CODE_SH_TO_UB "Fault code DK2_FEDERN - OBD P-code reported for short to battery voltage [verified]" VALUE 0x70FDA RL_VAL_UW 0 CM_0000 0 65535 /end CHARACTERISTIC
/begin CHARACTERISTIC K_ED_DK2_FEDERN.P_CODE_UNPLAUSIBEL "Fault code DK2_FEDERN - OBD P-code reported for implausible signal [verified]" VALUE 0x70FE0 RL_VAL_UW 0 CM_0000 0 65535 /end CHARACTERISTIC
/begin CHARACTERISTIC K_ED_DK2_PDR.DEC_NACH_EINTRAG "Fault code DK2_PDR - debounce filter decrement after fault-memory entry [verified]" VALUE 0x70F4B RL_VAL_UB 0 CM_0000 0 255 /end CHARACTERISTIC
/begin CHARACTERISTIC K_ED_DK2_PDR.DEC_VOR_EINTRAG "Fault code DK2_PDR - debounce filter decrement before fault-memory entry [verified]" VALUE 0x70F49 RL_VAL_UB 0 CM_0000 0 255 /end CHARACTERISTIC
/begin CHARACTERISTIC K_ED_DK2_PDR.FEHLERSCHWELLE "Fault code DK2_PDR - debounce filter threshold for setting the fault [verified]" VALUE 0x70F46 RL_VAL_UB 0 CM_0000 0 255 /end CHARACTERISTIC
/begin CHARACTERISTIC K_ED_DK2_PDR.INC_NACH_EINTRAG "Fault code DK2_PDR - debounce filter increment after fault-memory entry [verified]" VALUE 0x70F4A RL_VAL_UB 0 CM_0000 0 255 /end CHARACTERISTIC
/begin CHARACTERISTIC K_ED_DK2_PDR.INC_VOR_EINTRAG "Fault code DK2_PDR - debounce filter increment before fault-memory entry [verified]" VALUE 0x70F48 RL_VAL_UB 0 CM_0000 0 255 /end CHARACTERISTIC
/begin CHARACTERISTIC K_ED_DK2_PDR.KLASSENINDEX "Fault code DK2_PDR - fault class selection (lamp / warning behaviour) [verified]" VALUE 0x70F4C RL_VAL_UB 0 CM_0000 0 255 /end CHARACTERISTIC
/begin CHARACTERISTIC K_ED_DK2_PDR.OK_SCHWELLE "Fault code DK2_PDR - debounce filter threshold for clearing (healing) the fault [verified]" VALUE 0x70F47 RL_VAL_UB 0 CM_0000 0 255 /end CHARACTERISTIC
/begin CHARACTERISTIC K_ED_DK2_PDR.P_CODE_OPENLOAD "Fault code DK2_PDR - OBD P-code reported for open circuit [verified]" VALUE 0x70F42 RL_VAL_UW 0 CM_0000 0 65535 /end CHARACTERISTIC
/begin CHARACTERISTIC K_ED_DK2_PDR.P_CODE_SH_TO_GND "Fault code DK2_PDR - OBD P-code reported for short to ground [verified]" VALUE 0x70F40 RL_VAL_UW 0 CM_0000 0 65535 /end CHARACTERISTIC
/begin CHARACTERISTIC K_ED_DK2_PDR.P_CODE_SH_TO_UB "Fault code DK2_PDR - OBD P-code reported for short to battery voltage [verified]" VALUE 0x70F3E RL_VAL_UW 0 CM_0000 0 65535 /end CHARACTERISTIC
/begin CHARACTERISTIC K_ED_DK2_PDR.P_CODE_UNPLAUSIBEL "Fault code DK2_PDR - OBD P-code reported for implausible signal [verified]" VALUE 0x70F44 RL_VAL_UW 0 CM_0000 0 65535 /end CHARACTERISTIC
/begin CHARACTERISTIC K_ED_DK2_REGLER.DEC_NACH_EINTRAG "Fault code DK2_REGLER - debounce filter decrement after fault-memory entry [verified]" VALUE 0x70E13 RL_VAL_UB 0 CM_0000 0 255 /end CHARACTERISTIC
/begin CHARACTERISTIC K_ED_DK2_REGLER.DEC_VOR_EINTRAG "Fault code DK2_REGLER - debounce filter decrement before fault-memory entry [verified]" VALUE 0x70E11 RL_VAL_UB 0 CM_0000 0 255 /end CHARACTERISTIC
/begin CHARACTERISTIC K_ED_DK2_REGLER.FEHLERSCHWELLE "Fault code DK2_REGLER - debounce filter threshold for setting the fault [verified]" VALUE 0x70E0E RL_VAL_UB 0 CM_0000 0 255 /end CHARACTERISTIC
/begin CHARACTERISTIC K_ED_DK2_REGLER.INC_NACH_EINTRAG "Fault code DK2_REGLER - debounce filter increment after fault-memory entry [verified]" VALUE 0x70E12 RL_VAL_UB 0 CM_0000 0 255 /end CHARACTERISTIC
/begin CHARACTERISTIC K_ED_DK2_REGLER.INC_VOR_EINTRAG "Fault code DK2_REGLER - debounce filter increment before fault-memory entry [verified]" VALUE 0x70E10 RL_VAL_UB 0 CM_0000 0 255 /end CHARACTERISTIC
/begin CHARACTERISTIC K_ED_DK2_REGLER.KLASSENINDEX "Fault code DK2_REGLER - fault class selection (lamp / warning behaviour) [verified]" VALUE 0x70E14 RL_VAL_UB 0 CM_0000 0 255 /end CHARACTERISTIC
/begin CHARACTERISTIC K_ED_DK2_REGLER.OK_SCHWELLE "Fault code DK2_REGLER - debounce filter threshold for clearing (healing) the fault [verified]" VALUE 0x70E0F RL_VAL_UB 0 CM_0000 0 255 /end CHARACTERISTIC
/begin CHARACTERISTIC K_ED_DK2_REGLER.P_CODE_OPENLOAD "Fault code DK2_REGLER - OBD P-code reported for open circuit [verified]" VALUE 0x70E0A RL_VAL_UW 0 CM_0000 0 65535 /end CHARACTERISTIC
/begin CHARACTERISTIC K_ED_DK2_REGLER.P_CODE_SH_TO_GND "Fault code DK2_REGLER - OBD P-code reported for short to ground [verified]" VALUE 0x70E08 RL_VAL_UW 0 CM_0000 0 65535 /end CHARACTERISTIC
/begin CHARACTERISTIC K_ED_DK2_REGLER.P_CODE_SH_TO_UB "Fault code DK2_REGLER - OBD P-code reported for short to battery voltage [verified]" VALUE 0x70E06 RL_VAL_UW 0 CM_0000 0 65535 /end CHARACTERISTIC
/begin CHARACTERISTIC K_ED_DK2_REGLER.P_CODE_UNPLAUSIBEL "Fault code DK2_REGLER - OBD P-code reported for implausible signal [verified]" VALUE 0x70E0C RL_VAL_UW 0 CM_0000 0 65535 /end CHARACTERISTIC
/begin CHARACTERISTIC K_ED_DK2_SK_ERR.DEC_NACH_EINTRAG "Fault code DK2_SK_ERR - debounce filter decrement after fault-memory entry [verified]" VALUE 0x70FB3 RL_VAL_UB 0 CM_0000 0 255 /end CHARACTERISTIC
/begin CHARACTERISTIC K_ED_DK2_SK_ERR.DEC_VOR_EINTRAG "Fault code DK2_SK_ERR - debounce filter decrement before fault-memory entry [verified]" VALUE 0x70FB1 RL_VAL_UB 0 CM_0000 0 255 /end CHARACTERISTIC
/begin CHARACTERISTIC K_ED_DK2_SK_ERR.FEHLERSCHWELLE "Fault code DK2_SK_ERR - debounce filter threshold for setting the fault [verified]" VALUE 0x70FAE RL_VAL_UB 0 CM_0000 0 255 /end CHARACTERISTIC
/begin CHARACTERISTIC K_ED_DK2_SK_ERR.INC_NACH_EINTRAG "Fault code DK2_SK_ERR - debounce filter increment after fault-memory entry [verified]" VALUE 0x70FB2 RL_VAL_UB 0 CM_0000 0 255 /end CHARACTERISTIC
/begin CHARACTERISTIC K_ED_DK2_SK_ERR.INC_VOR_EINTRAG "Fault code DK2_SK_ERR - debounce filter increment before fault-memory entry [verified]" VALUE 0x70FB0 RL_VAL_UB 0 CM_0000 0 255 /end CHARACTERISTIC
/begin CHARACTERISTIC K_ED_DK2_SK_ERR.KLASSENINDEX "Fault code DK2_SK_ERR - fault class selection (lamp / warning behaviour) [verified]" VALUE 0x70FB4 RL_VAL_UB 0 CM_0000 0 255 /end CHARACTERISTIC
/begin CHARACTERISTIC K_ED_DK2_SK_ERR.OK_SCHWELLE "Fault code DK2_SK_ERR - debounce filter threshold for clearing (healing) the fault [verified]" VALUE 0x70FAF RL_VAL_UB 0 CM_0000 0 255 /end CHARACTERISTIC
/begin CHARACTERISTIC K_ED_DK2_SK_ERR.P_CODE_OPENLOAD "Fault code DK2_SK_ERR - OBD P-code reported for open circuit [verified]" VALUE 0x70FAA RL_VAL_UW 0 CM_0000 0 65535 /end CHARACTERISTIC
/begin CHARACTERISTIC K_ED_DK2_SK_ERR.P_CODE_SH_TO_GND "Fault code DK2_SK_ERR - OBD P-code reported for short to ground [verified]" VALUE 0x70FA8 RL_VAL_UW 0 CM_0000 0 65535 /end CHARACTERISTIC
/begin CHARACTERISTIC K_ED_DK2_SK_ERR.P_CODE_SH_TO_UB "Fault code DK2_SK_ERR - OBD P-code reported for short to battery voltage [verified]" VALUE 0x70FA6 RL_VAL_UW 0 CM_0000 0 65535 /end CHARACTERISTIC
/begin CHARACTERISTIC K_ED_DK2_SK_ERR.P_CODE_UNPLAUSIBEL "Fault code DK2_SK_ERR - OBD P-code reported for implausible signal [verified]" VALUE 0x70FAC RL_VAL_UW 0 CM_0000 0 65535 /end CHARACTERISTIC
/begin CHARACTERISTIC K_ED_DK2_WDK.DEC_NACH_EINTRAG "Fault code DK2_WDK - debounce filter decrement after fault-memory entry [verified]" VALUE 0x70F17 RL_VAL_UB 0 CM_0000 0 255 /end CHARACTERISTIC
/begin CHARACTERISTIC K_ED_DK2_WDK.DEC_VOR_EINTRAG "Fault code DK2_WDK - debounce filter decrement before fault-memory entry [verified]" VALUE 0x70F15 RL_VAL_UB 0 CM_0000 0 255 /end CHARACTERISTIC
/begin CHARACTERISTIC K_ED_DK2_WDK.FEHLERSCHWELLE "Fault code DK2_WDK - debounce filter threshold for setting the fault [verified]" VALUE 0x70F12 RL_VAL_UB 0 CM_0000 0 255 /end CHARACTERISTIC
/begin CHARACTERISTIC K_ED_DK2_WDK.INC_NACH_EINTRAG "Fault code DK2_WDK - debounce filter increment after fault-memory entry [verified]" VALUE 0x70F16 RL_VAL_UB 0 CM_0000 0 255 /end CHARACTERISTIC
/begin CHARACTERISTIC K_ED_DK2_WDK.INC_VOR_EINTRAG "Fault code DK2_WDK - debounce filter increment before fault-memory entry [verified]" VALUE 0x70F14 RL_VAL_UB 0 CM_0000 0 255 /end CHARACTERISTIC
/begin CHARACTERISTIC K_ED_DK2_WDK.KLASSENINDEX "Fault code DK2_WDK - fault class selection (lamp / warning behaviour) [verified]" VALUE 0x70F18 RL_VAL_UB 0 CM_0000 0 255 /end CHARACTERISTIC
/begin CHARACTERISTIC K_ED_DK2_WDK.OK_SCHWELLE "Fault code DK2_WDK - debounce filter threshold for clearing (healing) the fault [verified]" VALUE 0x70F13 RL_VAL_UB 0 CM_0000 0 255 /end CHARACTERISTIC
/begin CHARACTERISTIC K_ED_DK2_WDK.P_CODE_OPENLOAD "Fault code DK2_WDK - OBD P-code reported for open circuit [verified]" VALUE 0x70F0E RL_VAL_UW 0 CM_0000 0 65535 /end CHARACTERISTIC
/begin CHARACTERISTIC K_ED_DK2_WDK.P_CODE_SH_TO_GND "Fault code DK2_WDK - OBD P-code reported for short to ground [verified]" VALUE 0x70F0C RL_VAL_UW 0 CM_0000 0 65535 /end CHARACTERISTIC
/begin CHARACTERISTIC K_ED_DK2_WDK.P_CODE_SH_TO_UB "Fault code DK2_WDK - OBD P-code reported for short to battery voltage [verified]" VALUE 0x70F0A RL_VAL_UW 0 CM_0000 0 65535 /end CHARACTERISTIC
/begin CHARACTERISTIC K_ED_DK2_WDK.P_CODE_UNPLAUSIBEL "Fault code DK2_WDK - OBD P-code reported for implausible signal [verified]" VALUE 0x70F10 RL_VAL_UW 0 CM_0000 0 65535 /end CHARACTERISTIC
/begin CHARACTERISTIC K_ED_DK2_ZUST.DEC_NACH_EINTRAG "Fault code DK2_ZUST - debounce filter decrement after fault-memory entry [verified]" VALUE 0x7152F RL_VAL_UB 0 CM_0000 0 255 /end CHARACTERISTIC
/begin CHARACTERISTIC K_ED_DK2_ZUST.DEC_VOR_EINTRAG "Fault code DK2_ZUST - debounce filter decrement before fault-memory entry [verified]" VALUE 0x7152D RL_VAL_UB 0 CM_0000 0 255 /end CHARACTERISTIC
/begin CHARACTERISTIC K_ED_DK2_ZUST.FEHLERSCHWELLE "Fault code DK2_ZUST - debounce filter threshold for setting the fault [verified]" VALUE 0x7152A RL_VAL_UB 0 CM_0000 0 255 /end CHARACTERISTIC
/begin CHARACTERISTIC K_ED_DK2_ZUST.INC_NACH_EINTRAG "Fault code DK2_ZUST - debounce filter increment after fault-memory entry [verified]" VALUE 0x7152E RL_VAL_UB 0 CM_0000 0 255 /end CHARACTERISTIC
/begin CHARACTERISTIC K_ED_DK2_ZUST.INC_VOR_EINTRAG "Fault code DK2_ZUST - debounce filter increment before fault-memory entry [verified]" VALUE 0x7152C RL_VAL_UB 0 CM_0000 0 255 /end CHARACTERISTIC
/begin CHARACTERISTIC K_ED_DK2_ZUST.KLASSENINDEX "Fault code DK2_ZUST - fault class selection (lamp / warning behaviour) [verified]" VALUE 0x71530 RL_VAL_UB 0 CM_0000 0 255 /end CHARACTERISTIC
/begin CHARACTERISTIC K_ED_DK2_ZUST.OK_SCHWELLE "Fault code DK2_ZUST - debounce filter threshold for clearing (healing) the fault [verified]" VALUE 0x7152B RL_VAL_UB 0 CM_0000 0 255 /end CHARACTERISTIC
/begin CHARACTERISTIC K_ED_DK2_ZUST.P_CODE_OPENLOAD "Fault code DK2_ZUST - OBD P-code reported for open circuit [verified]" VALUE 0x71526 RL_VAL_UW 0 CM_0000 0 65535 /end CHARACTERISTIC
/begin CHARACTERISTIC K_ED_DK2_ZUST.P_CODE_SH_TO_GND "Fault code DK2_ZUST - OBD P-code reported for short to ground [verified]" VALUE 0x71524 RL_VAL_UW 0 CM_0000 0 65535 /end CHARACTERISTIC
/begin CHARACTERISTIC K_ED_DK2_ZUST.P_CODE_SH_TO_UB "Fault code DK2_ZUST - OBD P-code reported for short to battery voltage [verified]" VALUE 0x71522 RL_VAL_UW 0 CM_0000 0 65535 /end CHARACTERISTIC
/begin CHARACTERISTIC K_ED_DK2_ZUST.P_CODE_UNPLAUSIBEL "Fault code DK2_ZUST - OBD P-code reported for implausible signal [verified]" VALUE 0x71528 RL_VAL_UW 0 CM_0000 0 65535 /end CHARACTERISTIC
/begin CHARACTERISTIC K_ED_DKG_EINGR.DEC_NACH_EINTRAG "Fault code DKG_EINGR - debounce filter decrement after fault-memory entry [verified]" VALUE 0x713F7 RL_VAL_UB 0 CM_0000 0 255 /end CHARACTERISTIC
/begin CHARACTERISTIC K_ED_DKG_EINGR.DEC_VOR_EINTRAG "Fault code DKG_EINGR - debounce filter decrement before fault-memory entry [verified]" VALUE 0x713F5 RL_VAL_UB 0 CM_0000 0 255 /end CHARACTERISTIC
/begin CHARACTERISTIC K_ED_DKG_EINGR.FEHLERSCHWELLE "Fault code DKG_EINGR - debounce filter threshold for setting the fault [verified]" VALUE 0x713F2 RL_VAL_UB 0 CM_0000 0 255 /end CHARACTERISTIC
/begin CHARACTERISTIC K_ED_DKG_EINGR.INC_NACH_EINTRAG "Fault code DKG_EINGR - debounce filter increment after fault-memory entry [verified]" VALUE 0x713F6 RL_VAL_UB 0 CM_0000 0 255 /end CHARACTERISTIC
/begin CHARACTERISTIC K_ED_DKG_EINGR.INC_VOR_EINTRAG "Fault code DKG_EINGR - debounce filter increment before fault-memory entry [verified]" VALUE 0x713F4 RL_VAL_UB 0 CM_0000 0 255 /end CHARACTERISTIC
/begin CHARACTERISTIC K_ED_DKG_EINGR.KLASSENINDEX "Fault code DKG_EINGR - fault class selection (lamp / warning behaviour) [verified]" VALUE 0x713F8 RL_VAL_UB 0 CM_0000 0 255 /end CHARACTERISTIC
/begin CHARACTERISTIC K_ED_DKG_EINGR.OK_SCHWELLE "Fault code DKG_EINGR - debounce filter threshold for clearing (healing) the fault [verified]" VALUE 0x713F3 RL_VAL_UB 0 CM_0000 0 255 /end CHARACTERISTIC
/begin CHARACTERISTIC K_ED_DKG_EINGR.P_CODE_OPENLOAD "Fault code DKG_EINGR - OBD P-code reported for open circuit [verified]" VALUE 0x713EE RL_VAL_UW 0 CM_0000 0 65535 /end CHARACTERISTIC
/begin CHARACTERISTIC K_ED_DKG_EINGR.P_CODE_SH_TO_GND "Fault code DKG_EINGR - OBD P-code reported for short to ground [verified]" VALUE 0x713EC RL_VAL_UW 0 CM_0000 0 65535 /end CHARACTERISTIC
/begin CHARACTERISTIC K_ED_DKG_EINGR.P_CODE_SH_TO_UB "Fault code DKG_EINGR - OBD P-code reported for short to battery voltage [verified]" VALUE 0x713EA RL_VAL_UW 0 CM_0000 0 65535 /end CHARACTERISTIC
/begin CHARACTERISTIC K_ED_DKG_EINGR.P_CODE_UNPLAUSIBEL "Fault code DKG_EINGR - OBD P-code reported for implausible signal [verified]" VALUE 0x713F0 RL_VAL_UW 0 CM_0000 0 65535 /end CHARACTERISTIC
/begin CHARACTERISTIC K_ED_DK_INIT.DEC_NACH_EINTRAG "Fault code DK_INIT - debounce filter decrement after fault-memory entry [verified]" VALUE 0x70DDF RL_VAL_UB 0 CM_0000 0 255 /end CHARACTERISTIC
/begin CHARACTERISTIC K_ED_DK_INIT.DEC_VOR_EINTRAG "Fault code DK_INIT - debounce filter decrement before fault-memory entry [verified]" VALUE 0x70DDD RL_VAL_UB 0 CM_0000 0 255 /end CHARACTERISTIC
/begin CHARACTERISTIC K_ED_DK_INIT.FEHLERSCHWELLE "Fault code DK_INIT - debounce filter threshold for setting the fault [verified]" VALUE 0x70DDA RL_VAL_UB 0 CM_0000 0 255 /end CHARACTERISTIC
/begin CHARACTERISTIC K_ED_DK_INIT.INC_NACH_EINTRAG "Fault code DK_INIT - debounce filter increment after fault-memory entry [verified]" VALUE 0x70DDE RL_VAL_UB 0 CM_0000 0 255 /end CHARACTERISTIC
/begin CHARACTERISTIC K_ED_DK_INIT.INC_VOR_EINTRAG "Fault code DK_INIT - debounce filter increment before fault-memory entry [verified]" VALUE 0x70DDC RL_VAL_UB 0 CM_0000 0 255 /end CHARACTERISTIC
/begin CHARACTERISTIC K_ED_DK_INIT.KLASSENINDEX "Fault code DK_INIT - fault class selection (lamp / warning behaviour) [verified]" VALUE 0x70DE0 RL_VAL_UB 0 CM_0000 0 255 /end CHARACTERISTIC
/begin CHARACTERISTIC K_ED_DK_INIT.OK_SCHWELLE "Fault code DK_INIT - debounce filter threshold for clearing (healing) the fault [verified]" VALUE 0x70DDB RL_VAL_UB 0 CM_0000 0 255 /end CHARACTERISTIC
/begin CHARACTERISTIC K_ED_DK_INIT.P_CODE_OPENLOAD "Fault code DK_INIT - OBD P-code reported for open circuit [verified]" VALUE 0x70DD6 RL_VAL_UW 0 CM_0000 0 65535 /end CHARACTERISTIC
/begin CHARACTERISTIC K_ED_DK_INIT.P_CODE_SH_TO_GND "Fault code DK_INIT - OBD P-code reported for short to ground [verified]" VALUE 0x70DD4 RL_VAL_UW 0 CM_0000 0 65535 /end CHARACTERISTIC
/begin CHARACTERISTIC K_ED_DK_INIT.P_CODE_SH_TO_UB "Fault code DK_INIT - OBD P-code reported for short to battery voltage [verified]" VALUE 0x70DD2 RL_VAL_UW 0 CM_0000 0 65535 /end CHARACTERISTIC
/begin CHARACTERISTIC K_ED_DK_INIT.P_CODE_UNPLAUSIBEL "Fault code DK_INIT - OBD P-code reported for implausible signal [verified]" VALUE 0x70DD8 RL_VAL_UW 0 CM_0000 0 65535 /end CHARACTERISTIC
/begin CHARACTERISTIC K_ED_DSC_EINGR.DEC_NACH_EINTRAG "Fault code DSC_EINGR - debounce filter decrement after fault-memory entry [verified]" VALUE 0x71035 RL_VAL_UB 0 CM_0000 0 255 /end CHARACTERISTIC
/begin CHARACTERISTIC K_ED_DSC_EINGR.DEC_VOR_EINTRAG "Fault code DSC_EINGR - debounce filter decrement before fault-memory entry [verified]" VALUE 0x71033 RL_VAL_UB 0 CM_0000 0 255 /end CHARACTERISTIC
/begin CHARACTERISTIC K_ED_DSC_EINGR.FEHLERSCHWELLE "Fault code DSC_EINGR - debounce filter threshold for setting the fault [verified]" VALUE 0x71030 RL_VAL_UB 0 CM_0000 0 255 /end CHARACTERISTIC
/begin CHARACTERISTIC K_ED_DSC_EINGR.INC_NACH_EINTRAG "Fault code DSC_EINGR - debounce filter increment after fault-memory entry [verified]" VALUE 0x71034 RL_VAL_UB 0 CM_0000 0 255 /end CHARACTERISTIC
/begin CHARACTERISTIC K_ED_DSC_EINGR.INC_VOR_EINTRAG "Fault code DSC_EINGR - debounce filter increment before fault-memory entry [verified]" VALUE 0x71032 RL_VAL_UB 0 CM_0000 0 255 /end CHARACTERISTIC
/begin CHARACTERISTIC K_ED_DSC_EINGR.KLASSENINDEX "Fault code DSC_EINGR - fault class selection (lamp / warning behaviour) [verified]" VALUE 0x71036 RL_VAL_UB 0 CM_0000 0 255 /end CHARACTERISTIC
/begin CHARACTERISTIC K_ED_DSC_EINGR.OK_SCHWELLE "Fault code DSC_EINGR - debounce filter threshold for clearing (healing) the fault [verified]" VALUE 0x71031 RL_VAL_UB 0 CM_0000 0 255 /end CHARACTERISTIC
/begin CHARACTERISTIC K_ED_DSC_EINGR.P_CODE_OPENLOAD "Fault code DSC_EINGR - OBD P-code reported for open circuit [verified]" VALUE 0x7102C RL_VAL_UW 0 CM_0000 0 65535 /end CHARACTERISTIC
/begin CHARACTERISTIC K_ED_DSC_EINGR.P_CODE_SH_TO_GND "Fault code DSC_EINGR - OBD P-code reported for short to ground [verified]" VALUE 0x7102A RL_VAL_UW 0 CM_0000 0 65535 /end CHARACTERISTIC
/begin CHARACTERISTIC K_ED_DSC_EINGR.P_CODE_SH_TO_UB "Fault code DSC_EINGR - OBD P-code reported for short to battery voltage [verified]" VALUE 0x71028 RL_VAL_UW 0 CM_0000 0 65535 /end CHARACTERISTIC
/begin CHARACTERISTIC K_ED_DSC_EINGR.P_CODE_UNPLAUSIBEL "Fault code DSC_EINGR - OBD P-code reported for implausible signal [verified]" VALUE 0x7102E RL_VAL_UW 0 CM_0000 0 65535 /end CHARACTERISTIC
/begin CHARACTERISTIC K_ED_E2_IGN.DEC_NACH_EINTRAG "Fault code E2_IGN - debounce filter decrement after fault-memory entry [verified]" VALUE 0x71479 RL_VAL_UB 0 CM_0000 0 255 /end CHARACTERISTIC
/begin CHARACTERISTIC K_ED_E2_IGN.DEC_VOR_EINTRAG "Fault code E2_IGN - debounce filter decrement before fault-memory entry [verified]" VALUE 0x71477 RL_VAL_UB 0 CM_0000 0 255 /end CHARACTERISTIC
/begin CHARACTERISTIC K_ED_E2_IGN.FEHLERSCHWELLE "Fault code E2_IGN - debounce filter threshold for setting the fault [verified]" VALUE 0x71474 RL_VAL_UB 0 CM_0000 0 255 /end CHARACTERISTIC
/begin CHARACTERISTIC K_ED_E2_IGN.INC_NACH_EINTRAG "Fault code E2_IGN - debounce filter increment after fault-memory entry [verified]" VALUE 0x71478 RL_VAL_UB 0 CM_0000 0 255 /end CHARACTERISTIC
/begin CHARACTERISTIC K_ED_E2_IGN.INC_VOR_EINTRAG "Fault code E2_IGN - debounce filter increment before fault-memory entry [verified]" VALUE 0x71476 RL_VAL_UB 0 CM_0000 0 255 /end CHARACTERISTIC
/begin CHARACTERISTIC K_ED_E2_IGN.KLASSENINDEX "Fault code E2_IGN - fault class selection (lamp / warning behaviour) [verified]" VALUE 0x7147A RL_VAL_UB 0 CM_0000 0 255 /end CHARACTERISTIC
/begin CHARACTERISTIC K_ED_E2_IGN.OK_SCHWELLE "Fault code E2_IGN - debounce filter threshold for clearing (healing) the fault [verified]" VALUE 0x71475 RL_VAL_UB 0 CM_0000 0 255 /end CHARACTERISTIC
/begin CHARACTERISTIC K_ED_E2_IGN.P_CODE_OPENLOAD "Fault code E2_IGN - OBD P-code reported for open circuit [verified]" VALUE 0x71470 RL_VAL_UW 0 CM_0000 0 65535 /end CHARACTERISTIC
/begin CHARACTERISTIC K_ED_E2_IGN.P_CODE_SH_TO_GND "Fault code E2_IGN - OBD P-code reported for short to ground [verified]" VALUE 0x7146E RL_VAL_UW 0 CM_0000 0 65535 /end CHARACTERISTIC
/begin CHARACTERISTIC K_ED_E2_IGN.P_CODE_SH_TO_UB "Fault code E2_IGN - OBD P-code reported for short to battery voltage [verified]" VALUE 0x7146C RL_VAL_UW 0 CM_0000 0 65535 /end CHARACTERISTIC
/begin CHARACTERISTIC K_ED_E2_IGN.P_CODE_UNPLAUSIBEL "Fault code E2_IGN - OBD P-code reported for implausible signal [verified]" VALUE 0x71472 RL_VAL_UW 0 CM_0000 0 65535 /end CHARACTERISTIC
/begin CHARACTERISTIC K_ED_EC_BUSOFF.DEC_NACH_EINTRAG "Fault code EC_BUSOFF - debounce filter decrement after fault-memory entry [verified]" VALUE 0x7111F RL_VAL_UB 0 CM_0000 0 255 /end CHARACTERISTIC
/begin CHARACTERISTIC K_ED_EC_BUSOFF.DEC_VOR_EINTRAG "Fault code EC_BUSOFF - debounce filter decrement before fault-memory entry [verified]" VALUE 0x7111D RL_VAL_UB 0 CM_0000 0 255 /end CHARACTERISTIC
/begin CHARACTERISTIC K_ED_EC_BUSOFF.FEHLERSCHWELLE "Fault code EC_BUSOFF - debounce filter threshold for setting the fault [verified]" VALUE 0x7111A RL_VAL_UB 0 CM_0000 0 255 /end CHARACTERISTIC
/begin CHARACTERISTIC K_ED_EC_BUSOFF.INC_NACH_EINTRAG "Fault code EC_BUSOFF - debounce filter increment after fault-memory entry [verified]" VALUE 0x7111E RL_VAL_UB 0 CM_0000 0 255 /end CHARACTERISTIC
/begin CHARACTERISTIC K_ED_EC_BUSOFF.INC_VOR_EINTRAG "Fault code EC_BUSOFF - debounce filter increment before fault-memory entry [verified]" VALUE 0x7111C RL_VAL_UB 0 CM_0000 0 255 /end CHARACTERISTIC
/begin CHARACTERISTIC K_ED_EC_BUSOFF.KLASSENINDEX "Fault code EC_BUSOFF - fault class selection (lamp / warning behaviour) [verified]" VALUE 0x71120 RL_VAL_UB 0 CM_0000 0 255 /end CHARACTERISTIC
/begin CHARACTERISTIC K_ED_EC_BUSOFF.OK_SCHWELLE "Fault code EC_BUSOFF - debounce filter threshold for clearing (healing) the fault [verified]" VALUE 0x7111B RL_VAL_UB 0 CM_0000 0 255 /end CHARACTERISTIC
/begin CHARACTERISTIC K_ED_EC_BUSOFF.P_CODE_OPENLOAD "Fault code EC_BUSOFF - OBD P-code reported for open circuit [verified]" VALUE 0x71116 RL_VAL_UW 0 CM_0000 0 65535 /end CHARACTERISTIC
/begin CHARACTERISTIC K_ED_EC_BUSOFF.P_CODE_SH_TO_GND "Fault code EC_BUSOFF - OBD P-code reported for short to ground [verified]" VALUE 0x71114 RL_VAL_UW 0 CM_0000 0 65535 /end CHARACTERISTIC
/begin CHARACTERISTIC K_ED_EC_BUSOFF.P_CODE_SH_TO_UB "Fault code EC_BUSOFF - OBD P-code reported for short to battery voltage [verified]" VALUE 0x71112 RL_VAL_UW 0 CM_0000 0 65535 /end CHARACTERISTIC
/begin CHARACTERISTIC K_ED_EC_BUSOFF.P_CODE_UNPLAUSIBEL "Fault code EC_BUSOFF - OBD P-code reported for implausible signal [verified]" VALUE 0x71118 RL_VAL_UW 0 CM_0000 0 65535 /end CHARACTERISTIC
/begin CHARACTERISTIC K_ED_FGR_ABWURF.DEC_NACH_EINTRAG "Fault code FGR_ABWURF - debounce filter decrement after fault-memory entry [verified]" VALUE 0x71549 RL_VAL_UB 0 CM_0000 0 255 /end CHARACTERISTIC
/begin CHARACTERISTIC K_ED_FGR_ABWURF.DEC_VOR_EINTRAG "Fault code FGR_ABWURF - debounce filter decrement before fault-memory entry [verified]" VALUE 0x71547 RL_VAL_UB 0 CM_0000 0 255 /end CHARACTERISTIC
/begin CHARACTERISTIC K_ED_FGR_ABWURF.FEHLERSCHWELLE "Fault code FGR_ABWURF - debounce filter threshold for setting the fault [verified]" VALUE 0x71544 RL_VAL_UB 0 CM_0000 0 255 /end CHARACTERISTIC
/begin CHARACTERISTIC K_ED_FGR_ABWURF.INC_NACH_EINTRAG "Fault code FGR_ABWURF - debounce filter increment after fault-memory entry [verified]" VALUE 0x71548 RL_VAL_UB 0 CM_0000 0 255 /end CHARACTERISTIC
/begin CHARACTERISTIC K_ED_FGR_ABWURF.INC_VOR_EINTRAG "Fault code FGR_ABWURF - debounce filter increment before fault-memory entry [verified]" VALUE 0x71546 RL_VAL_UB 0 CM_0000 0 255 /end CHARACTERISTIC
/begin CHARACTERISTIC K_ED_FGR_ABWURF.KLASSENINDEX "Fault code FGR_ABWURF - fault class selection (lamp / warning behaviour) [verified]" VALUE 0x7154A RL_VAL_UB 0 CM_0000 0 255 /end CHARACTERISTIC
/begin CHARACTERISTIC K_ED_FGR_ABWURF.OK_SCHWELLE "Fault code FGR_ABWURF - debounce filter threshold for clearing (healing) the fault [verified]" VALUE 0x71545 RL_VAL_UB 0 CM_0000 0 255 /end CHARACTERISTIC
/begin CHARACTERISTIC K_ED_FGR_ABWURF.P_CODE_OPENLOAD "Fault code FGR_ABWURF - OBD P-code reported for open circuit [verified]" VALUE 0x71540 RL_VAL_UW 0 CM_0000 0 65535 /end CHARACTERISTIC
/begin CHARACTERISTIC K_ED_FGR_ABWURF.P_CODE_SH_TO_GND "Fault code FGR_ABWURF - OBD P-code reported for short to ground [verified]" VALUE 0x7153E RL_VAL_UW 0 CM_0000 0 65535 /end CHARACTERISTIC
/begin CHARACTERISTIC K_ED_FGR_ABWURF.P_CODE_SH_TO_UB "Fault code FGR_ABWURF - OBD P-code reported for short to battery voltage [verified]" VALUE 0x7153C RL_VAL_UW 0 CM_0000 0 65535 /end CHARACTERISTIC
/begin CHARACTERISTIC K_ED_FGR_ABWURF.P_CODE_UNPLAUSIBEL "Fault code FGR_ABWURF - OBD P-code reported for implausible signal [verified]" VALUE 0x71542 RL_VAL_UW 0 CM_0000 0 65535 /end CHARACTERISTIC
/begin CHARACTERISTIC K_ED_INDEX_121_IGN.DEC_NACH_EINTRAG "Fault code INDEX_121_IGN - debounce filter decrement after fault-memory entry [verified]" VALUE 0x71751 RL_VAL_UB 0 CM_0000 0 255 /end CHARACTERISTIC
/begin CHARACTERISTIC K_ED_INDEX_121_IGN.DEC_VOR_EINTRAG "Fault code INDEX_121_IGN - debounce filter decrement before fault-memory entry [verified]" VALUE 0x7174F RL_VAL_UB 0 CM_0000 0 255 /end CHARACTERISTIC
/begin CHARACTERISTIC K_ED_INDEX_121_IGN.FEHLERSCHWELLE "Fault code INDEX_121_IGN - debounce filter threshold for setting the fault [verified]" VALUE 0x7174C RL_VAL_UB 0 CM_0000 0 255 /end CHARACTERISTIC
/begin CHARACTERISTIC K_ED_INDEX_121_IGN.INC_NACH_EINTRAG "Fault code INDEX_121_IGN - debounce filter increment after fault-memory entry [verified]" VALUE 0x71750 RL_VAL_UB 0 CM_0000 0 255 /end CHARACTERISTIC
/begin CHARACTERISTIC K_ED_INDEX_121_IGN.INC_VOR_EINTRAG "Fault code INDEX_121_IGN - debounce filter increment before fault-memory entry [verified]" VALUE 0x7174E RL_VAL_UB 0 CM_0000 0 255 /end CHARACTERISTIC
/begin CHARACTERISTIC K_ED_INDEX_121_IGN.KLASSENINDEX "Fault code INDEX_121_IGN - fault class selection (lamp / warning behaviour) [verified]" VALUE 0x71752 RL_VAL_UB 0 CM_0000 0 255 /end CHARACTERISTIC
/begin CHARACTERISTIC K_ED_INDEX_121_IGN.OK_SCHWELLE "Fault code INDEX_121_IGN - debounce filter threshold for clearing (healing) the fault [verified]" VALUE 0x7174D RL_VAL_UB 0 CM_0000 0 255 /end CHARACTERISTIC
/begin CHARACTERISTIC K_ED_INDEX_121_IGN.P_CODE_OPENLOAD "Fault code INDEX_121_IGN - OBD P-code reported for open circuit [verified]" VALUE 0x71748 RL_VAL_UW 0 CM_0000 0 65535 /end CHARACTERISTIC
/begin CHARACTERISTIC K_ED_INDEX_121_IGN.P_CODE_SH_TO_GND "Fault code INDEX_121_IGN - OBD P-code reported for short to ground [verified]" VALUE 0x71746 RL_VAL_UW 0 CM_0000 0 65535 /end CHARACTERISTIC
/begin CHARACTERISTIC K_ED_INDEX_121_IGN.P_CODE_SH_TO_UB "Fault code INDEX_121_IGN - OBD P-code reported for short to battery voltage [verified]" VALUE 0x71744 RL_VAL_UW 0 CM_0000 0 65535 /end CHARACTERISTIC
/begin CHARACTERISTIC K_ED_INDEX_121_IGN.P_CODE_UNPLAUSIBEL "Fault code INDEX_121_IGN - OBD P-code reported for implausible signal [verified]" VALUE 0x7174A RL_VAL_UW 0 CM_0000 0 65535 /end CHARACTERISTIC
/begin CHARACTERISTIC K_ED_INDEX_122_IGN.DEC_NACH_EINTRAG "Fault code INDEX_122_IGN - debounce filter decrement after fault-memory entry [verified]" VALUE 0x7176B RL_VAL_UB 0 CM_0000 0 255 /end CHARACTERISTIC
/begin CHARACTERISTIC K_ED_INDEX_122_IGN.DEC_VOR_EINTRAG "Fault code INDEX_122_IGN - debounce filter decrement before fault-memory entry [verified]" VALUE 0x71769 RL_VAL_UB 0 CM_0000 0 255 /end CHARACTERISTIC
/begin CHARACTERISTIC K_ED_INDEX_122_IGN.FEHLERSCHWELLE "Fault code INDEX_122_IGN - debounce filter threshold for setting the fault [verified]" VALUE 0x71766 RL_VAL_UB 0 CM_0000 0 255 /end CHARACTERISTIC
/begin CHARACTERISTIC K_ED_INDEX_122_IGN.INC_NACH_EINTRAG "Fault code INDEX_122_IGN - debounce filter increment after fault-memory entry [verified]" VALUE 0x7176A RL_VAL_UB 0 CM_0000 0 255 /end CHARACTERISTIC
/begin CHARACTERISTIC K_ED_INDEX_122_IGN.INC_VOR_EINTRAG "Fault code INDEX_122_IGN - debounce filter increment before fault-memory entry [verified]" VALUE 0x71768 RL_VAL_UB 0 CM_0000 0 255 /end CHARACTERISTIC
/begin CHARACTERISTIC K_ED_INDEX_122_IGN.KLASSENINDEX "Fault code INDEX_122_IGN - fault class selection (lamp / warning behaviour) [verified]" VALUE 0x7176C RL_VAL_UB 0 CM_0000 0 255 /end CHARACTERISTIC
/begin CHARACTERISTIC K_ED_INDEX_122_IGN.OK_SCHWELLE "Fault code INDEX_122_IGN - debounce filter threshold for clearing (healing) the fault [verified]" VALUE 0x71767 RL_VAL_UB 0 CM_0000 0 255 /end CHARACTERISTIC
/begin CHARACTERISTIC K_ED_INDEX_122_IGN.P_CODE_OPENLOAD "Fault code INDEX_122_IGN - OBD P-code reported for open circuit [verified]" VALUE 0x71762 RL_VAL_UW 0 CM_0000 0 65535 /end CHARACTERISTIC
/begin CHARACTERISTIC K_ED_INDEX_122_IGN.P_CODE_SH_TO_GND "Fault code INDEX_122_IGN - OBD P-code reported for short to ground [verified]" VALUE 0x71760 RL_VAL_UW 0 CM_0000 0 65535 /end CHARACTERISTIC
/begin CHARACTERISTIC K_ED_INDEX_122_IGN.P_CODE_SH_TO_UB "Fault code INDEX_122_IGN - OBD P-code reported for short to battery voltage [verified]" VALUE 0x7175E RL_VAL_UW 0 CM_0000 0 65535 /end CHARACTERISTIC
/begin CHARACTERISTIC K_ED_INDEX_122_IGN.P_CODE_UNPLAUSIBEL "Fault code INDEX_122_IGN - OBD P-code reported for implausible signal [verified]" VALUE 0x71764 RL_VAL_UW 0 CM_0000 0 65535 /end CHARACTERISTIC
/begin CHARACTERISTIC K_ED_INDEX_123_IGN.DEC_NACH_EINTRAG "Fault code INDEX_123_IGN - debounce filter decrement after fault-memory entry [verified]" VALUE 0x71785 RL_VAL_UB 0 CM_0000 0 255 /end CHARACTERISTIC
/begin CHARACTERISTIC K_ED_INDEX_123_IGN.DEC_VOR_EINTRAG "Fault code INDEX_123_IGN - debounce filter decrement before fault-memory entry [verified]" VALUE 0x71783 RL_VAL_UB 0 CM_0000 0 255 /end CHARACTERISTIC
/begin CHARACTERISTIC K_ED_INDEX_123_IGN.FEHLERSCHWELLE "Fault code INDEX_123_IGN - debounce filter threshold for setting the fault [verified]" VALUE 0x71780 RL_VAL_UB 0 CM_0000 0 255 /end CHARACTERISTIC
/begin CHARACTERISTIC K_ED_INDEX_123_IGN.INC_NACH_EINTRAG "Fault code INDEX_123_IGN - debounce filter increment after fault-memory entry [verified]" VALUE 0x71784 RL_VAL_UB 0 CM_0000 0 255 /end CHARACTERISTIC
/begin CHARACTERISTIC K_ED_INDEX_123_IGN.INC_VOR_EINTRAG "Fault code INDEX_123_IGN - debounce filter increment before fault-memory entry [verified]" VALUE 0x71782 RL_VAL_UB 0 CM_0000 0 255 /end CHARACTERISTIC
/begin CHARACTERISTIC K_ED_INDEX_123_IGN.KLASSENINDEX "Fault code INDEX_123_IGN - fault class selection (lamp / warning behaviour) [verified]" VALUE 0x71786 RL_VAL_UB 0 CM_0000 0 255 /end CHARACTERISTIC
/begin CHARACTERISTIC K_ED_INDEX_123_IGN.OK_SCHWELLE "Fault code INDEX_123_IGN - debounce filter threshold for clearing (healing) the fault [verified]" VALUE 0x71781 RL_VAL_UB 0 CM_0000 0 255 /end CHARACTERISTIC
/begin CHARACTERISTIC K_ED_INDEX_123_IGN.P_CODE_OPENLOAD "Fault code INDEX_123_IGN - OBD P-code reported for open circuit [verified]" VALUE 0x7177C RL_VAL_UW 0 CM_0000 0 65535 /end CHARACTERISTIC
/begin CHARACTERISTIC K_ED_INDEX_123_IGN.P_CODE_SH_TO_GND "Fault code INDEX_123_IGN - OBD P-code reported for short to ground [verified]" VALUE 0x7177A RL_VAL_UW 0 CM_0000 0 65535 /end CHARACTERISTIC
/begin CHARACTERISTIC K_ED_INDEX_123_IGN.P_CODE_SH_TO_UB "Fault code INDEX_123_IGN - OBD P-code reported for short to battery voltage [verified]" VALUE 0x71778 RL_VAL_UW 0 CM_0000 0 65535 /end CHARACTERISTIC
/begin CHARACTERISTIC K_ED_INDEX_123_IGN.P_CODE_UNPLAUSIBEL "Fault code INDEX_123_IGN - OBD P-code reported for implausible signal [verified]" VALUE 0x7177E RL_VAL_UW 0 CM_0000 0 65535 /end CHARACTERISTIC
/begin CHARACTERISTIC K_ED_INDEX_124_IGN.DEC_NACH_EINTRAG "Fault code INDEX_124_IGN - debounce filter decrement after fault-memory entry [verified]" VALUE 0x7179F RL_VAL_UB 0 CM_0000 0 255 /end CHARACTERISTIC
/begin CHARACTERISTIC K_ED_INDEX_124_IGN.DEC_VOR_EINTRAG "Fault code INDEX_124_IGN - debounce filter decrement before fault-memory entry [verified]" VALUE 0x7179D RL_VAL_UB 0 CM_0000 0 255 /end CHARACTERISTIC
/begin CHARACTERISTIC K_ED_INDEX_124_IGN.FEHLERSCHWELLE "Fault code INDEX_124_IGN - debounce filter threshold for setting the fault [verified]" VALUE 0x7179A RL_VAL_UB 0 CM_0000 0 255 /end CHARACTERISTIC
/begin CHARACTERISTIC K_ED_INDEX_124_IGN.INC_NACH_EINTRAG "Fault code INDEX_124_IGN - debounce filter increment after fault-memory entry [verified]" VALUE 0x7179E RL_VAL_UB 0 CM_0000 0 255 /end CHARACTERISTIC
/begin CHARACTERISTIC K_ED_INDEX_124_IGN.INC_VOR_EINTRAG "Fault code INDEX_124_IGN - debounce filter increment before fault-memory entry [verified]" VALUE 0x7179C RL_VAL_UB 0 CM_0000 0 255 /end CHARACTERISTIC
/begin CHARACTERISTIC K_ED_INDEX_124_IGN.KLASSENINDEX "Fault code INDEX_124_IGN - fault class selection (lamp / warning behaviour) [verified]" VALUE 0x717A0 RL_VAL_UB 0 CM_0000 0 255 /end CHARACTERISTIC
/begin CHARACTERISTIC K_ED_INDEX_124_IGN.OK_SCHWELLE "Fault code INDEX_124_IGN - debounce filter threshold for clearing (healing) the fault [verified]" VALUE 0x7179B RL_VAL_UB 0 CM_0000 0 255 /end CHARACTERISTIC
/begin CHARACTERISTIC K_ED_INDEX_124_IGN.P_CODE_OPENLOAD "Fault code INDEX_124_IGN - OBD P-code reported for open circuit [verified]" VALUE 0x71796 RL_VAL_UW 0 CM_0000 0 65535 /end CHARACTERISTIC
/begin CHARACTERISTIC K_ED_INDEX_124_IGN.P_CODE_SH_TO_GND "Fault code INDEX_124_IGN - OBD P-code reported for short to ground [verified]" VALUE 0x71794 RL_VAL_UW 0 CM_0000 0 65535 /end CHARACTERISTIC
/begin CHARACTERISTIC K_ED_INDEX_124_IGN.P_CODE_SH_TO_UB "Fault code INDEX_124_IGN - OBD P-code reported for short to battery voltage [verified]" VALUE 0x71792 RL_VAL_UW 0 CM_0000 0 65535 /end CHARACTERISTIC
/begin CHARACTERISTIC K_ED_INDEX_124_IGN.P_CODE_UNPLAUSIBEL "Fault code INDEX_124_IGN - OBD P-code reported for implausible signal [verified]" VALUE 0x71798 RL_VAL_UW 0 CM_0000 0 65535 /end CHARACTERISTIC
/begin CHARACTERISTIC K_ED_INDEX_125_IGN.DEC_NACH_EINTRAG "Fault code INDEX_125_IGN - debounce filter decrement after fault-memory entry [verified]" VALUE 0x717B9 RL_VAL_UB 0 CM_0000 0 255 /end CHARACTERISTIC
/begin CHARACTERISTIC K_ED_INDEX_125_IGN.DEC_VOR_EINTRAG "Fault code INDEX_125_IGN - debounce filter decrement before fault-memory entry [verified]" VALUE 0x717B7 RL_VAL_UB 0 CM_0000 0 255 /end CHARACTERISTIC
/begin CHARACTERISTIC K_ED_INDEX_125_IGN.FEHLERSCHWELLE "Fault code INDEX_125_IGN - debounce filter threshold for setting the fault [verified]" VALUE 0x717B4 RL_VAL_UB 0 CM_0000 0 255 /end CHARACTERISTIC
/begin CHARACTERISTIC K_ED_INDEX_125_IGN.INC_NACH_EINTRAG "Fault code INDEX_125_IGN - debounce filter increment after fault-memory entry [verified]" VALUE 0x717B8 RL_VAL_UB 0 CM_0000 0 255 /end CHARACTERISTIC
/begin CHARACTERISTIC K_ED_INDEX_125_IGN.INC_VOR_EINTRAG "Fault code INDEX_125_IGN - debounce filter increment before fault-memory entry [verified]" VALUE 0x717B6 RL_VAL_UB 0 CM_0000 0 255 /end CHARACTERISTIC
/begin CHARACTERISTIC K_ED_INDEX_125_IGN.KLASSENINDEX "Fault code INDEX_125_IGN - fault class selection (lamp / warning behaviour) [verified]" VALUE 0x717BA RL_VAL_UB 0 CM_0000 0 255 /end CHARACTERISTIC
/begin CHARACTERISTIC K_ED_INDEX_125_IGN.OK_SCHWELLE "Fault code INDEX_125_IGN - debounce filter threshold for clearing (healing) the fault [verified]" VALUE 0x717B5 RL_VAL_UB 0 CM_0000 0 255 /end CHARACTERISTIC
/begin CHARACTERISTIC K_ED_INDEX_125_IGN.P_CODE_OPENLOAD "Fault code INDEX_125_IGN - OBD P-code reported for open circuit [verified]" VALUE 0x717B0 RL_VAL_UW 0 CM_0000 0 65535 /end CHARACTERISTIC
/begin CHARACTERISTIC K_ED_INDEX_125_IGN.P_CODE_SH_TO_GND "Fault code INDEX_125_IGN - OBD P-code reported for short to ground [verified]" VALUE 0x717AE RL_VAL_UW 0 CM_0000 0 65535 /end CHARACTERISTIC
/begin CHARACTERISTIC K_ED_INDEX_125_IGN.P_CODE_SH_TO_UB "Fault code INDEX_125_IGN - OBD P-code reported for short to battery voltage [verified]" VALUE 0x717AC RL_VAL_UW 0 CM_0000 0 65535 /end CHARACTERISTIC
/begin CHARACTERISTIC K_ED_INDEX_125_IGN.P_CODE_UNPLAUSIBEL "Fault code INDEX_125_IGN - OBD P-code reported for implausible signal [verified]" VALUE 0x717B2 RL_VAL_UW 0 CM_0000 0 65535 /end CHARACTERISTIC
/begin CHARACTERISTIC K_ED_INDEX_126_IGN.DEC_NACH_EINTRAG "Fault code INDEX_126_IGN - debounce filter decrement after fault-memory entry [verified]" VALUE 0x717D3 RL_VAL_UB 0 CM_0000 0 255 /end CHARACTERISTIC
/begin CHARACTERISTIC K_ED_INDEX_126_IGN.DEC_VOR_EINTRAG "Fault code INDEX_126_IGN - debounce filter decrement before fault-memory entry [verified]" VALUE 0x717D1 RL_VAL_UB 0 CM_0000 0 255 /end CHARACTERISTIC
/begin CHARACTERISTIC K_ED_INDEX_126_IGN.FEHLERSCHWELLE "Fault code INDEX_126_IGN - debounce filter threshold for setting the fault [verified]" VALUE 0x717CE RL_VAL_UB 0 CM_0000 0 255 /end CHARACTERISTIC
/begin CHARACTERISTIC K_ED_INDEX_126_IGN.INC_NACH_EINTRAG "Fault code INDEX_126_IGN - debounce filter increment after fault-memory entry [verified]" VALUE 0x717D2 RL_VAL_UB 0 CM_0000 0 255 /end CHARACTERISTIC
/begin CHARACTERISTIC K_ED_INDEX_126_IGN.INC_VOR_EINTRAG "Fault code INDEX_126_IGN - debounce filter increment before fault-memory entry [verified]" VALUE 0x717D0 RL_VAL_UB 0 CM_0000 0 255 /end CHARACTERISTIC
/begin CHARACTERISTIC K_ED_INDEX_126_IGN.KLASSENINDEX "Fault code INDEX_126_IGN - fault class selection (lamp / warning behaviour) [verified]" VALUE 0x717D4 RL_VAL_UB 0 CM_0000 0 255 /end CHARACTERISTIC
/begin CHARACTERISTIC K_ED_INDEX_126_IGN.OK_SCHWELLE "Fault code INDEX_126_IGN - debounce filter threshold for clearing (healing) the fault [verified]" VALUE 0x717CF RL_VAL_UB 0 CM_0000 0 255 /end CHARACTERISTIC
/begin CHARACTERISTIC K_ED_INDEX_126_IGN.P_CODE_OPENLOAD "Fault code INDEX_126_IGN - OBD P-code reported for open circuit [verified]" VALUE 0x717CA RL_VAL_UW 0 CM_0000 0 65535 /end CHARACTERISTIC
/begin CHARACTERISTIC K_ED_INDEX_126_IGN.P_CODE_SH_TO_GND "Fault code INDEX_126_IGN - OBD P-code reported for short to ground [verified]" VALUE 0x717C8 RL_VAL_UW 0 CM_0000 0 65535 /end CHARACTERISTIC
/begin CHARACTERISTIC K_ED_INDEX_126_IGN.P_CODE_SH_TO_UB "Fault code INDEX_126_IGN - OBD P-code reported for short to battery voltage [verified]" VALUE 0x717C6 RL_VAL_UW 0 CM_0000 0 65535 /end CHARACTERISTIC
/begin CHARACTERISTIC K_ED_INDEX_126_IGN.P_CODE_UNPLAUSIBEL "Fault code INDEX_126_IGN - OBD P-code reported for implausible signal [verified]" VALUE 0x717CC RL_VAL_UW 0 CM_0000 0 65535 /end CHARACTERISTIC
/begin CHARACTERISTIC K_ED_INDEX_127_IGN.DEC_NACH_EINTRAG "Fault code INDEX_127_IGN - debounce filter decrement after fault-memory entry [verified]" VALUE 0x717ED RL_VAL_UB 0 CM_0000 0 255 /end CHARACTERISTIC
/begin CHARACTERISTIC K_ED_INDEX_127_IGN.DEC_VOR_EINTRAG "Fault code INDEX_127_IGN - debounce filter decrement before fault-memory entry [verified]" VALUE 0x717EB RL_VAL_UB 0 CM_0000 0 255 /end CHARACTERISTIC
/begin CHARACTERISTIC K_ED_INDEX_127_IGN.FEHLERSCHWELLE "Fault code INDEX_127_IGN - debounce filter threshold for setting the fault [verified]" VALUE 0x717E8 RL_VAL_UB 0 CM_0000 0 255 /end CHARACTERISTIC
/begin CHARACTERISTIC K_ED_INDEX_127_IGN.INC_NACH_EINTRAG "Fault code INDEX_127_IGN - debounce filter increment after fault-memory entry [verified]" VALUE 0x717EC RL_VAL_UB 0 CM_0000 0 255 /end CHARACTERISTIC
/begin CHARACTERISTIC K_ED_INDEX_127_IGN.INC_VOR_EINTRAG "Fault code INDEX_127_IGN - debounce filter increment before fault-memory entry [verified]" VALUE 0x717EA RL_VAL_UB 0 CM_0000 0 255 /end CHARACTERISTIC
/begin CHARACTERISTIC K_ED_INDEX_127_IGN.KLASSENINDEX "Fault code INDEX_127_IGN - fault class selection (lamp / warning behaviour) [verified]" VALUE 0x717EE RL_VAL_UB 0 CM_0000 0 255 /end CHARACTERISTIC
/begin CHARACTERISTIC K_ED_INDEX_127_IGN.OK_SCHWELLE "Fault code INDEX_127_IGN - debounce filter threshold for clearing (healing) the fault [verified]" VALUE 0x717E9 RL_VAL_UB 0 CM_0000 0 255 /end CHARACTERISTIC
/begin CHARACTERISTIC K_ED_INDEX_127_IGN.P_CODE_OPENLOAD "Fault code INDEX_127_IGN - OBD P-code reported for open circuit [verified]" VALUE 0x717E4 RL_VAL_UW 0 CM_0000 0 65535 /end CHARACTERISTIC
/begin CHARACTERISTIC K_ED_INDEX_127_IGN.P_CODE_SH_TO_GND "Fault code INDEX_127_IGN - OBD P-code reported for short to ground [verified]" VALUE 0x717E2 RL_VAL_UW 0 CM_0000 0 65535 /end CHARACTERISTIC
/begin CHARACTERISTIC K_ED_INDEX_127_IGN.P_CODE_SH_TO_UB "Fault code INDEX_127_IGN - OBD P-code reported for short to battery voltage [verified]" VALUE 0x717E0 RL_VAL_UW 0 CM_0000 0 65535 /end CHARACTERISTIC
/begin CHARACTERISTIC K_ED_INDEX_127_IGN.P_CODE_UNPLAUSIBEL "Fault code INDEX_127_IGN - OBD P-code reported for implausible signal [verified]" VALUE 0x717E6 RL_VAL_UW 0 CM_0000 0 65535 /end CHARACTERISTIC
/begin CHARACTERISTIC K_ED_INDEX_33_IGN.DEC_NACH_EINTRAG "Fault code INDEX_33_IGN - debounce filter decrement after fault-memory entry [verified]" VALUE 0x70E61 RL_VAL_UB 0 CM_0000 0 255 /end CHARACTERISTIC
/begin CHARACTERISTIC K_ED_INDEX_33_IGN.DEC_VOR_EINTRAG "Fault code INDEX_33_IGN - debounce filter decrement before fault-memory entry [verified]" VALUE 0x70E5F RL_VAL_UB 0 CM_0000 0 255 /end CHARACTERISTIC
/begin CHARACTERISTIC K_ED_INDEX_33_IGN.FEHLERSCHWELLE "Fault code INDEX_33_IGN - debounce filter threshold for setting the fault [verified]" VALUE 0x70E5C RL_VAL_UB 0 CM_0000 0 255 /end CHARACTERISTIC
/begin CHARACTERISTIC K_ED_INDEX_33_IGN.INC_NACH_EINTRAG "Fault code INDEX_33_IGN - debounce filter increment after fault-memory entry [verified]" VALUE 0x70E60 RL_VAL_UB 0 CM_0000 0 255 /end CHARACTERISTIC
/begin CHARACTERISTIC K_ED_INDEX_33_IGN.INC_VOR_EINTRAG "Fault code INDEX_33_IGN - debounce filter increment before fault-memory entry [verified]" VALUE 0x70E5E RL_VAL_UB 0 CM_0000 0 255 /end CHARACTERISTIC
/begin CHARACTERISTIC K_ED_INDEX_33_IGN.KLASSENINDEX "Fault code INDEX_33_IGN - fault class selection (lamp / warning behaviour) [verified]" VALUE 0x70E62 RL_VAL_UB 0 CM_0000 0 255 /end CHARACTERISTIC
/begin CHARACTERISTIC K_ED_INDEX_33_IGN.OK_SCHWELLE "Fault code INDEX_33_IGN - debounce filter threshold for clearing (healing) the fault [verified]" VALUE 0x70E5D RL_VAL_UB 0 CM_0000 0 255 /end CHARACTERISTIC
/begin CHARACTERISTIC K_ED_INDEX_33_IGN.P_CODE_OPENLOAD "Fault code INDEX_33_IGN - OBD P-code reported for open circuit [verified]" VALUE 0x70E58 RL_VAL_UW 0 CM_0000 0 65535 /end CHARACTERISTIC
/begin CHARACTERISTIC K_ED_INDEX_33_IGN.P_CODE_SH_TO_GND "Fault code INDEX_33_IGN - OBD P-code reported for short to ground [verified]" VALUE 0x70E56 RL_VAL_UW 0 CM_0000 0 65535 /end CHARACTERISTIC
/begin CHARACTERISTIC K_ED_INDEX_33_IGN.P_CODE_SH_TO_UB "Fault code INDEX_33_IGN - OBD P-code reported for short to battery voltage [verified]" VALUE 0x70E54 RL_VAL_UW 0 CM_0000 0 65535 /end CHARACTERISTIC
/begin CHARACTERISTIC K_ED_INDEX_33_IGN.P_CODE_UNPLAUSIBEL "Fault code INDEX_33_IGN - OBD P-code reported for implausible signal [verified]" VALUE 0x70E5A RL_VAL_UW 0 CM_0000 0 65535 /end CHARACTERISTIC
/begin CHARACTERISTIC K_ED_INDEX_34_IGN.DEC_NACH_EINTRAG "Fault code INDEX_34_IGN - debounce filter decrement after fault-memory entry [verified]" VALUE 0x70E7B RL_VAL_UB 0 CM_0000 0 255 /end CHARACTERISTIC
/begin CHARACTERISTIC K_ED_INDEX_34_IGN.DEC_VOR_EINTRAG "Fault code INDEX_34_IGN - debounce filter decrement before fault-memory entry [verified]" VALUE 0x70E79 RL_VAL_UB 0 CM_0000 0 255 /end CHARACTERISTIC
/begin CHARACTERISTIC K_ED_INDEX_34_IGN.FEHLERSCHWELLE "Fault code INDEX_34_IGN - debounce filter threshold for setting the fault [verified]" VALUE 0x70E76 RL_VAL_UB 0 CM_0000 0 255 /end CHARACTERISTIC
/begin CHARACTERISTIC K_ED_INDEX_34_IGN.INC_NACH_EINTRAG "Fault code INDEX_34_IGN - debounce filter increment after fault-memory entry [verified]" VALUE 0x70E7A RL_VAL_UB 0 CM_0000 0 255 /end CHARACTERISTIC
/begin CHARACTERISTIC K_ED_INDEX_34_IGN.INC_VOR_EINTRAG "Fault code INDEX_34_IGN - debounce filter increment before fault-memory entry [verified]" VALUE 0x70E78 RL_VAL_UB 0 CM_0000 0 255 /end CHARACTERISTIC
/begin CHARACTERISTIC K_ED_INDEX_34_IGN.KLASSENINDEX "Fault code INDEX_34_IGN - fault class selection (lamp / warning behaviour) [verified]" VALUE 0x70E7C RL_VAL_UB 0 CM_0000 0 255 /end CHARACTERISTIC
/begin CHARACTERISTIC K_ED_INDEX_34_IGN.OK_SCHWELLE "Fault code INDEX_34_IGN - debounce filter threshold for clearing (healing) the fault [verified]" VALUE 0x70E77 RL_VAL_UB 0 CM_0000 0 255 /end CHARACTERISTIC
/begin CHARACTERISTIC K_ED_INDEX_34_IGN.P_CODE_OPENLOAD "Fault code INDEX_34_IGN - OBD P-code reported for open circuit [verified]" VALUE 0x70E72 RL_VAL_UW 0 CM_0000 0 65535 /end CHARACTERISTIC
/begin CHARACTERISTIC K_ED_INDEX_34_IGN.P_CODE_SH_TO_GND "Fault code INDEX_34_IGN - OBD P-code reported for short to ground [verified]" VALUE 0x70E70 RL_VAL_UW 0 CM_0000 0 65535 /end CHARACTERISTIC
/begin CHARACTERISTIC K_ED_INDEX_34_IGN.P_CODE_SH_TO_UB "Fault code INDEX_34_IGN - OBD P-code reported for short to battery voltage [verified]" VALUE 0x70E6E RL_VAL_UW 0 CM_0000 0 65535 /end CHARACTERISTIC
/begin CHARACTERISTIC K_ED_INDEX_34_IGN.P_CODE_UNPLAUSIBEL "Fault code INDEX_34_IGN - OBD P-code reported for implausible signal [verified]" VALUE 0x70E74 RL_VAL_UW 0 CM_0000 0 65535 /end CHARACTERISTIC
/begin CHARACTERISTIC K_ED_INDEX_35_IGN.DEC_NACH_EINTRAG "Fault code INDEX_35_IGN - debounce filter decrement after fault-memory entry [verified]" VALUE 0x70E95 RL_VAL_UB 0 CM_0000 0 255 /end CHARACTERISTIC
/begin CHARACTERISTIC K_ED_INDEX_35_IGN.DEC_VOR_EINTRAG "Fault code INDEX_35_IGN - debounce filter decrement before fault-memory entry [verified]" VALUE 0x70E93 RL_VAL_UB 0 CM_0000 0 255 /end CHARACTERISTIC
/begin CHARACTERISTIC K_ED_INDEX_35_IGN.FEHLERSCHWELLE "Fault code INDEX_35_IGN - debounce filter threshold for setting the fault [verified]" VALUE 0x70E90 RL_VAL_UB 0 CM_0000 0 255 /end CHARACTERISTIC
/begin CHARACTERISTIC K_ED_INDEX_35_IGN.INC_NACH_EINTRAG "Fault code INDEX_35_IGN - debounce filter increment after fault-memory entry [verified]" VALUE 0x70E94 RL_VAL_UB 0 CM_0000 0 255 /end CHARACTERISTIC
/begin CHARACTERISTIC K_ED_INDEX_35_IGN.INC_VOR_EINTRAG "Fault code INDEX_35_IGN - debounce filter increment before fault-memory entry [verified]" VALUE 0x70E92 RL_VAL_UB 0 CM_0000 0 255 /end CHARACTERISTIC
/begin CHARACTERISTIC K_ED_INDEX_35_IGN.KLASSENINDEX "Fault code INDEX_35_IGN - fault class selection (lamp / warning behaviour) [verified]" VALUE 0x70E96 RL_VAL_UB 0 CM_0000 0 255 /end CHARACTERISTIC
/begin CHARACTERISTIC K_ED_INDEX_35_IGN.OK_SCHWELLE "Fault code INDEX_35_IGN - debounce filter threshold for clearing (healing) the fault [verified]" VALUE 0x70E91 RL_VAL_UB 0 CM_0000 0 255 /end CHARACTERISTIC
/begin CHARACTERISTIC K_ED_INDEX_35_IGN.P_CODE_OPENLOAD "Fault code INDEX_35_IGN - OBD P-code reported for open circuit [verified]" VALUE 0x70E8C RL_VAL_UW 0 CM_0000 0 65535 /end CHARACTERISTIC
/begin CHARACTERISTIC K_ED_INDEX_35_IGN.P_CODE_SH_TO_GND "Fault code INDEX_35_IGN - OBD P-code reported for short to ground [verified]" VALUE 0x70E8A RL_VAL_UW 0 CM_0000 0 65535 /end CHARACTERISTIC
/begin CHARACTERISTIC K_ED_INDEX_35_IGN.P_CODE_SH_TO_UB "Fault code INDEX_35_IGN - OBD P-code reported for short to battery voltage [verified]" VALUE 0x70E88 RL_VAL_UW 0 CM_0000 0 65535 /end CHARACTERISTIC
/begin CHARACTERISTIC K_ED_INDEX_35_IGN.P_CODE_UNPLAUSIBEL "Fault code INDEX_35_IGN - OBD P-code reported for implausible signal [verified]" VALUE 0x70E8E RL_VAL_UW 0 CM_0000 0 65535 /end CHARACTERISTIC
/begin CHARACTERISTIC K_ED_INDEX_36_IGN.DEC_NACH_EINTRAG "Fault code INDEX_36_IGN - debounce filter decrement after fault-memory entry [verified]" VALUE 0x70EAF RL_VAL_UB 0 CM_0000 0 255 /end CHARACTERISTIC
/begin CHARACTERISTIC K_ED_INDEX_36_IGN.DEC_VOR_EINTRAG "Fault code INDEX_36_IGN - debounce filter decrement before fault-memory entry [verified]" VALUE 0x70EAD RL_VAL_UB 0 CM_0000 0 255 /end CHARACTERISTIC
/begin CHARACTERISTIC K_ED_INDEX_36_IGN.FEHLERSCHWELLE "Fault code INDEX_36_IGN - debounce filter threshold for setting the fault [verified]" VALUE 0x70EAA RL_VAL_UB 0 CM_0000 0 255 /end CHARACTERISTIC
/begin CHARACTERISTIC K_ED_INDEX_36_IGN.INC_NACH_EINTRAG "Fault code INDEX_36_IGN - debounce filter increment after fault-memory entry [verified]" VALUE 0x70EAE RL_VAL_UB 0 CM_0000 0 255 /end CHARACTERISTIC
/begin CHARACTERISTIC K_ED_INDEX_36_IGN.INC_VOR_EINTRAG "Fault code INDEX_36_IGN - debounce filter increment before fault-memory entry [verified]" VALUE 0x70EAC RL_VAL_UB 0 CM_0000 0 255 /end CHARACTERISTIC
/begin CHARACTERISTIC K_ED_INDEX_36_IGN.KLASSENINDEX "Fault code INDEX_36_IGN - fault class selection (lamp / warning behaviour) [verified]" VALUE 0x70EB0 RL_VAL_UB 0 CM_0000 0 255 /end CHARACTERISTIC
/begin CHARACTERISTIC K_ED_INDEX_36_IGN.OK_SCHWELLE "Fault code INDEX_36_IGN - debounce filter threshold for clearing (healing) the fault [verified]" VALUE 0x70EAB RL_VAL_UB 0 CM_0000 0 255 /end CHARACTERISTIC
/begin CHARACTERISTIC K_ED_INDEX_36_IGN.P_CODE_OPENLOAD "Fault code INDEX_36_IGN - OBD P-code reported for open circuit [verified]" VALUE 0x70EA6 RL_VAL_UW 0 CM_0000 0 65535 /end CHARACTERISTIC
/begin CHARACTERISTIC K_ED_INDEX_36_IGN.P_CODE_SH_TO_GND "Fault code INDEX_36_IGN - OBD P-code reported for short to ground [verified]" VALUE 0x70EA4 RL_VAL_UW 0 CM_0000 0 65535 /end CHARACTERISTIC
/begin CHARACTERISTIC K_ED_INDEX_36_IGN.P_CODE_SH_TO_UB "Fault code INDEX_36_IGN - OBD P-code reported for short to battery voltage [verified]" VALUE 0x70EA2 RL_VAL_UW 0 CM_0000 0 65535 /end CHARACTERISTIC
/begin CHARACTERISTIC K_ED_INDEX_36_IGN.P_CODE_UNPLAUSIBEL "Fault code INDEX_36_IGN - OBD P-code reported for implausible signal [verified]" VALUE 0x70EA8 RL_VAL_UW 0 CM_0000 0 65535 /end CHARACTERISTIC
/begin CHARACTERISTIC K_ED_INDEX_71_IGN.DEC_NACH_EINTRAG "Fault code INDEX_71_IGN - debounce filter decrement after fault-memory entry [verified]" VALUE 0x7123D RL_VAL_UB 0 CM_0000 0 255 /end CHARACTERISTIC
/begin CHARACTERISTIC K_ED_INDEX_71_IGN.DEC_VOR_EINTRAG "Fault code INDEX_71_IGN - debounce filter decrement before fault-memory entry [verified]" VALUE 0x7123B RL_VAL_UB 0 CM_0000 0 255 /end CHARACTERISTIC
/begin CHARACTERISTIC K_ED_INDEX_71_IGN.FEHLERSCHWELLE "Fault code INDEX_71_IGN - debounce filter threshold for setting the fault [verified]" VALUE 0x71238 RL_VAL_UB 0 CM_0000 0 255 /end CHARACTERISTIC
/begin CHARACTERISTIC K_ED_INDEX_71_IGN.INC_NACH_EINTRAG "Fault code INDEX_71_IGN - debounce filter increment after fault-memory entry [verified]" VALUE 0x7123C RL_VAL_UB 0 CM_0000 0 255 /end CHARACTERISTIC
/begin CHARACTERISTIC K_ED_INDEX_71_IGN.INC_VOR_EINTRAG "Fault code INDEX_71_IGN - debounce filter increment before fault-memory entry [verified]" VALUE 0x7123A RL_VAL_UB 0 CM_0000 0 255 /end CHARACTERISTIC
/begin CHARACTERISTIC K_ED_INDEX_71_IGN.KLASSENINDEX "Fault code INDEX_71_IGN - fault class selection (lamp / warning behaviour) [verified]" VALUE 0x7123E RL_VAL_UB 0 CM_0000 0 255 /end CHARACTERISTIC
/begin CHARACTERISTIC K_ED_INDEX_71_IGN.OK_SCHWELLE "Fault code INDEX_71_IGN - debounce filter threshold for clearing (healing) the fault [verified]" VALUE 0x71239 RL_VAL_UB 0 CM_0000 0 255 /end CHARACTERISTIC
/begin CHARACTERISTIC K_ED_INDEX_71_IGN.P_CODE_OPENLOAD "Fault code INDEX_71_IGN - OBD P-code reported for open circuit [verified]" VALUE 0x71234 RL_VAL_UW 0 CM_0000 0 65535 /end CHARACTERISTIC
/begin CHARACTERISTIC K_ED_INDEX_71_IGN.P_CODE_SH_TO_GND "Fault code INDEX_71_IGN - OBD P-code reported for short to ground [verified]" VALUE 0x71232 RL_VAL_UW 0 CM_0000 0 65535 /end CHARACTERISTIC
/begin CHARACTERISTIC K_ED_INDEX_71_IGN.P_CODE_SH_TO_UB "Fault code INDEX_71_IGN - OBD P-code reported for short to battery voltage [verified]" VALUE 0x71230 RL_VAL_UW 0 CM_0000 0 65535 /end CHARACTERISTIC
/begin CHARACTERISTIC K_ED_INDEX_71_IGN.P_CODE_UNPLAUSIBEL "Fault code INDEX_71_IGN - OBD P-code reported for implausible signal [verified]" VALUE 0x71236 RL_VAL_UW 0 CM_0000 0 65535 /end CHARACTERISTIC
/begin CHARACTERISTIC K_ED_INDEX_72_IGN.DEC_NACH_EINTRAG "Fault code INDEX_72_IGN - debounce filter decrement after fault-memory entry [verified]" VALUE 0x71257 RL_VAL_UB 0 CM_0000 0 255 /end CHARACTERISTIC
/begin CHARACTERISTIC K_ED_INDEX_72_IGN.DEC_VOR_EINTRAG "Fault code INDEX_72_IGN - debounce filter decrement before fault-memory entry [verified]" VALUE 0x71255 RL_VAL_UB 0 CM_0000 0 255 /end CHARACTERISTIC
/begin CHARACTERISTIC K_ED_INDEX_72_IGN.FEHLERSCHWELLE "Fault code INDEX_72_IGN - debounce filter threshold for setting the fault [verified]" VALUE 0x71252 RL_VAL_UB 0 CM_0000 0 255 /end CHARACTERISTIC
/begin CHARACTERISTIC K_ED_INDEX_72_IGN.INC_NACH_EINTRAG "Fault code INDEX_72_IGN - debounce filter increment after fault-memory entry [verified]" VALUE 0x71256 RL_VAL_UB 0 CM_0000 0 255 /end CHARACTERISTIC
/begin CHARACTERISTIC K_ED_INDEX_72_IGN.INC_VOR_EINTRAG "Fault code INDEX_72_IGN - debounce filter increment before fault-memory entry [verified]" VALUE 0x71254 RL_VAL_UB 0 CM_0000 0 255 /end CHARACTERISTIC
/begin CHARACTERISTIC K_ED_INDEX_72_IGN.KLASSENINDEX "Fault code INDEX_72_IGN - fault class selection (lamp / warning behaviour) [verified]" VALUE 0x71258 RL_VAL_UB 0 CM_0000 0 255 /end CHARACTERISTIC
/begin CHARACTERISTIC K_ED_INDEX_72_IGN.OK_SCHWELLE "Fault code INDEX_72_IGN - debounce filter threshold for clearing (healing) the fault [verified]" VALUE 0x71253 RL_VAL_UB 0 CM_0000 0 255 /end CHARACTERISTIC
/begin CHARACTERISTIC K_ED_INDEX_72_IGN.P_CODE_OPENLOAD "Fault code INDEX_72_IGN - OBD P-code reported for open circuit [verified]" VALUE 0x7124E RL_VAL_UW 0 CM_0000 0 65535 /end CHARACTERISTIC
/begin CHARACTERISTIC K_ED_INDEX_72_IGN.P_CODE_SH_TO_GND "Fault code INDEX_72_IGN - OBD P-code reported for short to ground [verified]" VALUE 0x7124C RL_VAL_UW 0 CM_0000 0 65535 /end CHARACTERISTIC
/begin CHARACTERISTIC K_ED_INDEX_72_IGN.P_CODE_SH_TO_UB "Fault code INDEX_72_IGN - OBD P-code reported for short to battery voltage [verified]" VALUE 0x7124A RL_VAL_UW 0 CM_0000 0 65535 /end CHARACTERISTIC
/begin CHARACTERISTIC K_ED_INDEX_72_IGN.P_CODE_UNPLAUSIBEL "Fault code INDEX_72_IGN - OBD P-code reported for implausible signal [verified]" VALUE 0x71250 RL_VAL_UW 0 CM_0000 0 65535 /end CHARACTERISTIC
/begin CHARACTERISTIC K_ED_LLR_DIAG.DEC_NACH_EINTRAG "Fault code LLR_DIAG - debounce filter decrement after fault-memory entry [verified]" VALUE 0x714C7 RL_VAL_UB 0 CM_0000 0 255 /end CHARACTERISTIC
/begin CHARACTERISTIC K_ED_LLR_DIAG.DEC_VOR_EINTRAG "Fault code LLR_DIAG - debounce filter decrement before fault-memory entry [verified]" VALUE 0x714C5 RL_VAL_UB 0 CM_0000 0 255 /end CHARACTERISTIC
/begin CHARACTERISTIC K_ED_LLR_DIAG.FEHLERSCHWELLE "Fault code LLR_DIAG - debounce filter threshold for setting the fault [verified]" VALUE 0x714C2 RL_VAL_UB 0 CM_0000 0 255 /end CHARACTERISTIC
/begin CHARACTERISTIC K_ED_LLR_DIAG.INC_NACH_EINTRAG "Fault code LLR_DIAG - debounce filter increment after fault-memory entry [verified]" VALUE 0x714C6 RL_VAL_UB 0 CM_0000 0 255 /end CHARACTERISTIC
/begin CHARACTERISTIC K_ED_LLR_DIAG.INC_VOR_EINTRAG "Fault code LLR_DIAG - debounce filter increment before fault-memory entry [verified]" VALUE 0x714C4 RL_VAL_UB 0 CM_0000 0 255 /end CHARACTERISTIC
/begin CHARACTERISTIC K_ED_LLR_DIAG.KLASSENINDEX "Fault code LLR_DIAG - fault class selection (lamp / warning behaviour) [verified]" VALUE 0x714C8 RL_VAL_UB 0 CM_0000 0 255 /end CHARACTERISTIC
/begin CHARACTERISTIC K_ED_LLR_DIAG.OK_SCHWELLE "Fault code LLR_DIAG - debounce filter threshold for clearing (healing) the fault [verified]" VALUE 0x714C3 RL_VAL_UB 0 CM_0000 0 255 /end CHARACTERISTIC
/begin CHARACTERISTIC K_ED_LLR_DIAG.P_CODE_OPENLOAD "Fault code LLR_DIAG - OBD P-code reported for open circuit [verified]" VALUE 0x714BE RL_VAL_UW 0 CM_0000 0 65535 /end CHARACTERISTIC
/begin CHARACTERISTIC K_ED_LLR_DIAG.P_CODE_SH_TO_GND "Fault code LLR_DIAG - OBD P-code reported for short to ground [verified]" VALUE 0x714BC RL_VAL_UW 0 CM_0000 0 65535 /end CHARACTERISTIC
/begin CHARACTERISTIC K_ED_LLR_DIAG.P_CODE_SH_TO_UB "Fault code LLR_DIAG - OBD P-code reported for short to battery voltage [verified]" VALUE 0x714BA RL_VAL_UW 0 CM_0000 0 65535 /end CHARACTERISTIC
/begin CHARACTERISTIC K_ED_LLR_DIAG.P_CODE_UNPLAUSIBEL "Fault code LLR_DIAG - OBD P-code reported for implausible signal [verified]" VALUE 0x714C0 RL_VAL_UW 0 CM_0000 0 65535 /end CHARACTERISTIC
/begin CHARACTERISTIC K_ED_LLR_DIAG_CSS.DEC_NACH_EINTRAG "Fault code LLR_DIAG_CSS - debounce filter decrement after fault-memory entry [verified]" VALUE 0x71619 RL_VAL_UB 0 CM_0000 0 255 /end CHARACTERISTIC
/begin CHARACTERISTIC K_ED_LLR_DIAG_CSS.DEC_VOR_EINTRAG "Fault code LLR_DIAG_CSS - debounce filter decrement before fault-memory entry [verified]" VALUE 0x71617 RL_VAL_UB 0 CM_0000 0 255 /end CHARACTERISTIC
/begin CHARACTERISTIC K_ED_LLR_DIAG_CSS.FEHLERSCHWELLE "Fault code LLR_DIAG_CSS - debounce filter threshold for setting the fault [verified]" VALUE 0x71614 RL_VAL_UB 0 CM_0000 0 255 /end CHARACTERISTIC
/begin CHARACTERISTIC K_ED_LLR_DIAG_CSS.INC_NACH_EINTRAG "Fault code LLR_DIAG_CSS - debounce filter increment after fault-memory entry [verified]" VALUE 0x71618 RL_VAL_UB 0 CM_0000 0 255 /end CHARACTERISTIC
/begin CHARACTERISTIC K_ED_LLR_DIAG_CSS.INC_VOR_EINTRAG "Fault code LLR_DIAG_CSS - debounce filter increment before fault-memory entry [verified]" VALUE 0x71616 RL_VAL_UB 0 CM_0000 0 255 /end CHARACTERISTIC
/begin CHARACTERISTIC K_ED_LLR_DIAG_CSS.KLASSENINDEX "Fault code LLR_DIAG_CSS - fault class selection (lamp / warning behaviour) [verified]" VALUE 0x7161A RL_VAL_UB 0 CM_0000 0 255 /end CHARACTERISTIC
/begin CHARACTERISTIC K_ED_LLR_DIAG_CSS.OK_SCHWELLE "Fault code LLR_DIAG_CSS - debounce filter threshold for clearing (healing) the fault [verified]" VALUE 0x71615 RL_VAL_UB 0 CM_0000 0 255 /end CHARACTERISTIC
/begin CHARACTERISTIC K_ED_LLR_DIAG_CSS.P_CODE_OPENLOAD "Fault code LLR_DIAG_CSS - OBD P-code reported for open circuit [verified]" VALUE 0x71610 RL_VAL_UW 0 CM_0000 0 65535 /end CHARACTERISTIC
/begin CHARACTERISTIC K_ED_LLR_DIAG_CSS.P_CODE_SH_TO_GND "Fault code LLR_DIAG_CSS - OBD P-code reported for short to ground [verified]" VALUE 0x7160E RL_VAL_UW 0 CM_0000 0 65535 /end CHARACTERISTIC
/begin CHARACTERISTIC K_ED_LLR_DIAG_CSS.P_CODE_SH_TO_UB "Fault code LLR_DIAG_CSS - OBD P-code reported for short to battery voltage [verified]" VALUE 0x7160C RL_VAL_UW 0 CM_0000 0 65535 /end CHARACTERISTIC
/begin CHARACTERISTIC K_ED_LLR_DIAG_CSS.P_CODE_UNPLAUSIBEL "Fault code LLR_DIAG_CSS - OBD P-code reported for implausible signal [verified]" VALUE 0x71612 RL_VAL_UW 0 CM_0000 0 65535 /end CHARACTERISTIC
/begin CHARACTERISTIC K_ED_LLS1_CAN.DEC_NACH_EINTRAG "Fault code LLS1_CAN - debounce filter decrement after fault-memory entry [verified]" VALUE 0x70CC1 RL_VAL_UB 0 CM_0000 0 255 /end CHARACTERISTIC
/begin CHARACTERISTIC K_ED_LLS1_CAN.DEC_VOR_EINTRAG "Fault code LLS1_CAN - debounce filter decrement before fault-memory entry [verified]" VALUE 0x70CBF RL_VAL_UB 0 CM_0000 0 255 /end CHARACTERISTIC
/begin CHARACTERISTIC K_ED_LLS1_CAN.FEHLERSCHWELLE "Fault code LLS1_CAN - debounce filter threshold for setting the fault [verified]" VALUE 0x70CBC RL_VAL_UB 0 CM_0000 0 255 /end CHARACTERISTIC
/begin CHARACTERISTIC K_ED_LLS1_CAN.INC_NACH_EINTRAG "Fault code LLS1_CAN - debounce filter increment after fault-memory entry [verified]" VALUE 0x70CC0 RL_VAL_UB 0 CM_0000 0 255 /end CHARACTERISTIC
/begin CHARACTERISTIC K_ED_LLS1_CAN.INC_VOR_EINTRAG "Fault code LLS1_CAN - debounce filter increment before fault-memory entry [verified]" VALUE 0x70CBE RL_VAL_UB 0 CM_0000 0 255 /end CHARACTERISTIC
/begin CHARACTERISTIC K_ED_LLS1_CAN.KLASSENINDEX "Fault code LLS1_CAN - fault class selection (lamp / warning behaviour) [verified]" VALUE 0x70CC2 RL_VAL_UB 0 CM_0000 0 255 /end CHARACTERISTIC
/begin CHARACTERISTIC K_ED_LLS1_CAN.OK_SCHWELLE "Fault code LLS1_CAN - debounce filter threshold for clearing (healing) the fault [verified]" VALUE 0x70CBD RL_VAL_UB 0 CM_0000 0 255 /end CHARACTERISTIC
/begin CHARACTERISTIC K_ED_LLS1_CAN.P_CODE_OPENLOAD "Fault code LLS1_CAN - OBD P-code reported for open circuit [verified]" VALUE 0x70CB8 RL_VAL_UW 0 CM_0000 0 65535 /end CHARACTERISTIC
/begin CHARACTERISTIC K_ED_LLS1_CAN.P_CODE_SH_TO_GND "Fault code LLS1_CAN - OBD P-code reported for short to ground [verified]" VALUE 0x70CB6 RL_VAL_UW 0 CM_0000 0 65535 /end CHARACTERISTIC
/begin CHARACTERISTIC K_ED_LLS1_CAN.P_CODE_SH_TO_UB "Fault code LLS1_CAN - OBD P-code reported for short to battery voltage [verified]" VALUE 0x70CB4 RL_VAL_UW 0 CM_0000 0 65535 /end CHARACTERISTIC
/begin CHARACTERISTIC K_ED_LLS1_CAN.P_CODE_UNPLAUSIBEL "Fault code LLS1_CAN - OBD P-code reported for implausible signal [verified]" VALUE 0x70CBA RL_VAL_UW 0 CM_0000 0 65535 /end CHARACTERISTIC
/begin CHARACTERISTIC K_ED_LLS1_CMD.DEC_NACH_EINTRAG "Fault code LLS1_CMD - debounce filter decrement after fault-memory entry [verified]" VALUE 0x71083 RL_VAL_UB 0 CM_0000 0 255 /end CHARACTERISTIC
/begin CHARACTERISTIC K_ED_LLS1_CMD.DEC_VOR_EINTRAG "Fault code LLS1_CMD - debounce filter decrement before fault-memory entry [verified]" VALUE 0x71081 RL_VAL_UB 0 CM_0000 0 255 /end CHARACTERISTIC
/begin CHARACTERISTIC K_ED_LLS1_CMD.FEHLERSCHWELLE "Fault code LLS1_CMD - debounce filter threshold for setting the fault [verified]" VALUE 0x7107E RL_VAL_UB 0 CM_0000 0 255 /end CHARACTERISTIC
/begin CHARACTERISTIC K_ED_LLS1_CMD.INC_NACH_EINTRAG "Fault code LLS1_CMD - debounce filter increment after fault-memory entry [verified]" VALUE 0x71082 RL_VAL_UB 0 CM_0000 0 255 /end CHARACTERISTIC
/begin CHARACTERISTIC K_ED_LLS1_CMD.INC_VOR_EINTRAG "Fault code LLS1_CMD - debounce filter increment before fault-memory entry [verified]" VALUE 0x71080 RL_VAL_UB 0 CM_0000 0 255 /end CHARACTERISTIC
/begin CHARACTERISTIC K_ED_LLS1_CMD.KLASSENINDEX "Fault code LLS1_CMD - fault class selection (lamp / warning behaviour) [verified]" VALUE 0x71084 RL_VAL_UB 0 CM_0000 0 255 /end CHARACTERISTIC
/begin CHARACTERISTIC K_ED_LLS1_CMD.OK_SCHWELLE "Fault code LLS1_CMD - debounce filter threshold for clearing (healing) the fault [verified]" VALUE 0x7107F RL_VAL_UB 0 CM_0000 0 255 /end CHARACTERISTIC
/begin CHARACTERISTIC K_ED_LLS1_CMD.P_CODE_OPENLOAD "Fault code LLS1_CMD - OBD P-code reported for open circuit [verified]" VALUE 0x7107A RL_VAL_UW 0 CM_0000 0 65535 /end CHARACTERISTIC
/begin CHARACTERISTIC K_ED_LLS1_CMD.P_CODE_SH_TO_GND "Fault code LLS1_CMD - OBD P-code reported for short to ground [verified]" VALUE 0x71078 RL_VAL_UW 0 CM_0000 0 65535 /end CHARACTERISTIC
/begin CHARACTERISTIC K_ED_LLS1_CMD.P_CODE_SH_TO_UB "Fault code LLS1_CMD - OBD P-code reported for short to battery voltage [verified]" VALUE 0x71076 RL_VAL_UW 0 CM_0000 0 65535 /end CHARACTERISTIC
/begin CHARACTERISTIC K_ED_LLS1_CMD.P_CODE_UNPLAUSIBEL "Fault code LLS1_CMD - OBD P-code reported for implausible signal [verified]" VALUE 0x7107C RL_VAL_UW 0 CM_0000 0 65535 /end CHARACTERISTIC
/begin CHARACTERISTIC K_ED_LLS1_REGLER.DEC_NACH_EINTRAG "Fault code LLS1_REGLER - debounce filter decrement after fault-memory entry [verified]" VALUE 0x70F65 RL_VAL_UB 0 CM_0000 0 255 /end CHARACTERISTIC
/begin CHARACTERISTIC K_ED_LLS1_REGLER.DEC_VOR_EINTRAG "Fault code LLS1_REGLER - debounce filter decrement before fault-memory entry [verified]" VALUE 0x70F63 RL_VAL_UB 0 CM_0000 0 255 /end CHARACTERISTIC
/begin CHARACTERISTIC K_ED_LLS1_REGLER.FEHLERSCHWELLE "Fault code LLS1_REGLER - debounce filter threshold for setting the fault [verified]" VALUE 0x70F60 RL_VAL_UB 0 CM_0000 0 255 /end CHARACTERISTIC
/begin CHARACTERISTIC K_ED_LLS1_REGLER.INC_NACH_EINTRAG "Fault code LLS1_REGLER - debounce filter increment after fault-memory entry [verified]" VALUE 0x70F64 RL_VAL_UB 0 CM_0000 0 255 /end CHARACTERISTIC
/begin CHARACTERISTIC K_ED_LLS1_REGLER.INC_VOR_EINTRAG "Fault code LLS1_REGLER - debounce filter increment before fault-memory entry [verified]" VALUE 0x70F62 RL_VAL_UB 0 CM_0000 0 255 /end CHARACTERISTIC
/begin CHARACTERISTIC K_ED_LLS1_REGLER.KLASSENINDEX "Fault code LLS1_REGLER - fault class selection (lamp / warning behaviour) [verified]" VALUE 0x70F66 RL_VAL_UB 0 CM_0000 0 255 /end CHARACTERISTIC
/begin CHARACTERISTIC K_ED_LLS1_REGLER.OK_SCHWELLE "Fault code LLS1_REGLER - debounce filter threshold for clearing (healing) the fault [verified]" VALUE 0x70F61 RL_VAL_UB 0 CM_0000 0 255 /end CHARACTERISTIC
/begin CHARACTERISTIC K_ED_LLS1_REGLER.P_CODE_OPENLOAD "Fault code LLS1_REGLER - OBD P-code reported for open circuit [verified]" VALUE 0x70F5C RL_VAL_UW 0 CM_0000 0 65535 /end CHARACTERISTIC
/begin CHARACTERISTIC K_ED_LLS1_REGLER.P_CODE_SH_TO_GND "Fault code LLS1_REGLER - OBD P-code reported for short to ground [verified]" VALUE 0x70F5A RL_VAL_UW 0 CM_0000 0 65535 /end CHARACTERISTIC
/begin CHARACTERISTIC K_ED_LLS1_REGLER.P_CODE_SH_TO_UB "Fault code LLS1_REGLER - OBD P-code reported for short to battery voltage [verified]" VALUE 0x70F58 RL_VAL_UW 0 CM_0000 0 65535 /end CHARACTERISTIC
/begin CHARACTERISTIC K_ED_LLS1_REGLER.P_CODE_UNPLAUSIBEL "Fault code LLS1_REGLER - OBD P-code reported for implausible signal [verified]" VALUE 0x70F5E RL_VAL_UW 0 CM_0000 0 65535 /end CHARACTERISTIC
/begin CHARACTERISTIC K_ED_LLS1_SK.DEC_NACH_EINTRAG "Fault code LLS1_SK - debounce filter decrement after fault-memory entry [verified]" VALUE 0x70D29 RL_VAL_UB 0 CM_0000 0 255 /end CHARACTERISTIC
/begin CHARACTERISTIC K_ED_LLS1_SK.DEC_VOR_EINTRAG "Fault code LLS1_SK - debounce filter decrement before fault-memory entry [verified]" VALUE 0x70D27 RL_VAL_UB 0 CM_0000 0 255 /end CHARACTERISTIC
/begin CHARACTERISTIC K_ED_LLS1_SK.FEHLERSCHWELLE "Fault code LLS1_SK - debounce filter threshold for setting the fault [verified]" VALUE 0x70D24 RL_VAL_UB 0 CM_0000 0 255 /end CHARACTERISTIC
/begin CHARACTERISTIC K_ED_LLS1_SK.INC_NACH_EINTRAG "Fault code LLS1_SK - debounce filter increment after fault-memory entry [verified]" VALUE 0x70D28 RL_VAL_UB 0 CM_0000 0 255 /end CHARACTERISTIC
/begin CHARACTERISTIC K_ED_LLS1_SK.INC_VOR_EINTRAG "Fault code LLS1_SK - debounce filter increment before fault-memory entry [verified]" VALUE 0x70D26 RL_VAL_UB 0 CM_0000 0 255 /end CHARACTERISTIC
/begin CHARACTERISTIC K_ED_LLS1_SK.KLASSENINDEX "Fault code LLS1_SK - fault class selection (lamp / warning behaviour) [verified]" VALUE 0x70D2A RL_VAL_UB 0 CM_0000 0 255 /end CHARACTERISTIC
/begin CHARACTERISTIC K_ED_LLS1_SK.OK_SCHWELLE "Fault code LLS1_SK - debounce filter threshold for clearing (healing) the fault [verified]" VALUE 0x70D25 RL_VAL_UB 0 CM_0000 0 255 /end CHARACTERISTIC
/begin CHARACTERISTIC K_ED_LLS1_SK.P_CODE_OPENLOAD "Fault code LLS1_SK - OBD P-code reported for open circuit [verified]" VALUE 0x70D20 RL_VAL_UW 0 CM_0000 0 65535 /end CHARACTERISTIC
/begin CHARACTERISTIC K_ED_LLS1_SK.P_CODE_SH_TO_GND "Fault code LLS1_SK - OBD P-code reported for short to ground [verified]" VALUE 0x70D1E RL_VAL_UW 0 CM_0000 0 65535 /end CHARACTERISTIC
/begin CHARACTERISTIC K_ED_LLS1_SK.P_CODE_SH_TO_UB "Fault code LLS1_SK - OBD P-code reported for short to battery voltage [verified]" VALUE 0x70D1C RL_VAL_UW 0 CM_0000 0 65535 /end CHARACTERISTIC
/begin CHARACTERISTIC K_ED_LLS1_SK.P_CODE_UNPLAUSIBEL "Fault code LLS1_SK - OBD P-code reported for implausible signal [verified]" VALUE 0x70D22 RL_VAL_UW 0 CM_0000 0 65535 /end CHARACTERISTIC
/begin CHARACTERISTIC K_ED_LLS2_CAN.DEC_NACH_EINTRAG "Fault code LLS2_CAN - debounce filter decrement after fault-memory entry [verified]" VALUE 0x70CDB RL_VAL_UB 0 CM_0000 0 255 /end CHARACTERISTIC
/begin CHARACTERISTIC K_ED_LLS2_CAN.DEC_VOR_EINTRAG "Fault code LLS2_CAN - debounce filter decrement before fault-memory entry [verified]" VALUE 0x70CD9 RL_VAL_UB 0 CM_0000 0 255 /end CHARACTERISTIC
/begin CHARACTERISTIC K_ED_LLS2_CAN.FEHLERSCHWELLE "Fault code LLS2_CAN - debounce filter threshold for setting the fault [verified]" VALUE 0x70CD6 RL_VAL_UB 0 CM_0000 0 255 /end CHARACTERISTIC
/begin CHARACTERISTIC K_ED_LLS2_CAN.INC_NACH_EINTRAG "Fault code LLS2_CAN - debounce filter increment after fault-memory entry [verified]" VALUE 0x70CDA RL_VAL_UB 0 CM_0000 0 255 /end CHARACTERISTIC
/begin CHARACTERISTIC K_ED_LLS2_CAN.INC_VOR_EINTRAG "Fault code LLS2_CAN - debounce filter increment before fault-memory entry [verified]" VALUE 0x70CD8 RL_VAL_UB 0 CM_0000 0 255 /end CHARACTERISTIC
/begin CHARACTERISTIC K_ED_LLS2_CAN.KLASSENINDEX "Fault code LLS2_CAN - fault class selection (lamp / warning behaviour) [verified]" VALUE 0x70CDC RL_VAL_UB 0 CM_0000 0 255 /end CHARACTERISTIC
/begin CHARACTERISTIC K_ED_LLS2_CAN.OK_SCHWELLE "Fault code LLS2_CAN - debounce filter threshold for clearing (healing) the fault [verified]" VALUE 0x70CD7 RL_VAL_UB 0 CM_0000 0 255 /end CHARACTERISTIC
/begin CHARACTERISTIC K_ED_LLS2_CAN.P_CODE_OPENLOAD "Fault code LLS2_CAN - OBD P-code reported for open circuit [verified]" VALUE 0x70CD2 RL_VAL_UW 0 CM_0000 0 65535 /end CHARACTERISTIC
/begin CHARACTERISTIC K_ED_LLS2_CAN.P_CODE_SH_TO_GND "Fault code LLS2_CAN - OBD P-code reported for short to ground [verified]" VALUE 0x70CD0 RL_VAL_UW 0 CM_0000 0 65535 /end CHARACTERISTIC
/begin CHARACTERISTIC K_ED_LLS2_CAN.P_CODE_SH_TO_UB "Fault code LLS2_CAN - OBD P-code reported for short to battery voltage [verified]" VALUE 0x70CCE RL_VAL_UW 0 CM_0000 0 65535 /end CHARACTERISTIC
/begin CHARACTERISTIC K_ED_LLS2_CAN.P_CODE_UNPLAUSIBEL "Fault code LLS2_CAN - OBD P-code reported for implausible signal [verified]" VALUE 0x70CD4 RL_VAL_UW 0 CM_0000 0 65535 /end CHARACTERISTIC
/begin CHARACTERISTIC K_ED_LLS2_CMD.DEC_NACH_EINTRAG "Fault code LLS2_CMD - debounce filter decrement after fault-memory entry [verified]" VALUE 0x7109D RL_VAL_UB 0 CM_0000 0 255 /end CHARACTERISTIC
/begin CHARACTERISTIC K_ED_LLS2_CMD.DEC_VOR_EINTRAG "Fault code LLS2_CMD - debounce filter decrement before fault-memory entry [verified]" VALUE 0x7109B RL_VAL_UB 0 CM_0000 0 255 /end CHARACTERISTIC
/begin CHARACTERISTIC K_ED_LLS2_CMD.FEHLERSCHWELLE "Fault code LLS2_CMD - debounce filter threshold for setting the fault [verified]" VALUE 0x71098 RL_VAL_UB 0 CM_0000 0 255 /end CHARACTERISTIC
/begin CHARACTERISTIC K_ED_LLS2_CMD.INC_NACH_EINTRAG "Fault code LLS2_CMD - debounce filter increment after fault-memory entry [verified]" VALUE 0x7109C RL_VAL_UB 0 CM_0000 0 255 /end CHARACTERISTIC
/begin CHARACTERISTIC K_ED_LLS2_CMD.INC_VOR_EINTRAG "Fault code LLS2_CMD - debounce filter increment before fault-memory entry [verified]" VALUE 0x7109A RL_VAL_UB 0 CM_0000 0 255 /end CHARACTERISTIC
/begin CHARACTERISTIC K_ED_LLS2_CMD.KLASSENINDEX "Fault code LLS2_CMD - fault class selection (lamp / warning behaviour) [verified]" VALUE 0x7109E RL_VAL_UB 0 CM_0000 0 255 /end CHARACTERISTIC
/begin CHARACTERISTIC K_ED_LLS2_CMD.OK_SCHWELLE "Fault code LLS2_CMD - debounce filter threshold for clearing (healing) the fault [verified]" VALUE 0x71099 RL_VAL_UB 0 CM_0000 0 255 /end CHARACTERISTIC
/begin CHARACTERISTIC K_ED_LLS2_CMD.P_CODE_OPENLOAD "Fault code LLS2_CMD - OBD P-code reported for open circuit [verified]" VALUE 0x71094 RL_VAL_UW 0 CM_0000 0 65535 /end CHARACTERISTIC
/begin CHARACTERISTIC K_ED_LLS2_CMD.P_CODE_SH_TO_GND "Fault code LLS2_CMD - OBD P-code reported for short to ground [verified]" VALUE 0x71092 RL_VAL_UW 0 CM_0000 0 65535 /end CHARACTERISTIC
/begin CHARACTERISTIC K_ED_LLS2_CMD.P_CODE_SH_TO_UB "Fault code LLS2_CMD - OBD P-code reported for short to battery voltage [verified]" VALUE 0x71090 RL_VAL_UW 0 CM_0000 0 65535 /end CHARACTERISTIC
/begin CHARACTERISTIC K_ED_LLS2_CMD.P_CODE_UNPLAUSIBEL "Fault code LLS2_CMD - OBD P-code reported for implausible signal [verified]" VALUE 0x71096 RL_VAL_UW 0 CM_0000 0 65535 /end CHARACTERISTIC
/begin CHARACTERISTIC K_ED_LLS2_REGLER.DEC_NACH_EINTRAG "Fault code LLS2_REGLER - debounce filter decrement after fault-memory entry [verified]" VALUE 0x70F7F RL_VAL_UB 0 CM_0000 0 255 /end CHARACTERISTIC
/begin CHARACTERISTIC K_ED_LLS2_REGLER.DEC_VOR_EINTRAG "Fault code LLS2_REGLER - debounce filter decrement before fault-memory entry [verified]" VALUE 0x70F7D RL_VAL_UB 0 CM_0000 0 255 /end CHARACTERISTIC
/begin CHARACTERISTIC K_ED_LLS2_REGLER.FEHLERSCHWELLE "Fault code LLS2_REGLER - debounce filter threshold for setting the fault [verified]" VALUE 0x70F7A RL_VAL_UB 0 CM_0000 0 255 /end CHARACTERISTIC
/begin CHARACTERISTIC K_ED_LLS2_REGLER.INC_NACH_EINTRAG "Fault code LLS2_REGLER - debounce filter increment after fault-memory entry [verified]" VALUE 0x70F7E RL_VAL_UB 0 CM_0000 0 255 /end CHARACTERISTIC
/begin CHARACTERISTIC K_ED_LLS2_REGLER.INC_VOR_EINTRAG "Fault code LLS2_REGLER - debounce filter increment before fault-memory entry [verified]" VALUE 0x70F7C RL_VAL_UB 0 CM_0000 0 255 /end CHARACTERISTIC
/begin CHARACTERISTIC K_ED_LLS2_REGLER.KLASSENINDEX "Fault code LLS2_REGLER - fault class selection (lamp / warning behaviour) [verified]" VALUE 0x70F80 RL_VAL_UB 0 CM_0000 0 255 /end CHARACTERISTIC
/begin CHARACTERISTIC K_ED_LLS2_REGLER.OK_SCHWELLE "Fault code LLS2_REGLER - debounce filter threshold for clearing (healing) the fault [verified]" VALUE 0x70F7B RL_VAL_UB 0 CM_0000 0 255 /end CHARACTERISTIC
/begin CHARACTERISTIC K_ED_LLS2_REGLER.P_CODE_OPENLOAD "Fault code LLS2_REGLER - OBD P-code reported for open circuit [verified]" VALUE 0x70F76 RL_VAL_UW 0 CM_0000 0 65535 /end CHARACTERISTIC
/begin CHARACTERISTIC K_ED_LLS2_REGLER.P_CODE_SH_TO_GND "Fault code LLS2_REGLER - OBD P-code reported for short to ground [verified]" VALUE 0x70F74 RL_VAL_UW 0 CM_0000 0 65535 /end CHARACTERISTIC
/begin CHARACTERISTIC K_ED_LLS2_REGLER.P_CODE_SH_TO_UB "Fault code LLS2_REGLER - OBD P-code reported for short to battery voltage [verified]" VALUE 0x70F72 RL_VAL_UW 0 CM_0000 0 65535 /end CHARACTERISTIC
/begin CHARACTERISTIC K_ED_LLS2_REGLER.P_CODE_UNPLAUSIBEL "Fault code LLS2_REGLER - OBD P-code reported for implausible signal [verified]" VALUE 0x70F78 RL_VAL_UW 0 CM_0000 0 65535 /end CHARACTERISTIC
/begin CHARACTERISTIC K_ED_LLS2_SK.DEC_NACH_EINTRAG "Fault code LLS2_SK - debounce filter decrement after fault-memory entry [verified]" VALUE 0x70D43 RL_VAL_UB 0 CM_0000 0 255 /end CHARACTERISTIC
/begin CHARACTERISTIC K_ED_LLS2_SK.DEC_VOR_EINTRAG "Fault code LLS2_SK - debounce filter decrement before fault-memory entry [verified]" VALUE 0x70D41 RL_VAL_UB 0 CM_0000 0 255 /end CHARACTERISTIC
/begin CHARACTERISTIC K_ED_LLS2_SK.FEHLERSCHWELLE "Fault code LLS2_SK - debounce filter threshold for setting the fault [verified]" VALUE 0x70D3E RL_VAL_UB 0 CM_0000 0 255 /end CHARACTERISTIC
/begin CHARACTERISTIC K_ED_LLS2_SK.INC_NACH_EINTRAG "Fault code LLS2_SK - debounce filter increment after fault-memory entry [verified]" VALUE 0x70D42 RL_VAL_UB 0 CM_0000 0 255 /end CHARACTERISTIC
/begin CHARACTERISTIC K_ED_LLS2_SK.INC_VOR_EINTRAG "Fault code LLS2_SK - debounce filter increment before fault-memory entry [verified]" VALUE 0x70D40 RL_VAL_UB 0 CM_0000 0 255 /end CHARACTERISTIC
/begin CHARACTERISTIC K_ED_LLS2_SK.KLASSENINDEX "Fault code LLS2_SK - fault class selection (lamp / warning behaviour) [verified]" VALUE 0x70D44 RL_VAL_UB 0 CM_0000 0 255 /end CHARACTERISTIC
/begin CHARACTERISTIC K_ED_LLS2_SK.OK_SCHWELLE "Fault code LLS2_SK - debounce filter threshold for clearing (healing) the fault [verified]" VALUE 0x70D3F RL_VAL_UB 0 CM_0000 0 255 /end CHARACTERISTIC
/begin CHARACTERISTIC K_ED_LLS2_SK.P_CODE_OPENLOAD "Fault code LLS2_SK - OBD P-code reported for open circuit [verified]" VALUE 0x70D3A RL_VAL_UW 0 CM_0000 0 65535 /end CHARACTERISTIC
/begin CHARACTERISTIC K_ED_LLS2_SK.P_CODE_SH_TO_GND "Fault code LLS2_SK - OBD P-code reported for short to ground [verified]" VALUE 0x70D38 RL_VAL_UW 0 CM_0000 0 65535 /end CHARACTERISTIC
/begin CHARACTERISTIC K_ED_LLS2_SK.P_CODE_SH_TO_UB "Fault code LLS2_SK - OBD P-code reported for short to battery voltage [verified]" VALUE 0x70D36 RL_VAL_UW 0 CM_0000 0 65535 /end CHARACTERISTIC
/begin CHARACTERISTIC K_ED_LLS2_SK.P_CODE_UNPLAUSIBEL "Fault code LLS2_SK - OBD P-code reported for implausible signal [verified]" VALUE 0x70D3C RL_VAL_UW 0 CM_0000 0 65535 /end CHARACTERISTIC
/begin CHARACTERISTIC K_ED_LLS_INIT.DEC_NACH_EINTRAG "Fault code LLS_INIT - debounce filter decrement after fault-memory entry [verified]" VALUE 0x7101B RL_VAL_UB 0 CM_0000 0 255 /end CHARACTERISTIC
/begin CHARACTERISTIC K_ED_LLS_INIT.DEC_VOR_EINTRAG "Fault code LLS_INIT - debounce filter decrement before fault-memory entry [verified]" VALUE 0x71019 RL_VAL_UB 0 CM_0000 0 255 /end CHARACTERISTIC
/begin CHARACTERISTIC K_ED_LLS_INIT.FEHLERSCHWELLE "Fault code LLS_INIT - debounce filter threshold for setting the fault [verified]" VALUE 0x71016 RL_VAL_UB 0 CM_0000 0 255 /end CHARACTERISTIC
/begin CHARACTERISTIC K_ED_LLS_INIT.INC_NACH_EINTRAG "Fault code LLS_INIT - debounce filter increment after fault-memory entry [verified]" VALUE 0x7101A RL_VAL_UB 0 CM_0000 0 255 /end CHARACTERISTIC
/begin CHARACTERISTIC K_ED_LLS_INIT.INC_VOR_EINTRAG "Fault code LLS_INIT - debounce filter increment before fault-memory entry [verified]" VALUE 0x71018 RL_VAL_UB 0 CM_0000 0 255 /end CHARACTERISTIC
/begin CHARACTERISTIC K_ED_LLS_INIT.KLASSENINDEX "Fault code LLS_INIT - fault class selection (lamp / warning behaviour) [verified]" VALUE 0x7101C RL_VAL_UB 0 CM_0000 0 255 /end CHARACTERISTIC
/begin CHARACTERISTIC K_ED_LLS_INIT.OK_SCHWELLE "Fault code LLS_INIT - debounce filter threshold for clearing (healing) the fault [verified]" VALUE 0x71017 RL_VAL_UB 0 CM_0000 0 255 /end CHARACTERISTIC
/begin CHARACTERISTIC K_ED_LLS_INIT.P_CODE_OPENLOAD "Fault code LLS_INIT - OBD P-code reported for open circuit [verified]" VALUE 0x71012 RL_VAL_UW 0 CM_0000 0 65535 /end CHARACTERISTIC
/begin CHARACTERISTIC K_ED_LLS_INIT.P_CODE_SH_TO_GND "Fault code LLS_INIT - OBD P-code reported for short to ground [verified]" VALUE 0x71010 RL_VAL_UW 0 CM_0000 0 65535 /end CHARACTERISTIC
/begin CHARACTERISTIC K_ED_LLS_INIT.P_CODE_SH_TO_UB "Fault code LLS_INIT - OBD P-code reported for short to battery voltage [verified]" VALUE 0x7100E RL_VAL_UW 0 CM_0000 0 65535 /end CHARACTERISTIC
/begin CHARACTERISTIC K_ED_LLS_INIT.P_CODE_UNPLAUSIBEL "Fault code LLS_INIT - OBD P-code reported for implausible signal [verified]" VALUE 0x71014 RL_VAL_UW 0 CM_0000 0 65535 /end CHARACTERISTIC
/begin CHARACTERISTIC K_ED_MD_SK_ERR.DEC_NACH_EINTRAG "Fault code MD_SK_ERR - debounce filter decrement after fault-memory entry [verified]" VALUE 0x71001 RL_VAL_UB 0 CM_0000 0 255 /end CHARACTERISTIC
/begin CHARACTERISTIC K_ED_MD_SK_ERR.DEC_VOR_EINTRAG "Fault code MD_SK_ERR - debounce filter decrement before fault-memory entry [verified]" VALUE 0x70FFF RL_VAL_UB 0 CM_0000 0 255 /end CHARACTERISTIC
/begin CHARACTERISTIC K_ED_MD_SK_ERR.FEHLERSCHWELLE "Fault code MD_SK_ERR - debounce filter threshold for setting the fault [verified]" VALUE 0x70FFC RL_VAL_UB 0 CM_0000 0 255 /end CHARACTERISTIC
/begin CHARACTERISTIC K_ED_MD_SK_ERR.INC_NACH_EINTRAG "Fault code MD_SK_ERR - debounce filter increment after fault-memory entry [verified]" VALUE 0x71000 RL_VAL_UB 0 CM_0000 0 255 /end CHARACTERISTIC
/begin CHARACTERISTIC K_ED_MD_SK_ERR.INC_VOR_EINTRAG "Fault code MD_SK_ERR - debounce filter increment before fault-memory entry [verified]" VALUE 0x70FFE RL_VAL_UB 0 CM_0000 0 255 /end CHARACTERISTIC
/begin CHARACTERISTIC K_ED_MD_SK_ERR.KLASSENINDEX "Fault code MD_SK_ERR - fault class selection (lamp / warning behaviour) [verified]" VALUE 0x71002 RL_VAL_UB 0 CM_0000 0 255 /end CHARACTERISTIC
/begin CHARACTERISTIC K_ED_MD_SK_ERR.OK_SCHWELLE "Fault code MD_SK_ERR - debounce filter threshold for clearing (healing) the fault [verified]" VALUE 0x70FFD RL_VAL_UB 0 CM_0000 0 255 /end CHARACTERISTIC
/begin CHARACTERISTIC K_ED_MD_SK_ERR.P_CODE_OPENLOAD "Fault code MD_SK_ERR - OBD P-code reported for open circuit [verified]" VALUE 0x70FF8 RL_VAL_UW 0 CM_0000 0 65535 /end CHARACTERISTIC
/begin CHARACTERISTIC K_ED_MD_SK_ERR.P_CODE_SH_TO_GND "Fault code MD_SK_ERR - OBD P-code reported for short to ground [verified]" VALUE 0x70FF6 RL_VAL_UW 0 CM_0000 0 65535 /end CHARACTERISTIC
/begin CHARACTERISTIC K_ED_MD_SK_ERR.P_CODE_SH_TO_UB "Fault code MD_SK_ERR - OBD P-code reported for short to battery voltage [verified]" VALUE 0x70FF4 RL_VAL_UW 0 CM_0000 0 65535 /end CHARACTERISTIC
/begin CHARACTERISTIC K_ED_MD_SK_ERR.P_CODE_UNPLAUSIBEL "Fault code MD_SK_ERR - OBD P-code reported for implausible signal [verified]" VALUE 0x70FFA RL_VAL_UW 0 CM_0000 0 65535 /end CHARACTERISTIC
/begin CHARACTERISTIC K_ED_M_SPULE_Z1.DEC_NACH_EINTRAG "Fault code M_SPULE_Z1 - debounce filter decrement after fault-memory entry [verified]" VALUE 0x7164D RL_VAL_UB 0 CM_0000 0 255 /end CHARACTERISTIC
/begin CHARACTERISTIC K_ED_M_SPULE_Z1.DEC_VOR_EINTRAG "Fault code M_SPULE_Z1 - debounce filter decrement before fault-memory entry [verified]" VALUE 0x7164B RL_VAL_UB 0 CM_0000 0 255 /end CHARACTERISTIC
/begin CHARACTERISTIC K_ED_M_SPULE_Z1.FEHLERSCHWELLE "Fault code M_SPULE_Z1 - debounce filter threshold for setting the fault [verified]" VALUE 0x71648 RL_VAL_UB 0 CM_0000 0 255 /end CHARACTERISTIC
/begin CHARACTERISTIC K_ED_M_SPULE_Z1.INC_NACH_EINTRAG "Fault code M_SPULE_Z1 - debounce filter increment after fault-memory entry [verified]" VALUE 0x7164C RL_VAL_UB 0 CM_0000 0 255 /end CHARACTERISTIC
/begin CHARACTERISTIC K_ED_M_SPULE_Z1.INC_VOR_EINTRAG "Fault code M_SPULE_Z1 - debounce filter increment before fault-memory entry [verified]" VALUE 0x7164A RL_VAL_UB 0 CM_0000 0 255 /end CHARACTERISTIC
/begin CHARACTERISTIC K_ED_M_SPULE_Z1.KLASSENINDEX "Fault code M_SPULE_Z1 - fault class selection (lamp / warning behaviour) [verified]" VALUE 0x7164E RL_VAL_UB 0 CM_0000 0 255 /end CHARACTERISTIC
/begin CHARACTERISTIC K_ED_M_SPULE_Z1.OK_SCHWELLE "Fault code M_SPULE_Z1 - debounce filter threshold for clearing (healing) the fault [verified]" VALUE 0x71649 RL_VAL_UB 0 CM_0000 0 255 /end CHARACTERISTIC
/begin CHARACTERISTIC K_ED_M_SPULE_Z1.P_CODE_OPENLOAD "Fault code M_SPULE_Z1 - OBD P-code reported for open circuit [verified]" VALUE 0x71644 RL_VAL_UW 0 CM_0000 0 65535 /end CHARACTERISTIC
/begin CHARACTERISTIC K_ED_M_SPULE_Z1.P_CODE_SH_TO_GND "Fault code M_SPULE_Z1 - OBD P-code reported for short to ground [verified]" VALUE 0x71642 RL_VAL_UW 0 CM_0000 0 65535 /end CHARACTERISTIC
/begin CHARACTERISTIC K_ED_M_SPULE_Z1.P_CODE_SH_TO_UB "Fault code M_SPULE_Z1 - OBD P-code reported for short to battery voltage [verified]" VALUE 0x71640 RL_VAL_UW 0 CM_0000 0 65535 /end CHARACTERISTIC
/begin CHARACTERISTIC K_ED_M_SPULE_Z1.P_CODE_UNPLAUSIBEL "Fault code M_SPULE_Z1 - OBD P-code reported for implausible signal [verified]" VALUE 0x71646 RL_VAL_UW 0 CM_0000 0 65535 /end CHARACTERISTIC
/begin CHARACTERISTIC K_ED_M_SPULE_Z10.DEC_NACH_EINTRAG "Fault code M_SPULE_Z10 - debounce filter decrement after fault-memory entry [verified]" VALUE 0x71737 RL_VAL_UB 0 CM_0000 0 255 /end CHARACTERISTIC
/begin CHARACTERISTIC K_ED_M_SPULE_Z10.DEC_VOR_EINTRAG "Fault code M_SPULE_Z10 - debounce filter decrement before fault-memory entry [verified]" VALUE 0x71735 RL_VAL_UB 0 CM_0000 0 255 /end CHARACTERISTIC
/begin CHARACTERISTIC K_ED_M_SPULE_Z10.FEHLERSCHWELLE "Fault code M_SPULE_Z10 - debounce filter threshold for setting the fault [verified]" VALUE 0x71732 RL_VAL_UB 0 CM_0000 0 255 /end CHARACTERISTIC
/begin CHARACTERISTIC K_ED_M_SPULE_Z10.INC_NACH_EINTRAG "Fault code M_SPULE_Z10 - debounce filter increment after fault-memory entry [verified]" VALUE 0x71736 RL_VAL_UB 0 CM_0000 0 255 /end CHARACTERISTIC
/begin CHARACTERISTIC K_ED_M_SPULE_Z10.INC_VOR_EINTRAG "Fault code M_SPULE_Z10 - debounce filter increment before fault-memory entry [verified]" VALUE 0x71734 RL_VAL_UB 0 CM_0000 0 255 /end CHARACTERISTIC
/begin CHARACTERISTIC K_ED_M_SPULE_Z10.KLASSENINDEX "Fault code M_SPULE_Z10 - fault class selection (lamp / warning behaviour) [verified]" VALUE 0x71738 RL_VAL_UB 0 CM_0000 0 255 /end CHARACTERISTIC
/begin CHARACTERISTIC K_ED_M_SPULE_Z10.OK_SCHWELLE "Fault code M_SPULE_Z10 - debounce filter threshold for clearing (healing) the fault [verified]" VALUE 0x71733 RL_VAL_UB 0 CM_0000 0 255 /end CHARACTERISTIC
/begin CHARACTERISTIC K_ED_M_SPULE_Z10.P_CODE_OPENLOAD "Fault code M_SPULE_Z10 - OBD P-code reported for open circuit [verified]" VALUE 0x7172E RL_VAL_UW 0 CM_0000 0 65535 /end CHARACTERISTIC
/begin CHARACTERISTIC K_ED_M_SPULE_Z10.P_CODE_SH_TO_GND "Fault code M_SPULE_Z10 - OBD P-code reported for short to ground [verified]" VALUE 0x7172C RL_VAL_UW 0 CM_0000 0 65535 /end CHARACTERISTIC
/begin CHARACTERISTIC K_ED_M_SPULE_Z10.P_CODE_SH_TO_UB "Fault code M_SPULE_Z10 - OBD P-code reported for short to battery voltage [verified]" VALUE 0x7172A RL_VAL_UW 0 CM_0000 0 65535 /end CHARACTERISTIC
/begin CHARACTERISTIC K_ED_M_SPULE_Z10.P_CODE_UNPLAUSIBEL "Fault code M_SPULE_Z10 - OBD P-code reported for implausible signal [verified]" VALUE 0x71730 RL_VAL_UW 0 CM_0000 0 65535 /end CHARACTERISTIC
/begin CHARACTERISTIC K_ED_M_SPULE_Z2.DEC_NACH_EINTRAG "Fault code M_SPULE_Z2 - debounce filter decrement after fault-memory entry [verified]" VALUE 0x71667 RL_VAL_UB 0 CM_0000 0 255 /end CHARACTERISTIC
/begin CHARACTERISTIC K_ED_M_SPULE_Z2.DEC_VOR_EINTRAG "Fault code M_SPULE_Z2 - debounce filter decrement before fault-memory entry [verified]" VALUE 0x71665 RL_VAL_UB 0 CM_0000 0 255 /end CHARACTERISTIC
/begin CHARACTERISTIC K_ED_M_SPULE_Z2.FEHLERSCHWELLE "Fault code M_SPULE_Z2 - debounce filter threshold for setting the fault [verified]" VALUE 0x71662 RL_VAL_UB 0 CM_0000 0 255 /end CHARACTERISTIC
/begin CHARACTERISTIC K_ED_M_SPULE_Z2.INC_NACH_EINTRAG "Fault code M_SPULE_Z2 - debounce filter increment after fault-memory entry [verified]" VALUE 0x71666 RL_VAL_UB 0 CM_0000 0 255 /end CHARACTERISTIC
/begin CHARACTERISTIC K_ED_M_SPULE_Z2.INC_VOR_EINTRAG "Fault code M_SPULE_Z2 - debounce filter increment before fault-memory entry [verified]" VALUE 0x71664 RL_VAL_UB 0 CM_0000 0 255 /end CHARACTERISTIC
/begin CHARACTERISTIC K_ED_M_SPULE_Z2.KLASSENINDEX "Fault code M_SPULE_Z2 - fault class selection (lamp / warning behaviour) [verified]" VALUE 0x71668 RL_VAL_UB 0 CM_0000 0 255 /end CHARACTERISTIC
/begin CHARACTERISTIC K_ED_M_SPULE_Z2.OK_SCHWELLE "Fault code M_SPULE_Z2 - debounce filter threshold for clearing (healing) the fault [verified]" VALUE 0x71663 RL_VAL_UB 0 CM_0000 0 255 /end CHARACTERISTIC
/begin CHARACTERISTIC K_ED_M_SPULE_Z2.P_CODE_OPENLOAD "Fault code M_SPULE_Z2 - OBD P-code reported for open circuit [verified]" VALUE 0x7165E RL_VAL_UW 0 CM_0000 0 65535 /end CHARACTERISTIC
/begin CHARACTERISTIC K_ED_M_SPULE_Z2.P_CODE_SH_TO_GND "Fault code M_SPULE_Z2 - OBD P-code reported for short to ground [verified]" VALUE 0x7165C RL_VAL_UW 0 CM_0000 0 65535 /end CHARACTERISTIC
/begin CHARACTERISTIC K_ED_M_SPULE_Z2.P_CODE_SH_TO_UB "Fault code M_SPULE_Z2 - OBD P-code reported for short to battery voltage [verified]" VALUE 0x7165A RL_VAL_UW 0 CM_0000 0 65535 /end CHARACTERISTIC
/begin CHARACTERISTIC K_ED_M_SPULE_Z2.P_CODE_UNPLAUSIBEL "Fault code M_SPULE_Z2 - OBD P-code reported for implausible signal [verified]" VALUE 0x71660 RL_VAL_UW 0 CM_0000 0 65535 /end CHARACTERISTIC
/begin CHARACTERISTIC K_ED_M_SPULE_Z3.DEC_NACH_EINTRAG "Fault code M_SPULE_Z3 - debounce filter decrement after fault-memory entry [verified]" VALUE 0x71681 RL_VAL_UB 0 CM_0000 0 255 /end CHARACTERISTIC
/begin CHARACTERISTIC K_ED_M_SPULE_Z3.DEC_VOR_EINTRAG "Fault code M_SPULE_Z3 - debounce filter decrement before fault-memory entry [verified]" VALUE 0x7167F RL_VAL_UB 0 CM_0000 0 255 /end CHARACTERISTIC
/begin CHARACTERISTIC K_ED_M_SPULE_Z3.FEHLERSCHWELLE "Fault code M_SPULE_Z3 - debounce filter threshold for setting the fault [verified]" VALUE 0x7167C RL_VAL_UB 0 CM_0000 0 255 /end CHARACTERISTIC
/begin CHARACTERISTIC K_ED_M_SPULE_Z3.INC_NACH_EINTRAG "Fault code M_SPULE_Z3 - debounce filter increment after fault-memory entry [verified]" VALUE 0x71680 RL_VAL_UB 0 CM_0000 0 255 /end CHARACTERISTIC
/begin CHARACTERISTIC K_ED_M_SPULE_Z3.INC_VOR_EINTRAG "Fault code M_SPULE_Z3 - debounce filter increment before fault-memory entry [verified]" VALUE 0x7167E RL_VAL_UB 0 CM_0000 0 255 /end CHARACTERISTIC
/begin CHARACTERISTIC K_ED_M_SPULE_Z3.KLASSENINDEX "Fault code M_SPULE_Z3 - fault class selection (lamp / warning behaviour) [verified]" VALUE 0x71682 RL_VAL_UB 0 CM_0000 0 255 /end CHARACTERISTIC
/begin CHARACTERISTIC K_ED_M_SPULE_Z3.OK_SCHWELLE "Fault code M_SPULE_Z3 - debounce filter threshold for clearing (healing) the fault [verified]" VALUE 0x7167D RL_VAL_UB 0 CM_0000 0 255 /end CHARACTERISTIC
/begin CHARACTERISTIC K_ED_M_SPULE_Z3.P_CODE_OPENLOAD "Fault code M_SPULE_Z3 - OBD P-code reported for open circuit [verified]" VALUE 0x71678 RL_VAL_UW 0 CM_0000 0 65535 /end CHARACTERISTIC
/begin CHARACTERISTIC K_ED_M_SPULE_Z3.P_CODE_SH_TO_GND "Fault code M_SPULE_Z3 - OBD P-code reported for short to ground [verified]" VALUE 0x71676 RL_VAL_UW 0 CM_0000 0 65535 /end CHARACTERISTIC
/begin CHARACTERISTIC K_ED_M_SPULE_Z3.P_CODE_SH_TO_UB "Fault code M_SPULE_Z3 - OBD P-code reported for short to battery voltage [verified]" VALUE 0x71674 RL_VAL_UW 0 CM_0000 0 65535 /end CHARACTERISTIC
/begin CHARACTERISTIC K_ED_M_SPULE_Z3.P_CODE_UNPLAUSIBEL "Fault code M_SPULE_Z3 - OBD P-code reported for implausible signal [verified]" VALUE 0x7167A RL_VAL_UW 0 CM_0000 0 65535 /end CHARACTERISTIC
/begin CHARACTERISTIC K_ED_M_SPULE_Z4.DEC_NACH_EINTRAG "Fault code M_SPULE_Z4 - debounce filter decrement after fault-memory entry [verified]" VALUE 0x7169B RL_VAL_UB 0 CM_0000 0 255 /end CHARACTERISTIC
/begin CHARACTERISTIC K_ED_M_SPULE_Z4.DEC_VOR_EINTRAG "Fault code M_SPULE_Z4 - debounce filter decrement before fault-memory entry [verified]" VALUE 0x71699 RL_VAL_UB 0 CM_0000 0 255 /end CHARACTERISTIC
/begin CHARACTERISTIC K_ED_M_SPULE_Z4.FEHLERSCHWELLE "Fault code M_SPULE_Z4 - debounce filter threshold for setting the fault [verified]" VALUE 0x71696 RL_VAL_UB 0 CM_0000 0 255 /end CHARACTERISTIC
/begin CHARACTERISTIC K_ED_M_SPULE_Z4.INC_NACH_EINTRAG "Fault code M_SPULE_Z4 - debounce filter increment after fault-memory entry [verified]" VALUE 0x7169A RL_VAL_UB 0 CM_0000 0 255 /end CHARACTERISTIC
/begin CHARACTERISTIC K_ED_M_SPULE_Z4.INC_VOR_EINTRAG "Fault code M_SPULE_Z4 - debounce filter increment before fault-memory entry [verified]" VALUE 0x71698 RL_VAL_UB 0 CM_0000 0 255 /end CHARACTERISTIC
/begin CHARACTERISTIC K_ED_M_SPULE_Z4.KLASSENINDEX "Fault code M_SPULE_Z4 - fault class selection (lamp / warning behaviour) [verified]" VALUE 0x7169C RL_VAL_UB 0 CM_0000 0 255 /end CHARACTERISTIC
/begin CHARACTERISTIC K_ED_M_SPULE_Z4.OK_SCHWELLE "Fault code M_SPULE_Z4 - debounce filter threshold for clearing (healing) the fault [verified]" VALUE 0x71697 RL_VAL_UB 0 CM_0000 0 255 /end CHARACTERISTIC
/begin CHARACTERISTIC K_ED_M_SPULE_Z4.P_CODE_OPENLOAD "Fault code M_SPULE_Z4 - OBD P-code reported for open circuit [verified]" VALUE 0x71692 RL_VAL_UW 0 CM_0000 0 65535 /end CHARACTERISTIC
/begin CHARACTERISTIC K_ED_M_SPULE_Z4.P_CODE_SH_TO_GND "Fault code M_SPULE_Z4 - OBD P-code reported for short to ground [verified]" VALUE 0x71690 RL_VAL_UW 0 CM_0000 0 65535 /end CHARACTERISTIC
/begin CHARACTERISTIC K_ED_M_SPULE_Z4.P_CODE_SH_TO_UB "Fault code M_SPULE_Z4 - OBD P-code reported for short to battery voltage [verified]" VALUE 0x7168E RL_VAL_UW 0 CM_0000 0 65535 /end CHARACTERISTIC
/begin CHARACTERISTIC K_ED_M_SPULE_Z4.P_CODE_UNPLAUSIBEL "Fault code M_SPULE_Z4 - OBD P-code reported for implausible signal [verified]" VALUE 0x71694 RL_VAL_UW 0 CM_0000 0 65535 /end CHARACTERISTIC
/begin CHARACTERISTIC K_ED_M_SPULE_Z5.DEC_NACH_EINTRAG "Fault code M_SPULE_Z5 - debounce filter decrement after fault-memory entry [verified]" VALUE 0x716B5 RL_VAL_UB 0 CM_0000 0 255 /end CHARACTERISTIC
/begin CHARACTERISTIC K_ED_M_SPULE_Z5.DEC_VOR_EINTRAG "Fault code M_SPULE_Z5 - debounce filter decrement before fault-memory entry [verified]" VALUE 0x716B3 RL_VAL_UB 0 CM_0000 0 255 /end CHARACTERISTIC
/begin CHARACTERISTIC K_ED_M_SPULE_Z5.FEHLERSCHWELLE "Fault code M_SPULE_Z5 - debounce filter threshold for setting the fault [verified]" VALUE 0x716B0 RL_VAL_UB 0 CM_0000 0 255 /end CHARACTERISTIC
/begin CHARACTERISTIC K_ED_M_SPULE_Z5.INC_NACH_EINTRAG "Fault code M_SPULE_Z5 - debounce filter increment after fault-memory entry [verified]" VALUE 0x716B4 RL_VAL_UB 0 CM_0000 0 255 /end CHARACTERISTIC
/begin CHARACTERISTIC K_ED_M_SPULE_Z5.INC_VOR_EINTRAG "Fault code M_SPULE_Z5 - debounce filter increment before fault-memory entry [verified]" VALUE 0x716B2 RL_VAL_UB 0 CM_0000 0 255 /end CHARACTERISTIC
/begin CHARACTERISTIC K_ED_M_SPULE_Z5.KLASSENINDEX "Fault code M_SPULE_Z5 - fault class selection (lamp / warning behaviour) [verified]" VALUE 0x716B6 RL_VAL_UB 0 CM_0000 0 255 /end CHARACTERISTIC
/begin CHARACTERISTIC K_ED_M_SPULE_Z5.OK_SCHWELLE "Fault code M_SPULE_Z5 - debounce filter threshold for clearing (healing) the fault [verified]" VALUE 0x716B1 RL_VAL_UB 0 CM_0000 0 255 /end CHARACTERISTIC
/begin CHARACTERISTIC K_ED_M_SPULE_Z5.P_CODE_OPENLOAD "Fault code M_SPULE_Z5 - OBD P-code reported for open circuit [verified]" VALUE 0x716AC RL_VAL_UW 0 CM_0000 0 65535 /end CHARACTERISTIC
/begin CHARACTERISTIC K_ED_M_SPULE_Z5.P_CODE_SH_TO_GND "Fault code M_SPULE_Z5 - OBD P-code reported for short to ground [verified]" VALUE 0x716AA RL_VAL_UW 0 CM_0000 0 65535 /end CHARACTERISTIC
/begin CHARACTERISTIC K_ED_M_SPULE_Z5.P_CODE_SH_TO_UB "Fault code M_SPULE_Z5 - OBD P-code reported for short to battery voltage [verified]" VALUE 0x716A8 RL_VAL_UW 0 CM_0000 0 65535 /end CHARACTERISTIC
/begin CHARACTERISTIC K_ED_M_SPULE_Z5.P_CODE_UNPLAUSIBEL "Fault code M_SPULE_Z5 - OBD P-code reported for implausible signal [verified]" VALUE 0x716AE RL_VAL_UW 0 CM_0000 0 65535 /end CHARACTERISTIC
/begin CHARACTERISTIC K_ED_M_SPULE_Z6.DEC_NACH_EINTRAG "Fault code M_SPULE_Z6 - debounce filter decrement after fault-memory entry [verified]" VALUE 0x716CF RL_VAL_UB 0 CM_0000 0 255 /end CHARACTERISTIC
/begin CHARACTERISTIC K_ED_M_SPULE_Z6.DEC_VOR_EINTRAG "Fault code M_SPULE_Z6 - debounce filter decrement before fault-memory entry [verified]" VALUE 0x716CD RL_VAL_UB 0 CM_0000 0 255 /end CHARACTERISTIC
/begin CHARACTERISTIC K_ED_M_SPULE_Z6.FEHLERSCHWELLE "Fault code M_SPULE_Z6 - debounce filter threshold for setting the fault [verified]" VALUE 0x716CA RL_VAL_UB 0 CM_0000 0 255 /end CHARACTERISTIC
/begin CHARACTERISTIC K_ED_M_SPULE_Z6.INC_NACH_EINTRAG "Fault code M_SPULE_Z6 - debounce filter increment after fault-memory entry [verified]" VALUE 0x716CE RL_VAL_UB 0 CM_0000 0 255 /end CHARACTERISTIC
/begin CHARACTERISTIC K_ED_M_SPULE_Z6.INC_VOR_EINTRAG "Fault code M_SPULE_Z6 - debounce filter increment before fault-memory entry [verified]" VALUE 0x716CC RL_VAL_UB 0 CM_0000 0 255 /end CHARACTERISTIC
/begin CHARACTERISTIC K_ED_M_SPULE_Z6.KLASSENINDEX "Fault code M_SPULE_Z6 - fault class selection (lamp / warning behaviour) [verified]" VALUE 0x716D0 RL_VAL_UB 0 CM_0000 0 255 /end CHARACTERISTIC
/begin CHARACTERISTIC K_ED_M_SPULE_Z6.OK_SCHWELLE "Fault code M_SPULE_Z6 - debounce filter threshold for clearing (healing) the fault [verified]" VALUE 0x716CB RL_VAL_UB 0 CM_0000 0 255 /end CHARACTERISTIC
/begin CHARACTERISTIC K_ED_M_SPULE_Z6.P_CODE_OPENLOAD "Fault code M_SPULE_Z6 - OBD P-code reported for open circuit [verified]" VALUE 0x716C6 RL_VAL_UW 0 CM_0000 0 65535 /end CHARACTERISTIC
/begin CHARACTERISTIC K_ED_M_SPULE_Z6.P_CODE_SH_TO_GND "Fault code M_SPULE_Z6 - OBD P-code reported for short to ground [verified]" VALUE 0x716C4 RL_VAL_UW 0 CM_0000 0 65535 /end CHARACTERISTIC
/begin CHARACTERISTIC K_ED_M_SPULE_Z6.P_CODE_SH_TO_UB "Fault code M_SPULE_Z6 - OBD P-code reported for short to battery voltage [verified]" VALUE 0x716C2 RL_VAL_UW 0 CM_0000 0 65535 /end CHARACTERISTIC
/begin CHARACTERISTIC K_ED_M_SPULE_Z6.P_CODE_UNPLAUSIBEL "Fault code M_SPULE_Z6 - OBD P-code reported for implausible signal [verified]" VALUE 0x716C8 RL_VAL_UW 0 CM_0000 0 65535 /end CHARACTERISTIC
/begin CHARACTERISTIC K_ED_M_SPULE_Z7.DEC_NACH_EINTRAG "Fault code M_SPULE_Z7 - debounce filter decrement after fault-memory entry [verified]" VALUE 0x716E9 RL_VAL_UB 0 CM_0000 0 255 /end CHARACTERISTIC
/begin CHARACTERISTIC K_ED_M_SPULE_Z7.DEC_VOR_EINTRAG "Fault code M_SPULE_Z7 - debounce filter decrement before fault-memory entry [verified]" VALUE 0x716E7 RL_VAL_UB 0 CM_0000 0 255 /end CHARACTERISTIC
/begin CHARACTERISTIC K_ED_M_SPULE_Z7.FEHLERSCHWELLE "Fault code M_SPULE_Z7 - debounce filter threshold for setting the fault [verified]" VALUE 0x716E4 RL_VAL_UB 0 CM_0000 0 255 /end CHARACTERISTIC
/begin CHARACTERISTIC K_ED_M_SPULE_Z7.INC_NACH_EINTRAG "Fault code M_SPULE_Z7 - debounce filter increment after fault-memory entry [verified]" VALUE 0x716E8 RL_VAL_UB 0 CM_0000 0 255 /end CHARACTERISTIC
/begin CHARACTERISTIC K_ED_M_SPULE_Z7.INC_VOR_EINTRAG "Fault code M_SPULE_Z7 - debounce filter increment before fault-memory entry [verified]" VALUE 0x716E6 RL_VAL_UB 0 CM_0000 0 255 /end CHARACTERISTIC
/begin CHARACTERISTIC K_ED_M_SPULE_Z7.KLASSENINDEX "Fault code M_SPULE_Z7 - fault class selection (lamp / warning behaviour) [verified]" VALUE 0x716EA RL_VAL_UB 0 CM_0000 0 255 /end CHARACTERISTIC
/begin CHARACTERISTIC K_ED_M_SPULE_Z7.OK_SCHWELLE "Fault code M_SPULE_Z7 - debounce filter threshold for clearing (healing) the fault [verified]" VALUE 0x716E5 RL_VAL_UB 0 CM_0000 0 255 /end CHARACTERISTIC
/begin CHARACTERISTIC K_ED_M_SPULE_Z7.P_CODE_OPENLOAD "Fault code M_SPULE_Z7 - OBD P-code reported for open circuit [verified]" VALUE 0x716E0 RL_VAL_UW 0 CM_0000 0 65535 /end CHARACTERISTIC
/begin CHARACTERISTIC K_ED_M_SPULE_Z7.P_CODE_SH_TO_GND "Fault code M_SPULE_Z7 - OBD P-code reported for short to ground [verified]" VALUE 0x716DE RL_VAL_UW 0 CM_0000 0 65535 /end CHARACTERISTIC
/begin CHARACTERISTIC K_ED_M_SPULE_Z7.P_CODE_SH_TO_UB "Fault code M_SPULE_Z7 - OBD P-code reported for short to battery voltage [verified]" VALUE 0x716DC RL_VAL_UW 0 CM_0000 0 65535 /end CHARACTERISTIC
/begin CHARACTERISTIC K_ED_M_SPULE_Z7.P_CODE_UNPLAUSIBEL "Fault code M_SPULE_Z7 - OBD P-code reported for implausible signal [verified]" VALUE 0x716E2 RL_VAL_UW 0 CM_0000 0 65535 /end CHARACTERISTIC
/begin CHARACTERISTIC K_ED_M_SPULE_Z8.DEC_NACH_EINTRAG "Fault code M_SPULE_Z8 - debounce filter decrement after fault-memory entry [verified]" VALUE 0x71703 RL_VAL_UB 0 CM_0000 0 255 /end CHARACTERISTIC
/begin CHARACTERISTIC K_ED_M_SPULE_Z8.DEC_VOR_EINTRAG "Fault code M_SPULE_Z8 - debounce filter decrement before fault-memory entry [verified]" VALUE 0x71701 RL_VAL_UB 0 CM_0000 0 255 /end CHARACTERISTIC
/begin CHARACTERISTIC K_ED_M_SPULE_Z8.FEHLERSCHWELLE "Fault code M_SPULE_Z8 - debounce filter threshold for setting the fault [verified]" VALUE 0x716FE RL_VAL_UB 0 CM_0000 0 255 /end CHARACTERISTIC
/begin CHARACTERISTIC K_ED_M_SPULE_Z8.INC_NACH_EINTRAG "Fault code M_SPULE_Z8 - debounce filter increment after fault-memory entry [verified]" VALUE 0x71702 RL_VAL_UB 0 CM_0000 0 255 /end CHARACTERISTIC
/begin CHARACTERISTIC K_ED_M_SPULE_Z8.INC_VOR_EINTRAG "Fault code M_SPULE_Z8 - debounce filter increment before fault-memory entry [verified]" VALUE 0x71700 RL_VAL_UB 0 CM_0000 0 255 /end CHARACTERISTIC
/begin CHARACTERISTIC K_ED_M_SPULE_Z8.KLASSENINDEX "Fault code M_SPULE_Z8 - fault class selection (lamp / warning behaviour) [verified]" VALUE 0x71704 RL_VAL_UB 0 CM_0000 0 255 /end CHARACTERISTIC
/begin CHARACTERISTIC K_ED_M_SPULE_Z8.OK_SCHWELLE "Fault code M_SPULE_Z8 - debounce filter threshold for clearing (healing) the fault [verified]" VALUE 0x716FF RL_VAL_UB 0 CM_0000 0 255 /end CHARACTERISTIC
/begin CHARACTERISTIC K_ED_M_SPULE_Z8.P_CODE_OPENLOAD "Fault code M_SPULE_Z8 - OBD P-code reported for open circuit [verified]" VALUE 0x716FA RL_VAL_UW 0 CM_0000 0 65535 /end CHARACTERISTIC
/begin CHARACTERISTIC K_ED_M_SPULE_Z8.P_CODE_SH_TO_GND "Fault code M_SPULE_Z8 - OBD P-code reported for short to ground [verified]" VALUE 0x716F8 RL_VAL_UW 0 CM_0000 0 65535 /end CHARACTERISTIC
/begin CHARACTERISTIC K_ED_M_SPULE_Z8.P_CODE_SH_TO_UB "Fault code M_SPULE_Z8 - OBD P-code reported for short to battery voltage [verified]" VALUE 0x716F6 RL_VAL_UW 0 CM_0000 0 65535 /end CHARACTERISTIC
/begin CHARACTERISTIC K_ED_M_SPULE_Z8.P_CODE_UNPLAUSIBEL "Fault code M_SPULE_Z8 - OBD P-code reported for implausible signal [verified]" VALUE 0x716FC RL_VAL_UW 0 CM_0000 0 65535 /end CHARACTERISTIC
/begin CHARACTERISTIC K_ED_M_SPULE_Z9.DEC_NACH_EINTRAG "Fault code M_SPULE_Z9 - debounce filter decrement after fault-memory entry [verified]" VALUE 0x7171D RL_VAL_UB 0 CM_0000 0 255 /end CHARACTERISTIC
/begin CHARACTERISTIC K_ED_M_SPULE_Z9.DEC_VOR_EINTRAG "Fault code M_SPULE_Z9 - debounce filter decrement before fault-memory entry [verified]" VALUE 0x7171B RL_VAL_UB 0 CM_0000 0 255 /end CHARACTERISTIC
/begin CHARACTERISTIC K_ED_M_SPULE_Z9.FEHLERSCHWELLE "Fault code M_SPULE_Z9 - debounce filter threshold for setting the fault [verified]" VALUE 0x71718 RL_VAL_UB 0 CM_0000 0 255 /end CHARACTERISTIC
/begin CHARACTERISTIC K_ED_M_SPULE_Z9.INC_NACH_EINTRAG "Fault code M_SPULE_Z9 - debounce filter increment after fault-memory entry [verified]" VALUE 0x7171C RL_VAL_UB 0 CM_0000 0 255 /end CHARACTERISTIC
/begin CHARACTERISTIC K_ED_M_SPULE_Z9.INC_VOR_EINTRAG "Fault code M_SPULE_Z9 - debounce filter increment before fault-memory entry [verified]" VALUE 0x7171A RL_VAL_UB 0 CM_0000 0 255 /end CHARACTERISTIC
/begin CHARACTERISTIC K_ED_M_SPULE_Z9.KLASSENINDEX "Fault code M_SPULE_Z9 - fault class selection (lamp / warning behaviour) [verified]" VALUE 0x7171E RL_VAL_UB 0 CM_0000 0 255 /end CHARACTERISTIC
/begin CHARACTERISTIC K_ED_M_SPULE_Z9.OK_SCHWELLE "Fault code M_SPULE_Z9 - debounce filter threshold for clearing (healing) the fault [verified]" VALUE 0x71719 RL_VAL_UB 0 CM_0000 0 255 /end CHARACTERISTIC
/begin CHARACTERISTIC K_ED_M_SPULE_Z9.P_CODE_OPENLOAD "Fault code M_SPULE_Z9 - OBD P-code reported for open circuit [verified]" VALUE 0x71714 RL_VAL_UW 0 CM_0000 0 65535 /end CHARACTERISTIC
/begin CHARACTERISTIC K_ED_M_SPULE_Z9.P_CODE_SH_TO_GND "Fault code M_SPULE_Z9 - OBD P-code reported for short to ground [verified]" VALUE 0x71712 RL_VAL_UW 0 CM_0000 0 65535 /end CHARACTERISTIC
/begin CHARACTERISTIC K_ED_M_SPULE_Z9.P_CODE_SH_TO_UB "Fault code M_SPULE_Z9 - OBD P-code reported for short to battery voltage [verified]" VALUE 0x71710 RL_VAL_UW 0 CM_0000 0 65535 /end CHARACTERISTIC
/begin CHARACTERISTIC K_ED_M_SPULE_Z9.P_CODE_UNPLAUSIBEL "Fault code M_SPULE_Z9 - OBD P-code reported for implausible signal [verified]" VALUE 0x71716 RL_VAL_UW 0 CM_0000 0 65535 /end CHARACTERISTIC
/begin CHARACTERISTIC K_ED_N_GETR_EIN_HS.DEC_NACH_EINTRAG "Fault code N_GETR_EIN_HS - debounce filter decrement after fault-memory entry [verified]" VALUE 0x715B1 RL_VAL_UB 0 CM_0000 0 255 /end CHARACTERISTIC
/begin CHARACTERISTIC K_ED_N_GETR_EIN_HS.DEC_VOR_EINTRAG "Fault code N_GETR_EIN_HS - debounce filter decrement before fault-memory entry [verified]" VALUE 0x715AF RL_VAL_UB 0 CM_0000 0 255 /end CHARACTERISTIC
/begin CHARACTERISTIC K_ED_N_GETR_EIN_HS.FEHLERSCHWELLE "Fault code N_GETR_EIN_HS - debounce filter threshold for setting the fault [verified]" VALUE 0x715AC RL_VAL_UB 0 CM_0000 0 255 /end CHARACTERISTIC
/begin CHARACTERISTIC K_ED_N_GETR_EIN_HS.INC_NACH_EINTRAG "Fault code N_GETR_EIN_HS - debounce filter increment after fault-memory entry [verified]" VALUE 0x715B0 RL_VAL_UB 0 CM_0000 0 255 /end CHARACTERISTIC
/begin CHARACTERISTIC K_ED_N_GETR_EIN_HS.INC_VOR_EINTRAG "Fault code N_GETR_EIN_HS - debounce filter increment before fault-memory entry [verified]" VALUE 0x715AE RL_VAL_UB 0 CM_0000 0 255 /end CHARACTERISTIC
/begin CHARACTERISTIC K_ED_N_GETR_EIN_HS.KLASSENINDEX "Fault code N_GETR_EIN_HS - fault class selection (lamp / warning behaviour) [verified]" VALUE 0x715B2 RL_VAL_UB 0 CM_0000 0 255 /end CHARACTERISTIC
/begin CHARACTERISTIC K_ED_N_GETR_EIN_HS.OK_SCHWELLE "Fault code N_GETR_EIN_HS - debounce filter threshold for clearing (healing) the fault [verified]" VALUE 0x715AD RL_VAL_UB 0 CM_0000 0 255 /end CHARACTERISTIC
/begin CHARACTERISTIC K_ED_N_GETR_EIN_HS.P_CODE_OPENLOAD "Fault code N_GETR_EIN_HS - OBD P-code reported for open circuit [verified]" VALUE 0x715A8 RL_VAL_UW 0 CM_0000 0 65535 /end CHARACTERISTIC
/begin CHARACTERISTIC K_ED_N_GETR_EIN_HS.P_CODE_SH_TO_GND "Fault code N_GETR_EIN_HS - OBD P-code reported for short to ground [verified]" VALUE 0x715A6 RL_VAL_UW 0 CM_0000 0 65535 /end CHARACTERISTIC
/begin CHARACTERISTIC K_ED_N_GETR_EIN_HS.P_CODE_SH_TO_UB "Fault code N_GETR_EIN_HS - OBD P-code reported for short to battery voltage [verified]" VALUE 0x715A4 RL_VAL_UW 0 CM_0000 0 65535 /end CHARACTERISTIC
/begin CHARACTERISTIC K_ED_N_GETR_EIN_HS.P_CODE_UNPLAUSIBEL "Fault code N_GETR_EIN_HS - OBD P-code reported for implausible signal [verified]" VALUE 0x715AA RL_VAL_UW 0 CM_0000 0 65535 /end CHARACTERISTIC
/begin CHARACTERISTIC K_ED_PCTRL_IGN.DEC_NACH_EINTRAG "Fault code PCTRL_IGN - debounce filter decrement after fault-memory entry [verified]" VALUE 0x70CA7 RL_VAL_UB 0 CM_0000 0 255 /end CHARACTERISTIC
/begin CHARACTERISTIC K_ED_PCTRL_IGN.DEC_VOR_EINTRAG "Fault code PCTRL_IGN - debounce filter decrement before fault-memory entry [verified]" VALUE 0x70CA5 RL_VAL_UB 0 CM_0000 0 255 /end CHARACTERISTIC
/begin CHARACTERISTIC K_ED_PCTRL_IGN.FEHLERSCHWELLE "Fault code PCTRL_IGN - debounce filter threshold for setting the fault [verified]" VALUE 0x70CA2 RL_VAL_UB 0 CM_0000 0 255 /end CHARACTERISTIC
/begin CHARACTERISTIC K_ED_PCTRL_IGN.INC_NACH_EINTRAG "Fault code PCTRL_IGN - debounce filter increment after fault-memory entry [verified]" VALUE 0x70CA6 RL_VAL_UB 0 CM_0000 0 255 /end CHARACTERISTIC
/begin CHARACTERISTIC K_ED_PCTRL_IGN.INC_VOR_EINTRAG "Fault code PCTRL_IGN - debounce filter increment before fault-memory entry [verified]" VALUE 0x70CA4 RL_VAL_UB 0 CM_0000 0 255 /end CHARACTERISTIC
/begin CHARACTERISTIC K_ED_PCTRL_IGN.KLASSENINDEX "Fault code PCTRL_IGN - fault class selection (lamp / warning behaviour) [verified]" VALUE 0x70CA8 RL_VAL_UB 0 CM_0000 0 255 /end CHARACTERISTIC
/begin CHARACTERISTIC K_ED_PCTRL_IGN.OK_SCHWELLE "Fault code PCTRL_IGN - debounce filter threshold for clearing (healing) the fault [verified]" VALUE 0x70CA3 RL_VAL_UB 0 CM_0000 0 255 /end CHARACTERISTIC
/begin CHARACTERISTIC K_ED_PCTRL_IGN.P_CODE_OPENLOAD "Fault code PCTRL_IGN - OBD P-code reported for open circuit [verified]" VALUE 0x70C9E RL_VAL_UW 0 CM_0000 0 65535 /end CHARACTERISTIC
/begin CHARACTERISTIC K_ED_PCTRL_IGN.P_CODE_SH_TO_GND "Fault code PCTRL_IGN - OBD P-code reported for short to ground [verified]" VALUE 0x70C9C RL_VAL_UW 0 CM_0000 0 65535 /end CHARACTERISTIC
/begin CHARACTERISTIC K_ED_PCTRL_IGN.P_CODE_SH_TO_UB "Fault code PCTRL_IGN - OBD P-code reported for short to battery voltage [verified]" VALUE 0x70C9A RL_VAL_UW 0 CM_0000 0 65535 /end CHARACTERISTIC
/begin CHARACTERISTIC K_ED_PCTRL_IGN.P_CODE_UNPLAUSIBEL "Fault code PCTRL_IGN - OBD P-code reported for implausible signal [verified]" VALUE 0x70CA0 RL_VAL_UW 0 CM_0000 0 65535 /end CHARACTERISTIC
/begin CHARACTERISTIC K_ED_PWG1.DEC_NACH_EINTRAG "Fault code PWG1 - debounce filter decrement after fault-memory entry [verified]" VALUE 0x70C59 RL_VAL_UB 0 CM_0000 0 255 /end CHARACTERISTIC
/begin CHARACTERISTIC K_ED_PWG1.DEC_VOR_EINTRAG "Fault code PWG1 - debounce filter decrement before fault-memory entry [verified]" VALUE 0x70C57 RL_VAL_UB 0 CM_0000 0 255 /end CHARACTERISTIC
/begin CHARACTERISTIC K_ED_PWG1.FEHLERSCHWELLE "Fault code PWG1 - debounce filter threshold for setting the fault [verified]" VALUE 0x70C54 RL_VAL_UB 0 CM_0000 0 255 /end CHARACTERISTIC
/begin CHARACTERISTIC K_ED_PWG1.INC_NACH_EINTRAG "Fault code PWG1 - debounce filter increment after fault-memory entry [verified]" VALUE 0x70C58 RL_VAL_UB 0 CM_0000 0 255 /end CHARACTERISTIC
/begin CHARACTERISTIC K_ED_PWG1.INC_VOR_EINTRAG "Fault code PWG1 - debounce filter increment before fault-memory entry [verified]" VALUE 0x70C56 RL_VAL_UB 0 CM_0000 0 255 /end CHARACTERISTIC
/begin CHARACTERISTIC K_ED_PWG1.KLASSENINDEX "Fault code PWG1 - fault class selection (lamp / warning behaviour) [verified]" VALUE 0x70C5A RL_VAL_UB 0 CM_0000 0 255 /end CHARACTERISTIC
/begin CHARACTERISTIC K_ED_PWG1.OK_SCHWELLE "Fault code PWG1 - debounce filter threshold for clearing (healing) the fault [verified]" VALUE 0x70C55 RL_VAL_UB 0 CM_0000 0 255 /end CHARACTERISTIC
/begin CHARACTERISTIC K_ED_PWG1.P_CODE_OPENLOAD "Fault code PWG1 - OBD P-code reported for open circuit [verified]" VALUE 0x70C50 RL_VAL_UW 0 CM_0000 0 65535 /end CHARACTERISTIC
/begin CHARACTERISTIC K_ED_PWG1.P_CODE_SH_TO_GND "Fault code PWG1 - OBD P-code reported for short to ground [verified]" VALUE 0x70C4E RL_VAL_UW 0 CM_0000 0 65535 /end CHARACTERISTIC
/begin CHARACTERISTIC K_ED_PWG1.P_CODE_SH_TO_UB "Fault code PWG1 - OBD P-code reported for short to battery voltage [verified]" VALUE 0x70C4C RL_VAL_UW 0 CM_0000 0 65535 /end CHARACTERISTIC
/begin CHARACTERISTIC K_ED_PWG1.P_CODE_UNPLAUSIBEL "Fault code PWG1 - OBD P-code reported for implausible signal [verified]" VALUE 0x70C52 RL_VAL_UW 0 CM_0000 0 65535 /end CHARACTERISTIC
/begin CHARACTERISTIC K_ED_PWG2.DEC_NACH_EINTRAG "Fault code PWG2 - debounce filter decrement after fault-memory entry [verified]" VALUE 0x70C73 RL_VAL_UB 0 CM_0000 0 255 /end CHARACTERISTIC
/begin CHARACTERISTIC K_ED_PWG2.DEC_VOR_EINTRAG "Fault code PWG2 - debounce filter decrement before fault-memory entry [verified]" VALUE 0x70C71 RL_VAL_UB 0 CM_0000 0 255 /end CHARACTERISTIC
/begin CHARACTERISTIC K_ED_PWG2.FEHLERSCHWELLE "Fault code PWG2 - debounce filter threshold for setting the fault [verified]" VALUE 0x70C6E RL_VAL_UB 0 CM_0000 0 255 /end CHARACTERISTIC
/begin CHARACTERISTIC K_ED_PWG2.INC_NACH_EINTRAG "Fault code PWG2 - debounce filter increment after fault-memory entry [verified]" VALUE 0x70C72 RL_VAL_UB 0 CM_0000 0 255 /end CHARACTERISTIC
/begin CHARACTERISTIC K_ED_PWG2.INC_VOR_EINTRAG "Fault code PWG2 - debounce filter increment before fault-memory entry [verified]" VALUE 0x70C70 RL_VAL_UB 0 CM_0000 0 255 /end CHARACTERISTIC
/begin CHARACTERISTIC K_ED_PWG2.KLASSENINDEX "Fault code PWG2 - fault class selection (lamp / warning behaviour) [verified]" VALUE 0x70C74 RL_VAL_UB 0 CM_0000 0 255 /end CHARACTERISTIC
/begin CHARACTERISTIC K_ED_PWG2.OK_SCHWELLE "Fault code PWG2 - debounce filter threshold for clearing (healing) the fault [verified]" VALUE 0x70C6F RL_VAL_UB 0 CM_0000 0 255 /end CHARACTERISTIC
/begin CHARACTERISTIC K_ED_PWG2.P_CODE_OPENLOAD "Fault code PWG2 - OBD P-code reported for open circuit [verified]" VALUE 0x70C6A RL_VAL_UW 0 CM_0000 0 65535 /end CHARACTERISTIC
/begin CHARACTERISTIC K_ED_PWG2.P_CODE_SH_TO_GND "Fault code PWG2 - OBD P-code reported for short to ground [verified]" VALUE 0x70C68 RL_VAL_UW 0 CM_0000 0 65535 /end CHARACTERISTIC
/begin CHARACTERISTIC K_ED_PWG2.P_CODE_SH_TO_UB "Fault code PWG2 - OBD P-code reported for short to battery voltage [verified]" VALUE 0x70C66 RL_VAL_UW 0 CM_0000 0 65535 /end CHARACTERISTIC
/begin CHARACTERISTIC K_ED_PWG2.P_CODE_UNPLAUSIBEL "Fault code PWG2 - OBD P-code reported for implausible signal [verified]" VALUE 0x70C6C RL_VAL_UW 0 CM_0000 0 65535 /end CHARACTERISTIC
/begin CHARACTERISTIC K_ED_PWG_BLS.DEC_NACH_EINTRAG "Fault code PWG_BLS - debounce filter decrement after fault-memory entry [verified]" VALUE 0x71563 RL_VAL_UB 0 CM_0000 0 255 /end CHARACTERISTIC
/begin CHARACTERISTIC K_ED_PWG_BLS.DEC_VOR_EINTRAG "Fault code PWG_BLS - debounce filter decrement before fault-memory entry [verified]" VALUE 0x71561 RL_VAL_UB 0 CM_0000 0 255 /end CHARACTERISTIC
/begin CHARACTERISTIC K_ED_PWG_BLS.FEHLERSCHWELLE "Fault code PWG_BLS - debounce filter threshold for setting the fault [verified]" VALUE 0x7155E RL_VAL_UB 0 CM_0000 0 255 /end CHARACTERISTIC
/begin CHARACTERISTIC K_ED_PWG_BLS.INC_NACH_EINTRAG "Fault code PWG_BLS - debounce filter increment after fault-memory entry [verified]" VALUE 0x71562 RL_VAL_UB 0 CM_0000 0 255 /end CHARACTERISTIC
/begin CHARACTERISTIC K_ED_PWG_BLS.INC_VOR_EINTRAG "Fault code PWG_BLS - debounce filter increment before fault-memory entry [verified]" VALUE 0x71560 RL_VAL_UB 0 CM_0000 0 255 /end CHARACTERISTIC
/begin CHARACTERISTIC K_ED_PWG_BLS.KLASSENINDEX "Fault code PWG_BLS - fault class selection (lamp / warning behaviour) [verified]" VALUE 0x71564 RL_VAL_UB 0 CM_0000 0 255 /end CHARACTERISTIC
/begin CHARACTERISTIC K_ED_PWG_BLS.OK_SCHWELLE "Fault code PWG_BLS - debounce filter threshold for clearing (healing) the fault [verified]" VALUE 0x7155F RL_VAL_UB 0 CM_0000 0 255 /end CHARACTERISTIC
/begin CHARACTERISTIC K_ED_PWG_BLS.P_CODE_OPENLOAD "Fault code PWG_BLS - OBD P-code reported for open circuit [verified]" VALUE 0x7155A RL_VAL_UW 0 CM_0000 0 65535 /end CHARACTERISTIC
/begin CHARACTERISTIC K_ED_PWG_BLS.P_CODE_SH_TO_GND "Fault code PWG_BLS - OBD P-code reported for short to ground [verified]" VALUE 0x71558 RL_VAL_UW 0 CM_0000 0 65535 /end CHARACTERISTIC
/begin CHARACTERISTIC K_ED_PWG_BLS.P_CODE_SH_TO_UB "Fault code PWG_BLS - OBD P-code reported for short to battery voltage [verified]" VALUE 0x71556 RL_VAL_UW 0 CM_0000 0 65535 /end CHARACTERISTIC
/begin CHARACTERISTIC K_ED_PWG_BLS.P_CODE_UNPLAUSIBEL "Fault code PWG_BLS - OBD P-code reported for implausible signal [verified]" VALUE 0x7155C RL_VAL_UW 0 CM_0000 0 65535 /end CHARACTERISTIC
/begin CHARACTERISTIC K_ED_PWG_VGL.DEC_NACH_EINTRAG "Fault code PWG_VGL - debounce filter decrement after fault-memory entry [verified]" VALUE 0x70C8D RL_VAL_UB 0 CM_0000 0 255 /end CHARACTERISTIC
/begin CHARACTERISTIC K_ED_PWG_VGL.DEC_VOR_EINTRAG "Fault code PWG_VGL - debounce filter decrement before fault-memory entry [verified]" VALUE 0x70C8B RL_VAL_UB 0 CM_0000 0 255 /end CHARACTERISTIC
/begin CHARACTERISTIC K_ED_PWG_VGL.FEHLERSCHWELLE "Fault code PWG_VGL - debounce filter threshold for setting the fault [verified]" VALUE 0x70C88 RL_VAL_UB 0 CM_0000 0 255 /end CHARACTERISTIC
/begin CHARACTERISTIC K_ED_PWG_VGL.INC_NACH_EINTRAG "Fault code PWG_VGL - debounce filter increment after fault-memory entry [verified]" VALUE 0x70C8C RL_VAL_UB 0 CM_0000 0 255 /end CHARACTERISTIC
/begin CHARACTERISTIC K_ED_PWG_VGL.INC_VOR_EINTRAG "Fault code PWG_VGL - debounce filter increment before fault-memory entry [verified]" VALUE 0x70C8A RL_VAL_UB 0 CM_0000 0 255 /end CHARACTERISTIC
/begin CHARACTERISTIC K_ED_PWG_VGL.KLASSENINDEX "Fault code PWG_VGL - fault class selection (lamp / warning behaviour) [verified]" VALUE 0x70C8E RL_VAL_UB 0 CM_0000 0 255 /end CHARACTERISTIC
/begin CHARACTERISTIC K_ED_PWG_VGL.OK_SCHWELLE "Fault code PWG_VGL - debounce filter threshold for clearing (healing) the fault [verified]" VALUE 0x70C89 RL_VAL_UB 0 CM_0000 0 255 /end CHARACTERISTIC
/begin CHARACTERISTIC K_ED_PWG_VGL.P_CODE_OPENLOAD "Fault code PWG_VGL - OBD P-code reported for open circuit [verified]" VALUE 0x70C84 RL_VAL_UW 0 CM_0000 0 65535 /end CHARACTERISTIC
/begin CHARACTERISTIC K_ED_PWG_VGL.P_CODE_SH_TO_GND "Fault code PWG_VGL - OBD P-code reported for short to ground [verified]" VALUE 0x70C82 RL_VAL_UW 0 CM_0000 0 65535 /end CHARACTERISTIC
/begin CHARACTERISTIC K_ED_PWG_VGL.P_CODE_SH_TO_UB "Fault code PWG_VGL - OBD P-code reported for short to battery voltage [verified]" VALUE 0x70C80 RL_VAL_UW 0 CM_0000 0 65535 /end CHARACTERISTIC
/begin CHARACTERISTIC K_ED_PWG_VGL.P_CODE_UNPLAUSIBEL "Fault code PWG_VGL - OBD P-code reported for implausible signal [verified]" VALUE 0x70C86 RL_VAL_UW 0 CM_0000 0 65535 /end CHARACTERISTIC
/begin CHARACTERISTIC K_ED_RBM_PUMG_MIN__IGN_ "Minimum air pressure for rate-based OBD monitoring [verified]" VALUE 0x71800 RL_VAL_SW 0 CM_0022 -2048 2047.9375 /end CHARACTERISTIC
/begin CHARACTERISTIC K_ED_RBM_TIME__IGN_ "Total time for drive cycle (rate-based monitoring) [verified]" VALUE 0x71804 RL_VAL_UW 0 CM_0023 0 6553.5 /end CHARACTERISTIC
/begin CHARACTERISTIC K_ED_RBM_TIME_LL__IGN_ "Minimum idle time in drive cycle (rate-based monitoring) [verified]" VALUE 0x71808 RL_VAL_UW 0 CM_0023 0 6553.5 /end CHARACTERISTIC
/begin CHARACTERISTIC K_ED_RBM_TIME_V__IGN_ "Time at speed in drive cycle (rate-based monitoring) [verified]" VALUE 0x71806 RL_VAL_UW 0 CM_0023 0 6553.5 /end CHARACTERISTIC
/begin CHARACTERISTIC K_ED_RBM_TUMG_MIN__IGN_ "Minimum ambient temperature (rate-based monitoring) [verified]" VALUE 0x71802 RL_VAL_SW 0 CM_0006 -3550 3003.5 /end CHARACTERISTIC
/begin CHARACTERISTIC K_ED_RBM_V_MIN__IGN_ "Minimum vehicle speed in drive cycle (rate-based monitoring) [verified]" VALUE 0x7180A RL_VAL_SW 0 CM_0010 -2048 2047.9375 /end CHARACTERISTIC
/begin CHARACTERISTIC K_ED_SCDN_ABDECKUNG_AUSTRAG__IGN_ "Similar-conditions coverage for fault-memory clearing [verified]" VALUE 0x717FA RL_VAL_UW 0 CM_0016 0 63.99902344 /end CHARACTERISTIC
/begin CHARACTERISTIC K_ED_SCDN_ABDECKUNG_EINTRAG__IGN_ "Similar-conditions coverage for fault-memory entry [verified]" VALUE 0x717F8 RL_VAL_UW 0 CM_0016 0 63.99902344 /end CHARACTERISTIC
/begin CHARACTERISTIC K_ED_SC_BUSOFF.DEC_NACH_EINTRAG "Fault code SC_BUSOFF - debounce filter decrement after fault-memory entry [verified]" VALUE 0x71105 RL_VAL_UB 0 CM_0000 0 255 /end CHARACTERISTIC
/begin CHARACTERISTIC K_ED_SC_BUSOFF.DEC_VOR_EINTRAG "Fault code SC_BUSOFF - debounce filter decrement before fault-memory entry [verified]" VALUE 0x71103 RL_VAL_UB 0 CM_0000 0 255 /end CHARACTERISTIC
/begin CHARACTERISTIC K_ED_SC_BUSOFF.FEHLERSCHWELLE "Fault code SC_BUSOFF - debounce filter threshold for setting the fault [verified]" VALUE 0x71100 RL_VAL_UB 0 CM_0000 0 255 /end CHARACTERISTIC
/begin CHARACTERISTIC K_ED_SC_BUSOFF.INC_NACH_EINTRAG "Fault code SC_BUSOFF - debounce filter increment after fault-memory entry [verified]" VALUE 0x71104 RL_VAL_UB 0 CM_0000 0 255 /end CHARACTERISTIC
/begin CHARACTERISTIC K_ED_SC_BUSOFF.INC_VOR_EINTRAG "Fault code SC_BUSOFF - debounce filter increment before fault-memory entry [verified]" VALUE 0x71102 RL_VAL_UB 0 CM_0000 0 255 /end CHARACTERISTIC
/begin CHARACTERISTIC K_ED_SC_BUSOFF.KLASSENINDEX "Fault code SC_BUSOFF - fault class selection (lamp / warning behaviour) [verified]" VALUE 0x71106 RL_VAL_UB 0 CM_0000 0 255 /end CHARACTERISTIC
/begin CHARACTERISTIC K_ED_SC_BUSOFF.OK_SCHWELLE "Fault code SC_BUSOFF - debounce filter threshold for clearing (healing) the fault [verified]" VALUE 0x71101 RL_VAL_UB 0 CM_0000 0 255 /end CHARACTERISTIC
/begin CHARACTERISTIC K_ED_SC_BUSOFF.P_CODE_OPENLOAD "Fault code SC_BUSOFF - OBD P-code reported for open circuit [verified]" VALUE 0x710FC RL_VAL_UW 0 CM_0000 0 65535 /end CHARACTERISTIC
/begin CHARACTERISTIC K_ED_SC_BUSOFF.P_CODE_SH_TO_GND "Fault code SC_BUSOFF - OBD P-code reported for short to ground [verified]" VALUE 0x710FA RL_VAL_UW 0 CM_0000 0 65535 /end CHARACTERISTIC
/begin CHARACTERISTIC K_ED_SC_BUSOFF.P_CODE_SH_TO_UB "Fault code SC_BUSOFF - OBD P-code reported for short to battery voltage [verified]" VALUE 0x710F8 RL_VAL_UW 0 CM_0000 0 65535 /end CHARACTERISTIC
/begin CHARACTERISTIC K_ED_SC_BUSOFF.P_CODE_UNPLAUSIBEL "Fault code SC_BUSOFF - OBD P-code reported for implausible signal [verified]" VALUE 0x710FE RL_VAL_UW 0 CM_0000 0 65535 /end CHARACTERISTIC
/begin CHARACTERISTIC K_ED_SC_PKS.DEC_NACH_EINTRAG "Fault code SC_PKS - debounce filter decrement after fault-memory entry [verified]" VALUE 0x71411 RL_VAL_UB 0 CM_0000 0 255 /end CHARACTERISTIC
/begin CHARACTERISTIC K_ED_SC_PKS.DEC_VOR_EINTRAG "Fault code SC_PKS - debounce filter decrement before fault-memory entry [verified]" VALUE 0x7140F RL_VAL_UB 0 CM_0000 0 255 /end CHARACTERISTIC
/begin CHARACTERISTIC K_ED_SC_PKS.FEHLERSCHWELLE "Fault code SC_PKS - debounce filter threshold for setting the fault [verified]" VALUE 0x7140C RL_VAL_UB 0 CM_0000 0 255 /end CHARACTERISTIC
/begin CHARACTERISTIC K_ED_SC_PKS.INC_NACH_EINTRAG "Fault code SC_PKS - debounce filter increment after fault-memory entry [verified]" VALUE 0x71410 RL_VAL_UB 0 CM_0000 0 255 /end CHARACTERISTIC
/begin CHARACTERISTIC K_ED_SC_PKS.INC_VOR_EINTRAG "Fault code SC_PKS - debounce filter increment before fault-memory entry [verified]" VALUE 0x7140E RL_VAL_UB 0 CM_0000 0 255 /end CHARACTERISTIC
/begin CHARACTERISTIC K_ED_SC_PKS.KLASSENINDEX "Fault code SC_PKS - fault class selection (lamp / warning behaviour) [verified]" VALUE 0x71412 RL_VAL_UB 0 CM_0000 0 255 /end CHARACTERISTIC
/begin CHARACTERISTIC K_ED_SC_PKS.OK_SCHWELLE "Fault code SC_PKS - debounce filter threshold for clearing (healing) the fault [verified]" VALUE 0x7140D RL_VAL_UB 0 CM_0000 0 255 /end CHARACTERISTIC
/begin CHARACTERISTIC K_ED_SC_PKS.P_CODE_OPENLOAD "Fault code SC_PKS - OBD P-code reported for open circuit [verified]" VALUE 0x71408 RL_VAL_UW 0 CM_0000 0 65535 /end CHARACTERISTIC
/begin CHARACTERISTIC K_ED_SC_PKS.P_CODE_SH_TO_GND "Fault code SC_PKS - OBD P-code reported for short to ground [verified]" VALUE 0x71406 RL_VAL_UW 0 CM_0000 0 65535 /end CHARACTERISTIC
/begin CHARACTERISTIC K_ED_SC_PKS.P_CODE_SH_TO_UB "Fault code SC_PKS - OBD P-code reported for short to battery voltage [verified]" VALUE 0x71404 RL_VAL_UW 0 CM_0000 0 65535 /end CHARACTERISTIC
/begin CHARACTERISTIC K_ED_SC_PKS.P_CODE_UNPLAUSIBEL "Fault code SC_PKS - OBD P-code reported for implausible signal [verified]" VALUE 0x7140A RL_VAL_UW 0 CM_0000 0 65535 /end CHARACTERISTIC
/begin CHARACTERISTIC K_ED_SC_SMG1.DEC_NACH_EINTRAG "Fault code SC_SMG1 - debounce filter decrement after fault-memory entry [verified]" VALUE 0x710B7 RL_VAL_UB 0 CM_0000 0 255 /end CHARACTERISTIC
/begin CHARACTERISTIC K_ED_SC_SMG1.DEC_VOR_EINTRAG "Fault code SC_SMG1 - debounce filter decrement before fault-memory entry [verified]" VALUE 0x710B5 RL_VAL_UB 0 CM_0000 0 255 /end CHARACTERISTIC
/begin CHARACTERISTIC K_ED_SC_SMG1.FEHLERSCHWELLE "Fault code SC_SMG1 - debounce filter threshold for setting the fault [verified]" VALUE 0x710B2 RL_VAL_UB 0 CM_0000 0 255 /end CHARACTERISTIC
/begin CHARACTERISTIC K_ED_SC_SMG1.INC_NACH_EINTRAG "Fault code SC_SMG1 - debounce filter increment after fault-memory entry [verified]" VALUE 0x710B6 RL_VAL_UB 0 CM_0000 0 255 /end CHARACTERISTIC
/begin CHARACTERISTIC K_ED_SC_SMG1.INC_VOR_EINTRAG "Fault code SC_SMG1 - debounce filter increment before fault-memory entry [verified]" VALUE 0x710B4 RL_VAL_UB 0 CM_0000 0 255 /end CHARACTERISTIC
/begin CHARACTERISTIC K_ED_SC_SMG1.KLASSENINDEX "Fault code SC_SMG1 - fault class selection (lamp / warning behaviour) [verified]" VALUE 0x710B8 RL_VAL_UB 0 CM_0000 0 255 /end CHARACTERISTIC
/begin CHARACTERISTIC K_ED_SC_SMG1.OK_SCHWELLE "Fault code SC_SMG1 - debounce filter threshold for clearing (healing) the fault [verified]" VALUE 0x710B3 RL_VAL_UB 0 CM_0000 0 255 /end CHARACTERISTIC
/begin CHARACTERISTIC K_ED_SC_SMG1.P_CODE_OPENLOAD "Fault code SC_SMG1 - OBD P-code reported for open circuit [verified]" VALUE 0x710AE RL_VAL_UW 0 CM_0000 0 65535 /end CHARACTERISTIC
/begin CHARACTERISTIC K_ED_SC_SMG1.P_CODE_SH_TO_GND "Fault code SC_SMG1 - OBD P-code reported for short to ground [verified]" VALUE 0x710AC RL_VAL_UW 0 CM_0000 0 65535 /end CHARACTERISTIC
/begin CHARACTERISTIC K_ED_SC_SMG1.P_CODE_SH_TO_UB "Fault code SC_SMG1 - OBD P-code reported for short to battery voltage [verified]" VALUE 0x710AA RL_VAL_UW 0 CM_0000 0 65535 /end CHARACTERISTIC
/begin CHARACTERISTIC K_ED_SC_SMG1.P_CODE_UNPLAUSIBEL "Fault code SC_SMG1 - OBD P-code reported for implausible signal [verified]" VALUE 0x710B0 RL_VAL_UW 0 CM_0000 0 65535 /end CHARACTERISTIC
/begin CHARACTERISTIC K_ED_SC_SMG2.DEC_NACH_EINTRAG "Fault code SC_SMG2 - debounce filter decrement after fault-memory entry [verified]" VALUE 0x710D1 RL_VAL_UB 0 CM_0000 0 255 /end CHARACTERISTIC
/begin CHARACTERISTIC K_ED_SC_SMG2.DEC_VOR_EINTRAG "Fault code SC_SMG2 - debounce filter decrement before fault-memory entry [verified]" VALUE 0x710CF RL_VAL_UB 0 CM_0000 0 255 /end CHARACTERISTIC
/begin CHARACTERISTIC K_ED_SC_SMG2.FEHLERSCHWELLE "Fault code SC_SMG2 - debounce filter threshold for setting the fault [verified]" VALUE 0x710CC RL_VAL_UB 0 CM_0000 0 255 /end CHARACTERISTIC
/begin CHARACTERISTIC K_ED_SC_SMG2.INC_NACH_EINTRAG "Fault code SC_SMG2 - debounce filter increment after fault-memory entry [verified]" VALUE 0x710D0 RL_VAL_UB 0 CM_0000 0 255 /end CHARACTERISTIC
/begin CHARACTERISTIC K_ED_SC_SMG2.INC_VOR_EINTRAG "Fault code SC_SMG2 - debounce filter increment before fault-memory entry [verified]" VALUE 0x710CE RL_VAL_UB 0 CM_0000 0 255 /end CHARACTERISTIC
/begin CHARACTERISTIC K_ED_SC_SMG2.KLASSENINDEX "Fault code SC_SMG2 - fault class selection (lamp / warning behaviour) [verified]" VALUE 0x710D2 RL_VAL_UB 0 CM_0000 0 255 /end CHARACTERISTIC
/begin CHARACTERISTIC K_ED_SC_SMG2.OK_SCHWELLE "Fault code SC_SMG2 - debounce filter threshold for clearing (healing) the fault [verified]" VALUE 0x710CD RL_VAL_UB 0 CM_0000 0 255 /end CHARACTERISTIC
/begin CHARACTERISTIC K_ED_SC_SMG2.P_CODE_OPENLOAD "Fault code SC_SMG2 - OBD P-code reported for open circuit [verified]" VALUE 0x710C8 RL_VAL_UW 0 CM_0000 0 65535 /end CHARACTERISTIC
/begin CHARACTERISTIC K_ED_SC_SMG2.P_CODE_SH_TO_GND "Fault code SC_SMG2 - OBD P-code reported for short to ground [verified]" VALUE 0x710C6 RL_VAL_UW 0 CM_0000 0 65535 /end CHARACTERISTIC
/begin CHARACTERISTIC K_ED_SC_SMG2.P_CODE_SH_TO_UB "Fault code SC_SMG2 - OBD P-code reported for short to battery voltage [verified]" VALUE 0x710C4 RL_VAL_UW 0 CM_0000 0 65535 /end CHARACTERISTIC
/begin CHARACTERISTIC K_ED_SC_SMG2.P_CODE_UNPLAUSIBEL "Fault code SC_SMG2 - OBD P-code reported for implausible signal [verified]" VALUE 0x710CA RL_VAL_UW 0 CM_0000 0 65535 /end CHARACTERISTIC
/begin CHARACTERISTIC K_ED_SC_SMG3.DEC_NACH_EINTRAG "Fault code SC_SMG3 - debounce filter decrement after fault-memory entry [verified]" VALUE 0x710EB RL_VAL_UB 0 CM_0000 0 255 /end CHARACTERISTIC
/begin CHARACTERISTIC K_ED_SC_SMG3.DEC_VOR_EINTRAG "Fault code SC_SMG3 - debounce filter decrement before fault-memory entry [verified]" VALUE 0x710E9 RL_VAL_UB 0 CM_0000 0 255 /end CHARACTERISTIC
/begin CHARACTERISTIC K_ED_SC_SMG3.FEHLERSCHWELLE "Fault code SC_SMG3 - debounce filter threshold for setting the fault [verified]" VALUE 0x710E6 RL_VAL_UB 0 CM_0000 0 255 /end CHARACTERISTIC
/begin CHARACTERISTIC K_ED_SC_SMG3.INC_NACH_EINTRAG "Fault code SC_SMG3 - debounce filter increment after fault-memory entry [verified]" VALUE 0x710EA RL_VAL_UB 0 CM_0000 0 255 /end CHARACTERISTIC
/begin CHARACTERISTIC K_ED_SC_SMG3.INC_VOR_EINTRAG "Fault code SC_SMG3 - debounce filter increment before fault-memory entry [verified]" VALUE 0x710E8 RL_VAL_UB 0 CM_0000 0 255 /end CHARACTERISTIC
/begin CHARACTERISTIC K_ED_SC_SMG3.KLASSENINDEX "Fault code SC_SMG3 - fault class selection (lamp / warning behaviour) [verified]" VALUE 0x710EC RL_VAL_UB 0 CM_0000 0 255 /end CHARACTERISTIC
/begin CHARACTERISTIC K_ED_SC_SMG3.OK_SCHWELLE "Fault code SC_SMG3 - debounce filter threshold for clearing (healing) the fault [verified]" VALUE 0x710E7 RL_VAL_UB 0 CM_0000 0 255 /end CHARACTERISTIC
/begin CHARACTERISTIC K_ED_SC_SMG3.P_CODE_OPENLOAD "Fault code SC_SMG3 - OBD P-code reported for open circuit [verified]" VALUE 0x710E2 RL_VAL_UW 0 CM_0000 0 65535 /end CHARACTERISTIC
/begin CHARACTERISTIC K_ED_SC_SMG3.P_CODE_SH_TO_GND "Fault code SC_SMG3 - OBD P-code reported for short to ground [verified]" VALUE 0x710E0 RL_VAL_UW 0 CM_0000 0 65535 /end CHARACTERISTIC
/begin CHARACTERISTIC K_ED_SC_SMG3.P_CODE_SH_TO_UB "Fault code SC_SMG3 - OBD P-code reported for short to battery voltage [verified]" VALUE 0x710DE RL_VAL_UW 0 CM_0000 0 65535 /end CHARACTERISTIC
/begin CHARACTERISTIC K_ED_SC_SMG3.P_CODE_UNPLAUSIBEL "Fault code SC_SMG3 - OBD P-code reported for implausible signal [verified]" VALUE 0x710E4 RL_VAL_UW 0 CM_0000 0 65535 /end CHARACTERISTIC
/begin CHARACTERISTIC K_ED_SERVO_I.DEC_NACH_EINTRAG "Fault code SERVO_I - debounce filter decrement after fault-memory entry [verified]" VALUE 0x715CB RL_VAL_UB 0 CM_0000 0 255 /end CHARACTERISTIC
/begin CHARACTERISTIC K_ED_SERVO_I.DEC_VOR_EINTRAG "Fault code SERVO_I - debounce filter decrement before fault-memory entry [verified]" VALUE 0x715C9 RL_VAL_UB 0 CM_0000 0 255 /end CHARACTERISTIC
/begin CHARACTERISTIC K_ED_SERVO_I.FEHLERSCHWELLE "Fault code SERVO_I - debounce filter threshold for setting the fault [verified]" VALUE 0x715C6 RL_VAL_UB 0 CM_0000 0 255 /end CHARACTERISTIC
/begin CHARACTERISTIC K_ED_SERVO_I.INC_NACH_EINTRAG "Fault code SERVO_I - debounce filter increment after fault-memory entry [verified]" VALUE 0x715CA RL_VAL_UB 0 CM_0000 0 255 /end CHARACTERISTIC
/begin CHARACTERISTIC K_ED_SERVO_I.INC_VOR_EINTRAG "Fault code SERVO_I - debounce filter increment before fault-memory entry [verified]" VALUE 0x715C8 RL_VAL_UB 0 CM_0000 0 255 /end CHARACTERISTIC
/begin CHARACTERISTIC K_ED_SERVO_I.KLASSENINDEX "Fault code SERVO_I - fault class selection (lamp / warning behaviour) [verified]" VALUE 0x715CC RL_VAL_UB 0 CM_0000 0 255 /end CHARACTERISTIC
/begin CHARACTERISTIC K_ED_SERVO_I.OK_SCHWELLE "Fault code SERVO_I - debounce filter threshold for clearing (healing) the fault [verified]" VALUE 0x715C7 RL_VAL_UB 0 CM_0000 0 255 /end CHARACTERISTIC
/begin CHARACTERISTIC K_ED_SERVO_I.P_CODE_OPENLOAD "Fault code SERVO_I - OBD P-code reported for open circuit [verified]" VALUE 0x715C2 RL_VAL_UW 0 CM_0000 0 65535 /end CHARACTERISTIC
/begin CHARACTERISTIC K_ED_SERVO_I.P_CODE_SH_TO_GND "Fault code SERVO_I - OBD P-code reported for short to ground [verified]" VALUE 0x715C0 RL_VAL_UW 0 CM_0000 0 65535 /end CHARACTERISTIC
/begin CHARACTERISTIC K_ED_SERVO_I.P_CODE_SH_TO_UB "Fault code SERVO_I - OBD P-code reported for short to battery voltage [verified]" VALUE 0x715BE RL_VAL_UW 0 CM_0000 0 65535 /end CHARACTERISTIC
/begin CHARACTERISTIC K_ED_SERVO_I.P_CODE_UNPLAUSIBEL "Fault code SERVO_I - OBD P-code reported for implausible signal [verified]" VALUE 0x715C4 RL_VAL_UW 0 CM_0000 0 65535 /end CHARACTERISTIC
/begin CHARACTERISTIC K_ED_SERVO_V.DEC_NACH_EINTRAG "Fault code SERVO_V - debounce filter decrement after fault-memory entry [verified]" VALUE 0x715E5 RL_VAL_UB 0 CM_0000 0 255 /end CHARACTERISTIC
/begin CHARACTERISTIC K_ED_SERVO_V.DEC_VOR_EINTRAG "Fault code SERVO_V - debounce filter decrement before fault-memory entry [verified]" VALUE 0x715E3 RL_VAL_UB 0 CM_0000 0 255 /end CHARACTERISTIC
/begin CHARACTERISTIC K_ED_SERVO_V.FEHLERSCHWELLE "Fault code SERVO_V - debounce filter threshold for setting the fault [verified]" VALUE 0x715E0 RL_VAL_UB 0 CM_0000 0 255 /end CHARACTERISTIC
/begin CHARACTERISTIC K_ED_SERVO_V.INC_NACH_EINTRAG "Fault code SERVO_V - debounce filter increment after fault-memory entry [verified]" VALUE 0x715E4 RL_VAL_UB 0 CM_0000 0 255 /end CHARACTERISTIC
/begin CHARACTERISTIC K_ED_SERVO_V.INC_VOR_EINTRAG "Fault code SERVO_V - debounce filter increment before fault-memory entry [verified]" VALUE 0x715E2 RL_VAL_UB 0 CM_0000 0 255 /end CHARACTERISTIC
/begin CHARACTERISTIC K_ED_SERVO_V.KLASSENINDEX "Fault code SERVO_V - fault class selection (lamp / warning behaviour) [verified]" VALUE 0x715E6 RL_VAL_UB 0 CM_0000 0 255 /end CHARACTERISTIC
/begin CHARACTERISTIC K_ED_SERVO_V.OK_SCHWELLE "Fault code SERVO_V - debounce filter threshold for clearing (healing) the fault [verified]" VALUE 0x715E1 RL_VAL_UB 0 CM_0000 0 255 /end CHARACTERISTIC
/begin CHARACTERISTIC K_ED_SERVO_V.P_CODE_OPENLOAD "Fault code SERVO_V - OBD P-code reported for open circuit [verified]" VALUE 0x715DC RL_VAL_UW 0 CM_0000 0 65535 /end CHARACTERISTIC
/begin CHARACTERISTIC K_ED_SERVO_V.P_CODE_SH_TO_GND "Fault code SERVO_V - OBD P-code reported for short to ground [verified]" VALUE 0x715DA RL_VAL_UW 0 CM_0000 0 65535 /end CHARACTERISTIC
/begin CHARACTERISTIC K_ED_SERVO_V.P_CODE_SH_TO_UB "Fault code SERVO_V - OBD P-code reported for short to battery voltage [verified]" VALUE 0x715D8 RL_VAL_UW 0 CM_0000 0 65535 /end CHARACTERISTIC
/begin CHARACTERISTIC K_ED_SERVO_V.P_CODE_UNPLAUSIBEL "Fault code SERVO_V - OBD P-code reported for implausible signal [verified]" VALUE 0x715DE RL_VAL_UW 0 CM_0000 0 65535 /end CHARACTERISTIC
/begin CHARACTERISTIC K_ED_SG_IGN.DEC_NACH_EINTRAG "Fault code SG_IGN - debounce filter decrement after fault-memory entry [verified]" VALUE 0x7145F RL_VAL_UB 0 CM_0000 0 255 /end CHARACTERISTIC
/begin CHARACTERISTIC K_ED_SG_IGN.DEC_VOR_EINTRAG "Fault code SG_IGN - debounce filter decrement before fault-memory entry [verified]" VALUE 0x7145D RL_VAL_UB 0 CM_0000 0 255 /end CHARACTERISTIC
/begin CHARACTERISTIC K_ED_SG_IGN.FEHLERSCHWELLE "Fault code SG_IGN - debounce filter threshold for setting the fault [verified]" VALUE 0x7145A RL_VAL_UB 0 CM_0000 0 255 /end CHARACTERISTIC
/begin CHARACTERISTIC K_ED_SG_IGN.INC_NACH_EINTRAG "Fault code SG_IGN - debounce filter increment after fault-memory entry [verified]" VALUE 0x7145E RL_VAL_UB 0 CM_0000 0 255 /end CHARACTERISTIC
/begin CHARACTERISTIC K_ED_SG_IGN.INC_VOR_EINTRAG "Fault code SG_IGN - debounce filter increment before fault-memory entry [verified]" VALUE 0x7145C RL_VAL_UB 0 CM_0000 0 255 /end CHARACTERISTIC
/begin CHARACTERISTIC K_ED_SG_IGN.KLASSENINDEX "Fault code SG_IGN - fault class selection (lamp / warning behaviour) [verified]" VALUE 0x71460 RL_VAL_UB 0 CM_0000 0 255 /end CHARACTERISTIC
/begin CHARACTERISTIC K_ED_SG_IGN.OK_SCHWELLE "Fault code SG_IGN - debounce filter threshold for clearing (healing) the fault [verified]" VALUE 0x7145B RL_VAL_UB 0 CM_0000 0 255 /end CHARACTERISTIC
/begin CHARACTERISTIC K_ED_SG_IGN.P_CODE_OPENLOAD "Fault code SG_IGN - OBD P-code reported for open circuit [verified]" VALUE 0x71456 RL_VAL_UW 0 CM_0000 0 65535 /end CHARACTERISTIC
/begin CHARACTERISTIC K_ED_SG_IGN.P_CODE_SH_TO_GND "Fault code SG_IGN - OBD P-code reported for short to ground [verified]" VALUE 0x71454 RL_VAL_UW 0 CM_0000 0 65535 /end CHARACTERISTIC
/begin CHARACTERISTIC K_ED_SG_IGN.P_CODE_SH_TO_UB "Fault code SG_IGN - OBD P-code reported for short to battery voltage [verified]" VALUE 0x71452 RL_VAL_UW 0 CM_0000 0 65535 /end CHARACTERISTIC
/begin CHARACTERISTIC K_ED_SG_IGN.P_CODE_UNPLAUSIBEL "Fault code SG_IGN - OBD P-code reported for implausible signal [verified]" VALUE 0x71458 RL_VAL_UW 0 CM_0000 0 65535 /end CHARACTERISTIC
/begin CHARACTERISTIC K_ED_SK_MANAGER_IGN.DEC_NACH_EINTRAG "Fault code SK_MANAGER_IGN - debounce filter decrement after fault-memory entry [verified]" VALUE 0x714AD RL_VAL_UB 0 CM_0000 0 255 /end CHARACTERISTIC
/begin CHARACTERISTIC K_ED_SK_MANAGER_IGN.DEC_VOR_EINTRAG "Fault code SK_MANAGER_IGN - debounce filter decrement before fault-memory entry [verified]" VALUE 0x714AB RL_VAL_UB 0 CM_0000 0 255 /end CHARACTERISTIC
/begin CHARACTERISTIC K_ED_SK_MANAGER_IGN.FEHLERSCHWELLE "Fault code SK_MANAGER_IGN - debounce filter threshold for setting the fault [verified]" VALUE 0x714A8 RL_VAL_UB 0 CM_0000 0 255 /end CHARACTERISTIC
/begin CHARACTERISTIC K_ED_SK_MANAGER_IGN.INC_NACH_EINTRAG "Fault code SK_MANAGER_IGN - debounce filter increment after fault-memory entry [verified]" VALUE 0x714AC RL_VAL_UB 0 CM_0000 0 255 /end CHARACTERISTIC
/begin CHARACTERISTIC K_ED_SK_MANAGER_IGN.INC_VOR_EINTRAG "Fault code SK_MANAGER_IGN - debounce filter increment before fault-memory entry [verified]" VALUE 0x714AA RL_VAL_UB 0 CM_0000 0 255 /end CHARACTERISTIC
/begin CHARACTERISTIC K_ED_SK_MANAGER_IGN.KLASSENINDEX "Fault code SK_MANAGER_IGN - fault class selection (lamp / warning behaviour) [verified]" VALUE 0x714AE RL_VAL_UB 0 CM_0000 0 255 /end CHARACTERISTIC
/begin CHARACTERISTIC K_ED_SK_MANAGER_IGN.OK_SCHWELLE "Fault code SK_MANAGER_IGN - debounce filter threshold for clearing (healing) the fault [verified]" VALUE 0x714A9 RL_VAL_UB 0 CM_0000 0 255 /end CHARACTERISTIC
/begin CHARACTERISTIC K_ED_SK_MANAGER_IGN.P_CODE_OPENLOAD "Fault code SK_MANAGER_IGN - OBD P-code reported for open circuit [verified]" VALUE 0x714A4 RL_VAL_UW 0 CM_0000 0 65535 /end CHARACTERISTIC
/begin CHARACTERISTIC K_ED_SK_MANAGER_IGN.P_CODE_SH_TO_GND "Fault code SK_MANAGER_IGN - OBD P-code reported for short to ground [verified]" VALUE 0x714A2 RL_VAL_UW 0 CM_0000 0 65535 /end CHARACTERISTIC
/begin CHARACTERISTIC K_ED_SK_MANAGER_IGN.P_CODE_SH_TO_UB "Fault code SK_MANAGER_IGN - OBD P-code reported for short to battery voltage [verified]" VALUE 0x714A0 RL_VAL_UW 0 CM_0000 0 65535 /end CHARACTERISTIC
/begin CHARACTERISTIC K_ED_SK_MANAGER_IGN.P_CODE_UNPLAUSIBEL "Fault code SK_MANAGER_IGN - OBD P-code reported for implausible signal [verified]" VALUE 0x714A6 RL_VAL_UW 0 CM_0000 0 65535 /end CHARACTERISTIC
/begin CHARACTERISTIC K_ED_SK_TR_IGN.KLASSENINDEX "Fault code SK_TR_IGN - fault class selection (lamp / warning behaviour) [verified]" VALUE 0x70B08 RL_VAL_UB 0 CM_0000 0 255 /end CHARACTERISTIC
/begin CHARACTERISTIC K_ED_SMG_SCHALTAB.DEC_NACH_EINTRAG "Fault code SMG_SCHALTAB - debounce filter decrement after fault-memory entry [verified]" VALUE 0x70D5D RL_VAL_UB 0 CM_0000 0 255 /end CHARACTERISTIC
/begin CHARACTERISTIC K_ED_SMG_SCHALTAB.DEC_VOR_EINTRAG "Fault code SMG_SCHALTAB - debounce filter decrement before fault-memory entry [verified]" VALUE 0x70D5B RL_VAL_UB 0 CM_0000 0 255 /end CHARACTERISTIC
/begin CHARACTERISTIC K_ED_SMG_SCHALTAB.FEHLERSCHWELLE "Fault code SMG_SCHALTAB - debounce filter threshold for setting the fault [verified]" VALUE 0x70D58 RL_VAL_UB 0 CM_0000 0 255 /end CHARACTERISTIC
/begin CHARACTERISTIC K_ED_SMG_SCHALTAB.INC_NACH_EINTRAG "Fault code SMG_SCHALTAB - debounce filter increment after fault-memory entry [verified]" VALUE 0x70D5C RL_VAL_UB 0 CM_0000 0 255 /end CHARACTERISTIC
/begin CHARACTERISTIC K_ED_SMG_SCHALTAB.INC_VOR_EINTRAG "Fault code SMG_SCHALTAB - debounce filter increment before fault-memory entry [verified]" VALUE 0x70D5A RL_VAL_UB 0 CM_0000 0 255 /end CHARACTERISTIC
/begin CHARACTERISTIC K_ED_SMG_SCHALTAB.KLASSENINDEX "Fault code SMG_SCHALTAB - fault class selection (lamp / warning behaviour) [verified]" VALUE 0x70D5E RL_VAL_UB 0 CM_0000 0 255 /end CHARACTERISTIC
/begin CHARACTERISTIC K_ED_SMG_SCHALTAB.OK_SCHWELLE "Fault code SMG_SCHALTAB - debounce filter threshold for clearing (healing) the fault [verified]" VALUE 0x70D59 RL_VAL_UB 0 CM_0000 0 255 /end CHARACTERISTIC
/begin CHARACTERISTIC K_ED_SMG_SCHALTAB.P_CODE_OPENLOAD "Fault code SMG_SCHALTAB - OBD P-code reported for open circuit [verified]" VALUE 0x70D54 RL_VAL_UW 0 CM_0000 0 65535 /end CHARACTERISTIC
/begin CHARACTERISTIC K_ED_SMG_SCHALTAB.P_CODE_SH_TO_GND "Fault code SMG_SCHALTAB - OBD P-code reported for short to ground [verified]" VALUE 0x70D52 RL_VAL_UW 0 CM_0000 0 65535 /end CHARACTERISTIC
/begin CHARACTERISTIC K_ED_SMG_SCHALTAB.P_CODE_SH_TO_UB "Fault code SMG_SCHALTAB - OBD P-code reported for short to battery voltage [verified]" VALUE 0x70D50 RL_VAL_UW 0 CM_0000 0 65535 /end CHARACTERISTIC
/begin CHARACTERISTIC K_ED_SMG_SCHALTAB.P_CODE_UNPLAUSIBEL "Fault code SMG_SCHALTAB - OBD P-code reported for implausible signal [verified]" VALUE 0x70D56 RL_VAL_UW 0 CM_0000 0 65535 /end CHARACTERISTIC
/begin CHARACTERISTIC K_ED_SMG_SK.DEC_NACH_EINTRAG "Fault code SMG_SK - debounce filter decrement after fault-memory entry [verified]" VALUE 0x70D77 RL_VAL_UB 0 CM_0000 0 255 /end CHARACTERISTIC
/begin CHARACTERISTIC K_ED_SMG_SK.DEC_VOR_EINTRAG "Fault code SMG_SK - debounce filter decrement before fault-memory entry [verified]" VALUE 0x70D75 RL_VAL_UB 0 CM_0000 0 255 /end CHARACTERISTIC
/begin CHARACTERISTIC K_ED_SMG_SK.FEHLERSCHWELLE "Fault code SMG_SK - debounce filter threshold for setting the fault [verified]" VALUE 0x70D72 RL_VAL_UB 0 CM_0000 0 255 /end CHARACTERISTIC
/begin CHARACTERISTIC K_ED_SMG_SK.INC_NACH_EINTRAG "Fault code SMG_SK - debounce filter increment after fault-memory entry [verified]" VALUE 0x70D76 RL_VAL_UB 0 CM_0000 0 255 /end CHARACTERISTIC
/begin CHARACTERISTIC K_ED_SMG_SK.INC_VOR_EINTRAG "Fault code SMG_SK - debounce filter increment before fault-memory entry [verified]" VALUE 0x70D74 RL_VAL_UB 0 CM_0000 0 255 /end CHARACTERISTIC
/begin CHARACTERISTIC K_ED_SMG_SK.KLASSENINDEX "Fault code SMG_SK - fault class selection (lamp / warning behaviour) [verified]" VALUE 0x70D78 RL_VAL_UB 0 CM_0000 0 255 /end CHARACTERISTIC
/begin CHARACTERISTIC K_ED_SMG_SK.OK_SCHWELLE "Fault code SMG_SK - debounce filter threshold for clearing (healing) the fault [verified]" VALUE 0x70D73 RL_VAL_UB 0 CM_0000 0 255 /end CHARACTERISTIC
/begin CHARACTERISTIC K_ED_SMG_SK.P_CODE_OPENLOAD "Fault code SMG_SK - OBD P-code reported for open circuit [verified]" VALUE 0x70D6E RL_VAL_UW 0 CM_0000 0 65535 /end CHARACTERISTIC
/begin CHARACTERISTIC K_ED_SMG_SK.P_CODE_SH_TO_GND "Fault code SMG_SK - OBD P-code reported for short to ground [verified]" VALUE 0x70D6C RL_VAL_UW 0 CM_0000 0 65535 /end CHARACTERISTIC
/begin CHARACTERISTIC K_ED_SMG_SK.P_CODE_SH_TO_UB "Fault code SMG_SK - OBD P-code reported for short to battery voltage [verified]" VALUE 0x70D6A RL_VAL_UW 0 CM_0000 0 65535 /end CHARACTERISTIC
/begin CHARACTERISTIC K_ED_SMG_SK.P_CODE_UNPLAUSIBEL "Fault code SMG_SK - OBD P-code reported for implausible signal [verified]" VALUE 0x70D70 RL_VAL_UW 0 CM_0000 0 65535 /end CHARACTERISTIC
/begin CHARACTERISTIC K_ED_SMG_SK_N.DEC_NACH_EINTRAG "Fault code SMG_SK_N - debounce filter decrement after fault-memory entry [verified]" VALUE 0x70D91 RL_VAL_UB 0 CM_0000 0 255 /end CHARACTERISTIC
/begin CHARACTERISTIC K_ED_SMG_SK_N.DEC_VOR_EINTRAG "Fault code SMG_SK_N - debounce filter decrement before fault-memory entry [verified]" VALUE 0x70D8F RL_VAL_UB 0 CM_0000 0 255 /end CHARACTERISTIC
/begin CHARACTERISTIC K_ED_SMG_SK_N.FEHLERSCHWELLE "Fault code SMG_SK_N - debounce filter threshold for setting the fault [verified]" VALUE 0x70D8C RL_VAL_UB 0 CM_0000 0 255 /end CHARACTERISTIC
/begin CHARACTERISTIC K_ED_SMG_SK_N.INC_NACH_EINTRAG "Fault code SMG_SK_N - debounce filter increment after fault-memory entry [verified]" VALUE 0x70D90 RL_VAL_UB 0 CM_0000 0 255 /end CHARACTERISTIC
/begin CHARACTERISTIC K_ED_SMG_SK_N.INC_VOR_EINTRAG "Fault code SMG_SK_N - debounce filter increment before fault-memory entry [verified]" VALUE 0x70D8E RL_VAL_UB 0 CM_0000 0 255 /end CHARACTERISTIC
/begin CHARACTERISTIC K_ED_SMG_SK_N.KLASSENINDEX "Fault code SMG_SK_N - fault class selection (lamp / warning behaviour) [verified]" VALUE 0x70D92 RL_VAL_UB 0 CM_0000 0 255 /end CHARACTERISTIC
/begin CHARACTERISTIC K_ED_SMG_SK_N.OK_SCHWELLE "Fault code SMG_SK_N - debounce filter threshold for clearing (healing) the fault [verified]" VALUE 0x70D8D RL_VAL_UB 0 CM_0000 0 255 /end CHARACTERISTIC
/begin CHARACTERISTIC K_ED_SMG_SK_N.P_CODE_OPENLOAD "Fault code SMG_SK_N - OBD P-code reported for open circuit [verified]" VALUE 0x70D88 RL_VAL_UW 0 CM_0000 0 65535 /end CHARACTERISTIC
/begin CHARACTERISTIC K_ED_SMG_SK_N.P_CODE_SH_TO_GND "Fault code SMG_SK_N - OBD P-code reported for short to ground [verified]" VALUE 0x70D86 RL_VAL_UW 0 CM_0000 0 65535 /end CHARACTERISTIC
/begin CHARACTERISTIC K_ED_SMG_SK_N.P_CODE_SH_TO_UB "Fault code SMG_SK_N - OBD P-code reported for short to battery voltage [verified]" VALUE 0x70D84 RL_VAL_UW 0 CM_0000 0 65535 /end CHARACTERISTIC
/begin CHARACTERISTIC K_ED_SMG_SK_N.P_CODE_UNPLAUSIBEL "Fault code SMG_SK_N - OBD P-code reported for implausible signal [verified]" VALUE 0x70D8A RL_VAL_UW 0 CM_0000 0 65535 /end CHARACTERISTIC
/begin CHARACTERISTIC K_ED_START_RL.DEC_NACH_EINTRAG "Fault code START_RL - debounce filter decrement after fault-memory entry [verified]" VALUE 0x7157D RL_VAL_UB 0 CM_0000 0 255 /end CHARACTERISTIC
/begin CHARACTERISTIC K_ED_START_RL.DEC_VOR_EINTRAG "Fault code START_RL - debounce filter decrement before fault-memory entry [verified]" VALUE 0x7157B RL_VAL_UB 0 CM_0000 0 255 /end CHARACTERISTIC
/begin CHARACTERISTIC K_ED_START_RL.FEHLERSCHWELLE "Fault code START_RL - debounce filter threshold for setting the fault [verified]" VALUE 0x71578 RL_VAL_UB 0 CM_0000 0 255 /end CHARACTERISTIC
/begin CHARACTERISTIC K_ED_START_RL.INC_NACH_EINTRAG "Fault code START_RL - debounce filter increment after fault-memory entry [verified]" VALUE 0x7157C RL_VAL_UB 0 CM_0000 0 255 /end CHARACTERISTIC
/begin CHARACTERISTIC K_ED_START_RL.INC_VOR_EINTRAG "Fault code START_RL - debounce filter increment before fault-memory entry [verified]" VALUE 0x7157A RL_VAL_UB 0 CM_0000 0 255 /end CHARACTERISTIC
/begin CHARACTERISTIC K_ED_START_RL.KLASSENINDEX "Fault code START_RL - fault class selection (lamp / warning behaviour) [verified]" VALUE 0x7157E RL_VAL_UB 0 CM_0000 0 255 /end CHARACTERISTIC
/begin CHARACTERISTIC K_ED_START_RL.OK_SCHWELLE "Fault code START_RL - debounce filter threshold for clearing (healing) the fault [verified]" VALUE 0x71579 RL_VAL_UB 0 CM_0000 0 255 /end CHARACTERISTIC
/begin CHARACTERISTIC K_ED_START_RL.P_CODE_OPENLOAD "Fault code START_RL - OBD P-code reported for open circuit [verified]" VALUE 0x71574 RL_VAL_UW 0 CM_0000 0 65535 /end CHARACTERISTIC
/begin CHARACTERISTIC K_ED_START_RL.P_CODE_SH_TO_GND "Fault code START_RL - OBD P-code reported for short to ground [verified]" VALUE 0x71572 RL_VAL_UW 0 CM_0000 0 65535 /end CHARACTERISTIC
/begin CHARACTERISTIC K_ED_START_RL.P_CODE_SH_TO_UB "Fault code START_RL - OBD P-code reported for short to battery voltage [verified]" VALUE 0x71570 RL_VAL_UW 0 CM_0000 0 65535 /end CHARACTERISTIC
/begin CHARACTERISTIC K_ED_START_RL.P_CODE_UNPLAUSIBEL "Fault code START_RL - OBD P-code reported for implausible signal [verified]" VALUE 0x71576 RL_VAL_UW 0 CM_0000 0 65535 /end CHARACTERISTIC
/begin CHARACTERISTIC K_ED_TABG1.DEC_NACH_EINTRAG "Fault code TABG1 - debounce filter decrement after fault-memory entry [verified]" VALUE 0x70EC9 RL_VAL_UB 0 CM_0000 0 255 /end CHARACTERISTIC
/begin CHARACTERISTIC K_ED_TABG1.DEC_VOR_EINTRAG "Fault code TABG1 - debounce filter decrement before fault-memory entry [verified]" VALUE 0x70EC7 RL_VAL_UB 0 CM_0000 0 255 /end CHARACTERISTIC
/begin CHARACTERISTIC K_ED_TABG1.FEHLERSCHWELLE "Fault code TABG1 - debounce filter threshold for setting the fault [verified]" VALUE 0x70EC4 RL_VAL_UB 0 CM_0000 0 255 /end CHARACTERISTIC
/begin CHARACTERISTIC K_ED_TABG1.INC_NACH_EINTRAG "Fault code TABG1 - debounce filter increment after fault-memory entry [verified]" VALUE 0x70EC8 RL_VAL_UB 0 CM_0000 0 255 /end CHARACTERISTIC
/begin CHARACTERISTIC K_ED_TABG1.INC_VOR_EINTRAG "Fault code TABG1 - debounce filter increment before fault-memory entry [verified]" VALUE 0x70EC6 RL_VAL_UB 0 CM_0000 0 255 /end CHARACTERISTIC
/begin CHARACTERISTIC K_ED_TABG1.KLASSENINDEX "Fault code TABG1 - fault class selection (lamp / warning behaviour) [verified]" VALUE 0x70ECA RL_VAL_UB 0 CM_0000 0 255 /end CHARACTERISTIC
/begin CHARACTERISTIC K_ED_TABG1.OK_SCHWELLE "Fault code TABG1 - debounce filter threshold for clearing (healing) the fault [verified]" VALUE 0x70EC5 RL_VAL_UB 0 CM_0000 0 255 /end CHARACTERISTIC
/begin CHARACTERISTIC K_ED_TABG1.P_CODE_OPENLOAD "Fault code TABG1 - OBD P-code reported for open circuit [verified]" VALUE 0x70EC0 RL_VAL_UW 0 CM_0000 0 65535 /end CHARACTERISTIC
/begin CHARACTERISTIC K_ED_TABG1.P_CODE_SH_TO_GND "Fault code TABG1 - OBD P-code reported for short to ground [verified]" VALUE 0x70EBE RL_VAL_UW 0 CM_0000 0 65535 /end CHARACTERISTIC
/begin CHARACTERISTIC K_ED_TABG1.P_CODE_SH_TO_UB "Fault code TABG1 - OBD P-code reported for short to battery voltage [verified]" VALUE 0x70EBC RL_VAL_UW 0 CM_0000 0 65535 /end CHARACTERISTIC
/begin CHARACTERISTIC K_ED_TABG1.P_CODE_UNPLAUSIBEL "Fault code TABG1 - OBD P-code reported for implausible signal [verified]" VALUE 0x70EC2 RL_VAL_UW 0 CM_0000 0 65535 /end CHARACTERISTIC
/begin CHARACTERISTIC K_ED_TABG2.DEC_NACH_EINTRAG "Fault code TABG2 - debounce filter decrement after fault-memory entry [verified]" VALUE 0x70EE3 RL_VAL_UB 0 CM_0000 0 255 /end CHARACTERISTIC
/begin CHARACTERISTIC K_ED_TABG2.DEC_VOR_EINTRAG "Fault code TABG2 - debounce filter decrement before fault-memory entry [verified]" VALUE 0x70EE1 RL_VAL_UB 0 CM_0000 0 255 /end CHARACTERISTIC
/begin CHARACTERISTIC K_ED_TABG2.FEHLERSCHWELLE "Fault code TABG2 - debounce filter threshold for setting the fault [verified]" VALUE 0x70EDE RL_VAL_UB 0 CM_0000 0 255 /end CHARACTERISTIC
/begin CHARACTERISTIC K_ED_TABG2.INC_NACH_EINTRAG "Fault code TABG2 - debounce filter increment after fault-memory entry [verified]" VALUE 0x70EE2 RL_VAL_UB 0 CM_0000 0 255 /end CHARACTERISTIC
/begin CHARACTERISTIC K_ED_TABG2.INC_VOR_EINTRAG "Fault code TABG2 - debounce filter increment before fault-memory entry [verified]" VALUE 0x70EE0 RL_VAL_UB 0 CM_0000 0 255 /end CHARACTERISTIC
/begin CHARACTERISTIC K_ED_TABG2.KLASSENINDEX "Fault code TABG2 - fault class selection (lamp / warning behaviour) [verified]" VALUE 0x70EE4 RL_VAL_UB 0 CM_0000 0 255 /end CHARACTERISTIC
/begin CHARACTERISTIC K_ED_TABG2.OK_SCHWELLE "Fault code TABG2 - debounce filter threshold for clearing (healing) the fault [verified]" VALUE 0x70EDF RL_VAL_UB 0 CM_0000 0 255 /end CHARACTERISTIC
/begin CHARACTERISTIC K_ED_TABG2.P_CODE_OPENLOAD "Fault code TABG2 - OBD P-code reported for open circuit [verified]" VALUE 0x70EDA RL_VAL_UW 0 CM_0000 0 65535 /end CHARACTERISTIC
/begin CHARACTERISTIC K_ED_TABG2.P_CODE_SH_TO_GND "Fault code TABG2 - OBD P-code reported for short to ground [verified]" VALUE 0x70ED8 RL_VAL_UW 0 CM_0000 0 65535 /end CHARACTERISTIC
/begin CHARACTERISTIC K_ED_TABG2.P_CODE_SH_TO_UB "Fault code TABG2 - OBD P-code reported for short to battery voltage [verified]" VALUE 0x70ED6 RL_VAL_UW 0 CM_0000 0 65535 /end CHARACTERISTIC
/begin CHARACTERISTIC K_ED_TABG2.P_CODE_UNPLAUSIBEL "Fault code TABG2 - OBD P-code reported for implausible signal [verified]" VALUE 0x70EDC RL_VAL_UW 0 CM_0000 0 65535 /end CHARACTERISTIC
/begin CHARACTERISTIC K_ED_TAN1.DEC_NACH_EINTRAG "Fault code TAN1 - debounce filter decrement after fault-memory entry [verified]" VALUE 0x70B55 RL_VAL_UB 0 CM_0000 0 255 /end CHARACTERISTIC
/begin CHARACTERISTIC K_ED_TAN1.DEC_VOR_EINTRAG "Fault code TAN1 - debounce filter decrement before fault-memory entry [verified]" VALUE 0x70B53 RL_VAL_UB 0 CM_0000 0 255 /end CHARACTERISTIC
/begin CHARACTERISTIC K_ED_TAN1.FEHLERSCHWELLE "Fault code TAN1 - debounce filter threshold for setting the fault [verified]" VALUE 0x70B50 RL_VAL_UB 0 CM_0000 0 255 /end CHARACTERISTIC
/begin CHARACTERISTIC K_ED_TAN1.INC_NACH_EINTRAG "Fault code TAN1 - debounce filter increment after fault-memory entry [verified]" VALUE 0x70B54 RL_VAL_UB 0 CM_0000 0 255 /end CHARACTERISTIC
/begin CHARACTERISTIC K_ED_TAN1.INC_VOR_EINTRAG "Fault code TAN1 - debounce filter increment before fault-memory entry [verified]" VALUE 0x70B52 RL_VAL_UB 0 CM_0000 0 255 /end CHARACTERISTIC
/begin CHARACTERISTIC K_ED_TAN1.KLASSENINDEX "Fault code TAN1 - fault class selection (lamp / warning behaviour) [verified]" VALUE 0x70B56 RL_VAL_UB 0 CM_0000 0 255 /end CHARACTERISTIC
/begin CHARACTERISTIC K_ED_TAN1.OK_SCHWELLE "Fault code TAN1 - debounce filter threshold for clearing (healing) the fault [verified]" VALUE 0x70B51 RL_VAL_UB 0 CM_0000 0 255 /end CHARACTERISTIC
/begin CHARACTERISTIC K_ED_TAN1.P_CODE_OPENLOAD "Fault code TAN1 - OBD P-code reported for open circuit [verified]" VALUE 0x70B4C RL_VAL_UW 0 CM_0000 0 65535 /end CHARACTERISTIC
/begin CHARACTERISTIC K_ED_TAN1.P_CODE_SH_TO_GND "Fault code TAN1 - OBD P-code reported for short to ground [verified]" VALUE 0x70B4A RL_VAL_UW 0 CM_0000 0 65535 /end CHARACTERISTIC
/begin CHARACTERISTIC K_ED_TAN1.P_CODE_SH_TO_UB "Fault code TAN1 - OBD P-code reported for short to battery voltage [verified]" VALUE 0x70B48 RL_VAL_UW 0 CM_0000 0 65535 /end CHARACTERISTIC
/begin CHARACTERISTIC K_ED_TAN1.P_CODE_UNPLAUSIBEL "Fault code TAN1 - OBD P-code reported for implausible signal [verified]" VALUE 0x70B4E RL_VAL_UW 0 CM_0000 0 65535 /end CHARACTERISTIC
/begin CHARACTERISTIC K_ED_TAN2.DEC_NACH_EINTRAG "Fault code TAN2 - debounce filter decrement after fault-memory entry [verified]" VALUE 0x70B6F RL_VAL_UB 0 CM_0000 0 255 /end CHARACTERISTIC
/begin CHARACTERISTIC K_ED_TAN2.DEC_VOR_EINTRAG "Fault code TAN2 - debounce filter decrement before fault-memory entry [verified]" VALUE 0x70B6D RL_VAL_UB 0 CM_0000 0 255 /end CHARACTERISTIC
/begin CHARACTERISTIC K_ED_TAN2.FEHLERSCHWELLE "Fault code TAN2 - debounce filter threshold for setting the fault [verified]" VALUE 0x70B6A RL_VAL_UB 0 CM_0000 0 255 /end CHARACTERISTIC
/begin CHARACTERISTIC K_ED_TAN2.INC_NACH_EINTRAG "Fault code TAN2 - debounce filter increment after fault-memory entry [verified]" VALUE 0x70B6E RL_VAL_UB 0 CM_0000 0 255 /end CHARACTERISTIC
/begin CHARACTERISTIC K_ED_TAN2.INC_VOR_EINTRAG "Fault code TAN2 - debounce filter increment before fault-memory entry [verified]" VALUE 0x70B6C RL_VAL_UB 0 CM_0000 0 255 /end CHARACTERISTIC
/begin CHARACTERISTIC K_ED_TAN2.KLASSENINDEX "Fault code TAN2 - fault class selection (lamp / warning behaviour) [verified]" VALUE 0x70B70 RL_VAL_UB 0 CM_0000 0 255 /end CHARACTERISTIC
/begin CHARACTERISTIC K_ED_TAN2.OK_SCHWELLE "Fault code TAN2 - debounce filter threshold for clearing (healing) the fault [verified]" VALUE 0x70B6B RL_VAL_UB 0 CM_0000 0 255 /end CHARACTERISTIC
/begin CHARACTERISTIC K_ED_TAN2.P_CODE_OPENLOAD "Fault code TAN2 - OBD P-code reported for open circuit [verified]" VALUE 0x70B66 RL_VAL_UW 0 CM_0000 0 65535 /end CHARACTERISTIC
/begin CHARACTERISTIC K_ED_TAN2.P_CODE_SH_TO_GND "Fault code TAN2 - OBD P-code reported for short to ground [verified]" VALUE 0x70B64 RL_VAL_UW 0 CM_0000 0 65535 /end CHARACTERISTIC
/begin CHARACTERISTIC K_ED_TAN2.P_CODE_SH_TO_UB "Fault code TAN2 - OBD P-code reported for short to battery voltage [verified]" VALUE 0x70B62 RL_VAL_UW 0 CM_0000 0 65535 /end CHARACTERISTIC
/begin CHARACTERISTIC K_ED_TAN2.P_CODE_UNPLAUSIBEL "Fault code TAN2 - OBD P-code reported for implausible signal [verified]" VALUE 0x70B68 RL_VAL_UW 0 CM_0000 0 65535 /end CHARACTERISTIC
/begin CHARACTERISTIC K_ED_TAN_OBD_B1.DEC_NACH_EINTRAG "Fault code TAN_OBD_B1 - debounce filter decrement after fault-memory entry [verified]" VALUE 0x7138F RL_VAL_UB 0 CM_0000 0 255 /end CHARACTERISTIC
/begin CHARACTERISTIC K_ED_TAN_OBD_B1.DEC_VOR_EINTRAG "Fault code TAN_OBD_B1 - debounce filter decrement before fault-memory entry [verified]" VALUE 0x7138D RL_VAL_UB 0 CM_0000 0 255 /end CHARACTERISTIC
/begin CHARACTERISTIC K_ED_TAN_OBD_B1.FEHLERSCHWELLE "Fault code TAN_OBD_B1 - debounce filter threshold for setting the fault [verified]" VALUE 0x7138A RL_VAL_UB 0 CM_0000 0 255 /end CHARACTERISTIC
/begin CHARACTERISTIC K_ED_TAN_OBD_B1.INC_NACH_EINTRAG "Fault code TAN_OBD_B1 - debounce filter increment after fault-memory entry [verified]" VALUE 0x7138E RL_VAL_UB 0 CM_0000 0 255 /end CHARACTERISTIC
/begin CHARACTERISTIC K_ED_TAN_OBD_B1.INC_VOR_EINTRAG "Fault code TAN_OBD_B1 - debounce filter increment before fault-memory entry [verified]" VALUE 0x7138C RL_VAL_UB 0 CM_0000 0 255 /end CHARACTERISTIC
/begin CHARACTERISTIC K_ED_TAN_OBD_B1.KLASSENINDEX "Fault code TAN_OBD_B1 - fault class selection (lamp / warning behaviour) [verified]" VALUE 0x71390 RL_VAL_UB 0 CM_0000 0 255 /end CHARACTERISTIC
/begin CHARACTERISTIC K_ED_TAN_OBD_B1.OK_SCHWELLE "Fault code TAN_OBD_B1 - debounce filter threshold for clearing (healing) the fault [verified]" VALUE 0x7138B RL_VAL_UB 0 CM_0000 0 255 /end CHARACTERISTIC
/begin CHARACTERISTIC K_ED_TAN_OBD_B1.P_CODE_OPENLOAD "Fault code TAN_OBD_B1 - OBD P-code reported for open circuit [verified]" VALUE 0x71386 RL_VAL_UW 0 CM_0000 0 65535 /end CHARACTERISTIC
/begin CHARACTERISTIC K_ED_TAN_OBD_B1.P_CODE_SH_TO_GND "Fault code TAN_OBD_B1 - OBD P-code reported for short to ground [verified]" VALUE 0x71384 RL_VAL_UW 0 CM_0000 0 65535 /end CHARACTERISTIC
/begin CHARACTERISTIC K_ED_TAN_OBD_B1.P_CODE_SH_TO_UB "Fault code TAN_OBD_B1 - OBD P-code reported for short to battery voltage [verified]" VALUE 0x71382 RL_VAL_UW 0 CM_0000 0 65535 /end CHARACTERISTIC
/begin CHARACTERISTIC K_ED_TAN_OBD_B1.P_CODE_UNPLAUSIBEL "Fault code TAN_OBD_B1 - OBD P-code reported for implausible signal [verified]" VALUE 0x71388 RL_VAL_UW 0 CM_0000 0 65535 /end CHARACTERISTIC
/begin CHARACTERISTIC K_ED_TAN_OBD_B2.DEC_NACH_EINTRAG "Fault code TAN_OBD_B2 - debounce filter decrement after fault-memory entry [verified]" VALUE 0x714FB RL_VAL_UB 0 CM_0000 0 255 /end CHARACTERISTIC
/begin CHARACTERISTIC K_ED_TAN_OBD_B2.DEC_VOR_EINTRAG "Fault code TAN_OBD_B2 - debounce filter decrement before fault-memory entry [verified]" VALUE 0x714F9 RL_VAL_UB 0 CM_0000 0 255 /end CHARACTERISTIC
/begin CHARACTERISTIC K_ED_TAN_OBD_B2.FEHLERSCHWELLE "Fault code TAN_OBD_B2 - debounce filter threshold for setting the fault [verified]" VALUE 0x714F6 RL_VAL_UB 0 CM_0000 0 255 /end CHARACTERISTIC
/begin CHARACTERISTIC K_ED_TAN_OBD_B2.INC_NACH_EINTRAG "Fault code TAN_OBD_B2 - debounce filter increment after fault-memory entry [verified]" VALUE 0x714FA RL_VAL_UB 0 CM_0000 0 255 /end CHARACTERISTIC
/begin CHARACTERISTIC K_ED_TAN_OBD_B2.INC_VOR_EINTRAG "Fault code TAN_OBD_B2 - debounce filter increment before fault-memory entry [verified]" VALUE 0x714F8 RL_VAL_UB 0 CM_0000 0 255 /end CHARACTERISTIC
/begin CHARACTERISTIC K_ED_TAN_OBD_B2.KLASSENINDEX "Fault code TAN_OBD_B2 - fault class selection (lamp / warning behaviour) [verified]" VALUE 0x714FC RL_VAL_UB 0 CM_0000 0 255 /end CHARACTERISTIC
/begin CHARACTERISTIC K_ED_TAN_OBD_B2.OK_SCHWELLE "Fault code TAN_OBD_B2 - debounce filter threshold for clearing (healing) the fault [verified]" VALUE 0x714F7 RL_VAL_UB 0 CM_0000 0 255 /end CHARACTERISTIC
/begin CHARACTERISTIC K_ED_TAN_OBD_B2.P_CODE_OPENLOAD "Fault code TAN_OBD_B2 - OBD P-code reported for open circuit [verified]" VALUE 0x714F2 RL_VAL_UW 0 CM_0000 0 65535 /end CHARACTERISTIC
/begin CHARACTERISTIC K_ED_TAN_OBD_B2.P_CODE_SH_TO_GND "Fault code TAN_OBD_B2 - OBD P-code reported for short to ground [verified]" VALUE 0x714F0 RL_VAL_UW 0 CM_0000 0 65535 /end CHARACTERISTIC
/begin CHARACTERISTIC K_ED_TAN_OBD_B2.P_CODE_SH_TO_UB "Fault code TAN_OBD_B2 - OBD P-code reported for short to battery voltage [verified]" VALUE 0x714EE RL_VAL_UW 0 CM_0000 0 65535 /end CHARACTERISTIC
/begin CHARACTERISTIC K_ED_TAN_OBD_B2.P_CODE_UNPLAUSIBEL "Fault code TAN_OBD_B2 - OBD P-code reported for implausible signal [verified]" VALUE 0x714F4 RL_VAL_UW 0 CM_0000 0 65535 /end CHARACTERISTIC
/begin CHARACTERISTIC K_ED_TDME.DEC_NACH_EINTRAG "Fault code TDME - debounce filter decrement after fault-memory entry [verified]" VALUE 0x70BD7 RL_VAL_UB 0 CM_0000 0 255 /end CHARACTERISTIC
/begin CHARACTERISTIC K_ED_TDME.DEC_VOR_EINTRAG "Fault code TDME - debounce filter decrement before fault-memory entry [verified]" VALUE 0x70BD5 RL_VAL_UB 0 CM_0000 0 255 /end CHARACTERISTIC
/begin CHARACTERISTIC K_ED_TDME.FEHLERSCHWELLE "Fault code TDME - debounce filter threshold for setting the fault [verified]" VALUE 0x70BD2 RL_VAL_UB 0 CM_0000 0 255 /end CHARACTERISTIC
/begin CHARACTERISTIC K_ED_TDME.INC_NACH_EINTRAG "Fault code TDME - debounce filter increment after fault-memory entry [verified]" VALUE 0x70BD6 RL_VAL_UB 0 CM_0000 0 255 /end CHARACTERISTIC
/begin CHARACTERISTIC K_ED_TDME.INC_VOR_EINTRAG "Fault code TDME - debounce filter increment before fault-memory entry [verified]" VALUE 0x70BD4 RL_VAL_UB 0 CM_0000 0 255 /end CHARACTERISTIC
/begin CHARACTERISTIC K_ED_TDME.KLASSENINDEX "Fault code TDME - fault class selection (lamp / warning behaviour) [verified]" VALUE 0x70BD8 RL_VAL_UB 0 CM_0000 0 255 /end CHARACTERISTIC
/begin CHARACTERISTIC K_ED_TDME.OK_SCHWELLE "Fault code TDME - debounce filter threshold for clearing (healing) the fault [verified]" VALUE 0x70BD3 RL_VAL_UB 0 CM_0000 0 255 /end CHARACTERISTIC
/begin CHARACTERISTIC K_ED_TDME.P_CODE_OPENLOAD "Fault code TDME - OBD P-code reported for open circuit [verified]" VALUE 0x70BCE RL_VAL_UW 0 CM_0000 0 65535 /end CHARACTERISTIC
/begin CHARACTERISTIC K_ED_TDME.P_CODE_SH_TO_GND "Fault code TDME - OBD P-code reported for short to ground [verified]" VALUE 0x70BCC RL_VAL_UW 0 CM_0000 0 65535 /end CHARACTERISTIC
/begin CHARACTERISTIC K_ED_TDME.P_CODE_SH_TO_UB "Fault code TDME - OBD P-code reported for short to battery voltage [verified]" VALUE 0x70BCA RL_VAL_UW 0 CM_0000 0 65535 /end CHARACTERISTIC
/begin CHARACTERISTIC K_ED_TDME.P_CODE_UNPLAUSIBEL "Fault code TDME - OBD P-code reported for implausible signal [verified]" VALUE 0x70BD0 RL_VAL_UW 0 CM_0000 0 65535 /end CHARACTERISTIC
/begin CHARACTERISTIC K_ED_THERMOSTAT.DEC_NACH_EINTRAG "Fault code THERMOSTAT - debounce filter decrement after fault-memory entry [verified]" VALUE 0x714E1 RL_VAL_UB 0 CM_0000 0 255 /end CHARACTERISTIC
/begin COMPU_METHOD CM_0000 "X" RAT_FUNC "%.4g" "-" COEFFS 0 1 0 0 0 1 /end COMPU_METHOD
/begin COMPU_METHOD CM_0006 "X*0.1-273.2" RAT_FUNC "%.4g" "?C" COEFFS 0 1 273.2 0 0 0.1 /end COMPU_METHOD
/begin COMPU_METHOD CM_0010 "X*0.0625" RAT_FUNC "%.4g" "km/h" COEFFS 0 1 0 0 0 0.0625 /end COMPU_METHOD
/begin COMPU_METHOD CM_0016 "X*0.0009765625" RAT_FUNC "%.4g" "-" COEFFS 0 1 0 0 0 0.0009765625 /end COMPU_METHOD
/begin COMPU_METHOD CM_0022 "X*0.0625" RAT_FUNC "%.4g" "mbar" COEFFS 0 1 0 0 0 0.0625 /end COMPU_METHOD
/begin COMPU_METHOD CM_0023 "X*0.1" RAT_FUNC "%.4g" "s" COEFFS 0 1 0 0 0 0.1 /end COMPU_METHOD
/begin RECORD_LAYOUT RL_VAL_SW FNC_VALUES 1 SWORD COLUMN_DIR DIRECT /end RECORD_LAYOUT
/begin RECORD_LAYOUT RL_VAL_UB FNC_VALUES 1 UBYTE COLUMN_DIR DIRECT /end RECORD_LAYOUT
/begin RECORD_LAYOUT RL_VAL_UW FNC_VALUES 1 UWORD COLUMN_DIR DIRECT /end RECORD_LAYOUT
/begin GROUP G_y_Fault_paths__K_ED_ "y Fault paths (K_ED)" ROOT
 /begin REF_CHARACTERISTIC K_ED_DK1_WDK.FEHLERSCHWELLE K_ED_DK1_WDK.INC_NACH_EINTRAG K_ED_DK1_WDK.INC_VOR_EINTRAG K_ED_DK1_WDK.KLASSENINDEX K_ED_DK1_WDK.OK_SCHWELLE K_ED_DK1_WDK.P_CODE_OPENLOAD K_ED_DK1_WDK.P_CODE_SH_TO_GND K_ED_DK1_WDK.P_CODE_SH_TO_UB K_ED_DK1_WDK.P_CODE_UNPLAUSIBEL K_ED_DK1_ZUST.DEC_NACH_EINTRAG K_ED_DK1_ZUST.DEC_VOR_EINTRAG K_ED_DK1_ZUST.FEHLERSCHWELLE K_ED_DK1_ZUST.INC_NACH_EINTRAG K_ED_DK1_ZUST.INC_VOR_EINTRAG K_ED_DK1_ZUST.KLASSENINDEX K_ED_DK1_ZUST.OK_SCHWELLE K_ED_DK1_ZUST.P_CODE_OPENLOAD K_ED_DK1_ZUST.P_CODE_SH_TO_GND K_ED_DK1_ZUST.P_CODE_SH_TO_UB K_ED_DK1_ZUST.P_CODE_UNPLAUSIBEL K_ED_DK2_ADAPT.DEC_NACH_EINTRAG K_ED_DK2_ADAPT.DEC_VOR_EINTRAG K_ED_DK2_ADAPT.FEHLERSCHWELLE K_ED_DK2_ADAPT.INC_NACH_EINTRAG K_ED_DK2_ADAPT.INC_VOR_EINTRAG K_ED_DK2_ADAPT.KLASSENINDEX K_ED_DK2_ADAPT.OK_SCHWELLE K_ED_DK2_ADAPT.P_CODE_OPENLOAD K_ED_DK2_ADAPT.P_CODE_SH_TO_GND K_ED_DK2_ADAPT.P_CODE_SH_TO_UB K_ED_DK2_ADAPT.P_CODE_UNPLAUSIBEL K_ED_DK2_CAN.DEC_NACH_EINTRAG K_ED_DK2_CAN.DEC_VOR_EINTRAG K_ED_DK2_CAN.FEHLERSCHWELLE K_ED_DK2_CAN.INC_NACH_EINTRAG K_ED_DK2_CAN.INC_VOR_EINTRAG K_ED_DK2_CAN.KLASSENINDEX K_ED_DK2_CAN.OK_SCHWELLE K_ED_DK2_CAN.P_CODE_OPENLOAD K_ED_DK2_CAN.P_CODE_SH_TO_GND K_ED_DK2_CAN.P_CODE_SH_TO_UB K_ED_DK2_CAN.P_CODE_UNPLAUSIBEL K_ED_DK2_CMD.DEC_NACH_EINTRAG K_ED_DK2_CMD.DEC_VOR_EINTRAG K_ED_DK2_CMD.FEHLERSCHWELLE K_ED_DK2_CMD.INC_NACH_EINTRAG K_ED_DK2_CMD.INC_VOR_EINTRAG K_ED_DK2_CMD.KLASSENINDEX K_ED_DK2_CMD.OK_SCHWELLE K_ED_DK2_CMD.P_CODE_OPENLOAD K_ED_DK2_CMD.P_CODE_SH_TO_GND K_ED_DK2_CMD.P_CODE_SH_TO_UB K_ED_DK2_CMD.P_CODE_UNPLAUSIBEL K_ED_DK2_FEDERN.DEC_NACH_EINTRAG K_ED_DK2_FEDERN.DEC_VOR_EINTRAG K_ED_DK2_FEDERN.FEHLERSCHWELLE K_ED_DK2_FEDERN.INC_NACH_EINTRAG K_ED_DK2_FEDERN.INC_VOR_EINTRAG K_ED_DK2_FEDERN.KLASSENINDEX K_ED_DK2_FEDERN.OK_SCHWELLE K_ED_DK2_FEDERN.P_CODE_OPENLOAD K_ED_DK2_FEDERN.P_CODE_SH_TO_GND K_ED_DK2_FEDERN.P_CODE_SH_TO_UB K_ED_DK2_FEDERN.P_CODE_UNPLAUSIBEL K_ED_DK2_PDR.DEC_NACH_EINTRAG K_ED_DK2_PDR.DEC_VOR_EINTRAG K_ED_DK2_PDR.FEHLERSCHWELLE K_ED_DK2_PDR.INC_NACH_EINTRAG K_ED_DK2_PDR.INC_VOR_EINTRAG K_ED_DK2_PDR.KLASSENINDEX K_ED_DK2_PDR.OK_SCHWELLE K_ED_DK2_PDR.P_CODE_OPENLOAD K_ED_DK2_PDR.P_CODE_SH_TO_GND K_ED_DK2_PDR.P_CODE_SH_TO_UB K_ED_DK2_PDR.P_CODE_UNPLAUSIBEL K_ED_DK2_REGLER.DEC_NACH_EINTRAG K_ED_DK2_REGLER.DEC_VOR_EINTRAG K_ED_DK2_REGLER.FEHLERSCHWELLE K_ED_DK2_REGLER.INC_NACH_EINTRAG K_ED_DK2_REGLER.INC_VOR_EINTRAG K_ED_DK2_REGLER.KLASSENINDEX K_ED_DK2_REGLER.OK_SCHWELLE K_ED_DK2_REGLER.P_CODE_OPENLOAD K_ED_DK2_REGLER.P_CODE_SH_TO_GND K_ED_DK2_REGLER.P_CODE_SH_TO_UB K_ED_DK2_REGLER.P_CODE_UNPLAUSIBEL K_ED_DK2_SK_ERR.DEC_NACH_EINTRAG K_ED_DK2_SK_ERR.DEC_VOR_EINTRAG K_ED_DK2_SK_ERR.FEHLERSCHWELLE K_ED_DK2_SK_ERR.INC_NACH_EINTRAG K_ED_DK2_SK_ERR.INC_VOR_EINTRAG K_ED_DK2_SK_ERR.KLASSENINDEX K_ED_DK2_SK_ERR.OK_SCHWELLE K_ED_DK2_SK_ERR.P_CODE_OPENLOAD K_ED_DK2_SK_ERR.P_CODE_SH_TO_GND K_ED_DK2_SK_ERR.P_CODE_SH_TO_UB K_ED_DK2_SK_ERR.P_CODE_UNPLAUSIBEL K_ED_DK2_WDK.DEC_NACH_EINTRAG K_ED_DK2_WDK.DEC_VOR_EINTRAG K_ED_DK2_WDK.FEHLERSCHWELLE K_ED_DK2_WDK.INC_NACH_EINTRAG K_ED_DK2_WDK.INC_VOR_EINTRAG K_ED_DK2_WDK.KLASSENINDEX K_ED_DK2_WDK.OK_SCHWELLE K_ED_DK2_WDK.P_CODE_OPENLOAD K_ED_DK2_WDK.P_CODE_SH_TO_GND K_ED_DK2_WDK.P_CODE_SH_TO_UB K_ED_DK2_WDK.P_CODE_UNPLAUSIBEL K_ED_DK2_ZUST.DEC_NACH_EINTRAG K_ED_DK2_ZUST.DEC_VOR_EINTRAG K_ED_DK2_ZUST.FEHLERSCHWELLE K_ED_DK2_ZUST.INC_NACH_EINTRAG K_ED_DK2_ZUST.INC_VOR_EINTRAG K_ED_DK2_ZUST.KLASSENINDEX K_ED_DK2_ZUST.OK_SCHWELLE K_ED_DK2_ZUST.P_CODE_OPENLOAD K_ED_DK2_ZUST.P_CODE_SH_TO_GND K_ED_DK2_ZUST.P_CODE_SH_TO_UB K_ED_DK2_ZUST.P_CODE_UNPLAUSIBEL K_ED_DKG_EINGR.DEC_NACH_EINTRAG K_ED_DKG_EINGR.DEC_VOR_EINTRAG K_ED_DKG_EINGR.FEHLERSCHWELLE K_ED_DKG_EINGR.INC_NACH_EINTRAG K_ED_DKG_EINGR.INC_VOR_EINTRAG K_ED_DKG_EINGR.KLASSENINDEX K_ED_DKG_EINGR.OK_SCHWELLE K_ED_DKG_EINGR.P_CODE_OPENLOAD K_ED_DKG_EINGR.P_CODE_SH_TO_GND K_ED_DKG_EINGR.P_CODE_SH_TO_UB K_ED_DKG_EINGR.P_CODE_UNPLAUSIBEL K_ED_DK_INIT.DEC_NACH_EINTRAG K_ED_DK_INIT.DEC_VOR_EINTRAG K_ED_DK_INIT.FEHLERSCHWELLE K_ED_DK_INIT.INC_NACH_EINTRAG K_ED_DK_INIT.INC_VOR_EINTRAG K_ED_DK_INIT.KLASSENINDEX K_ED_DK_INIT.OK_SCHWELLE K_ED_DK_INIT.P_CODE_OPENLOAD K_ED_DK_INIT.P_CODE_SH_TO_GND K_ED_DK_INIT.P_CODE_SH_TO_UB K_ED_DK_INIT.P_CODE_UNPLAUSIBEL K_ED_DSC_EINGR.DEC_NACH_EINTRAG K_ED_DSC_EINGR.DEC_VOR_EINTRAG K_ED_DSC_EINGR.FEHLERSCHWELLE K_ED_DSC_EINGR.INC_NACH_EINTRAG K_ED_DSC_EINGR.INC_VOR_EINTRAG K_ED_DSC_EINGR.KLASSENINDEX K_ED_DSC_EINGR.OK_SCHWELLE K_ED_DSC_EINGR.P_CODE_OPENLOAD K_ED_DSC_EINGR.P_CODE_SH_TO_GND K_ED_DSC_EINGR.P_CODE_SH_TO_UB K_ED_DSC_EINGR.P_CODE_UNPLAUSIBEL K_ED_E2_IGN.DEC_NACH_EINTRAG K_ED_E2_IGN.DEC_VOR_EINTRAG K_ED_E2_IGN.FEHLERSCHWELLE K_ED_E2_IGN.INC_NACH_EINTRAG K_ED_E2_IGN.INC_VOR_EINTRAG K_ED_E2_IGN.KLASSENINDEX K_ED_E2_IGN.OK_SCHWELLE K_ED_E2_IGN.P_CODE_OPENLOAD K_ED_E2_IGN.P_CODE_SH_TO_GND K_ED_E2_IGN.P_CODE_SH_TO_UB K_ED_E2_IGN.P_CODE_UNPLAUSIBEL K_ED_EC_BUSOFF.DEC_NACH_EINTRAG K_ED_EC_BUSOFF.DEC_VOR_EINTRAG K_ED_EC_BUSOFF.FEHLERSCHWELLE K_ED_EC_BUSOFF.INC_NACH_EINTRAG K_ED_EC_BUSOFF.INC_VOR_EINTRAG K_ED_EC_BUSOFF.KLASSENINDEX K_ED_EC_BUSOFF.OK_SCHWELLE K_ED_EC_BUSOFF.P_CODE_OPENLOAD K_ED_EC_BUSOFF.P_CODE_SH_TO_GND K_ED_EC_BUSOFF.P_CODE_SH_TO_UB K_ED_EC_BUSOFF.P_CODE_UNPLAUSIBEL K_ED_FGR_ABWURF.DEC_NACH_EINTRAG K_ED_FGR_ABWURF.DEC_VOR_EINTRAG K_ED_FGR_ABWURF.FEHLERSCHWELLE K_ED_FGR_ABWURF.INC_NACH_EINTRAG K_ED_FGR_ABWURF.INC_VOR_EINTRAG K_ED_FGR_ABWURF.KLASSENINDEX K_ED_FGR_ABWURF.OK_SCHWELLE K_ED_FGR_ABWURF.P_CODE_OPENLOAD K_ED_FGR_ABWURF.P_CODE_SH_TO_GND K_ED_FGR_ABWURF.P_CODE_SH_TO_UB K_ED_FGR_ABWURF.P_CODE_UNPLAUSIBEL K_ED_INDEX_121_IGN.DEC_NACH_EINTRAG K_ED_INDEX_121_IGN.DEC_VOR_EINTRAG K_ED_INDEX_121_IGN.FEHLERSCHWELLE K_ED_INDEX_121_IGN.INC_NACH_EINTRAG K_ED_INDEX_121_IGN.INC_VOR_EINTRAG K_ED_INDEX_121_IGN.KLASSENINDEX K_ED_INDEX_121_IGN.OK_SCHWELLE K_ED_INDEX_121_IGN.P_CODE_OPENLOAD K_ED_INDEX_121_IGN.P_CODE_SH_TO_GND K_ED_INDEX_121_IGN.P_CODE_SH_TO_UB K_ED_INDEX_121_IGN.P_CODE_UNPLAUSIBEL K_ED_INDEX_122_IGN.DEC_NACH_EINTRAG K_ED_INDEX_122_IGN.DEC_VOR_EINTRAG K_ED_INDEX_122_IGN.FEHLERSCHWELLE K_ED_INDEX_122_IGN.INC_NACH_EINTRAG K_ED_INDEX_122_IGN.INC_VOR_EINTRAG K_ED_INDEX_122_IGN.KLASSENINDEX K_ED_INDEX_122_IGN.OK_SCHWELLE K_ED_INDEX_122_IGN.P_CODE_OPENLOAD K_ED_INDEX_122_IGN.P_CODE_SH_TO_GND K_ED_INDEX_122_IGN.P_CODE_SH_TO_UB K_ED_INDEX_122_IGN.P_CODE_UNPLAUSIBEL K_ED_INDEX_123_IGN.DEC_NACH_EINTRAG K_ED_INDEX_123_IGN.DEC_VOR_EINTRAG K_ED_INDEX_123_IGN.FEHLERSCHWELLE K_ED_INDEX_123_IGN.INC_NACH_EINTRAG K_ED_INDEX_123_IGN.INC_VOR_EINTRAG K_ED_INDEX_123_IGN.KLASSENINDEX K_ED_INDEX_123_IGN.OK_SCHWELLE K_ED_INDEX_123_IGN.P_CODE_OPENLOAD K_ED_INDEX_123_IGN.P_CODE_SH_TO_GND K_ED_INDEX_123_IGN.P_CODE_SH_TO_UB K_ED_INDEX_123_IGN.P_CODE_UNPLAUSIBEL K_ED_INDEX_124_IGN.DEC_NACH_EINTRAG K_ED_INDEX_124_IGN.DEC_VOR_EINTRAG K_ED_INDEX_124_IGN.FEHLERSCHWELLE K_ED_INDEX_124_IGN.INC_NACH_EINTRAG K_ED_INDEX_124_IGN.INC_VOR_EINTRAG K_ED_INDEX_124_IGN.KLASSENINDEX K_ED_INDEX_124_IGN.OK_SCHWELLE K_ED_INDEX_124_IGN.P_CODE_OPENLOAD K_ED_INDEX_124_IGN.P_CODE_SH_TO_GND K_ED_INDEX_124_IGN.P_CODE_SH_TO_UB K_ED_INDEX_124_IGN.P_CODE_UNPLAUSIBEL K_ED_INDEX_125_IGN.DEC_NACH_EINTRAG K_ED_INDEX_125_IGN.DEC_VOR_EINTRAG K_ED_INDEX_125_IGN.FEHLERSCHWELLE K_ED_INDEX_125_IGN.INC_NACH_EINTRAG K_ED_INDEX_125_IGN.INC_VOR_EINTRAG K_ED_INDEX_125_IGN.KLASSENINDEX K_ED_INDEX_125_IGN.OK_SCHWELLE K_ED_INDEX_125_IGN.P_CODE_OPENLOAD K_ED_INDEX_125_IGN.P_CODE_SH_TO_GND K_ED_INDEX_125_IGN.P_CODE_SH_TO_UB K_ED_INDEX_125_IGN.P_CODE_UNPLAUSIBEL K_ED_INDEX_126_IGN.DEC_NACH_EINTRAG K_ED_INDEX_126_IGN.DEC_VOR_EINTRAG K_ED_INDEX_126_IGN.FEHLERSCHWELLE K_ED_INDEX_126_IGN.INC_NACH_EINTRAG K_ED_INDEX_126_IGN.INC_VOR_EINTRAG K_ED_INDEX_126_IGN.KLASSENINDEX K_ED_INDEX_126_IGN.OK_SCHWELLE K_ED_INDEX_126_IGN.P_CODE_OPENLOAD K_ED_INDEX_126_IGN.P_CODE_SH_TO_GND K_ED_INDEX_126_IGN.P_CODE_SH_TO_UB K_ED_INDEX_126_IGN.P_CODE_UNPLAUSIBEL K_ED_INDEX_127_IGN.DEC_NACH_EINTRAG K_ED_INDEX_127_IGN.DEC_VOR_EINTRAG K_ED_INDEX_127_IGN.FEHLERSCHWELLE K_ED_INDEX_127_IGN.INC_NACH_EINTRAG K_ED_INDEX_127_IGN.INC_VOR_EINTRAG K_ED_INDEX_127_IGN.KLASSENINDEX K_ED_INDEX_127_IGN.OK_SCHWELLE K_ED_INDEX_127_IGN.P_CODE_OPENLOAD K_ED_INDEX_127_IGN.P_CODE_SH_TO_GND K_ED_INDEX_127_IGN.P_CODE_SH_TO_UB K_ED_INDEX_127_IGN.P_CODE_UNPLAUSIBEL K_ED_INDEX_33_IGN.DEC_NACH_EINTRAG K_ED_INDEX_33_IGN.DEC_VOR_EINTRAG K_ED_INDEX_33_IGN.FEHLERSCHWELLE K_ED_INDEX_33_IGN.INC_NACH_EINTRAG K_ED_INDEX_33_IGN.INC_VOR_EINTRAG K_ED_INDEX_33_IGN.KLASSENINDEX K_ED_INDEX_33_IGN.OK_SCHWELLE K_ED_INDEX_33_IGN.P_CODE_OPENLOAD K_ED_INDEX_33_IGN.P_CODE_SH_TO_GND K_ED_INDEX_33_IGN.P_CODE_SH_TO_UB K_ED_INDEX_33_IGN.P_CODE_UNPLAUSIBEL K_ED_INDEX_34_IGN.DEC_NACH_EINTRAG K_ED_INDEX_34_IGN.DEC_VOR_EINTRAG K_ED_INDEX_34_IGN.FEHLERSCHWELLE K_ED_INDEX_34_IGN.INC_NACH_EINTRAG K_ED_INDEX_34_IGN.INC_VOR_EINTRAG K_ED_INDEX_34_IGN.KLASSENINDEX K_ED_INDEX_34_IGN.OK_SCHWELLE K_ED_INDEX_34_IGN.P_CODE_OPENLOAD K_ED_INDEX_34_IGN.P_CODE_SH_TO_GND K_ED_INDEX_34_IGN.P_CODE_SH_TO_UB K_ED_INDEX_34_IGN.P_CODE_UNPLAUSIBEL K_ED_INDEX_35_IGN.DEC_NACH_EINTRAG K_ED_INDEX_35_IGN.DEC_VOR_EINTRAG K_ED_INDEX_35_IGN.FEHLERSCHWELLE K_ED_INDEX_35_IGN.INC_NACH_EINTRAG K_ED_INDEX_35_IGN.INC_VOR_EINTRAG K_ED_INDEX_35_IGN.KLASSENINDEX K_ED_INDEX_35_IGN.OK_SCHWELLE K_ED_INDEX_35_IGN.P_CODE_OPENLOAD K_ED_INDEX_35_IGN.P_CODE_SH_TO_GND K_ED_INDEX_35_IGN.P_CODE_SH_TO_UB K_ED_INDEX_35_IGN.P_CODE_UNPLAUSIBEL K_ED_INDEX_36_IGN.DEC_NACH_EINTRAG K_ED_INDEX_36_IGN.DEC_VOR_EINTRAG K_ED_INDEX_36_IGN.FEHLERSCHWELLE K_ED_INDEX_36_IGN.INC_NACH_EINTRAG K_ED_INDEX_36_IGN.INC_VOR_EINTRAG K_ED_INDEX_36_IGN.KLASSENINDEX K_ED_INDEX_36_IGN.OK_SCHWELLE K_ED_INDEX_36_IGN.P_CODE_OPENLOAD K_ED_INDEX_36_IGN.P_CODE_SH_TO_GND K_ED_INDEX_36_IGN.P_CODE_SH_TO_UB K_ED_INDEX_36_IGN.P_CODE_UNPLAUSIBEL K_ED_INDEX_71_IGN.DEC_NACH_EINTRAG K_ED_INDEX_71_IGN.DEC_VOR_EINTRAG K_ED_INDEX_71_IGN.FEHLERSCHWELLE K_ED_INDEX_71_IGN.INC_NACH_EINTRAG K_ED_INDEX_71_IGN.INC_VOR_EINTRAG K_ED_INDEX_71_IGN.KLASSENINDEX K_ED_INDEX_71_IGN.OK_SCHWELLE K_ED_INDEX_71_IGN.P_CODE_OPENLOAD K_ED_INDEX_71_IGN.P_CODE_SH_TO_GND K_ED_INDEX_71_IGN.P_CODE_SH_TO_UB K_ED_INDEX_71_IGN.P_CODE_UNPLAUSIBEL K_ED_INDEX_72_IGN.DEC_NACH_EINTRAG K_ED_INDEX_72_IGN.DEC_VOR_EINTRAG K_ED_INDEX_72_IGN.FEHLERSCHWELLE K_ED_INDEX_72_IGN.INC_NACH_EINTRAG K_ED_INDEX_72_IGN.INC_VOR_EINTRAG K_ED_INDEX_72_IGN.KLASSENINDEX K_ED_INDEX_72_IGN.OK_SCHWELLE K_ED_INDEX_72_IGN.P_CODE_OPENLOAD K_ED_INDEX_72_IGN.P_CODE_SH_TO_GND K_ED_INDEX_72_IGN.P_CODE_SH_TO_UB K_ED_INDEX_72_IGN.P_CODE_UNPLAUSIBEL K_ED_LLR_DIAG.DEC_NACH_EINTRAG K_ED_LLR_DIAG.DEC_VOR_EINTRAG K_ED_LLR_DIAG.FEHLERSCHWELLE K_ED_LLR_DIAG.INC_NACH_EINTRAG K_ED_LLR_DIAG.INC_VOR_EINTRAG K_ED_LLR_DIAG.KLASSENINDEX K_ED_LLR_DIAG.OK_SCHWELLE K_ED_LLR_DIAG.P_CODE_OPENLOAD K_ED_LLR_DIAG.P_CODE_SH_TO_GND K_ED_LLR_DIAG.P_CODE_SH_TO_UB K_ED_LLR_DIAG.P_CODE_UNPLAUSIBEL K_ED_LLR_DIAG_CSS.DEC_NACH_EINTRAG K_ED_LLR_DIAG_CSS.DEC_VOR_EINTRAG K_ED_LLR_DIAG_CSS.FEHLERSCHWELLE K_ED_LLR_DIAG_CSS.INC_NACH_EINTRAG K_ED_LLR_DIAG_CSS.INC_VOR_EINTRAG K_ED_LLR_DIAG_CSS.KLASSENINDEX K_ED_LLR_DIAG_CSS.OK_SCHWELLE K_ED_LLR_DIAG_CSS.P_CODE_OPENLOAD K_ED_LLR_DIAG_CSS.P_CODE_SH_TO_GND K_ED_LLR_DIAG_CSS.P_CODE_SH_TO_UB K_ED_LLR_DIAG_CSS.P_CODE_UNPLAUSIBEL K_ED_LLS1_CAN.DEC_NACH_EINTRAG K_ED_LLS1_CAN.DEC_VOR_EINTRAG K_ED_LLS1_CAN.FEHLERSCHWELLE K_ED_LLS1_CAN.INC_NACH_EINTRAG K_ED_LLS1_CAN.INC_VOR_EINTRAG K_ED_LLS1_CAN.KLASSENINDEX K_ED_LLS1_CAN.OK_SCHWELLE K_ED_LLS1_CAN.P_CODE_OPENLOAD K_ED_LLS1_CAN.P_CODE_SH_TO_GND K_ED_LLS1_CAN.P_CODE_SH_TO_UB K_ED_LLS1_CAN.P_CODE_UNPLAUSIBEL K_ED_LLS1_CMD.DEC_NACH_EINTRAG K_ED_LLS1_CMD.DEC_VOR_EINTRAG K_ED_LLS1_CMD.FEHLERSCHWELLE K_ED_LLS1_CMD.INC_NACH_EINTRAG K_ED_LLS1_CMD.INC_VOR_EINTRAG K_ED_LLS1_CMD.KLASSENINDEX K_ED_LLS1_CMD.OK_SCHWELLE K_ED_LLS1_CMD.P_CODE_OPENLOAD K_ED_LLS1_CMD.P_CODE_SH_TO_GND K_ED_LLS1_CMD.P_CODE_SH_TO_UB K_ED_LLS1_CMD.P_CODE_UNPLAUSIBEL K_ED_LLS1_REGLER.DEC_NACH_EINTRAG K_ED_LLS1_REGLER.DEC_VOR_EINTRAG K_ED_LLS1_REGLER.FEHLERSCHWELLE K_ED_LLS1_REGLER.INC_NACH_EINTRAG K_ED_LLS1_REGLER.INC_VOR_EINTRAG K_ED_LLS1_REGLER.KLASSENINDEX K_ED_LLS1_REGLER.OK_SCHWELLE K_ED_LLS1_REGLER.P_CODE_OPENLOAD K_ED_LLS1_REGLER.P_CODE_SH_TO_GND K_ED_LLS1_REGLER.P_CODE_SH_TO_UB K_ED_LLS1_REGLER.P_CODE_UNPLAUSIBEL K_ED_LLS1_SK.DEC_NACH_EINTRAG K_ED_LLS1_SK.DEC_VOR_EINTRAG K_ED_LLS1_SK.FEHLERSCHWELLE K_ED_LLS1_SK.INC_NACH_EINTRAG K_ED_LLS1_SK.INC_VOR_EINTRAG K_ED_LLS1_SK.KLASSENINDEX K_ED_LLS1_SK.OK_SCHWELLE K_ED_LLS1_SK.P_CODE_OPENLOAD K_ED_LLS1_SK.P_CODE_SH_TO_GND K_ED_LLS1_SK.P_CODE_SH_TO_UB K_ED_LLS1_SK.P_CODE_UNPLAUSIBEL K_ED_LLS2_CAN.DEC_NACH_EINTRAG K_ED_LLS2_CAN.DEC_VOR_EINTRAG K_ED_LLS2_CAN.FEHLERSCHWELLE K_ED_LLS2_CAN.INC_NACH_EINTRAG K_ED_LLS2_CAN.INC_VOR_EINTRAG K_ED_LLS2_CAN.KLASSENINDEX K_ED_LLS2_CAN.OK_SCHWELLE K_ED_LLS2_CAN.P_CODE_OPENLOAD K_ED_LLS2_CAN.P_CODE_SH_TO_GND K_ED_LLS2_CAN.P_CODE_SH_TO_UB K_ED_LLS2_CAN.P_CODE_UNPLAUSIBEL K_ED_LLS2_CMD.DEC_NACH_EINTRAG K_ED_LLS2_CMD.DEC_VOR_EINTRAG K_ED_LLS2_CMD.FEHLERSCHWELLE K_ED_LLS2_CMD.INC_NACH_EINTRAG K_ED_LLS2_CMD.INC_VOR_EINTRAG K_ED_LLS2_CMD.KLASSENINDEX K_ED_LLS2_CMD.OK_SCHWELLE K_ED_LLS2_CMD.P_CODE_OPENLOAD K_ED_LLS2_CMD.P_CODE_SH_TO_GND K_ED_LLS2_CMD.P_CODE_SH_TO_UB K_ED_LLS2_CMD.P_CODE_UNPLAUSIBEL K_ED_LLS2_REGLER.DEC_NACH_EINTRAG K_ED_LLS2_REGLER.DEC_VOR_EINTRAG K_ED_LLS2_REGLER.FEHLERSCHWELLE K_ED_LLS2_REGLER.INC_NACH_EINTRAG K_ED_LLS2_REGLER.INC_VOR_EINTRAG K_ED_LLS2_REGLER.KLASSENINDEX K_ED_LLS2_REGLER.OK_SCHWELLE K_ED_LLS2_REGLER.P_CODE_OPENLOAD K_ED_LLS2_REGLER.P_CODE_SH_TO_GND K_ED_LLS2_REGLER.P_CODE_SH_TO_UB K_ED_LLS2_REGLER.P_CODE_UNPLAUSIBEL K_ED_LLS2_SK.DEC_NACH_EINTRAG K_ED_LLS2_SK.DEC_VOR_EINTRAG K_ED_LLS2_SK.FEHLERSCHWELLE K_ED_LLS2_SK.INC_NACH_EINTRAG K_ED_LLS2_SK.INC_VOR_EINTRAG K_ED_LLS2_SK.KLASSENINDEX K_ED_LLS2_SK.OK_SCHWELLE K_ED_LLS2_SK.P_CODE_OPENLOAD K_ED_LLS2_SK.P_CODE_SH_TO_GND K_ED_LLS2_SK.P_CODE_SH_TO_UB K_ED_LLS2_SK.P_CODE_UNPLAUSIBEL K_ED_LLS_INIT.DEC_NACH_EINTRAG K_ED_LLS_INIT.DEC_VOR_EINTRAG K_ED_LLS_INIT.FEHLERSCHWELLE K_ED_LLS_INIT.INC_NACH_EINTRAG K_ED_LLS_INIT.INC_VOR_EINTRAG K_ED_LLS_INIT.KLASSENINDEX K_ED_LLS_INIT.OK_SCHWELLE K_ED_LLS_INIT.P_CODE_OPENLOAD K_ED_LLS_INIT.P_CODE_SH_TO_GND K_ED_LLS_INIT.P_CODE_SH_TO_UB K_ED_LLS_INIT.P_CODE_UNPLAUSIBEL K_ED_MD_SK_ERR.DEC_NACH_EINTRAG K_ED_MD_SK_ERR.DEC_VOR_EINTRAG K_ED_MD_SK_ERR.FEHLERSCHWELLE K_ED_MD_SK_ERR.INC_NACH_EINTRAG K_ED_MD_SK_ERR.INC_VOR_EINTRAG K_ED_MD_SK_ERR.KLASSENINDEX K_ED_MD_SK_ERR.OK_SCHWELLE K_ED_MD_SK_ERR.P_CODE_OPENLOAD K_ED_MD_SK_ERR.P_CODE_SH_TO_GND K_ED_MD_SK_ERR.P_CODE_SH_TO_UB K_ED_MD_SK_ERR.P_CODE_UNPLAUSIBEL K_ED_M_SPULE_Z1.DEC_NACH_EINTRAG K_ED_M_SPULE_Z1.DEC_VOR_EINTRAG K_ED_M_SPULE_Z1.FEHLERSCHWELLE K_ED_M_SPULE_Z1.INC_NACH_EINTRAG K_ED_M_SPULE_Z1.INC_VOR_EINTRAG K_ED_M_SPULE_Z1.KLASSENINDEX K_ED_M_SPULE_Z1.OK_SCHWELLE K_ED_M_SPULE_Z1.P_CODE_OPENLOAD K_ED_M_SPULE_Z1.P_CODE_SH_TO_GND K_ED_M_SPULE_Z1.P_CODE_SH_TO_UB K_ED_M_SPULE_Z1.P_CODE_UNPLAUSIBEL K_ED_M_SPULE_Z10.DEC_NACH_EINTRAG K_ED_M_SPULE_Z10.DEC_VOR_EINTRAG K_ED_M_SPULE_Z10.FEHLERSCHWELLE K_ED_M_SPULE_Z10.INC_NACH_EINTRAG K_ED_M_SPULE_Z10.INC_VOR_EINTRAG K_ED_M_SPULE_Z10.KLASSENINDEX K_ED_M_SPULE_Z10.OK_SCHWELLE K_ED_M_SPULE_Z10.P_CODE_OPENLOAD K_ED_M_SPULE_Z10.P_CODE_SH_TO_GND K_ED_M_SPULE_Z10.P_CODE_SH_TO_UB K_ED_M_SPULE_Z10.P_CODE_UNPLAUSIBEL K_ED_M_SPULE_Z2.DEC_NACH_EINTRAG K_ED_M_SPULE_Z2.DEC_VOR_EINTRAG K_ED_M_SPULE_Z2.FEHLERSCHWELLE K_ED_M_SPULE_Z2.INC_NACH_EINTRAG K_ED_M_SPULE_Z2.INC_VOR_EINTRAG K_ED_M_SPULE_Z2.KLASSENINDEX K_ED_M_SPULE_Z2.OK_SCHWELLE K_ED_M_SPULE_Z2.P_CODE_OPENLOAD K_ED_M_SPULE_Z2.P_CODE_SH_TO_GND K_ED_M_SPULE_Z2.P_CODE_SH_TO_UB K_ED_M_SPULE_Z2.P_CODE_UNPLAUSIBEL K_ED_M_SPULE_Z3.DEC_NACH_EINTRAG K_ED_M_SPULE_Z3.DEC_VOR_EINTRAG K_ED_M_SPULE_Z3.FEHLERSCHWELLE K_ED_M_SPULE_Z3.INC_NACH_EINTRAG K_ED_M_SPULE_Z3.INC_VOR_EINTRAG K_ED_M_SPULE_Z3.KLASSENINDEX K_ED_M_SPULE_Z3.OK_SCHWELLE K_ED_M_SPULE_Z3.P_CODE_OPENLOAD K_ED_M_SPULE_Z3.P_CODE_SH_TO_GND K_ED_M_SPULE_Z3.P_CODE_SH_TO_UB K_ED_M_SPULE_Z3.P_CODE_UNPLAUSIBEL K_ED_M_SPULE_Z4.DEC_NACH_EINTRAG K_ED_M_SPULE_Z4.DEC_VOR_EINTRAG K_ED_M_SPULE_Z4.FEHLERSCHWELLE K_ED_M_SPULE_Z4.INC_NACH_EINTRAG K_ED_M_SPULE_Z4.INC_VOR_EINTRAG K_ED_M_SPULE_Z4.KLASSENINDEX K_ED_M_SPULE_Z4.OK_SCHWELLE K_ED_M_SPULE_Z4.P_CODE_OPENLOAD K_ED_M_SPULE_Z4.P_CODE_SH_TO_GND K_ED_M_SPULE_Z4.P_CODE_SH_TO_UB K_ED_M_SPULE_Z4.P_CODE_UNPLAUSIBEL K_ED_M_SPULE_Z5.DEC_NACH_EINTRAG K_ED_M_SPULE_Z5.DEC_VOR_EINTRAG K_ED_M_SPULE_Z5.FEHLERSCHWELLE K_ED_M_SPULE_Z5.INC_NACH_EINTRAG K_ED_M_SPULE_Z5.INC_VOR_EINTRAG K_ED_M_SPULE_Z5.KLASSENINDEX K_ED_M_SPULE_Z5.OK_SCHWELLE K_ED_M_SPULE_Z5.P_CODE_OPENLOAD K_ED_M_SPULE_Z5.P_CODE_SH_TO_GND K_ED_M_SPULE_Z5.P_CODE_SH_TO_UB K_ED_M_SPULE_Z5.P_CODE_UNPLAUSIBEL K_ED_M_SPULE_Z6.DEC_NACH_EINTRAG K_ED_M_SPULE_Z6.DEC_VOR_EINTRAG K_ED_M_SPULE_Z6.FEHLERSCHWELLE K_ED_M_SPULE_Z6.INC_NACH_EINTRAG K_ED_M_SPULE_Z6.INC_VOR_EINTRAG K_ED_M_SPULE_Z6.KLASSENINDEX K_ED_M_SPULE_Z6.OK_SCHWELLE K_ED_M_SPULE_Z6.P_CODE_OPENLOAD K_ED_M_SPULE_Z6.P_CODE_SH_TO_GND K_ED_M_SPULE_Z6.P_CODE_SH_TO_UB K_ED_M_SPULE_Z6.P_CODE_UNPLAUSIBEL K_ED_M_SPULE_Z7.DEC_NACH_EINTRAG K_ED_M_SPULE_Z7.DEC_VOR_EINTRAG K_ED_M_SPULE_Z7.FEHLERSCHWELLE K_ED_M_SPULE_Z7.INC_NACH_EINTRAG K_ED_M_SPULE_Z7.INC_VOR_EINTRAG K_ED_M_SPULE_Z7.KLASSENINDEX K_ED_M_SPULE_Z7.OK_SCHWELLE K_ED_M_SPULE_Z7.P_CODE_OPENLOAD K_ED_M_SPULE_Z7.P_CODE_SH_TO_GND K_ED_M_SPULE_Z7.P_CODE_SH_TO_UB K_ED_M_SPULE_Z7.P_CODE_UNPLAUSIBEL K_ED_M_SPULE_Z8.DEC_NACH_EINTRAG K_ED_M_SPULE_Z8.DEC_VOR_EINTRAG K_ED_M_SPULE_Z8.FEHLERSCHWELLE K_ED_M_SPULE_Z8.INC_NACH_EINTRAG K_ED_M_SPULE_Z8.INC_VOR_EINTRAG K_ED_M_SPULE_Z8.KLASSENINDEX K_ED_M_SPULE_Z8.OK_SCHWELLE K_ED_M_SPULE_Z8.P_CODE_OPENLOAD K_ED_M_SPULE_Z8.P_CODE_SH_TO_GND K_ED_M_SPULE_Z8.P_CODE_SH_TO_UB K_ED_M_SPULE_Z8.P_CODE_UNPLAUSIBEL K_ED_M_SPULE_Z9.DEC_NACH_EINTRAG K_ED_M_SPULE_Z9.DEC_VOR_EINTRAG K_ED_M_SPULE_Z9.FEHLERSCHWELLE K_ED_M_SPULE_Z9.INC_NACH_EINTRAG K_ED_M_SPULE_Z9.INC_VOR_EINTRAG K_ED_M_SPULE_Z9.KLASSENINDEX K_ED_M_SPULE_Z9.OK_SCHWELLE K_ED_M_SPULE_Z9.P_CODE_OPENLOAD K_ED_M_SPULE_Z9.P_CODE_SH_TO_GND K_ED_M_SPULE_Z9.P_CODE_SH_TO_UB K_ED_M_SPULE_Z9.P_CODE_UNPLAUSIBEL K_ED_N_GETR_EIN_HS.DEC_NACH_EINTRAG K_ED_N_GETR_EIN_HS.DEC_VOR_EINTRAG K_ED_N_GETR_EIN_HS.FEHLERSCHWELLE K_ED_N_GETR_EIN_HS.INC_NACH_EINTRAG K_ED_N_GETR_EIN_HS.INC_VOR_EINTRAG K_ED_N_GETR_EIN_HS.KLASSENINDEX K_ED_N_GETR_EIN_HS.OK_SCHWELLE K_ED_N_GETR_EIN_HS.P_CODE_OPENLOAD K_ED_N_GETR_EIN_HS.P_CODE_SH_TO_GND K_ED_N_GETR_EIN_HS.P_CODE_SH_TO_UB K_ED_N_GETR_EIN_HS.P_CODE_UNPLAUSIBEL K_ED_PCTRL_IGN.DEC_NACH_EINTRAG K_ED_PCTRL_IGN.DEC_VOR_EINTRAG K_ED_PCTRL_IGN.FEHLERSCHWELLE K_ED_PCTRL_IGN.INC_NACH_EINTRAG K_ED_PCTRL_IGN.INC_VOR_EINTRAG K_ED_PCTRL_IGN.KLASSENINDEX K_ED_PCTRL_IGN.OK_SCHWELLE K_ED_PCTRL_IGN.P_CODE_OPENLOAD K_ED_PCTRL_IGN.P_CODE_SH_TO_GND K_ED_PCTRL_IGN.P_CODE_SH_TO_UB K_ED_PCTRL_IGN.P_CODE_UNPLAUSIBEL K_ED_PWG1.DEC_NACH_EINTRAG K_ED_PWG1.DEC_VOR_EINTRAG K_ED_PWG1.FEHLERSCHWELLE K_ED_PWG1.INC_NACH_EINTRAG K_ED_PWG1.INC_VOR_EINTRAG K_ED_PWG1.KLASSENINDEX K_ED_PWG1.OK_SCHWELLE K_ED_PWG1.P_CODE_OPENLOAD K_ED_PWG1.P_CODE_SH_TO_GND K_ED_PWG1.P_CODE_SH_TO_UB K_ED_PWG1.P_CODE_UNPLAUSIBEL K_ED_PWG2.DEC_NACH_EINTRAG K_ED_PWG2.DEC_VOR_EINTRAG K_ED_PWG2.FEHLERSCHWELLE K_ED_PWG2.INC_NACH_EINTRAG K_ED_PWG2.INC_VOR_EINTRAG K_ED_PWG2.KLASSENINDEX K_ED_PWG2.OK_SCHWELLE K_ED_PWG2.P_CODE_OPENLOAD K_ED_PWG2.P_CODE_SH_TO_GND K_ED_PWG2.P_CODE_SH_TO_UB K_ED_PWG2.P_CODE_UNPLAUSIBEL K_ED_PWG_BLS.DEC_NACH_EINTRAG K_ED_PWG_BLS.DEC_VOR_EINTRAG K_ED_PWG_BLS.FEHLERSCHWELLE K_ED_PWG_BLS.INC_NACH_EINTRAG K_ED_PWG_BLS.INC_VOR_EINTRAG K_ED_PWG_BLS.KLASSENINDEX K_ED_PWG_BLS.OK_SCHWELLE K_ED_PWG_BLS.P_CODE_OPENLOAD K_ED_PWG_BLS.P_CODE_SH_TO_GND K_ED_PWG_BLS.P_CODE_SH_TO_UB K_ED_PWG_BLS.P_CODE_UNPLAUSIBEL K_ED_PWG_VGL.DEC_NACH_EINTRAG K_ED_PWG_VGL.DEC_VOR_EINTRAG K_ED_PWG_VGL.FEHLERSCHWELLE K_ED_PWG_VGL.INC_NACH_EINTRAG K_ED_PWG_VGL.INC_VOR_EINTRAG K_ED_PWG_VGL.KLASSENINDEX K_ED_PWG_VGL.OK_SCHWELLE K_ED_PWG_VGL.P_CODE_OPENLOAD K_ED_PWG_VGL.P_CODE_SH_TO_GND K_ED_PWG_VGL.P_CODE_SH_TO_UB K_ED_PWG_VGL.P_CODE_UNPLAUSIBEL K_ED_RBM_PUMG_MIN__IGN_ K_ED_RBM_TIME__IGN_ K_ED_RBM_TIME_LL__IGN_ K_ED_RBM_TIME_V__IGN_ K_ED_RBM_TUMG_MIN__IGN_ K_ED_RBM_V_MIN__IGN_ K_ED_SCDN_ABDECKUNG_AUSTRAG__IGN_ K_ED_SCDN_ABDECKUNG_EINTRAG__IGN_ K_ED_SC_BUSOFF.DEC_NACH_EINTRAG K_ED_SC_BUSOFF.DEC_VOR_EINTRAG K_ED_SC_BUSOFF.FEHLERSCHWELLE K_ED_SC_BUSOFF.INC_NACH_EINTRAG K_ED_SC_BUSOFF.INC_VOR_EINTRAG K_ED_SC_BUSOFF.KLASSENINDEX K_ED_SC_BUSOFF.OK_SCHWELLE K_ED_SC_BUSOFF.P_CODE_OPENLOAD K_ED_SC_BUSOFF.P_CODE_SH_TO_GND K_ED_SC_BUSOFF.P_CODE_SH_TO_UB K_ED_SC_BUSOFF.P_CODE_UNPLAUSIBEL K_ED_SC_PKS.DEC_NACH_EINTRAG K_ED_SC_PKS.DEC_VOR_EINTRAG K_ED_SC_PKS.FEHLERSCHWELLE K_ED_SC_PKS.INC_NACH_EINTRAG K_ED_SC_PKS.INC_VOR_EINTRAG K_ED_SC_PKS.KLASSENINDEX K_ED_SC_PKS.OK_SCHWELLE K_ED_SC_PKS.P_CODE_OPENLOAD K_ED_SC_PKS.P_CODE_SH_TO_GND K_ED_SC_PKS.P_CODE_SH_TO_UB K_ED_SC_PKS.P_CODE_UNPLAUSIBEL K_ED_SC_SMG1.DEC_NACH_EINTRAG K_ED_SC_SMG1.DEC_VOR_EINTRAG K_ED_SC_SMG1.FEHLERSCHWELLE K_ED_SC_SMG1.INC_NACH_EINTRAG K_ED_SC_SMG1.INC_VOR_EINTRAG K_ED_SC_SMG1.KLASSENINDEX K_ED_SC_SMG1.OK_SCHWELLE K_ED_SC_SMG1.P_CODE_OPENLOAD K_ED_SC_SMG1.P_CODE_SH_TO_GND K_ED_SC_SMG1.P_CODE_SH_TO_UB K_ED_SC_SMG1.P_CODE_UNPLAUSIBEL K_ED_SC_SMG2.DEC_NACH_EINTRAG K_ED_SC_SMG2.DEC_VOR_EINTRAG K_ED_SC_SMG2.FEHLERSCHWELLE K_ED_SC_SMG2.INC_NACH_EINTRAG K_ED_SC_SMG2.INC_VOR_EINTRAG K_ED_SC_SMG2.KLASSENINDEX K_ED_SC_SMG2.OK_SCHWELLE K_ED_SC_SMG2.P_CODE_OPENLOAD K_ED_SC_SMG2.P_CODE_SH_TO_GND K_ED_SC_SMG2.P_CODE_SH_TO_UB K_ED_SC_SMG2.P_CODE_UNPLAUSIBEL K_ED_SC_SMG3.DEC_NACH_EINTRAG K_ED_SC_SMG3.DEC_VOR_EINTRAG K_ED_SC_SMG3.FEHLERSCHWELLE K_ED_SC_SMG3.INC_NACH_EINTRAG K_ED_SC_SMG3.INC_VOR_EINTRAG K_ED_SC_SMG3.KLASSENINDEX K_ED_SC_SMG3.OK_SCHWELLE K_ED_SC_SMG3.P_CODE_OPENLOAD K_ED_SC_SMG3.P_CODE_SH_TO_GND K_ED_SC_SMG3.P_CODE_SH_TO_UB K_ED_SC_SMG3.P_CODE_UNPLAUSIBEL K_ED_SERVO_I.DEC_NACH_EINTRAG K_ED_SERVO_I.DEC_VOR_EINTRAG K_ED_SERVO_I.FEHLERSCHWELLE K_ED_SERVO_I.INC_NACH_EINTRAG K_ED_SERVO_I.INC_VOR_EINTRAG K_ED_SERVO_I.KLASSENINDEX K_ED_SERVO_I.OK_SCHWELLE K_ED_SERVO_I.P_CODE_OPENLOAD K_ED_SERVO_I.P_CODE_SH_TO_GND K_ED_SERVO_I.P_CODE_SH_TO_UB K_ED_SERVO_I.P_CODE_UNPLAUSIBEL K_ED_SERVO_V.DEC_NACH_EINTRAG K_ED_SERVO_V.DEC_VOR_EINTRAG K_ED_SERVO_V.FEHLERSCHWELLE K_ED_SERVO_V.INC_NACH_EINTRAG K_ED_SERVO_V.INC_VOR_EINTRAG K_ED_SERVO_V.KLASSENINDEX K_ED_SERVO_V.OK_SCHWELLE K_ED_SERVO_V.P_CODE_OPENLOAD K_ED_SERVO_V.P_CODE_SH_TO_GND K_ED_SERVO_V.P_CODE_SH_TO_UB K_ED_SERVO_V.P_CODE_UNPLAUSIBEL K_ED_SG_IGN.DEC_NACH_EINTRAG K_ED_SG_IGN.DEC_VOR_EINTRAG K_ED_SG_IGN.FEHLERSCHWELLE K_ED_SG_IGN.INC_NACH_EINTRAG K_ED_SG_IGN.INC_VOR_EINTRAG K_ED_SG_IGN.KLASSENINDEX K_ED_SG_IGN.OK_SCHWELLE K_ED_SG_IGN.P_CODE_OPENLOAD K_ED_SG_IGN.P_CODE_SH_TO_GND K_ED_SG_IGN.P_CODE_SH_TO_UB K_ED_SG_IGN.P_CODE_UNPLAUSIBEL K_ED_SK_MANAGER_IGN.DEC_NACH_EINTRAG K_ED_SK_MANAGER_IGN.DEC_VOR_EINTRAG K_ED_SK_MANAGER_IGN.FEHLERSCHWELLE K_ED_SK_MANAGER_IGN.INC_NACH_EINTRAG K_ED_SK_MANAGER_IGN.INC_VOR_EINTRAG K_ED_SK_MANAGER_IGN.KLASSENINDEX K_ED_SK_MANAGER_IGN.OK_SCHWELLE K_ED_SK_MANAGER_IGN.P_CODE_OPENLOAD K_ED_SK_MANAGER_IGN.P_CODE_SH_TO_GND K_ED_SK_MANAGER_IGN.P_CODE_SH_TO_UB K_ED_SK_MANAGER_IGN.P_CODE_UNPLAUSIBEL K_ED_SK_TR_IGN.KLASSENINDEX K_ED_SMG_SCHALTAB.DEC_NACH_EINTRAG K_ED_SMG_SCHALTAB.DEC_VOR_EINTRAG K_ED_SMG_SCHALTAB.FEHLERSCHWELLE K_ED_SMG_SCHALTAB.INC_NACH_EINTRAG K_ED_SMG_SCHALTAB.INC_VOR_EINTRAG K_ED_SMG_SCHALTAB.KLASSENINDEX K_ED_SMG_SCHALTAB.OK_SCHWELLE K_ED_SMG_SCHALTAB.P_CODE_OPENLOAD K_ED_SMG_SCHALTAB.P_CODE_SH_TO_GND K_ED_SMG_SCHALTAB.P_CODE_SH_TO_UB K_ED_SMG_SCHALTAB.P_CODE_UNPLAUSIBEL K_ED_SMG_SK.DEC_NACH_EINTRAG K_ED_SMG_SK.DEC_VOR_EINTRAG K_ED_SMG_SK.FEHLERSCHWELLE K_ED_SMG_SK.INC_NACH_EINTRAG K_ED_SMG_SK.INC_VOR_EINTRAG K_ED_SMG_SK.KLASSENINDEX K_ED_SMG_SK.OK_SCHWELLE K_ED_SMG_SK.P_CODE_OPENLOAD K_ED_SMG_SK.P_CODE_SH_TO_GND K_ED_SMG_SK.P_CODE_SH_TO_UB K_ED_SMG_SK.P_CODE_UNPLAUSIBEL K_ED_SMG_SK_N.DEC_NACH_EINTRAG K_ED_SMG_SK_N.DEC_VOR_EINTRAG K_ED_SMG_SK_N.FEHLERSCHWELLE K_ED_SMG_SK_N.INC_NACH_EINTRAG K_ED_SMG_SK_N.INC_VOR_EINTRAG K_ED_SMG_SK_N.KLASSENINDEX K_ED_SMG_SK_N.OK_SCHWELLE K_ED_SMG_SK_N.P_CODE_OPENLOAD K_ED_SMG_SK_N.P_CODE_SH_TO_GND K_ED_SMG_SK_N.P_CODE_SH_TO_UB K_ED_SMG_SK_N.P_CODE_UNPLAUSIBEL K_ED_START_RL.DEC_NACH_EINTRAG K_ED_START_RL.DEC_VOR_EINTRAG K_ED_START_RL.FEHLERSCHWELLE K_ED_START_RL.INC_NACH_EINTRAG K_ED_START_RL.INC_VOR_EINTRAG K_ED_START_RL.KLASSENINDEX K_ED_START_RL.OK_SCHWELLE K_ED_START_RL.P_CODE_OPENLOAD K_ED_START_RL.P_CODE_SH_TO_GND K_ED_START_RL.P_CODE_SH_TO_UB K_ED_START_RL.P_CODE_UNPLAUSIBEL K_ED_TABG1.DEC_NACH_EINTRAG K_ED_TABG1.DEC_VOR_EINTRAG K_ED_TABG1.FEHLERSCHWELLE K_ED_TABG1.INC_NACH_EINTRAG K_ED_TABG1.INC_VOR_EINTRAG K_ED_TABG1.KLASSENINDEX K_ED_TABG1.OK_SCHWELLE K_ED_TABG1.P_CODE_OPENLOAD K_ED_TABG1.P_CODE_SH_TO_GND K_ED_TABG1.P_CODE_SH_TO_UB K_ED_TABG1.P_CODE_UNPLAUSIBEL K_ED_TABG2.DEC_NACH_EINTRAG K_ED_TABG2.DEC_VOR_EINTRAG K_ED_TABG2.FEHLERSCHWELLE K_ED_TABG2.INC_NACH_EINTRAG K_ED_TABG2.INC_VOR_EINTRAG K_ED_TABG2.KLASSENINDEX K_ED_TABG2.OK_SCHWELLE K_ED_TABG2.P_CODE_OPENLOAD K_ED_TABG2.P_CODE_SH_TO_GND K_ED_TABG2.P_CODE_SH_TO_UB K_ED_TABG2.P_CODE_UNPLAUSIBEL K_ED_TAN1.DEC_NACH_EINTRAG K_ED_TAN1.DEC_VOR_EINTRAG K_ED_TAN1.FEHLERSCHWELLE K_ED_TAN1.INC_NACH_EINTRAG K_ED_TAN1.INC_VOR_EINTRAG K_ED_TAN1.KLASSENINDEX K_ED_TAN1.OK_SCHWELLE K_ED_TAN1.P_CODE_OPENLOAD K_ED_TAN1.P_CODE_SH_TO_GND K_ED_TAN1.P_CODE_SH_TO_UB K_ED_TAN1.P_CODE_UNPLAUSIBEL K_ED_TAN2.DEC_NACH_EINTRAG K_ED_TAN2.DEC_VOR_EINTRAG K_ED_TAN2.FEHLERSCHWELLE K_ED_TAN2.INC_NACH_EINTRAG K_ED_TAN2.INC_VOR_EINTRAG K_ED_TAN2.KLASSENINDEX K_ED_TAN2.OK_SCHWELLE K_ED_TAN2.P_CODE_OPENLOAD K_ED_TAN2.P_CODE_SH_TO_GND K_ED_TAN2.P_CODE_SH_TO_UB K_ED_TAN2.P_CODE_UNPLAUSIBEL K_ED_TAN_OBD_B1.DEC_NACH_EINTRAG K_ED_TAN_OBD_B1.DEC_VOR_EINTRAG K_ED_TAN_OBD_B1.FEHLERSCHWELLE K_ED_TAN_OBD_B1.INC_NACH_EINTRAG K_ED_TAN_OBD_B1.INC_VOR_EINTRAG K_ED_TAN_OBD_B1.KLASSENINDEX K_ED_TAN_OBD_B1.OK_SCHWELLE K_ED_TAN_OBD_B1.P_CODE_OPENLOAD K_ED_TAN_OBD_B1.P_CODE_SH_TO_GND K_ED_TAN_OBD_B1.P_CODE_SH_TO_UB K_ED_TAN_OBD_B1.P_CODE_UNPLAUSIBEL K_ED_TAN_OBD_B2.DEC_NACH_EINTRAG K_ED_TAN_OBD_B2.DEC_VOR_EINTRAG K_ED_TAN_OBD_B2.FEHLERSCHWELLE K_ED_TAN_OBD_B2.INC_NACH_EINTRAG K_ED_TAN_OBD_B2.INC_VOR_EINTRAG K_ED_TAN_OBD_B2.KLASSENINDEX K_ED_TAN_OBD_B2.OK_SCHWELLE K_ED_TAN_OBD_B2.P_CODE_OPENLOAD K_ED_TAN_OBD_B2.P_CODE_SH_TO_GND K_ED_TAN_OBD_B2.P_CODE_SH_TO_UB K_ED_TAN_OBD_B2.P_CODE_UNPLAUSIBEL K_ED_TDME.DEC_NACH_EINTRAG K_ED_TDME.DEC_VOR_EINTRAG K_ED_TDME.FEHLERSCHWELLE K_ED_TDME.INC_NACH_EINTRAG K_ED_TDME.INC_VOR_EINTRAG K_ED_TDME.KLASSENINDEX K_ED_TDME.OK_SCHWELLE K_ED_TDME.P_CODE_OPENLOAD K_ED_TDME.P_CODE_SH_TO_GND K_ED_TDME.P_CODE_SH_TO_UB K_ED_TDME.P_CODE_UNPLAUSIBEL K_ED_THERMOSTAT.DEC_NACH_EINTRAG /end REF_CHARACTERISTIC
/end GROUP
/end MODULE
/end PROJECT
