/* ------------------------------------------------------------------
MSS60 IGN A2L - Production calibration 7848136 (V762.01-B500.02)
Created by ZiMMie for the M5Board and Nam3Forum communities.
This project exists to make this information freely available
to everyone: to share the work, encourage collaboration, and let
others learn from it, use it and add their own knowledge.
The reference material is based on publicly available beta
program software. Ghidra was used to disassemble and analyse
the current V762 program.
This is a community effort, and every contribution matters.
Corrections, additional findings, technical knowledge and general
feedback are all very welcome. The more knowledge is shared and
the more people work together, the more can be achieved.
Completely free to use and share.
------------------------------------------------------------------ */
ASAP2_VERSION 1 60
/begin PROJECT MSS60_V762_IGN "MSS60 (S65) V762 IGN CPU - production calibration 7848136 (V762.01-B500.02)"
/begin HEADER "Calibration description. Measurements: V530 RAM names transferred to V762 addresses (confidence in each long identifier). Status tag in every long identifier: verified (checked against the code) / A2L-ref (placed from the V530 A2L) / EST (estimated) / unassigned (unidentified)." VERSION "V762-RE-04112026" /end HEADER
/begin MODULE IGN "MSS60 V762 IGN"
/begin MOD_COMMON "" BYTE_ORDER MSB_FIRST ALIGNMENT_BYTE 1 ALIGNMENT_WORD 2 ALIGNMENT_LONG 4 /end MOD_COMMON
/begin MOD_PAR "" ECU "MSS60-IGN" SUPPLIER "Siemens VDO / BMW M"
 /begin MEMORY_SEGMENT DATASEG1 "Calibration data" DATA FLASH INTERN 0x70000 0x10000 -1 -1 -1 -1 -1 /end MEMORY_SEGMENT
 /begin MEMORY_SEGMENT CODESEG1 "Program" CODE FLASH INTERN 0x10000 0x60000 -1 -1 -1 -1 -1 /end MEMORY_SEGMENT
/end MOD_PAR
/begin AXIS_PTS GAX_136F0 "Group axis (16 points) shared by group curves/maps" 0x736F0 NO_INPUT_QUANTITY RL_AXP_SW 0 CM_0002 16 -32768 32767 /end AXIS_PTS
/begin AXIS_PTS GAX_1372C "Group axis (10 points) shared by group curves/maps" 0x7372C NO_INPUT_QUANTITY RL_AXP_SW 0 CM_0003 10 -3.2768 3.2767 /end AXIS_PTS
/begin AXIS_PTS GAX_139C0 "Group axis (5 points) shared by group curves/maps" 0x739C0 NO_INPUT_QUANTITY RL_AXP_UB 0 CM_0069 5 1 256 /end AXIS_PTS
/begin AXIS_PTS GAX_136C0 "Group axis (10 points) shared by group curves/maps" 0x736C0 NO_INPUT_QUANTITY RL_AXP_SW 0 CM_0235 10 -32768 32767 /end AXIS_PTS
/begin AXIS_PTS GAX_136D6 "Group axis (12 points) shared by group curves/maps" 0x736D6 NO_INPUT_QUANTITY RL_AXP_SW 0 CM_0235 12 -32768 32767 /end AXIS_PTS
/begin CHARACTERISTIC KF_AQ_IST_RF_TAU_NEG "Time constant for negative egas_aq_soll_grad (throttle closing) [verified]" MAP 0x70352 RL_MAP_SW_UW_UW 0 CM_0011 0.004999923705 327.67 /begin AXIS_DESCR STD_AXIS NO_INPUT_QUANTITY CM_0002 5 -32768 32767 /end AXIS_DESCR /begin AXIS_DESCR STD_AXIS NO_INPUT_QUANTITY CM_0012 5 0 6553.5 /end AXIS_DESCR /end CHARACTERISTIC
/begin CHARACTERISTIC KF_AQ_IST_RF_TAU_POS "Time constant for positive egas_aq_soll_grad (throttle opening) [verified]" MAP 0x7039A RL_MAP_SW_UW_UW 0 CM_0011 0.004999923705 327.67 /begin AXIS_DESCR STD_AXIS NO_INPUT_QUANTITY CM_0002 5 -32768 32767 /end AXIS_DESCR /begin AXIS_DESCR STD_AXIS NO_INPUT_QUANTITY CM_0012 5 0 6553.5 /end AXIS_DESCR /end CHARACTERISTIC
/begin CHARACTERISTIC KL_AQ_ABS_DK "Throttle opening cross-section (per bank) [verified]" CURVE 0x702CC RL_CUR_SW_UW 0 CM_0012 0 6553.5 /begin AXIS_DESCR STD_AXIS NO_INPUT_QUANTITY CM_0013 8 -3276.8 3276.7 /end AXIS_DESCR /end CHARACTERISTIC
/begin CHARACTERISTIC KL_AQ_ABS_DK_ABW_MAX "Threshold for throttle position settled [verified]" CURVE 0x70300 RL_CUR_UW_UW 0 CM_0012 0 6553.5 /begin AXIS_DESCR STD_AXIS NO_INPUT_QUANTITY CM_0012 4 0 6553.5 /end AXIS_DESCR /end CHARACTERISTIC
/begin CHARACTERISTIC KL_AQ_ABS_LLS "Idle air valve (LLS) opening cross-section (per bank) [verified]" CURVE 0x702AA RL_CUR_SW_UW 0 CM_0012 0 6553.5 /begin AXIS_DESCR STD_AXIS NO_INPUT_QUANTITY CM_0013 8 -3276.8 3276.7 /end AXIS_DESCR /end CHARACTERISTIC
/begin CHARACTERISTIC KL_AQ_ABS_LLS_ABW_MAX "Threshold for idle air valve settled [verified]" CURVE 0x702EE RL_CUR_UW_UW 0 CM_0012 0 6553.5 /begin AXIS_DESCR STD_AXIS NO_INPUT_QUANTITY CM_0012 4 0 6553.5 /end AXIS_DESCR /end CHARACTERISTIC
/begin CHARACTERISTIC KL_AQ_MAX "Maximum air cross-section (AQ) [verified]" CURVE 0x70312 RL_CUR_SW_UW 0 CM_0012 0 6553.5 /begin AXIS_DESCR STD_AXIS NO_INPUT_QUANTITY CM_0002 10 -32768 32767 /end AXIS_DESCR /end CHARACTERISTIC
/begin CHARACTERISTIC KF_AR_MD_FAKTOR "P controller [verified]" MAP 0x704AC RL_MAP_SW_SW_SW 0 CM_0014 -6.4 6.399804688 /begin AXIS_DESCR STD_AXIS NO_INPUT_QUANTITY CM_0002 8 -32768 32767 /end AXIS_DESCR /begin AXIS_DESCR STD_AXIS NO_INPUT_QUANTITY CM_0015 8 -32768 32767 /end AXIS_DESCR /end CHARACTERISTIC
/begin CHARACTERISTIC K_AR_CFG "Configuration [verified]" VALUE 0x70472 RL_VAL_UB 0 CM_0000 0 255 /end CHARACTERISTIC
/begin CHARACTERISTIC K_AR_FAK_KOMFORT "Weighting factor in Comfort mode [verified]" VALUE 0x704A4 RL_VAL_UW 0 CM_0016 0 63.99902344 /end CHARACTERISTIC
/begin CHARACTERISTIC K_AR_FAK_SPORT "Weighting factor in Sport mode [verified]" VALUE 0x704A6 RL_VAL_UW 0 CM_0016 0 63.99902344 /end CHARACTERISTIC
/begin CHARACTERISTIC K_AR_KORR_P_1 "P share for ramping up to target rpm [verified]" VALUE 0x7048C RL_VAL_UW 0 CM_0014 0 12.79980469 /end CHARACTERISTIC
/begin CHARACTERISTIC K_AR_KORR_P_2 "P share for ramping up to target rpm [verified]" VALUE 0x7048E RL_VAL_UW 0 CM_0014 0 12.79980469 /end CHARACTERISTIC
/begin CHARACTERISTIC K_AR_KORR_P_3 "P share for ramping up to target rpm [verified]" VALUE 0x70490 RL_VAL_UW 0 CM_0014 0 12.79980469 /end CHARACTERISTIC
/begin CHARACTERISTIC K_AR_KORR_P_4 "P share for ramping up to target rpm [verified]" VALUE 0x70492 RL_VAL_UW 0 CM_0014 0 12.79980469 /end CHARACTERISTIC
/begin CHARACTERISTIC K_AR_KORR_P_5 "P share for ramping up to target rpm [verified]" VALUE 0x70494 RL_VAL_UW 0 CM_0014 0 12.79980469 /end CHARACTERISTIC
/begin CHARACTERISTIC K_AR_KORR_P_6 "P share for ramping up to target rpm [verified]" VALUE 0x70496 RL_VAL_UW 0 CM_0014 0 12.79980469 /end CHARACTERISTIC
/begin CHARACTERISTIC K_AR_KORR_P_7 "P share for ramping up to target rpm [verified]" VALUE 0x70498 RL_VAL_UW 0 CM_0014 0 12.79980469 /end CHARACTERISTIC
/begin CHARACTERISTIC K_AR_KORR_P_N "P share for ramping up to target rpm [verified]" VALUE 0x7048A RL_VAL_UW 0 CM_0014 0 12.79980469 /end CHARACTERISTIC
/begin CHARACTERISTIC K_AR_KORR_P_R "P share for ramping up to target rpm [verified]" VALUE 0x70488 RL_VAL_UW 0 CM_0014 0 12.79980469 /end CHARACTERISTIC
/begin CHARACTERISTIC K_AR_MD_MAX "Maximum torque request [verified]" VALUE 0x704AA RL_VAL_SW 0 CM_0017 -3276.8 3276.7 /end CHARACTERISTIC
/begin CHARACTERISTIC K_AR_MD_MIN "Minimum torque request [verified]" VALUE 0x704A8 RL_VAL_SW 0 CM_0017 -3276.8 3276.7 /end CHARACTERISTIC
/begin CHARACTERISTIC K_AR_N_DIF_BESCHL_1 "Threshold for 1st acceleration wave [verified]" VALUE 0x7047C RL_VAL_SW 0 CM_0002 -32768 32767 /end CHARACTERISTIC
/begin CHARACTERISTIC K_AR_N_DIF_BESCHL_2 "Threshold for 2nd acceleration wave [verified]" VALUE 0x7047E RL_VAL_SW 0 CM_0002 -32768 32767 /end CHARACTERISTIC
/begin CHARACTERISTIC K_AR_N_DIF_REF_MAX "Maximum difference [verified]" VALUE 0x70486 RL_VAL_SW 0 CM_0002 -32768 32767 /end CHARACTERISTIC
/begin CHARACTERISTIC K_AR_N_DIF_REF_MIN "Minimum difference [verified]" VALUE 0x70484 RL_VAL_SW 0 CM_0002 -32768 32767 /end CHARACTERISTIC
/begin CHARACTERISTIC K_AR_N_DIF_VERZ_1 "Threshold for 1st deceleration wave [verified]" VALUE 0x70480 RL_VAL_SW 0 CM_0002 -32768 32767 /end CHARACTERISTIC
/begin CHARACTERISTIC K_AR_N_DIF_VERZ_2 "Threshold for 2nd deceleration wave [verified]" VALUE 0x70482 RL_VAL_SW 0 CM_0002 -32768 32767 /end CHARACTERISTIC
/begin CHARACTERISTIC K_AR_N_FIL_0 "Filter constant [verified]" VALUE 0x7049A RL_VAL_SW 0 CM_0018 -0.0312508416 0.0312498879 /end CHARACTERISTIC
/begin CHARACTERISTIC K_AR_N_FIL_1 "Filter constant [verified]" VALUE 0x7049C RL_VAL_SW 0 CM_0018 -0.0312508416 0.0312498879 /end CHARACTERISTIC
/begin CHARACTERISTIC K_AR_N_FIL_2 "Filter constant [verified]" VALUE 0x7049E RL_VAL_SW 0 CM_0018 -0.0312508416 0.0312498879 /end CHARACTERISTIC
/begin CHARACTERISTIC K_AR_N_FIL_3 "Filter constant [verified]" VALUE 0x704A0 RL_VAL_SW 0 CM_0019 -2.000001434 1.999940398 /end CHARACTERISTIC
/begin CHARACTERISTIC K_AR_N_FIL_4 "Filter constant [verified]" VALUE 0x704A2 RL_VAL_SW 0 CM_0019 -2.000001434 1.999940398 /end CHARACTERISTIC
/begin CHARACTERISTIC K_AR_N_MAX "Maximum threshold [verified]" VALUE 0x70476 RL_VAL_SW 0 CM_0002 -32768 32767 /end CHARACTERISTIC
/begin CHARACTERISTIC K_AR_N_MIN "Minimum threshold [verified]" VALUE 0x70474 RL_VAL_SW 0 CM_0002 -32768 32767 /end CHARACTERISTIC
/begin CHARACTERISTIC K_AR_T_MAX "Maximum anti-jerk intervention time [verified]" VALUE 0x7047A RL_VAL_UW 0 CM_0020 0 327.675 /end CHARACTERISTIC
/begin CHARACTERISTIC K_AR_T_PAS_DELAY "Delay after lock-out [verified]" VALUE 0x70478 RL_VAL_UW 0 CM_0020 0 327.675 /end CHARACTERISTIC
/begin CHARACTERISTIC K_AT_CFG "Schalter Konfiguration Anti-Trampel-Funktion [verified]" VALUE 0x7054E RL_VAL_UB 0 CM_0000 0 255 /end CHARACTERISTIC
/begin CHARACTERISTIC KF_EGAS_SOLL_AQ "Target charge (rf) from throttle opening area, per bank - core airflow/load model (normal operation) [verified]" MAP 0x71926 RL_MAP_SW_SW_SW 0 CM_0003 -3.2768 3.2767 /begin AXIS_DESCR STD_AXIS NO_INPUT_QUANTITY CM_0002 22 -32768 32767 /end AXIS_DESCR /begin AXIS_DESCR STD_AXIS NO_INPUT_QUANTITY CM_0012 24 -3276.8 3276.7 /end AXIS_DESCR /end CHARACTERISTIC
/begin CHARACTERISTIC KF_EGAS_SOLL_AQ_NOTL "Target charge (rf) from throttle opening area, per bank - LIMP-HOME (Notlauf) map [verified]" MAP 0x71DA4 RL_MAP_SW_SW_SW 0 CM_0003 -3.2768 3.2767 /begin AXIS_DESCR STD_AXIS NO_INPUT_QUANTITY CM_0002 22 -32768 32767 /end AXIS_DESCR /begin AXIS_DESCR STD_AXIS NO_INPUT_QUANTITY CM_0012 22 -3276.8 3276.7 /end AXIS_DESCR /end CHARACTERISTIC
/begin CHARACTERISTIC KF_EGAS_SOLL_AQ_START "Air cross-section during start [verified]" MAP 0x72340 RL_MAP_SW_SW_UW 0 CM_0012 0 6553.5 /begin AXIS_DESCR STD_AXIS NO_INPUT_QUANTITY CM_0002 4 -32768 32767 /end AXIS_DESCR /begin AXIS_DESCR STD_AXIS NO_INPUT_QUANTITY CM_0003 12 -3.2768 3.2767 /end AXIS_DESCR /end CHARACTERISTIC
/begin CHARACTERISTIC KF_EGAS_SOLL_WL_GEW_F "Warm-up weighting factor (factor around 0) [verified]" MAP 0x72268 RL_MAP_SW_SW_SW 0 CM_0016 -32 31.99902344 /begin AXIS_DESCR STD_AXIS NO_INPUT_QUANTITY CM_0025 8 -327.68 327.67 /end AXIS_DESCR /begin AXIS_DESCR STD_AXIS NO_INPUT_QUANTITY CM_0006 8 -3550 3003.5 /end AXIS_DESCR /end CHARACTERISTIC
/begin CHARACTERISTIC KF_EGAS_SOLL_WL_OFFS "Warm-up correction factor [verified]" MAP 0x721C6 RL_MAP_SW_SW_SW 0 CM_0016 -32 31.99902344 /begin AXIS_DESCR STD_AXIS NO_INPUT_QUANTITY CM_0002 8 -32768 32767 /end AXIS_DESCR /begin AXIS_DESCR STD_AXIS NO_INPUT_QUANTITY CM_0003 8 -3.2768 3.2767 /end AXIS_DESCR /end CHARACTERISTIC
/begin CHARACTERISTIC KL_EGAS_N_AQ_START_NEG "Negative engine-speed filter during start [verified]" CURVE 0x718B2 RL_CUR_SW_UB 0 CM_0027 0 255 /begin AXIS_DESCR STD_AXIS NO_INPUT_QUANTITY CM_0002 6 -32768 32767 /end AXIS_DESCR /end CHARACTERISTIC
/begin CHARACTERISTIC KL_EGAS_N_AQ_START_POS "Positive engine-speed filter during start [verified]" CURVE 0x7189E RL_CUR_SW_UB 0 CM_0027 0 255 /begin AXIS_DESCR STD_AXIS NO_INPUT_QUANTITY CM_0002 6 -32768 32767 /end AXIS_DESCR /end CHARACTERISTIC
/begin CHARACTERISTIC K_EGAS_CAN_ED_TSPERR "Wait time for CAN diagnosis [sec] [verified]" VALUE 0x71878 RL_VAL_UB 0 CM_0029 0 1.275 /end CHARACTERISTIC
/begin CHARACTERISTIC K_EGAS_CAN_ED_UB_MIN "Minimum battery voltage for CAN diagnosis [V] [verified]" VALUE 0x7187A RL_VAL_SW 0 CM_0021 -3276.8 3276.7 /end CHARACTERISTIC
/begin CHARACTERISTIC K_EGAS_CFG_DK "DK-Konfiguration [verified]" VALUE 0x7184A RL_VAL_UB 0 CM_0000 0 255 /end CHARACTERISTIC
/begin CHARACTERISTIC K_EGAS_SOLL_BOWDEN_LLS_F "Weighting factor [verified]" VALUE 0x71888 RL_VAL_UW 0 CM_0016 0 63.99902344 /end CHARACTERISTIC
/begin CHARACTERISTIC K_EGAS_SOLL_BOWDEN_MIN "Minimum idle air valve threshold [%] [verified]" VALUE 0x7188A RL_VAL_SW 0 CM_0013 -3276.8 3276.7 /end CHARACTERISTIC
/begin CHARACTERISTIC K_EGAS_STM_DK_FT_TMOT "Minimum temperature for spring test [?C] [verified]" VALUE 0x72466 RL_VAL_SW 0 CM_0006 -3550 3003.5 /end CHARACTERISTIC
/begin CHARACTERISTIC K_EGAS_STM_DK_GT_MAX "Maximum position for aborting linkage test [%] [verified]" VALUE 0x72460 RL_VAL_SW 0 CM_0013 -3276.8 3276.7 /end CHARACTERISTIC
/begin CHARACTERISTIC K_EGAS_STM_DK_GT_MIN "Minimum delta for linkage test [%] [verified]" VALUE 0x7245E RL_VAL_SW 0 CM_0013 -3276.8 3276.7 /end CHARACTERISTIC
/begin CHARACTERISTIC K_EGAS_STM_DK_GT_TIME "Maximum time for linkage test [sec] [verified]" VALUE 0x72458 RL_VAL_UW 0 CM_0029 0 327.675 /end CHARACTERISTIC
/begin CHARACTERISTIC K_EGAS_STM_DK_GT_TMOT "Minimum temperature for linkage test [?C] [verified]" VALUE 0x7245A RL_VAL_SW 0 CM_0006 -3550 3003.5 /end CHARACTERISTIC
/begin CHARACTERISTIC K_EGAS_STM_DK_GT_UB "Minimum battery voltage for linkage test [V] [verified]" VALUE 0x7245C RL_VAL_SW 0 CM_0021 -3276.8 3276.7 /end CHARACTERISTIC
/begin CHARACTERISTIC K_EGAS_STM_DK_MODE_HW "Hardware number for mode comparison (redundancy check) [verified]" VALUE 0x72472 RL_VAL_UW 0 CM_0000 0 65535 /end CHARACTERISTIC
/begin CHARACTERISTIC K_EGAS_STM_DK_NP_NMAX "Maximum engine speed for post-adaptation [Upm] [verified]" VALUE 0x7246A RL_VAL_SW 0 CM_0002 -32768 32767 /end CHARACTERISTIC
/begin CHARACTERISTIC K_EGAS_STM_DK_NP_PMAX "Maximum intake manifold pressure for post-adaptation [%] [verified]" VALUE 0x72470 RL_VAL_SW 0 CM_0005 -199.9999992 199.9938957 /end CHARACTERISTIC
/begin CHARACTERISTIC K_EGAS_STM_DK_NP_PMIN "Minimum intake manifold pressure for post-adaptation [%] [verified]" VALUE 0x7246E RL_VAL_SW 0 CM_0005 -199.9999992 199.9938957 /end CHARACTERISTIC
/begin CHARACTERISTIC K_EGAS_STM_DK_NP_UB "Minimum battery voltage for zero-point adaptation [V] [verified]" VALUE 0x72468 RL_VAL_SW 0 CM_0021 -3276.8 3276.7 /end CHARACTERISTIC
/begin CHARACTERISTIC K_EGAS_STM_DK_N_FAST "Fast throttle run-up on reset [Upm] [verified]" VALUE 0x72462 RL_VAL_SW 0 CM_0002 -32768 32767 /end CHARACTERISTIC
/begin CHARACTERISTIC K_EGAS_STM_DK_N_KL50 "Fast throttle run-up at terminal 50 (cranking) [Upm] [verified]" VALUE 0x72464 RL_VAL_SW 0 CM_0002 -32768 32767 /end CHARACTERISTIC
/begin CHARACTERISTIC K_EGAS_STM_DK_WAIT_DIS "Wait for disable [sec] [verified]" VALUE 0x72452 RL_VAL_UW 0 CM_0029 0 327.675 /end CHARACTERISTIC
/begin CHARACTERISTIC K_EGAS_T_KL50 "Wait time at terminal 50 (cranking) [s] [verified]" VALUE 0x71886 RL_VAL_UB 0 CM_0020 0 1.275 /end CHARACTERISTIC
/begin CHARACTERISTIC K_EGAS_WDK_A0_ANZAHL "Number of A0 averages [mal] [verified]" VALUE 0x71876 RL_VAL_UB 0 CM_0030 0 255 /end CHARACTERISTIC
/begin CHARACTERISTIC K_EGAS_WDK_A0_DELTA_MAX "Maximum A0 delta [V] [verified]" VALUE 0x71874 RL_VAL_SW 0 CM_0031 -160 159.9951172 /end CHARACTERISTIC
/begin CHARACTERISTIC K_EGAS_WDK_A0_DFT "Default A0 value [V] [verified]" VALUE 0x71872 RL_VAL_SW 0 CM_0031 -160 159.9951172 /end CHARACTERISTIC
/begin CHARACTERISTIC K_EGAS_WDK_A0_KONST "A0 constant [V] [verified]" VALUE 0x71868 RL_VAL_SW 0 CM_0031 -160 159.9951172 /end CHARACTERISTIC
/begin CHARACTERISTIC K_EGAS_WDK_A0_MAX "Maximum A0 value [V] [verified]" VALUE 0x71870 RL_VAL_SW 0 CM_0031 -160 159.9951172 /end CHARACTERISTIC
/begin CHARACTERISTIC K_EGAS_WDK_A0_MIN "Minimum A0 value [V] [verified]" VALUE 0x7186E RL_VAL_SW 0 CM_0031 -160 159.9951172 /end CHARACTERISTIC
/begin CHARACTERISTIC K_EGAS_WDK_A0_OFF_B1 "Minimum A0 value [verified]" VALUE 0x7186A RL_VAL_SW 0 CM_0031 -160 159.9951172 /end CHARACTERISTIC
/begin CHARACTERISTIC K_EGAS_WDK_A0_OFF_B2 "Minimum A0 value [verified]" VALUE 0x7186C RL_VAL_SW 0 CM_0031 -160 159.9951172 /end CHARACTERISTIC
/begin CHARACTERISTIC K_EGAS_WDK_A0_TIME "Time for constant value [ms] [verified]" VALUE 0x71866 RL_VAL_UB 0 CM_0032 0 1275 /end CHARACTERISTIC
/begin CHARACTERISTIC K_EGAS_WDK_MAX "Maximum throttle angle [V] [verified]" VALUE 0x71862 RL_VAL_SW 0 CM_0031 -160 159.9951172 /end CHARACTERISTIC
/begin CHARACTERISTIC K_EGAS_WDK_MIN "Minimum throttle angle [V] [verified]" VALUE 0x71860 RL_VAL_SW 0 CM_0031 -160 159.9951172 /end CHARACTERISTIC
/begin CHARACTERISTIC K_EGAS_WDK_NORM "Conversion V to % [%/V] [verified]" VALUE 0x71864 RL_VAL_SW 0 CM_0033 -327.3600008 327.3500106 /end CHARACTERISTIC
/begin CHARACTERISTIC KF_FR_RF_DELTA_REL_HYS "Switch-off threshold on control error [verified]" MAP 0x731A8 RL_MAP_SW_SW_SW 0 CM_0047 -1.000030208 0.9999996895 /begin AXIS_DESCR STD_AXIS NO_INPUT_QUANTITY CM_0002 4 -32768 32767 /end AXIS_DESCR /begin AXIS_DESCR STD_AXIS NO_INPUT_QUANTITY CM_0003 4 -3.2768 3.2767 /end AXIS_DESCR /end CHARACTERISTIC
/begin CHARACTERISTIC KF_FR_SA_DELAY "Lock-out time after switch-off [verified]" MAP 0x731DA RL_MAP_SW_SW_UW 0 CM_0025 0 655.35 /begin AXIS_DESCR STD_AXIS NO_INPUT_QUANTITY CM_0002 4 -32768 32767 /end AXIS_DESCR /begin AXIS_DESCR STD_AXIS NO_INPUT_QUANTITY CM_0003 4 -3.2768 3.2767 /end AXIS_DESCR /end CHARACTERISTIC
/begin CHARACTERISTIC KL_FR_IANT "Integral step size [verified]" CURVE 0x7314A RL_CUR_SW_SW 0 CM_0048 -99.99999959 99.99694783
 /begin AXIS_DESCR STD_AXIS NO_INPUT_QUANTITY CM_0047 8 -1.000030208 0.9999996895 /end AXIS_DESCR
/end CHARACTERISTIC
/begin CHARACTERISTIC KL_FR_MDRFSOLLPT_MAX_N "md_rf_soll_pt threshold for freezing the charge controller [verified]" CURVE 0x7318E RL_CUR_SW_SW 0 CM_0003 -3.2768 3.2767 /begin AXIS_DESCR STD_AXIS NO_INPUT_QUANTITY CM_0002 6 -32768 32767 /end AXIS_DESCR /end CHARACTERISTIC
/begin CHARACTERISTIC KL_FR_PANT "P share [verified]" CURVE 0x7316C RL_CUR_SW_SW 0 CM_0047 -1.000030208 0.9999996895
 /begin AXIS_DESCR STD_AXIS NO_INPUT_QUANTITY CM_0047 8 -1.000030208 0.9999996895 /end AXIS_DESCR
/end CHARACTERISTIC
/begin CHARACTERISTIC K_FR_AQGRAD_MAX "Trigger for dynamics deactivation [qmm/s] [verified]" VALUE 0x73140 RL_VAL_SW 0 CM_0049 -655360 655340 /end CHARACTERISTIC
/begin CHARACTERISTIC K_FR_EDK_DIFF "Maximum setpoint/actual difference [%] [verified]" VALUE 0x73144 RL_VAL_SW 0 CM_0013 -3276.8 3276.7 /end CHARACTERISTIC
/begin CHARACTERISTIC K_FR_EINGER_HYS "Threshold for settled [%] [verified]" VALUE 0x7312E RL_VAL_SW 0 CM_0050 -99.99999959 99.99694783 /end CHARACTERISTIC
/begin CHARACTERISTIC K_FR_EINGER_SCHW "Threshold for settled [%] [verified]" VALUE 0x7312C RL_VAL_SW 0 CM_0050 -99.99999959 99.99694783 /end CHARACTERISTIC
/begin CHARACTERISTIC K_FR_IMAX "Maximum integral share [verified]" VALUE 0x73124 RL_VAL_SW 0 CM_0047 -1.000030208 0.9999996895 /end CHARACTERISTIC
/begin CHARACTERISTIC K_FR_IMIN "Minimum integral share [verified]" VALUE 0x73122 RL_VAL_SW 0 CM_0047 -1.000030208 0.9999996895 /end CHARACTERISTIC
/begin CHARACTERISTIC K_FR_MAX "Maximum limit of controller output [verified]" VALUE 0x73128 RL_VAL_SW 0 CM_0047 -1.000030208 0.9999996895 /end CHARACTERISTIC
/begin CHARACTERISTIC K_FR_MIN "Minimum limit of controller output [verified]" VALUE 0x73126 RL_VAL_SW 0 CM_0047 -1.000030208 0.9999996895 /end CHARACTERISTIC
/begin CHARACTERISTIC K_FR_MVAC_RF_MAX "Maximum load threshold for charge-controller deactivation [verified]" VALUE 0x73142 RL_VAL_SW 0 CM_0003 -3.2768 3.2767 /end CHARACTERISTIC
/begin CHARACTERISTIC K_FR_PUMG_MAX "Lock level for maximum ambient pressure [mbar] [verified]" VALUE 0x73134 RL_VAL_SW 0 CM_0022 -2048 2047.9375 /end CHARACTERISTIC
/begin CHARACTERISTIC K_FR_PUMG_MIN "Lock level for minimum ambient pressure [mbar] [verified]" VALUE 0x73136 RL_VAL_SW 0 CM_0022 -2048 2047.9375 /end CHARACTERISTIC
/begin CHARACTERISTIC K_FR_START_DELAY "Delay after start [s] [verified]" VALUE 0x7312A RL_VAL_UW 0 CM_0025 0 655.35 /end CHARACTERISTIC
/begin CHARACTERISTIC K_FR_TAN_MAX "Maximum permitted intake air temperature for charge controller [?C] [verified]" VALUE 0x73138 RL_VAL_SW 0 CM_0006 -3550 3003.5 /end CHARACTERISTIC
/begin CHARACTERISTIC K_FR_TAN_MIN "Minimum permitted intake air temperature for charge controller [?C] [verified]" VALUE 0x7313A RL_VAL_SW 0 CM_0006 -3550 3003.5 /end CHARACTERISTIC
/begin CHARACTERISTIC K_FR_TE_C_AKF_MAX "Maximum concentration from carbon canister (purge) [verified]" VALUE 0x73146 RL_VAL_UW 0 CM_0019 0 3.999941832 /end CHARACTERISTIC
/begin CHARACTERISTIC K_FR_TE_X_ML_MIN "Minimum scavenging-air share with charge controller off [verified]" VALUE 0x73148 RL_VAL_UW 0 CM_0051 0 1.999970916 /end CHARACTERISTIC
/begin CHARACTERISTIC K_FR_TKSM_MAX "Maximum permitted fuel-model temperature for charge controller [?C] [verified]" VALUE 0x7313C RL_VAL_SW 0 CM_0006 -3550 3003.5 /end CHARACTERISTIC
/begin CHARACTERISTIC K_FR_TKSM_MIN "Minimum permitted fuel-model temperature for charge controller [?C] [verified]" VALUE 0x7313E RL_VAL_SW 0 CM_0006 -3550 3003.5 /end CHARACTERISTIC
/begin CHARACTERISTIC K_FR_TMOT_MAX "Temperature threshold for TMOT-MAX [?C] [verified]" VALUE 0x73130 RL_VAL_SW 0 CM_0006 -3550 3003.5 /end CHARACTERISTIC
/begin CHARACTERISTIC K_FR_TMOT_MIN "Temperature threshold for TMOT-MIN [?C] [verified]" VALUE 0x73132 RL_VAL_SW 0 CM_0006 -3550 3003.5 /end CHARACTERISTIC
/begin CHARACTERISTIC K_FR_T_ABREG "Step size for ramp-down [1/s] [verified]" VALUE 0x73120 RL_VAL_UW 0 CM_0048 0 199.9969474 /end CHARACTERISTIC
/begin CHARACTERISTIC KF_FRA_PROV_B1 "Provisional charge adaptation, bank 1 [verified]" MAP 0x73212 RL_MAP_SW_SW_UW 0 CM_0051 0 1.999970916 /begin AXIS_DESCR STD_AXIS NO_INPUT_QUANTITY CM_0002 10 -32768 32767 /end AXIS_DESCR /begin AXIS_DESCR STD_AXIS NO_INPUT_QUANTITY CM_0003 10 -3.2768 3.2767 /end AXIS_DESCR /end CHARACTERISTIC
/begin CHARACTERISTIC KF_FRA_PROV_B2 "Provisional charge adaptation, bank 2 [verified]" MAP 0x73304 RL_MAP_SW_SW_UW 0 CM_0051 0 1.999970916 /begin AXIS_DESCR STD_AXIS NO_INPUT_QUANTITY CM_0002 10 -32768 32767 /end AXIS_DESCR /begin AXIS_DESCR STD_AXIS NO_INPUT_QUANTITY CM_0003 10 -3.2768 3.2767 /end AXIS_DESCR /end CHARACTERISTIC
/begin CHARACTERISTIC GKF_VR_VORST_BAS "Base pre-control of the measuring stage (ion current) [verified]" MAP 0x7E56A RL_GRP_SW_C 0 CM_0053 -64 63.99804688
 /begin AXIS_DESCR COM_AXIS NO_INPUT_QUANTITY CM_0002 16 -32768 32767 AXIS_PTS_REF GAX_136F0 /end AXIS_DESCR
 /begin AXIS_DESCR COM_AXIS NO_INPUT_QUANTITY CM_0003 10 -3.2768 3.2767 AXIS_PTS_REF GAX_1372C /end AXIS_DESCR
/end CHARACTERISTIC
/begin CHARACTERISTIC KL_VR_VORST_DTZ "Correction factor over retraction angle [verified]" CURVE 0x7E548 RL_CUR_SW_SW 0 CM_0053 -64 63.99804688 /begin AXIS_DESCR STD_AXIS NO_INPUT_QUANTITY CM_0028 8 -3276.8 3276.7 /end AXIS_DESCR /end CHARACTERISTIC
/begin CHARACTERISTIC K_VR_HYST "Hysteresis for switching threshold [verified]" VALUE 0x7E4F2 RL_VAL_SW 0 CM_0055 -800 799.9755859 /end CHARACTERISTIC
/begin CHARACTERISTIC K_VR_MESS_ED "Measuring gain in fault case [verified]" VALUE 0x7E4EE RL_VAL_SW 0 CM_0053 -64 63.99804688 /end CHARACTERISTIC
/begin CHARACTERISTIC K_VR_SET_INI "Initial value of all gain stages [verified]" VALUE 0x7E4E8 RL_VAL_UB 0 CM_0056 0 255 /end CHARACTERISTIC
/begin CHARACTERISTIC K_VR_SET_MAX "Initial value of all gain stages [verified]" VALUE 0x7E4EA RL_VAL_UB 0 CM_0056 0 255 /end CHARACTERISTIC
/begin CHARACTERISTIC K_VR_SET_MIN "Initial value of all gain stages [verified]" VALUE 0x7E4E9 RL_VAL_UB 0 CM_0056 0 255 /end CHARACTERISTIC
/begin CHARACTERISTIC K_VR_SOLL "Target signal level [verified]" VALUE 0x7E4F0 RL_VAL_SW 0 CM_0055 -800 799.9755859 /end CHARACTERISTIC
/begin CHARACTERISTIC K_VR_VORST_MAX "Maximum gain of the pre-control [verified]" VALUE 0x7E4F6 RL_VAL_SW 0 CM_0053 -64 63.99804688 /end CHARACTERISTIC
/begin CHARACTERISTIC K_VR_VORST_MIN "Minimum gain of the pre-control [verified]" VALUE 0x7E4F4 RL_VAL_SW 0 CM_0053 -64 63.99804688 /end CHARACTERISTIC
/begin CHARACTERISTIC K_J_AC "Moment of inertia, A/C compressor [verified]" VALUE 0x7388E RL_VAL_UW 0 CM_0058 0 127.9980469 /end CHARACTERISTIC
/begin CHARACTERISTIC K_J_FZG_DKG_1 "Moment of inertia, vehicle - SMG [verified]" VALUE 0x738B8 RL_VAL_UW 0 CM_0058 0 127.9980469 /end CHARACTERISTIC
/begin CHARACTERISTIC K_J_FZG_DKG_2 "Moment of inertia, vehicle - SMG [verified]" VALUE 0x738BA RL_VAL_UW 0 CM_0058 0 127.9980469 /end CHARACTERISTIC
/begin CHARACTERISTIC K_J_FZG_DKG_3 "Moment of inertia, vehicle - SMG [verified]" VALUE 0x738BC RL_VAL_UW 0 CM_0058 0 127.9980469 /end CHARACTERISTIC
/begin CHARACTERISTIC K_J_FZG_DKG_4 "Moment of inertia, vehicle - SMG [verified]" VALUE 0x738BE RL_VAL_UW 0 CM_0058 0 127.9980469 /end CHARACTERISTIC
/begin CHARACTERISTIC K_J_FZG_DKG_5 "Moment of inertia, vehicle - SMG [verified]" VALUE 0x738C0 RL_VAL_UW 0 CM_0058 0 127.9980469 /end CHARACTERISTIC
/begin CHARACTERISTIC K_J_FZG_DKG_6 "Moment of inertia, vehicle - SMG [verified]" VALUE 0x738C2 RL_VAL_UW 0 CM_0058 0 127.9980469 /end CHARACTERISTIC
/begin CHARACTERISTIC K_J_FZG_DKG_7 "Moment of inertia, vehicle - SMG [verified]" VALUE 0x738C4 RL_VAL_UW 0 CM_0058 0 127.9980469 /end CHARACTERISTIC
/begin CHARACTERISTIC K_J_FZG_DKG_N "Moment of inertia, vehicle - SMG [verified]" VALUE 0x738B6 RL_VAL_UW 0 CM_0058 0 127.9980469 /end CHARACTERISTIC
/begin CHARACTERISTIC K_J_FZG_DKG_R "Moment of inertia, vehicle - SMG [verified]" VALUE 0x738B4 RL_VAL_UW 0 CM_0058 0 127.9980469 /end CHARACTERISTIC
/begin CHARACTERISTIC K_J_FZG_HSG_1 "Moment of inertia, vehicle - SMG [verified]" VALUE 0x738A6 RL_VAL_UW 0 CM_0058 0 127.9980469 /end CHARACTERISTIC
/begin CHARACTERISTIC K_J_FZG_HSG_2 "Moment of inertia, vehicle - SMG [verified]" VALUE 0x738A8 RL_VAL_UW 0 CM_0058 0 127.9980469 /end CHARACTERISTIC
/begin CHARACTERISTIC K_J_FZG_HSG_3 "Moment of inertia, vehicle - SMG [verified]" VALUE 0x738AA RL_VAL_UW 0 CM_0058 0 127.9980469 /end CHARACTERISTIC
/begin CHARACTERISTIC K_J_FZG_HSG_4 "Moment of inertia, vehicle - SMG [verified]" VALUE 0x738AC RL_VAL_UW 0 CM_0058 0 127.9980469 /end CHARACTERISTIC
/begin CHARACTERISTIC K_J_FZG_HSG_5 "Moment of inertia, vehicle - SMG [verified]" VALUE 0x738AE RL_VAL_UW 0 CM_0058 0 127.9980469 /end CHARACTERISTIC
/begin CHARACTERISTIC K_J_FZG_HSG_6 "Moment of inertia, vehicle - SMG [verified]" VALUE 0x738B0 RL_VAL_UW 0 CM_0058 0 127.9980469 /end CHARACTERISTIC
/begin CHARACTERISTIC K_J_FZG_HSG_7 "Moment of inertia, vehicle - SMG [verified]" VALUE 0x738B2 RL_VAL_UW 0 CM_0058 0 127.9980469 /end CHARACTERISTIC
/begin CHARACTERISTIC K_J_FZG_HSG_N "Moment of inertia, vehicle - SMG [verified]" VALUE 0x738A4 RL_VAL_UW 0 CM_0058 0 127.9980469 /end CHARACTERISTIC
/begin CHARACTERISTIC K_J_FZG_HSG_R "Moment of inertia, vehicle - SMG [verified]" VALUE 0x738A2 RL_VAL_UW 0 CM_0058 0 127.9980469 /end CHARACTERISTIC
/begin CHARACTERISTIC K_J_FZG_SMG_1 "Moment of inertia, vehicle - SMG [verified]" VALUE 0x73894 RL_VAL_UW 0 CM_0058 0 127.9980469 /end CHARACTERISTIC
/begin CHARACTERISTIC K_J_FZG_SMG_2 "Moment of inertia, vehicle - SMG [verified]" VALUE 0x73896 RL_VAL_UW 0 CM_0058 0 127.9980469 /end CHARACTERISTIC
/begin CHARACTERISTIC K_J_FZG_SMG_3 "Moment of inertia, vehicle - SMG [verified]" VALUE 0x73898 RL_VAL_UW 0 CM_0058 0 127.9980469 /end CHARACTERISTIC
/begin CHARACTERISTIC K_J_FZG_SMG_4 "Moment of inertia, vehicle - SMG [verified]" VALUE 0x7389A RL_VAL_UW 0 CM_0058 0 127.9980469 /end CHARACTERISTIC
/begin CHARACTERISTIC K_J_FZG_SMG_5 "Moment of inertia, vehicle - SMG [verified]" VALUE 0x7389C RL_VAL_UW 0 CM_0058 0 127.9980469 /end CHARACTERISTIC
/begin CHARACTERISTIC K_J_FZG_SMG_6 "Moment of inertia, vehicle - SMG [verified]" VALUE 0x7389E RL_VAL_UW 0 CM_0058 0 127.9980469 /end CHARACTERISTIC
/begin CHARACTERISTIC K_J_FZG_SMG_7 "Moment of inertia, vehicle - SMG [verified]" VALUE 0x738A0 RL_VAL_UW 0 CM_0058 0 127.9980469 /end CHARACTERISTIC
/begin CHARACTERISTIC K_J_FZG_SMG_N "Moment of inertia, vehicle - SMG [verified]" VALUE 0x73892 RL_VAL_UW 0 CM_0058 0 127.9980469 /end CHARACTERISTIC
/begin CHARACTERISTIC K_J_FZG_SMG_R "Moment of inertia, vehicle - SMG [verified]" VALUE 0x73890 RL_VAL_UW 0 CM_0058 0 127.9980469 /end CHARACTERISTIC
/begin CHARACTERISTIC K_J_MOTOR "Moment of inertia, engine [verified]" VALUE 0x7388C RL_VAL_UW 0 CM_0058 0 127.9980469 /end CHARACTERISTIC
/begin CHARACTERISTIC KF_KA_F "Weighting factor [verified]" MAP 0x73C12 RL_MAP_SW_SW_UW 0 CM_0016 0 63.99902344 /begin AXIS_DESCR STD_AXIS NO_INPUT_QUANTITY CM_0002 18 -32768 32767 /end AXIS_DESCR /begin AXIS_DESCR STD_AXIS NO_INPUT_QUANTITY CM_0003 12 -3.2768 3.2767 /end AXIS_DESCR /end CHARACTERISTIC
/begin CHARACTERISTIC KF_KA_OFFS "Distance to knock limit [verified]" MAP 0x73E00 RL_MAP_SW_SW_SW 0 CM_0028 -3276.8 3276.7 /begin AXIS_DESCR STD_AXIS NO_INPUT_QUANTITY CM_0002 18 -32768 32767 /end AXIS_DESCR /begin AXIS_DESCR STD_AXIS NO_INPUT_QUANTITY CM_0003 12 -3.2768 3.2767 /end AXIS_DESCR /end CHARACTERISTIC
/begin CHARACTERISTIC KF_KA_OFFS_VL "Distance to knock limit [verified]" MAP 0x73A70 RL_MAP_SW_SW_SW 0 CM_0028 -3276.8 3276.7 /begin AXIS_DESCR STD_AXIS NO_INPUT_QUANTITY CM_0002 18 -32768 32767 /end AXIS_DESCR /begin AXIS_DESCR STD_AXIS NO_INPUT_QUANTITY CM_0000 10 -32768 32767 /end AXIS_DESCR /end CHARACTERISTIC
/begin CHARACTERISTIC KF_KA_T_KOMP "Temperature compensation of knock adaptation [verified]" MAP 0x73FEE RL_MAP_SW_SW_SW 0 CM_0028 -3276.8 3276.7 /begin AXIS_DESCR STD_AXIS NO_INPUT_QUANTITY CM_0006 6 -3550 3003.5 /end AXIS_DESCR /begin AXIS_DESCR STD_AXIS NO_INPUT_QUANTITY CM_0006 6 -3550 3003.5 /end AXIS_DESCR /end CHARACTERISTIC
/begin CHARACTERISTIC KL_KA_F_VL "Weighting factor [verified]" CURVE 0x73902 RL_CUR_SW_UW 0 CM_0016 0 63.99902344 /begin AXIS_DESCR STD_AXIS NO_INPUT_QUANTITY CM_0002 18 -32768 32767 /end AXIS_DESCR /end CHARACTERISTIC
/begin CHARACTERISTIC KL_KA_PUMG_VL "Ignition angle offset [verified]" CURVE 0x73962 RL_CUR_SW_SW 0 CM_0028 -3276.8 3276.7 /begin AXIS_DESCR STD_AXIS NO_INPUT_QUANTITY CM_0022 6 -2048 2047.9375 /end AXIS_DESCR /end CHARACTERISTIC
/begin CHARACTERISTIC KL_KA_RF_MIN "Load threshold 0-1 [verified]" CURVE 0x73996 RL_CUR_SW_SW 0 CM_0003 -3.2768 3.2767 /begin AXIS_DESCR STD_AXIS NO_INPUT_QUANTITY CM_0002 10 -32768 32767 /end AXIS_DESCR /end CHARACTERISTIC
/begin CHARACTERISTIC K_KR_APPL_DTZ_ZYL1 "Calibration ignition angle offset [verified]" VALUE 0x74DCC RL_VAL_SW 0 CM_0028 -3276.8 3276.7 /end CHARACTERISTIC
/begin CHARACTERISTIC K_KR_APPL_DTZ_ZYL10 "Calibration ignition angle offset [verified]" VALUE 0x74DDE RL_VAL_SW 0 CM_0028 -3276.8 3276.7 /end CHARACTERISTIC
/begin CHARACTERISTIC K_KR_APPL_DTZ_ZYL2 "Calibration ignition angle offset [verified]" VALUE 0x74DCE RL_VAL_SW 0 CM_0028 -3276.8 3276.7 /end CHARACTERISTIC
/begin CHARACTERISTIC K_KR_APPL_DTZ_ZYL3 "Calibration ignition angle offset [verified]" VALUE 0x74DD0 RL_VAL_SW 0 CM_0028 -3276.8 3276.7 /end CHARACTERISTIC
/begin CHARACTERISTIC K_KR_APPL_DTZ_ZYL4 "Calibration ignition angle offset [verified]" VALUE 0x74DD2 RL_VAL_SW 0 CM_0028 -3276.8 3276.7 /end CHARACTERISTIC
/begin CHARACTERISTIC K_KR_APPL_DTZ_ZYL5 "Calibration ignition angle offset [verified]" VALUE 0x74DD4 RL_VAL_SW 0 CM_0028 -3276.8 3276.7 /end CHARACTERISTIC
/begin CHARACTERISTIC K_KR_APPL_DTZ_ZYL6 "Calibration ignition angle offset [verified]" VALUE 0x74DD6 RL_VAL_SW 0 CM_0028 -3276.8 3276.7 /end CHARACTERISTIC
/begin CHARACTERISTIC K_KR_APPL_DTZ_ZYL7 "Calibration ignition angle offset [verified]" VALUE 0x74DD8 RL_VAL_SW 0 CM_0028 -3276.8 3276.7 /end CHARACTERISTIC
/begin CHARACTERISTIC K_KR_APPL_DTZ_ZYL8 "Calibration ignition angle offset [verified]" VALUE 0x74DDA RL_VAL_SW 0 CM_0028 -3276.8 3276.7 /end CHARACTERISTIC
/begin CHARACTERISTIC K_KR_APPL_DTZ_ZYL9 "Calibration ignition angle offset [verified]" VALUE 0x74DDC RL_VAL_SW 0 CM_0028 -3276.8 3276.7 /end CHARACTERISTIC
/begin CHARACTERISTIC K_KR_APPL_NUM_ZYL1 "Number of calibration ignition-angle adjustments [verified]" VALUE 0x74DC2 RL_VAL_UB 0 CM_0000 0 255 /end CHARACTERISTIC
/begin CHARACTERISTIC K_KR_APPL_NUM_ZYL10 "Number of calibration ignition-angle adjustments [verified]" VALUE 0x74DCB RL_VAL_UB 0 CM_0000 0 255 /end CHARACTERISTIC
/begin CHARACTERISTIC K_KR_APPL_NUM_ZYL2 "Number of calibration ignition-angle adjustments [verified]" VALUE 0x74DC3 RL_VAL_UB 0 CM_0000 0 255 /end CHARACTERISTIC
/begin CHARACTERISTIC K_KR_APPL_NUM_ZYL3 "Number of calibration ignition-angle adjustments [verified]" VALUE 0x74DC4 RL_VAL_UB 0 CM_0000 0 255 /end CHARACTERISTIC
/begin CHARACTERISTIC K_KR_APPL_NUM_ZYL4 "Number of calibration ignition-angle adjustments [verified]" VALUE 0x74DC5 RL_VAL_UB 0 CM_0000 0 255 /end CHARACTERISTIC
/begin CHARACTERISTIC K_KR_APPL_NUM_ZYL5 "Number of calibration ignition-angle adjustments [verified]" VALUE 0x74DC6 RL_VAL_UB 0 CM_0000 0 255 /end CHARACTERISTIC
/begin CHARACTERISTIC K_KR_APPL_NUM_ZYL6 "Number of calibration ignition-angle adjustments [verified]" VALUE 0x74DC7 RL_VAL_UB 0 CM_0000 0 255 /end CHARACTERISTIC
/begin CHARACTERISTIC K_KR_APPL_NUM_ZYL7 "Number of calibration ignition-angle adjustments [verified]" VALUE 0x74DC8 RL_VAL_UB 0 CM_0000 0 255 /end CHARACTERISTIC
/begin CHARACTERISTIC K_KR_APPL_NUM_ZYL8 "Number of calibration ignition-angle adjustments [verified]" VALUE 0x74DC9 RL_VAL_UB 0 CM_0000 0 255 /end CHARACTERISTIC
/begin CHARACTERISTIC K_KR_APPL_NUM_ZYL9 "Number of calibration ignition-angle adjustments [verified]" VALUE 0x74DCA RL_VAL_UB 0 CM_0000 0 255 /end CHARACTERISTIC
/begin CHARACTERISTIC K_KR_KLIPPING_MAX "Maximum permitted clipping in the knock window [V] [verified]" VALUE 0x74DC0 RL_VAL_SW 0 CM_0062 -26.4 26.39919434 /end CHARACTERISTIC
/begin CHARACTERISTIC KF_MD_KUS_KR "Control parameter KR (gain) [verified]" MAP 0x78F22 RL_MAP_SW_SW_SW 0 CM_0063 -327.68 327.67 /begin AXIS_DESCR STD_AXIS NO_INPUT_QUANTITY CM_0016 7 -32 31.99902344 /end AXIS_DESCR /begin AXIS_DESCR STD_AXIS NO_INPUT_QUANTITY CM_0002 6 -32768 32767 /end AXIS_DESCR /end CHARACTERISTIC
/begin CHARACTERISTIC KF_MD_KUS_TV "Control parameter TV (derivative time) [verified]" MAP 0x79002 RL_MAP_SW_SW_SW 0 CM_0064 -32.768 32.767 /begin AXIS_DESCR STD_AXIS NO_INPUT_QUANTITY CM_0016 7 -32 31.99902344 /end AXIS_DESCR /begin AXIS_DESCR STD_AXIS NO_INPUT_QUANTITY CM_0002 6 -32768 32767 /end AXIS_DESCR /end CHARACTERISTIC
/begin CHARACTERISTIC KL_MD_KUS_KR_FAK "Factor on KR (gain) [verified]" CURVE 0x78EC2 RL_CUR_SW_UW 0 CM_0016 0 63.99902344 /begin AXIS_DESCR STD_AXIS NO_INPUT_QUANTITY CM_0002 6 -32768 32767 /end AXIS_DESCR /end CHARACTERISTIC
/begin CHARACTERISTIC KL_MD_KUS_KUPP_MIN "Maximum IPM clutch torque [verified]" CURVE 0x78EDC RL_CUR_SW_SW 0 CM_0017 -3276.8 3276.7 /begin AXIS_DESCR STD_AXIS NO_INPUT_QUANTITY CM_0002 4 -32768 32767 /end AXIS_DESCR /end CHARACTERISTIC
/begin CHARACTERISTIC KL_MD_KUS_TN_FAK "Factor on TN (integral time) [verified]" CURVE 0x78EEE RL_CUR_SW_UW 0 CM_0016 0 63.99902344 /begin AXIS_DESCR STD_AXIS NO_INPUT_QUANTITY CM_0002 6 -32768 32767 /end AXIS_DESCR /end CHARACTERISTIC
/begin CHARACTERISTIC KL_MD_KUS_TV_FAK "Factor on TV (derivative time) [verified]" CURVE 0x78F08 RL_CUR_SW_UW 0 CM_0016 0 63.99902344 /begin AXIS_DESCR STD_AXIS NO_INPUT_QUANTITY CM_0002 6 -32768 32767 /end AXIS_DESCR /end CHARACTERISTIC
/begin CHARACTERISTIC K_MD_KUS_BEGR_TAU1_AUS "Time constant soft ramp-up, off [s] [verified]" VALUE 0x78EBF RL_VAL_UB 0 CM_0065 0.005019607843 1.28 /end CHARACTERISTIC
/begin CHARACTERISTIC K_MD_KUS_BEGR_TAU1_EIN "Time constant soft ramp-up, on [s] [verified]" VALUE 0x78EBE RL_VAL_UB 0 CM_0065 0.005019607843 1.28 /end CHARACTERISTIC
/begin CHARACTERISTIC K_MD_KUS_BEGR_TAU_AUS "Time constant soft ramp-up, off [s] [verified]" VALUE 0x78EC1 RL_VAL_UB 0 CM_0065 0.005019607843 1.28 /end CHARACTERISTIC
/begin CHARACTERISTIC K_MD_KUS_BEGR_TAU_EIN "Time constant soft ramp-up, on [s] [verified]" VALUE 0x78EC0 RL_VAL_UB 0 CM_0065 0.005019607843 1.28 /end CHARACTERISTIC
/begin CHARACTERISTIC K_MD_KUS_PID_A1 "Coefficient a1, PID controller [verified]" VALUE 0x78EBC RL_VAL_SW 0 CM_0039 -327.68 327.67 /end CHARACTERISTIC
/begin CHARACTERISTIC KF_LLR_MD_I_NEG_MKS "Integral share for negative deviation [verified]" MAP 0x76718 RL_MAP_SW_SW_SW 0 CM_0066 -6553.6 6553.4 /begin AXIS_DESCR STD_AXIS NO_INPUT_QUANTITY CM_0002 8 -32768 32767 /end AXIS_DESCR /begin AXIS_DESCR STD_AXIS NO_INPUT_QUANTITY CM_0067 12 -32768 32767 /end AXIS_DESCR /end CHARACTERISTIC
/begin CHARACTERISTIC KF_LLR_MD_I_NEG_OKS "Integral share for negative deviation [verified]" MAP 0x76544 RL_MAP_SW_SW_SW 0 CM_0066 -6553.6 6553.4 /begin AXIS_DESCR STD_AXIS NO_INPUT_QUANTITY CM_0002 8 -32768 32767 /end AXIS_DESCR /begin AXIS_DESCR STD_AXIS NO_INPUT_QUANTITY CM_0067 12 -32768 32767 /end AXIS_DESCR /end CHARACTERISTIC
/begin CHARACTERISTIC KF_LLR_MD_I_POS_MKS "Integral share for positive deviation [verified]" MAP 0x7662E RL_MAP_SW_SW_SW 0 CM_0066 -6553.6 6553.4 /begin AXIS_DESCR STD_AXIS NO_INPUT_QUANTITY CM_0002 8 -32768 32767 /end AXIS_DESCR /begin AXIS_DESCR STD_AXIS NO_INPUT_QUANTITY CM_0067 12 -32768 32767 /end AXIS_DESCR /end CHARACTERISTIC
/begin CHARACTERISTIC KF_LLR_MD_I_POS_OKS "Integral share for positive deviation [verified]" MAP 0x7645A RL_MAP_SW_SW_SW 0 CM_0066 -6553.6 6553.4 /begin AXIS_DESCR STD_AXIS NO_INPUT_QUANTITY CM_0002 8 -32768 32767 /end AXIS_DESCR /begin AXIS_DESCR STD_AXIS NO_INPUT_QUANTITY CM_0067 12 -32768 32767 /end AXIS_DESCR /end CHARACTERISTIC
/begin CHARACTERISTIC KL_LLR_D_FAK_TOEL "Derivative share [verified]" CURVE 0x76328 RL_CUR_SW_UW 0 CM_0016 0 63.99902344 /begin AXIS_DESCR STD_AXIS NO_INPUT_QUANTITY CM_0006 8 -3550 3003.5 /end AXIS_DESCR /end CHARACTERISTIC
/begin CHARACTERISTIC KL_LLR_MD_RES_TMOT "Reserve over engine temperature [verified]" CURVE 0x7634A RL_CUR_SW_SW 0 CM_0017 -3276.8 3276.7 /begin AXIS_DESCR STD_AXIS NO_INPUT_QUANTITY CM_0006 8 -3550 3003.5 /end AXIS_DESCR /end CHARACTERISTIC
/begin CHARACTERISTIC KL_LLR_MD_TZ_MKS_KH "Idle controller ignition intervention during catalyst heating [verified]" CURVE 0x763EC RL_CUR_SW_SW 0 CM_0017 -3276.8 3276.7 /begin AXIS_DESCR STD_AXIS NO_INPUT_QUANTITY CM_0002 9 -32768 32767 /end AXIS_DESCR /end CHARACTERISTIC
/begin CHARACTERISTIC KL_LLR_MD_TZ_OKS "Idle controller ignition intervention [verified]" CURVE 0x7637A RL_CUR_SW_SW 0 CM_0017 -3276.8 3276.7 /begin AXIS_DESCR STD_AXIS NO_INPUT_QUANTITY CM_0002 9 -32768 32767 /end AXIS_DESCR /end CHARACTERISTIC
/begin CHARACTERISTIC KL_LLR_N_SOLL_KH3 "Offset during catalyst heating [EST]" CURVE 0x762D8 RL_CUR_SW_SW 0 CM_0002 -32768 32767 /begin AXIS_DESCR STD_AXIS NO_INPUT_QUANTITY CM_0006 6 -3550 3003.5 /end AXIS_DESCR /end CHARACTERISTIC
/begin CHARACTERISTIC KL_LLR_N_SOLL_TMOT "Idle speed over engine temperature [verified]" CURVE 0x76294 RL_CUR_SW_SW 0 CM_0002 -32768 32767 /begin AXIS_DESCR STD_AXIS NO_INPUT_QUANTITY CM_0006 8 -3550 3003.5 /end AXIS_DESCR /end CHARACTERISTIC
/begin CHARACTERISTIC KL_LLR_N_SOLL_TOEL_OFF "Offset over oil temperature [verified]" CURVE 0x762B6 RL_CUR_SW_SW 0 CM_0002 -32768 32767 /begin AXIS_DESCR STD_AXIS NO_INPUT_QUANTITY CM_0006 8 -3550 3003.5 /end AXIS_DESCR /end CHARACTERISTIC
/begin CHARACTERISTIC KF_LAZ_TAU "Time constant for LAZ (roughness) [verified]" MAP 0x7619E RL_MAP_SW_SW_UB 0 CM_0027 0 255 /begin AXIS_DESCR STD_AXIS NO_INPUT_QUANTITY CM_0002 8 -32768 32767 /end AXIS_DESCR /begin AXIS_DESCR STD_AXIS NO_INPUT_QUANTITY CM_0003 8 -3.2768 3.2767 /end AXIS_DESCR /end CHARACTERISTIC
/begin CHARACTERISTIC K_LAZ_ANZ_SEG "Number of delay segments [verified]" VALUE 0x7619C RL_VAL_UB 0 CM_0000 0 255 /end CHARACTERISTIC
/begin CHARACTERISTIC KF_MD_DELTA_DP_ON "Activation threshold [verified]" MAP 0x781F8 RL_MAP_SW_SW_SW 0 CM_0017 -3276.8 3276.7 /begin AXIS_DESCR STD_AXIS NO_INPUT_QUANTITY CM_0015 7 -32768 32767 /end AXIS_DESCR /begin AXIS_DESCR STD_AXIS NO_INPUT_QUANTITY CM_0017 9 -3276.8 3276.7 /end AXIS_DESCR /end CHARACTERISTIC
/begin CHARACTERISTIC KF_MD_DYN_FIL_RES "Torque reserve [verified]" MAP 0x786EE RL_MAP_SW_SW_SW 0 CM_0017 -3276.8 3276.7 /begin AXIS_DESCR STD_AXIS NO_INPUT_QUANTITY CM_0015 7 -32768 32767 /end AXIS_DESCR /begin AXIS_DESCR STD_AXIS NO_INPUT_QUANTITY CM_0017 9 -3276.8 3276.7 /end AXIS_DESCR /end CHARACTERISTIC
/begin CHARACTERISTIC KF_MD_DYN_FIL_RES_FAK "Torque reserve [verified]" MAP 0x7878E RL_MAP_SW_SW_UW 0 CM_0016 0 63.99902344 /begin AXIS_DESCR STD_AXIS NO_INPUT_QUANTITY CM_0013 7 -3276.8 3276.7 /end AXIS_DESCR /begin AXIS_DESCR STD_AXIS NO_INPUT_QUANTITY CM_0017 7 -3276.8 3276.7 /end AXIS_DESCR /end CHARACTERISTIC
/begin CHARACTERISTIC KF_MD_ETA_LA "Lambda efficiency [verified]" MAP 0x77AC8 RL_MAP_SW_SW_UW 0 CM_0050 0 199.9969474 /begin AXIS_DESCR STD_AXIS NO_INPUT_QUANTITY CM_0028 8 -3276.8 3276.7 /end AXIS_DESCR
 /begin AXIS_DESCR STD_AXIS NO_INPUT_QUANTITY CM_0019 8 -2.000001434 1.999940398 /end AXIS_DESCR
/end CHARACTERISTIC
/begin CHARACTERISTIC KF_MD_FAHRER_KOMFORT "Driver demand (pedal map) - Komfort (with M-Drive option), SMG/manual [verified]" MAP 0x794AA RL_MAP_SW_SW_SW 0 CM_0013 -3276.8 3276.7 /begin AXIS_DESCR STD_AXIS NO_INPUT_QUANTITY CM_0002 12 -32768 32767 /end AXIS_DESCR /begin AXIS_DESCR STD_AXIS NO_INPUT_QUANTITY CM_0013 12 -3276.8 3276.7 /end AXIS_DESCR /end CHARACTERISTIC
/begin CHARACTERISTIC KF_MD_FAHRER_KOMFORT_DKG "Driver demand (pedal map) - Komfort, DKG gearbox [verified]" MAP 0x795FC RL_MAP_SW_SW_SW 0 CM_0013 -3276.8 3276.7 /begin AXIS_DESCR STD_AXIS NO_INPUT_QUANTITY CM_0002 12 -32768 32767 /end AXIS_DESCR /begin AXIS_DESCR STD_AXIS NO_INPUT_QUANTITY CM_0013 12 -3276.8 3276.7 /end AXIS_DESCR /end CHARACTERISTIC
/begin CHARACTERISTIC KF_MD_FAHRER_MUEDE "Driver demand (pedal map) - 'Muede' soft map, used without M-Drive option (Sport button off) [verified]" MAP 0x79C96 RL_MAP_SW_SW_SW 0 CM_0013 -3276.8 3276.7 /begin AXIS_DESCR STD_AXIS NO_INPUT_QUANTITY CM_0002 12 -32768 32767 /end AXIS_DESCR /begin AXIS_DESCR STD_AXIS NO_INPUT_QUANTITY CM_0013 12 -3276.8 3276.7 /end AXIS_DESCR /end CHARACTERISTIC
/begin CHARACTERISTIC KF_MD_FAHRER_MUEDE_DKG "Driver demand (pedal map) - 'Muede' soft map, DKG, without M-Drive option [verified]" MAP 0x79DE8 RL_MAP_SW_SW_SW 0 CM_0013 -3276.8 3276.7 /begin AXIS_DESCR STD_AXIS NO_INPUT_QUANTITY CM_0002 12 -32768 32767 /end AXIS_DESCR /begin AXIS_DESCR STD_AXIS NO_INPUT_QUANTITY CM_0013 12 -3276.8 3276.7 /end AXIS_DESCR /end CHARACTERISTIC
/begin CHARACTERISTIC KF_MD_FAHRER_MUNTER "Driver demand (pedal map) - 'Munter' lively map, used without M-Drive option (Sport button on); shared by SMG/manual and DKG [verified]" MAP 0x79F3A RL_MAP_SW_SW_SW 0 CM_0013 -3276.8 3276.7 /begin AXIS_DESCR STD_AXIS NO_INPUT_QUANTITY CM_0002 12 -32768 32767 /end AXIS_DESCR /begin AXIS_DESCR STD_AXIS NO_INPUT_QUANTITY CM_0013 12 -3276.8 3276.7 /end AXIS_DESCR /end CHARACTERISTIC
/begin CHARACTERISTIC KF_MD_FAHRER_NORMAL "Driver demand (pedal map) - Normal (with M-Drive option) [verified]" MAP 0x7974E RL_MAP_SW_SW_SW 0 CM_0013 -3276.8 3276.7 /begin AXIS_DESCR STD_AXIS NO_INPUT_QUANTITY CM_0002 12 -32768 32767 /end AXIS_DESCR /begin AXIS_DESCR STD_AXIS NO_INPUT_QUANTITY CM_0013 12 -3276.8 3276.7 /end AXIS_DESCR /end CHARACTERISTIC
/begin CHARACTERISTIC KF_MD_FAHRER_NORMAL_DKG "Driver demand (pedal map) - Normal, DKG gearbox (previously mislabelled KF_MD_FAHRER_KOMFORT) [verified]" MAP 0x798A0 RL_MAP_SW_SW_SW 0 CM_0013 -3276.8 3276.7 /begin AXIS_DESCR STD_AXIS NO_INPUT_QUANTITY CM_0002 12 -32768 32767 /end AXIS_DESCR /begin AXIS_DESCR STD_AXIS NO_INPUT_QUANTITY CM_0013 12 -3276.8 3276.7 /end AXIS_DESCR /end CHARACTERISTIC
/begin CHARACTERISTIC KF_MD_FAHRER_PST "Driver demand - test bench [verified]" MAP 0x7A08C RL_MAP_SW_SW_SW 0 CM_0013 -3276.8 3276.7 /begin AXIS_DESCR STD_AXIS NO_INPUT_QUANTITY CM_0002 12 -32768 32767 /end AXIS_DESCR /begin AXIS_DESCR STD_AXIS NO_INPUT_QUANTITY CM_0013 12 -3276.8 3276.7 /end AXIS_DESCR /end CHARACTERISTIC
/begin CHARACTERISTIC KF_MD_FAHRER_SPORT "Driver demand (pedal map) - Sport (with M-Drive option) [verified]" MAP 0x799F2 RL_MAP_SW_SW_SW 0 CM_0013 -3276.8 3276.7 /begin AXIS_DESCR STD_AXIS NO_INPUT_QUANTITY CM_0002 12 -32768 32767 /end AXIS_DESCR /begin AXIS_DESCR STD_AXIS NO_INPUT_QUANTITY CM_0013 12 -3276.8 3276.7 /end AXIS_DESCR /end CHARACTERISTIC
/begin CHARACTERISTIC KF_MD_FAHRER_SPORT_DKG "Driver demand (pedal map) - Sport, DKG gearbox [verified]" MAP 0x79B44 RL_MAP_SW_SW_SW 0 CM_0013 -3276.8 3276.7 /begin AXIS_DESCR STD_AXIS NO_INPUT_QUANTITY CM_0002 12 -32768 32767 /end AXIS_DESCR /begin AXIS_DESCR STD_AXIS NO_INPUT_QUANTITY CM_0013 12 -3276.8 3276.7 /end AXIS_DESCR /end CHARACTERISTIC
/begin CHARACTERISTIC KF_MD_FAK_GRAD_DP_B2 "Dashpot weighting, range 2 [verified]" MAP 0x7868A RL_MAP_SW_SW_UW 0 CM_0016 0 63.99902344 /begin AXIS_DESCR STD_AXIS NO_INPUT_QUANTITY CM_0007 4 -655360 655340 /end AXIS_DESCR /begin AXIS_DESCR STD_AXIS NO_INPUT_QUANTITY CM_0017 4 -3276.8 3276.7 /end AXIS_DESCR /end CHARACTERISTIC
/begin CHARACTERISTIC KF_MD_FAK_GRAD_DP_B3 "Dashpot weighting, range 3 [verified]" MAP 0x786BC RL_MAP_SW_SW_UW 0 CM_0016 0 63.99902344 /begin AXIS_DESCR STD_AXIS NO_INPUT_QUANTITY CM_0007 4 -655360 655340 /end AXIS_DESCR /begin AXIS_DESCR STD_AXIS NO_INPUT_QUANTITY CM_0017 4 -3276.8 3276.7 /end AXIS_DESCR /end CHARACTERISTIC
/begin CHARACTERISTIC KF_MD_FR_WICHT "Weighting map for charge controller and fra_out [verified]" MAP 0x7A4BA RL_MAP_SW_SW_UW 0 CM_0051 0 1.999970916 /begin AXIS_DESCR STD_AXIS NO_INPUT_QUANTITY CM_0002 6 -32768 32767 /end AXIS_DESCR /begin AXIS_DESCR STD_AXIS NO_INPUT_QUANTITY CM_0003 6 -3.2768 3.2767 /end AXIS_DESCR /end CHARACTERISTIC
/begin CHARACTERISTIC KF_MD_GRAD_DP_B1 "Gradient, range 1 [verified]" MAP 0x783D8 RL_MAP_SW_SW_SW 0 CM_0068 -32768 32767 /begin AXIS_DESCR STD_AXIS NO_INPUT_QUANTITY CM_0015 7 -32768 32767 /end AXIS_DESCR /begin AXIS_DESCR STD_AXIS NO_INPUT_QUANTITY CM_0002 9 -32768 32767 /end AXIS_DESCR /end CHARACTERISTIC
/begin CHARACTERISTIC KF_MD_GRAD_DP_B2 "Gradient, range 2 [verified]" MAP 0x78478 RL_MAP_SW_SW_SW 0 CM_0068 -32768 32767 /begin AXIS_DESCR STD_AXIS NO_INPUT_QUANTITY CM_0015 7 -32768 32767 /end AXIS_DESCR /begin AXIS_DESCR STD_AXIS NO_INPUT_QUANTITY CM_0002 9 -32768 32767 /end AXIS_DESCR /end CHARACTERISTIC
/begin CHARACTERISTIC KF_MD_GRAD_DP_B3 "Gradient, range 3 [verified]" MAP 0x78518 RL_MAP_SW_SW_SW 0 CM_0068 -32768 32767 /begin AXIS_DESCR STD_AXIS NO_INPUT_QUANTITY CM_0015 7 -32768 32767 /end AXIS_DESCR /begin AXIS_DESCR STD_AXIS NO_INPUT_QUANTITY CM_0002 9 -32768 32767 /end AXIS_DESCR /end CHARACTERISTIC
/begin CHARACTERISTIC KF_MD_GRAD_DP_LLMKS "Gradient at idle with clutch closed [verified]" MAP 0x785B8 RL_MAP_SW_SW_SW 0 CM_0068 -32768 32767 /begin AXIS_DESCR STD_AXIS NO_INPUT_QUANTITY CM_0015 7 -32768 32767 /end AXIS_DESCR /begin AXIS_DESCR STD_AXIS NO_INPUT_QUANTITY CM_0002 9 -32768 32767 /end AXIS_DESCR /end CHARACTERISTIC
/begin CHARACTERISTIC KF_MD_GRAD_LSD_B1 "Gradient, range 1 [verified]" MAP 0x77F78 RL_MAP_SW_SW_SW 0 CM_0068 -32768 32767 /begin AXIS_DESCR STD_AXIS NO_INPUT_QUANTITY CM_0015 7 -32768 32767 /end AXIS_DESCR /begin AXIS_DESCR STD_AXIS NO_INPUT_QUANTITY CM_0002 9 -32768 32767 /end AXIS_DESCR /end CHARACTERISTIC
/begin CHARACTERISTIC KF_MD_GRAD_LSD_B2 "Gradient, range 2 [verified]" MAP 0x78018 RL_MAP_SW_SW_SW 0 CM_0068 -32768 32767 /begin AXIS_DESCR STD_AXIS NO_INPUT_QUANTITY CM_0015 7 -32768 32767 /end AXIS_DESCR /begin AXIS_DESCR STD_AXIS NO_INPUT_QUANTITY CM_0002 9 -32768 32767 /end AXIS_DESCR /end CHARACTERISTIC
/begin CHARACTERISTIC KF_MD_GRAD_LSD_B3 "Gradient, range 3 [verified]" MAP 0x780B8 RL_MAP_SW_SW_SW 0 CM_0068 -32768 32767 /begin AXIS_DESCR STD_AXIS NO_INPUT_QUANTITY CM_0015 7 -32768 32767 /end AXIS_DESCR /begin AXIS_DESCR STD_AXIS NO_INPUT_QUANTITY CM_0002 9 -32768 32767 /end AXIS_DESCR /end CHARACTERISTIC
/begin CHARACTERISTIC KF_MD_GRAD_LSD_LLMKS "Gradient at idle with clutch closed [verified]" MAP 0x78158 RL_MAP_SW_SW_SW 0 CM_0068 -32768 32767 /begin AXIS_DESCR STD_AXIS NO_INPUT_QUANTITY CM_0015 7 -32768 32767 /end AXIS_DESCR /begin AXIS_DESCR STD_AXIS NO_INPUT_QUANTITY CM_0002 9 -32768 32767 /end AXIS_DESCR /end CHARACTERISTIC
/begin CHARACTERISTIC KF_MD_IND_LW_VERLUSTE "Gas-exchange (pumping) losses [verified]" MAP 0x770DA RL_MAP_SW_SW_SW 0 CM_0017 -3276.8 3276.7 /begin AXIS_DESCR STD_AXIS NO_INPUT_QUANTITY CM_0002 10 -32768 32767 /end AXIS_DESCR /begin AXIS_DESCR STD_AXIS NO_INPUT_QUANTITY CM_0003 8 -3.2768 3.2767 /end AXIS_DESCR /end CHARACTERISTIC
/begin CHARACTERISTIC KF_MD_IND_MIN_SCHUB "Minimum overrun torque [verified]" MAP 0x76FBA RL_MAP_SW_SW_SW 0 CM_0017 -3276.8 3276.7 /begin AXIS_DESCR STD_AXIS NO_INPUT_QUANTITY CM_0002 8 -32768 32767 /end AXIS_DESCR /begin AXIS_DESCR STD_AXIS NO_INPUT_QUANTITY CM_0006 6 -3550 3003.5 /end AXIS_DESCR /end CHARACTERISTIC
/begin CHARACTERISTIC KF_MD_IND_OPT "Optimum torque at lambda 1 [verified]" MAP 0x76D4E RL_MAP_SW_SW_SW 0 CM_0017 -3276.8 3276.7 /begin AXIS_DESCR STD_AXIS NO_INPUT_QUANTITY CM_0002 18 -32768 32767 /end AXIS_DESCR /begin AXIS_DESCR STD_AXIS NO_INPUT_QUANTITY CM_0003 12 -3.2768 3.2767 /end AXIS_DESCR /end CHARACTERISTIC
/begin CHARACTERISTIC KF_MD_IND_REIB "Friction torque [verified]" MAP 0x77038 RL_MAP_SW_SW_SW 0 CM_0017 -3276.8 3276.7 /begin AXIS_DESCR STD_AXIS NO_INPUT_QUANTITY CM_0006 8 -3550 3003.5 /end AXIS_DESCR /begin AXIS_DESCR STD_AXIS NO_INPUT_QUANTITY CM_0006 8 -3550 3003.5 /end AXIS_DESCR /end CHARACTERISTIC
/begin CHARACTERISTIC KF_MD_KKOS_KORR "Corrected A/C compressor torque [verified]" MAP 0x77CC6 RL_MAP_SW_SW_SW 0 CM_0017 -3276.8 3276.7 /begin AXIS_DESCR STD_AXIS NO_INPUT_QUANTITY CM_0002 5 -32768 32767 /end AXIS_DESCR /begin AXIS_DESCR STD_AXIS NO_INPUT_QUANTITY CM_0017 5 -3276.8 3276.7 /end AXIS_DESCR /end CHARACTERISTIC
/begin CHARACTERISTIC KF_MD_KOMFORT_DP "Weighting factor, Comfort [verified]" MAP 0x789AE RL_MAP_SW_SW_UW 0 CM_0016 0 63.99902344 /begin AXIS_DESCR STD_AXIS NO_INPUT_QUANTITY CM_0069 3 -32767 32768 /end AXIS_DESCR /begin AXIS_DESCR STD_AXIS NO_INPUT_QUANTITY CM_0015 7 -32768 32767 /end AXIS_DESCR /end CHARACTERISTIC
/begin CHARACTERISTIC KF_MD_KOMFORT_LSD "Weighting factor, Comfort [verified]" MAP 0x788AE RL_MAP_SW_SW_UW 0 CM_0016 0 63.99902344 /begin AXIS_DESCR STD_AXIS NO_INPUT_QUANTITY CM_0069 3 -32767 32768 /end AXIS_DESCR /begin AXIS_DESCR STD_AXIS NO_INPUT_QUANTITY CM_0015 7 -32768 32767 /end AXIS_DESCR /end CHARACTERISTIC
/begin CHARACTERISTIC KF_MD_KUPP_GRENZ_DP_O "Transition range 2 to 3 [verified]" MAP 0x78338 RL_MAP_SW_SW_SW 0 CM_0017 -3276.8 3276.7 /begin AXIS_DESCR STD_AXIS NO_INPUT_QUANTITY CM_0015 7 -32768 32767 /end AXIS_DESCR /begin AXIS_DESCR STD_AXIS NO_INPUT_QUANTITY CM_0002 9 -32768 32767 /end AXIS_DESCR /end CHARACTERISTIC
/begin CHARACTERISTIC KF_MD_KUPP_GRENZ_DP_U_OFFS "Transition range 1 to 2 [verified]" MAP 0x78298 RL_MAP_SW_SW_SW 0 CM_0017 -3276.8 3276.7 /begin AXIS_DESCR STD_AXIS NO_INPUT_QUANTITY CM_0015 7 -32768 32767 /end AXIS_DESCR /begin AXIS_DESCR STD_AXIS NO_INPUT_QUANTITY CM_0002 9 -32768 32767 /end AXIS_DESCR /end CHARACTERISTIC
/begin CHARACTERISTIC KF_MD_NBEGR_KR "Control parameter KR (gain) [verified]" MAP 0x7A26E RL_MAP_SW_SW_UW 0 CM_0063 0 655.35 /begin AXIS_DESCR STD_AXIS NO_INPUT_QUANTITY CM_0015 8 -32768 32767 /end AXIS_DESCR /begin AXIS_DESCR STD_AXIS NO_INPUT_QUANTITY CM_0002 6 -32768 32767 /end AXIS_DESCR /end CHARACTERISTIC
/begin CHARACTERISTIC KF_MD_NBEGR_TN "Control parameter TN (integral time) [verified]" MAP 0x7A2EC RL_MAP_SW_SW_UW 0 CM_0070 0 65.535 /begin AXIS_DESCR STD_AXIS NO_INPUT_QUANTITY CM_0015 8 -32768 32767 /end AXIS_DESCR /begin AXIS_DESCR STD_AXIS NO_INPUT_QUANTITY CM_0002 6 -32768 32767 /end AXIS_DESCR /end CHARACTERISTIC
/begin CHARACTERISTIC KF_MD_NBEGR_TV "Control parameter TV (derivative time) [verified]" MAP 0x7A36A RL_MAP_SW_SW_UW 0 CM_0070 0 65.535 /begin AXIS_DESCR STD_AXIS NO_INPUT_QUANTITY CM_0015 8 -32768 32767 /end AXIS_DESCR /begin AXIS_DESCR STD_AXIS NO_INPUT_QUANTITY CM_0002 6 -32768 32767 /end AXIS_DESCR /end CHARACTERISTIC
/begin CHARACTERISTIC KF_MD_POLYNOM_A "A parameter of polynomial for ignition hook (torque vs spark) [verified]" MAP 0x77562 RL_MAP_SW_SW_SW 0 CM_0071 -327.68 327.67 /begin AXIS_DESCR STD_AXIS NO_INPUT_QUANTITY CM_0002 18 -32768 32767 /end AXIS_DESCR /begin AXIS_DESCR STD_AXIS NO_INPUT_QUANTITY CM_0003 12 -3.2768 3.2767 /end AXIS_DESCR /end CHARACTERISTIC
/begin CHARACTERISTIC KF_MD_POLYNOM_B "B parameter of polynomial for ignition hook [verified]" MAP 0x7793E RL_MAP_SW_SW_SW 0 CM_0071 -327.68 327.67 /begin AXIS_DESCR STD_AXIS NO_INPUT_QUANTITY CM_0002 6 -32768 32767 /end AXIS_DESCR /begin AXIS_DESCR STD_AXIS NO_INPUT_QUANTITY CM_0003 4 -3.2768 3.2767 /end AXIS_DESCR /end CHARACTERISTIC
/begin CHARACTERISTIC KF_MD_SMG_BEGR_OFF "Maximum offset on driver demand [verified]" MAP 0x7A1DE RL_MAP_SW_SW_SW 0 CM_0017 -3276.8 3276.7 /begin AXIS_DESCR STD_AXIS NO_INPUT_QUANTITY CM_0017 5 -3276.8 3276.7 /end AXIS_DESCR /begin AXIS_DESCR STD_AXIS NO_INPUT_QUANTITY CM_0002 5 -32768 32767 /end AXIS_DESCR /end CHARACTERISTIC
/begin CHARACTERISTIC KF_MD_SPORT_DP "Weighting factor, Sport [verified]" MAP 0x788EE RL_MAP_SW_SW_UW 0 CM_0016 0 63.99902344 /begin AXIS_DESCR STD_AXIS NO_INPUT_QUANTITY CM_0069 3 -32767 32768 /end AXIS_DESCR /begin AXIS_DESCR STD_AXIS NO_INPUT_QUANTITY CM_0015 7 -32768 32767 /end AXIS_DESCR /end CHARACTERISTIC
/begin CHARACTERISTIC KF_MD_VBEGR_KR "Control parameter KR (gain) [verified]" MAP 0x7A3E8 RL_MAP_SW_SW_UW 0 CM_0072 0 655.35 /begin AXIS_DESCR STD_AXIS NO_INPUT_QUANTITY CM_0015 4 -32768 32767 /end AXIS_DESCR /begin AXIS_DESCR STD_AXIS NO_INPUT_QUANTITY CM_0010 6 -2048 2047.9375 /end AXIS_DESCR /end CHARACTERISTIC
/begin CHARACTERISTIC KF_MD_VBEGR_TN "Control parameter TN (integral time) [verified]" MAP 0x7A42E RL_MAP_SW_SW_UW 0 CM_0070 0 65.535 /begin AXIS_DESCR STD_AXIS NO_INPUT_QUANTITY CM_0015 4 -32768 32767 /end AXIS_DESCR /begin AXIS_DESCR STD_AXIS NO_INPUT_QUANTITY CM_0010 6 -2048 2047.9375 /end AXIS_DESCR /end CHARACTERISTIC
/begin CHARACTERISTIC KF_MD_VBEGR_TV "Control parameter TV (derivative time) [verified]" MAP 0x7A474 RL_MAP_SW_SW_UW 0 CM_0070 0 65.535 /begin AXIS_DESCR STD_AXIS NO_INPUT_QUANTITY CM_0015 4 -32768 32767 /end AXIS_DESCR /begin AXIS_DESCR STD_AXIS NO_INPUT_QUANTITY CM_0010 6 -2048 2047.9375 /end AXIS_DESCR /end CHARACTERISTIC
/begin CHARACTERISTIC KF_MD_VERBR_FZG "Vehicle consumer (accessory) offset [verified]" MAP 0x77A20 RL_MAP_SW_SW_SW 0 CM_0017 -3276.8 3276.7 /begin AXIS_DESCR STD_AXIS NO_INPUT_QUANTITY CM_0002 6 -32768 32767 /end AXIS_DESCR /begin AXIS_DESCR STD_AXIS NO_INPUT_QUANTITY CM_0006 5 -3550 3003.5 /end AXIS_DESCR /end CHARACTERISTIC
/begin CHARACTERISTIC KF_MD_WUNSCH_REL_KOMFORT "Desired output torque - Comfort [verified]" MAP 0x78B62 RL_MAP_SW_SW_SW 0 CM_0013 -3276.8 3276.7 /begin AXIS_DESCR STD_AXIS NO_INPUT_QUANTITY CM_0010 12 -2048 2047.9375 /end AXIS_DESCR /begin AXIS_DESCR STD_AXIS NO_INPUT_QUANTITY CM_0013 10 -3276.8 3276.7 /end AXIS_DESCR /end CHARACTERISTIC
/begin CHARACTERISTIC KF_MD_WUNSCH_REL_NORMAL "Desired output torque - Normal [verified]" MAP 0x78C80 RL_MAP_SW_SW_SW 0 CM_0013 -3276.8 3276.7 /begin AXIS_DESCR STD_AXIS NO_INPUT_QUANTITY CM_0010 12 -2048 2047.9375 /end AXIS_DESCR /begin AXIS_DESCR STD_AXIS NO_INPUT_QUANTITY CM_0013 10 -3276.8 3276.7 /end AXIS_DESCR /end CHARACTERISTIC
/begin CHARACTERISTIC KF_MD_WUNSCH_REL_SPORT "Desired output torque - Sport [verified]" MAP 0x78D9E RL_MAP_SW_SW_SW 0 CM_0013 -3276.8 3276.7 /begin AXIS_DESCR STD_AXIS NO_INPUT_QUANTITY CM_0010 12 -2048 2047.9375 /end AXIS_DESCR /begin AXIS_DESCR STD_AXIS NO_INPUT_QUANTITY CM_0013 10 -3276.8 3276.7 /end AXIS_DESCR /end CHARACTERISTIC
/begin CHARACTERISTIC KF_MD_ZW_OFFSET "Ignition-angle offset over engine speed and charge [verified]" MAP 0x773D4 RL_MAP_SW_SW_SW 0 CM_0028 -3276.8 3276.7 /begin AXIS_DESCR STD_AXIS NO_INPUT_QUANTITY CM_0002 4 -32768 32767 /end AXIS_DESCR /begin AXIS_DESCR STD_AXIS NO_INPUT_QUANTITY CM_0003 5 -3.2768 3.2767 /end AXIS_DESCR /end CHARACTERISTIC
/begin CHARACTERISTIC KF_MD_ZW_OPT "Optimum ignition hook [verified]" MAP 0x7E258 RL_MAP_SW_SW_SW 0 CM_0028 -3276.8 3276.7 /begin AXIS_DESCR STD_AXIS NO_INPUT_QUANTITY CM_0002 18 -32768 32767 /end AXIS_DESCR /begin AXIS_DESCR STD_AXIS NO_INPUT_QUANTITY CM_0003 12 -3.2768 3.2767 /end AXIS_DESCR /end CHARACTERISTIC
/begin CHARACTERISTIC KL_MD_ABTRIEB_NULL_KOMFORT "Zero output torque - Comfort [verified]" CURVE 0x78AB2 RL_CUR_SW_SW 0 CM_0013 -3276.8 3276.7 /begin AXIS_DESCR STD_AXIS NO_INPUT_QUANTITY CM_0010 6 -2048 2047.9375 /end AXIS_DESCR /end CHARACTERISTIC
/begin CHARACTERISTIC KL_MD_ABTRIEB_NULL_SPORT "Zero output torque - Sport [verified]" CURVE 0x78ACC RL_CUR_SW_SW 0 CM_0013 -3276.8 3276.7 /begin AXIS_DESCR STD_AXIS NO_INPUT_QUANTITY CM_0010 6 -2048 2047.9375 /end AXIS_DESCR /end CHARACTERISTIC
/begin CHARACTERISTIC KL_MD_ABTRIEB_SCHLEPP_MAX "Maximum IPM drag torque [verified]" CURVE 0x78A56 RL_CUR_SW_SW 0 CM_0017 -3276.8 3276.7 /begin AXIS_DESCR STD_AXIS NO_INPUT_QUANTITY CM_0010 11 -2048 2047.9375 /end AXIS_DESCR /end CHARACTERISTIC
/begin CHARACTERISTIC KL_MD_BEGR_NOISE "Maximum torque [verified]" CURVE 0x79224 RL_CUR_SW_SW 0 CM_0017 -3276.8 3276.7 /begin AXIS_DESCR STD_AXIS NO_INPUT_QUANTITY CM_0010 3 -2048 2047.9375 /end AXIS_DESCR /end CHARACTERISTIC
/begin CHARACTERISTIC KL_MD_ETA_LA "Lambda efficiency [verified]" CURVE 0x76BBC RL_CUR_UW_UW 0 CM_0050 0 199.9969474 /begin AXIS_DESCR STD_AXIS NO_INPUT_QUANTITY CM_0019 8 0 3.999941832 /end AXIS_DESCR /end CHARACTERISTIC
/begin CHARACTERISTIC KL_MD_FAHRER_FAK_KOMFORT "Speed progression factor on pedal map - Komfort [verified]" CURVE 0x793A4 RL_CUR_SW_UW 0 CM_0016 0 63.99902344 /begin AXIS_DESCR STD_AXIS NO_INPUT_QUANTITY CM_0010 8 -2048 2047.9375 /end AXIS_DESCR /end CHARACTERISTIC
/begin CHARACTERISTIC KL_MD_FAHRER_FAK_KOMFORT_DKG "Speed progression factor on pedal map - Komfort, DKG [verified]" CURVE 0x7940A RL_CUR_SW_UW 0 CM_0016 0 63.99902344 /begin AXIS_DESCR STD_AXIS NO_INPUT_QUANTITY CM_0010 8 -2048 2047.9375 /end AXIS_DESCR /end CHARACTERISTIC
/begin CHARACTERISTIC KL_MD_FAHRER_FAK_NORMAL "Speed progression factor on pedal map - Normal [verified]" CURVE 0x793C6 RL_CUR_SW_UW 0 CM_0016 0 63.99902344 /begin AXIS_DESCR STD_AXIS NO_INPUT_QUANTITY CM_0010 8 -2048 2047.9375 /end AXIS_DESCR /end CHARACTERISTIC
/begin CHARACTERISTIC KL_MD_FAHRER_FAK_SPORT "Speed progression factor on pedal map - Sport [verified]" CURVE 0x793E8 RL_CUR_SW_UW 0 CM_0016 0 63.99902344 /begin AXIS_DESCR STD_AXIS NO_INPUT_QUANTITY CM_0010 8 -2048 2047.9375 /end AXIS_DESCR /end CHARACTERISTIC
/begin CHARACTERISTIC KL_MD_FAK_DP_B1 "Dashpot factor, range 1 and idle with clutch closed [verified]" CURVE 0x77DF2 RL_CUR_SW_UW 0 CM_0016 0 63.99902344 /begin AXIS_DESCR STD_AXIS NO_INPUT_QUANTITY CM_0017 6 -3276.8 3276.7 /end AXIS_DESCR /end CHARACTERISTIC
/begin CHARACTERISTIC KL_MD_FAK_DP_B3 "Dashpot factor, range 3 [verified]" CURVE 0x77E0C RL_CUR_SW_UW 0 CM_0016 0 63.99902344 /begin AXIS_DESCR STD_AXIS NO_INPUT_QUANTITY CM_0017 6 -3276.8 3276.7 /end AXIS_DESCR /end CHARACTERISTIC
/begin CHARACTERISTIC KL_MD_FAK_LSD_ANFF "LSD factor, pull-away filter [verified]" CURVE 0x77E26 RL_CUR_SW_UW 0 CM_0016 0 63.99902344 /begin AXIS_DESCR STD_AXIS NO_INPUT_QUANTITY CM_0015 4 -32768 32767 /end AXIS_DESCR /end CHARACTERISTIC
/begin CHARACTERISTIC KL_MD_FAK_LSD_B2 "LSD factor, range 2 [verified]" CURVE 0x77DA4 RL_CUR_SW_UW 0 CM_0016 0 63.99902344 /begin AXIS_DESCR STD_AXIS NO_INPUT_QUANTITY CM_0017 6 -3276.8 3276.7 /end AXIS_DESCR /end CHARACTERISTIC
/begin CHARACTERISTIC KL_MD_FAK_LSD_B3 "LSD factor, range 3 [verified]" CURVE 0x77DBE RL_CUR_SW_UW 0 CM_0016 0 63.99902344 /begin AXIS_DESCR STD_AXIS NO_INPUT_QUANTITY CM_0017 6 -3276.8 3276.7 /end AXIS_DESCR /end CHARACTERISTIC
/begin CHARACTERISTIC KL_MD_HYP_DN "Engine-speed offset for MD_MIN hyperbola load [verified]" CURVE 0x76BAE RL_CUR_SW_SW 0 CM_0002 -32768 32767 /begin AXIS_DESCR STD_AXIS NO_INPUT_QUANTITY CM_0006 3 -3550 3003.5 /end AXIS_DESCR /end CHARACTERISTIC
/begin CHARACTERISTIC KL_MD_HYP_VERH_KRAFTS "X: Time (t) [s] | Value: Factor (Maxwert) [verified]" CURVE 0x76CA8 RL_CUR_UW_UW 0 CM_0037 0 511.9921875 /begin AXIS_DESCR STD_AXIS NO_INPUT_QUANTITY CM_0025 4 0 655.35 /end AXIS_DESCR /end CHARACTERISTIC
/begin CHARACTERISTIC KL_MD_IDX_FP "Re-normalisation of pedal-map index [verified]" CURVE 0x78A9E RL_CUR_UB_SW 0 CM_0016 -32 31.99902344 /begin AXIS_DESCR STD_AXIS NO_INPUT_QUANTITY CM_0000 6 0 255 /end AXIS_DESCR /end CHARACTERISTIC
/begin CHARACTERISTIC KL_MD_IND_REIB_ABREG "Ramp-down for friction torque after start [verified]" CURVE 0x76C20 RL_CUR_SW_SW 0 CM_0073 -3276.8 3276.7 /begin AXIS_DESCR STD_AXIS NO_INPUT_QUANTITY CM_0006 4 -3550 3003.5 /end AXIS_DESCR /end CHARACTERISTIC
/begin CHARACTERISTIC KL_MD_IND_REIB_OFFSET "Offset for friction torque after start [verified]" CURVE 0x76BF8 RL_CUR_SW_SW 0 CM_0074 -327.68 327.67 /begin AXIS_DESCR STD_AXIS NO_INPUT_QUANTITY CM_0006 4 -3550 3003.5 /end AXIS_DESCR /end CHARACTERISTIC
/begin CHARACTERISTIC KL_MD_IND_RF_MIN_OFFS "Minimum relative charge offset [verified]" CURVE 0x76C74 RL_CUR_SW_SW 0 CM_0017 -3276.8 3276.7 /begin AXIS_DESCR STD_AXIS NO_INPUT_QUANTITY CM_0002 8 -32768 32767 /end AXIS_DESCR /end CHARACTERISTIC
/begin CHARACTERISTIC KL_MD_KKOS_DELAY_OFF "A/C compressor delay on switch-off [verified]" CURVE 0x77C64 RL_CUR_SW_SW 0 CM_0025 -327.68 327.67 /begin AXIS_DESCR STD_AXIS NO_INPUT_QUANTITY CM_0002 4 -32768 32767 /end AXIS_DESCR /end CHARACTERISTIC
/begin CHARACTERISTIC KL_MD_KKOS_DELAY_ON "A/C compressor delay on switch-on [verified]" CURVE 0x77C52 RL_CUR_SW_SW 0 CM_0025 -327.68 327.67 /begin AXIS_DESCR STD_AXIS NO_INPUT_QUANTITY CM_0002 4 -32768 32767 /end AXIS_DESCR /end CHARACTERISTIC
/begin CHARACTERISTIC KL_MD_KKOS_RES_MAX "A/C compressor reserve [verified]" CURVE 0x77C76 RL_CUR_SW_SW 0 CM_0017 -3276.8 3276.7 /begin AXIS_DESCR STD_AXIS NO_INPUT_QUANTITY CM_0002 4 -32768 32767 /end AXIS_DESCR /end CHARACTERISTIC
/begin CHARACTERISTIC KL_MD_KKOS_ZH_RES_MAX "A/C compressor reserve [verified]" CURVE 0x77C88 RL_CUR_SW_SW 0 CM_0017 -3276.8 3276.7 /begin AXIS_DESCR STD_AXIS NO_INPUT_QUANTITY CM_0002 4 -32768 32767 /end AXIS_DESCR /end CHARACTERISTIC
/begin CHARACTERISTIC KL_MD_KR_DTZ_DOWN "Knock-control limit, down [verified]" CURVE 0x76C5E RL_CUR_SW_SW 0 CM_0075 -655360 655340 /begin AXIS_DESCR STD_AXIS NO_INPUT_QUANTITY CM_0002 5 -32768 32767 /end AXIS_DESCR /end CHARACTERISTIC
/begin CHARACTERISTIC KL_MD_KR_DTZ_UP "Knock-control limit, up [verified]" CURVE 0x76C48 RL_CUR_SW_SW 0 CM_0075 -655360 655340 /begin AXIS_DESCR STD_AXIS NO_INPUT_QUANTITY CM_0002 5 -32768 32767 /end AXIS_DESCR /end CHARACTERISTIC
/begin CHARACTERISTIC KL_MD_KUPP_MAX_CAN "Scaling factor for CAN output [verified]" CURVE 0x76B94 RL_CUR_SW_UW 0 CM_0016 0 63.99902344 /begin AXIS_DESCR STD_AXIS NO_INPUT_QUANTITY CM_0002 6 -32768 32767 /end AXIS_DESCR /end CHARACTERISTIC
/begin CHARACTERISTIC KL_MD_KUPP_MAX_GANG "Torque limit per gear [verified]" CURVE 0x79472 RL_CUR_SW_SW 0 CM_0017 -3276.8 3276.7 /begin AXIS_DESCR STD_AXIS NO_INPUT_QUANTITY CM_0015 9 -32768 32767 /end AXIS_DESCR /end CHARACTERISTIC
/begin CHARACTERISTIC KL_MD_KUPP_MIN "Maximum IPM clutch torque [verified]" CURVE 0x789FA RL_CUR_SW_SW 0 CM_0017 -3276.8 3276.7 /begin AXIS_DESCR STD_AXIS NO_INPUT_QUANTITY CM_0002 11 -32768 32767 /end AXIS_DESCR /end CHARACTERISTIC
/begin CHARACTERISTIC KL_MD_KUPP_MIN_ASC "Minimum torque during ASC intervention [verified]" CURVE 0x7920A RL_CUR_SW_SW 0 CM_0017 -3276.8 3276.7 /begin AXIS_DESCR STD_AXIS NO_INPUT_QUANTITY CM_0002 6 -32768 32767 /end AXIS_DESCR /end CHARACTERISTIC
/begin CHARACTERISTIC KL_MD_LRW_FAK "Factor on steering-angle torque [verified]" CURVE 0x77C9A RL_CUR_SW_UW 0 CM_0016 0 63.99902344 /begin AXIS_DESCR STD_AXIS NO_INPUT_QUANTITY CM_0002 6 -32768 32767 /end AXIS_DESCR /end CHARACTERISTIC
/begin CHARACTERISTIC KL_MD_MAX_FAK_POWER "Maximum relative charge [verified]" CURVE 0x76B4A RL_CUR_SW_UW 0 CM_0016 0 63.99902344 /begin AXIS_DESCR STD_AXIS NO_INPUT_QUANTITY CM_0002 18 -32768 32767 /end AXIS_DESCR /end CHARACTERISTIC
/begin CHARACTERISTIC KL_MD_MAX_N_OFFS "Engine-speed offset for rf_max [verified]" CURVE 0x76B16 RL_CUR_SW_SW 0 CM_0002 -32768 32767 /begin AXIS_DESCR STD_AXIS NO_INPUT_QUANTITY CM_0006 6 -3550 3003.5 /end AXIS_DESCR /end CHARACTERISTIC
/begin CHARACTERISTIC KL_MD_MAX_TMOT "Engine-temperature correction for rf_max [verified]" CURVE 0x76B30 RL_CUR_SW_UW 0 CM_0016 0 63.99902344 /begin AXIS_DESCR STD_AXIS NO_INPUT_QUANTITY CM_0006 6 -3550 3003.5 /end AXIS_DESCR /end CHARACTERISTIC
/begin CHARACTERISTIC KL_MD_NBEGR_ABSTAND "X: Gear [.Gang] | Value: Engine speed (n_ab) [rpm] [verified]" CURVE 0x79244 RL_CUR_UB_SW 0 CM_0002 -32768 32767 /begin AXIS_DESCR STD_AXIS NO_INPUT_QUANTITY CM_0015 8 0 255 /end AXIS_DESCR /end CHARACTERISTIC
/begin CHARACTERISTIC KL_MD_NBEGR_GANG "Influence over gradient [verified]" CURVE 0x79232 RL_CUR_SW_UB 0 CM_0015 0 255 /begin AXIS_DESCR STD_AXIS NO_INPUT_QUANTITY CM_0067 5 -32768 32767 /end AXIS_DESCR /end CHARACTERISTIC
/begin CHARACTERISTIC KL_MD_NBEGR_KR_FAK "Factor on KR (gain) [verified]" CURVE 0x792AC RL_CUR_SW_UW 0 CM_0016 0 63.99902344 /begin AXIS_DESCR STD_AXIS NO_INPUT_QUANTITY CM_0002 6 -32768 32767 /end AXIS_DESCR /end CHARACTERISTIC
/begin CHARACTERISTIC KL_MD_NBEGR_KR_FAK_SK "Factor during cylinder suppression [verified]" CURVE 0x79388 RL_CUR_UB_SW 0 CM_0016 -32 31.99902344 /begin AXIS_DESCR STD_AXIS NO_INPUT_QUANTITY CM_0000 4 0 255 /end AXIS_DESCR /end CHARACTERISTIC
/begin CHARACTERISTIC KL_MD_NBEGR_N_MAX "Limit of cut-off engine speed [verified]" CURVE 0x79278 RL_CUR_UB_SW 0 CM_0076 -409600 409587.5 /begin AXIS_DESCR STD_AXIS NO_INPUT_QUANTITY CM_0015 8 0 255 /end AXIS_DESCR /end CHARACTERISTIC
/begin CHARACTERISTIC KL_MD_NBEGR_RAMPE "Rate limit [verified]" CURVE 0x79292 RL_CUR_UB_SW 0 CM_0007 -655360 655340 /begin AXIS_DESCR STD_AXIS NO_INPUT_QUANTITY CM_0015 8 0 255 /end AXIS_DESCR /end CHARACTERISTIC
/begin CHARACTERISTIC KL_MD_NBEGR_TN_FAK "Factor on TN (integral time) [verified]" CURVE 0x792C6 RL_CUR_SW_UW 0 CM_0016 0 63.99902344 /begin AXIS_DESCR STD_AXIS NO_INPUT_QUANTITY CM_0002 6 -32768 32767 /end AXIS_DESCR /end CHARACTERISTIC
/begin CHARACTERISTIC KL_MD_NBEGR_TN_FAK_SK "Factor during cylinder suppression [verified]" CURVE 0x79396 RL_CUR_UB_SW 0 CM_0016 -32 31.99902344 /begin AXIS_DESCR STD_AXIS NO_INPUT_QUANTITY CM_0000 4 0 255 /end AXIS_DESCR /end CHARACTERISTIC
/begin CHARACTERISTIC KL_MD_NBEGR_TV_FAK "Factor on TV (derivative time) [verified]" CURVE 0x792E0 RL_CUR_SW_UW 0 CM_0016 0 63.99902344 /begin AXIS_DESCR STD_AXIS NO_INPUT_QUANTITY CM_0002 6 -32768 32767 /end AXIS_DESCR /end CHARACTERISTIC
/begin CHARACTERISTIC KL_MD_RAD_BREMSE_TAU "Brake torque filter [verified]" CURVE 0x78B48 RL_CUR_UW_UW 0 CM_0027 0 65535 /begin AXIS_DESCR STD_AXIS NO_INPUT_QUANTITY CM_0077 6 -65535 0 /end AXIS_DESCR /end CHARACTERISTIC
/begin CHARACTERISTIC KL_MD_RAD_STEIG_BREMS "Gradient influence on brake torque [verified]" CURVE 0x78B2E RL_CUR_SW_SW 0 CM_0078 -32768 32767 /begin AXIS_DESCR STD_AXIS NO_INPUT_QUANTITY CM_0017 6 -3276.8 3276.7 /end AXIS_DESCR /end CHARACTERISTIC
/begin CHARACTERISTIC KL_MD_RES_MIN "Minimum torque reserve for OBD [verified]" CURVE 0x7942C RL_CUR_SW_SW 0 CM_0017 -3276.8 3276.7 /begin AXIS_DESCR STD_AXIS NO_INPUT_QUANTITY CM_0017 4 -3276.8 3276.7 /end AXIS_DESCR /end CHARACTERISTIC
/begin CHARACTERISTIC KL_MD_RF_MAX_ROH "Maximum relative charge [verified]" CURVE 0x76AC4 RL_CUR_SW_SW 0 CM_0003 -3.2768 3.2767 /begin AXIS_DESCR STD_AXIS NO_INPUT_QUANTITY CM_0002 20 -32768 32767 /end AXIS_DESCR /end CHARACTERISTIC
/begin CHARACTERISTIC KL_MD_RF_TABG_VO_KOR "Correction over van_soll_vo_abw (exhaust VANOS deviation) [verified]" CURVE 0x79460 RL_CUR_SW_UW 0 CM_0016 0 63.99902344 /begin AXIS_DESCR STD_AXIS NO_INPUT_QUANTITY CM_0028 4 -3276.8 3276.7 /end AXIS_DESCR /end CHARACTERISTIC
/begin CHARACTERISTIC KL_MD_SCHW_TAU "Filter constant Md_Schw [verified]" CURVE 0x76C96 RL_CUR_UB_UB 0 CM_0027 0 255 /begin AXIS_DESCR STD_AXIS NO_INPUT_QUANTITY CM_0015 8 0 255 /end AXIS_DESCR /end CHARACTERISTIC
/begin CHARACTERISTIC KL_MD_TAU_START_OFF "Filter for start offset [verified]" CURVE 0x76C32 RL_CUR_SW_UW 0 CM_0027 0 65535 /begin AXIS_DESCR STD_AXIS NO_INPUT_QUANTITY CM_0006 5 -3550 3003.5 /end AXIS_DESCR /end CHARACTERISTIC
/begin CHARACTERISTIC KL_MD_VBEGR_ABSTAND "Distance [verified]" CURVE 0x7933C RL_CUR_SW_SW 0 CM_0010 -2048 2047.9375 /begin AXIS_DESCR STD_AXIS NO_INPUT_QUANTITY CM_0015 4 -32768 32767 /end AXIS_DESCR /end CHARACTERISTIC
/begin CHARACTERISTIC KL_MD_VBEGR_RAMPE "Rate limit [verified]" CURVE 0x7934E RL_CUR_SW_SW 0 CM_0007 -655360 655340 /begin AXIS_DESCR STD_AXIS NO_INPUT_QUANTITY CM_0015 4 -32768 32767 /end AXIS_DESCR /end CHARACTERISTIC
/begin CHARACTERISTIC KL_MD_VBEGR_TAU "Rate limit [verified]" CURVE 0x79360 RL_CUR_SW_UB 0 CM_0027 0 255 /begin AXIS_DESCR STD_AXIS NO_INPUT_QUANTITY CM_0020 3 -163.84 163.835 /end AXIS_DESCR /end CHARACTERISTIC
/begin CHARACTERISTIC KL_MD_VBEGR_TN_FAK "Factor on TN (integral time) [verified]" CURVE 0x79310 RL_CUR_SW_UW 0 CM_0016 0 63.99902344 /begin AXIS_DESCR STD_AXIS NO_INPUT_QUANTITY CM_0010 5 -2048 2047.9375 /end AXIS_DESCR /end CHARACTERISTIC
/begin CHARACTERISTIC KL_MD_VBEGR_TN_FAK_SK "Factor during cylinder suppression [verified]" CURVE 0x7937A RL_CUR_UB_SW 0 CM_0016 -32 31.99902344 /begin AXIS_DESCR STD_AXIS NO_INPUT_QUANTITY CM_0000 4 0 255 /end AXIS_DESCR /end CHARACTERISTIC
/begin CHARACTERISTIC KL_MD_VBEGR_TV_FAK "Factor on TV (derivative time) [verified]" CURVE 0x79326 RL_CUR_SW_UW 0 CM_0016 0 63.99902344 /begin AXIS_DESCR STD_AXIS NO_INPUT_QUANTITY CM_0010 5 -2048 2047.9375 /end AXIS_DESCR /end CHARACTERISTIC
/begin CHARACTERISTIC KL_MD_ZW_LA "Ignition-angle influence from lambda [verified]" CURVE 0x76BDE RL_CUR_SW_SW 0 CM_0028 -3276.8 3276.7
 /begin AXIS_DESCR STD_AXIS NO_INPUT_QUANTITY CM_0019 6 -2.000001434 1.999940398 /end AXIS_DESCR
/end CHARACTERISTIC
/begin CHARACTERISTIC K_MD_ANFF_V_ON "Pull-away filter speed threshold [verified]" VALUE 0x77D82 RL_VAL_SW 0 CM_0010 -2048 2047.9375 /end CHARACTERISTIC
/begin CHARACTERISTIC K_MD_ASC_AUSBLEND_HYS "Hysteresis over drag torque [Nm] [verified]" VALUE 0x77C06 RL_VAL_SW 0 CM_0017 -3276.8 3276.7 /end CHARACTERISTIC
/begin CHARACTERISTIC K_MD_ASC_ENABLE "ASC enable [verified]" VALUE 0x77BFE RL_VAL_UB 0 CM_0000 0 255 /end CHARACTERISTIC
/begin CHARACTERISTIC K_MD_ASC_M_AEBEGR "Rate limit after ASC intervention [Nm/s] [verified]" VALUE 0x77C0C RL_VAL_SW 0 CM_0007 -655360 655340 /end CHARACTERISTIC
/begin CHARACTERISTIC K_MD_ASC_M_RAMPE "Slope of ASC ramp [Nm/s] [verified]" VALUE 0x77C0A RL_VAL_SW 0 CM_0007 -655360 655340 /end CHARACTERISTIC
/begin CHARACTERISTIC K_MD_ASC_T_WAIT "Wait time before ASC ramp [s] [verified]" VALUE 0x77C08 RL_VAL_UW 0 CM_0020 0 327.675 /end CHARACTERISTIC
/begin CHARACTERISTIC K_MD_CAN_BEGR_ST "MD-Begrenzungen default [verified]" VALUE 0x77C10 RL_VAL_UB 0 CM_0000 0 255 /end CHARACTERISTIC
/begin CHARACTERISTIC K_MD_CAN_ETA_ZW_OFF "ASC enable [%] [verified]" VALUE 0x77C0E RL_VAL_UW 0 CM_0050 0 199.9969474 /end CHARACTERISTIC
/begin CHARACTERISTIC K_MD_CFG_DYN_FIL "Filterkonfiguration [verified]" VALUE 0x77D70 RL_VAL_UB 0 CM_0000 0 255 /end CHARACTERISTIC
/begin CHARACTERISTIC K_MD_CFG_FW_BLS "Einfluss Bremse auf Fahrerwunsch [verified]" VALUE 0x7916B RL_VAL_UB 0 CM_0000 0 255 /end CHARACTERISTIC
/begin CHARACTERISTIC K_MD_CFG_MCS "Vorgaben per MCS [verified]" VALUE 0x79168 RL_VAL_UB 0 CM_0000 0 255 /end CHARACTERISTIC
/begin CHARACTERISTIC K_MD_CFG_TZ_EINGR "Freigabe Zuendwinkeleingriff [verified]" VALUE 0x7916A RL_VAL_UB 0 CM_0000 0 255 /end CHARACTERISTIC
/begin CHARACTERISTIC K_MD_CFG_ZW_BEZUG "ZW-Bezug [verified]" VALUE 0x79169 RL_VAL_UB 0 CM_0000 0 255 /end CHARACTERISTIC
/begin CHARACTERISTIC K_MD_DYN_FIL_RES_TAU "Time constant of torque reserve [s] [verified]" VALUE 0x77D80 RL_VAL_UB 0 CM_0027 0 255 /end CHARACTERISTIC
/begin CHARACTERISTIC K_MD_ETA_ZW_MIN "Minimum efficiency [%] [verified]" VALUE 0x76A80 RL_VAL_UW 0 CM_0050 0 199.9969474 /end CHARACTERISTIC
/begin CHARACTERISTIC K_MD_GRAD_DP_OKS "Gradient without drivetrain engaged [Nm/s] [verified]" VALUE 0x77D7E RL_VAL_SW 0 CM_0068 -32768 32767 /end CHARACTERISTIC
/begin CHARACTERISTIC K_MD_GRAD_LSD_OKS "Gradient without drivetrain engaged [Nm/s] [verified]" VALUE 0x77D7C RL_VAL_SW 0 CM_0068 -32768 32767 /end CHARACTERISTIC
/begin CHARACTERISTIC K_MD_GRAD_SA "Switching step size when TZmin reached [Nm/s] [verified]" VALUE 0x77D76 RL_VAL_SW 0 CM_0007 -655360 655340 /end CHARACTERISTIC
/begin CHARACTERISTIC K_MD_GRAD_SA_CUF "Switching step size during fuel cut-off [Nm/s] [verified]" VALUE 0x77D78 RL_VAL_SW 0 CM_0007 -655360 655340 /end CHARACTERISTIC
/begin CHARACTERISTIC K_MD_GRAD_SA_VMA "Switching step size during VMA [Nm/s] [verified]" VALUE 0x77D7A RL_VAL_SW 0 CM_0007 -655360 655340 /end CHARACTERISTIC
/begin CHARACTERISTIC K_MD_HYS_RICHTUNG "Hysteresis for direction detection [Nm/s] [verified]" VALUE 0x77D71 RL_VAL_UB 0 CM_0068 0 255 /end CHARACTERISTIC
/begin CHARACTERISTIC K_MD_HYS_SA "Offset on drag torque incl. EtaMin [Nm] [verified]" VALUE 0x77D72 RL_VAL_SW 0 CM_0017 -3276.8 3276.7 /end CHARACTERISTIC
/begin CHARACTERISTIC K_MD_HYS_SA_TZ "Offset on tz_min (latest ignition) [?KW] [verified]" VALUE 0x77D74 RL_VAL_SW 0 CM_0028 -3276.8 3276.7 /end CHARACTERISTIC
/begin CHARACTERISTIC K_MD_KKOS_DYN_ST "Trigger threshold for BA [verified]" VALUE 0x77C11 RL_VAL_UB 0 CM_0000 0 255 /end CHARACTERISTIC
/begin CHARACTERISTIC K_MD_KKOS_ELU_TMOT_MAX "Engine temperature for A/C cut with defective electric fan [?C] [verified]" VALUE 0x77C16 RL_VAL_SW 0 CM_0006 -3550 3003.5 /end CHARACTERISTIC
/begin CHARACTERISTIC K_MD_KKOS_ELU_TMOT_MAX_HYS "Engine temperature for A/C cut with defective electric fan - hysteresis [verified]" VALUE 0x77C18 RL_VAL_SW 0 CM_0024 -3276.8 3276.7 /end CHARACTERISTIC
/begin CHARACTERISTIC K_MD_KKOS_N "Threshold for BA/full load [Upm] [verified]" VALUE 0x77C1E RL_VAL_SW 0 CM_0002 -32768 32767 /end CHARACTERISTIC
/begin CHARACTERISTIC K_MD_KKOS_N_MAX "Maximum engine speed for A/C compressor [Upm] [verified]" VALUE 0x77C1A RL_VAL_SW 0 CM_0002 -32768 32767 /end CHARACTERISTIC
/begin CHARACTERISTIC K_MD_KKOS_N_MAX_HYS "Maximum engine speed for A/C compressor - hysteresis [Upm] [verified]" VALUE 0x77C1C RL_VAL_SW 0 CM_0002 -32768 32767 /end CHARACTERISTIC
/begin CHARACTERISTIC K_MD_KKOS_TMOT_MAX "Engine temperature for A/C compressor [?C] [verified]" VALUE 0x77C12 RL_VAL_SW 0 CM_0006 -3550 3003.5 /end CHARACTERISTIC
/begin CHARACTERISTIC K_MD_KKOS_TMOT_MAX_HYS "Engine temperature for A/C compressor - hysteresis [verified]" VALUE 0x77C14 RL_VAL_SW 0 CM_0024 -3276.8 3276.7 /end CHARACTERISTIC
/begin CHARACTERISTIC K_MD_MAX_FAK "Full-load correction of rf_max [verified]" VALUE 0x76A7E RL_VAL_UW 0 CM_0016 0 63.99902344 /end CHARACTERISTIC
/begin CHARACTERISTIC K_MD_MAX_POWER_NEG "Power factor limit [1/sec] [verified]" VALUE 0x76A85 RL_VAL_UB 0 CM_0079 0 49.8046875 /end CHARACTERISTIC
/begin CHARACTERISTIC K_MD_MAX_POWER_POS "Power factor limit [1/sec] [verified]" VALUE 0x76A84 RL_VAL_UB 0 CM_0079 0 49.8046875 /end CHARACTERISTIC
/begin CHARACTERISTIC K_MD_MSR_ENABLE "MSR-Freigabe [verified]" VALUE 0x77BFF RL_VAL_UB 0 CM_0000 0 255 /end CHARACTERISTIC
/begin CHARACTERISTIC K_MD_MSR_MAX "Maximum MSR (engine drag control) request [Nm] [verified]" VALUE 0x77C00 RL_VAL_SW 0 CM_0017 -3276.8 3276.7 /end CHARACTERISTIC
/begin CHARACTERISTIC K_MD_MSR_M_RAMPE "Slope of MSR ramp [Nm/s] [verified]" VALUE 0x77C04 RL_VAL_SW 0 CM_0007 -655360 655340 /end CHARACTERISTIC
/begin CHARACTERISTIC K_MD_MSR_T_WAIT "Wait time before MSR ramp [s] [verified]" VALUE 0x77C02 RL_VAL_UW 0 CM_0020 0 327.675 /end CHARACTERISTIC
/begin CHARACTERISTIC K_MD_NOISE_CFG "Noise configuration [verified]" VALUE 0x791B5 RL_VAL_UB 0 CM_0080 0 255 /end CHARACTERISTIC
/begin CHARACTERISTIC K_MD_NOISE_PWG_SOLL "Noise threshold, pedal [%] [verified]" VALUE 0x791C4 RL_VAL_SW 0 CM_0013 -3276.8 3276.7 /end CHARACTERISTIC
/begin CHARACTERISTIC K_MD_NOISE_RAMPE "Noise threshold, pedal [Nm/s] [verified]" VALUE 0x791C6 RL_VAL_SW 0 CM_0068 -32768 32767 /end CHARACTERISTIC
/begin CHARACTERISTIC K_MD_NOISE_T "Noise time [s] [verified]" VALUE 0x791B6 RL_VAL_UW 0 CM_0023 0 6553.5 /end CHARACTERISTIC
/begin CHARACTERISTIC K_MD_NOISE_V_MAX1 "Entry condition [km/h] [verified]" VALUE 0x791BA RL_VAL_SW 0 CM_0010 -2048 2047.9375 /end CHARACTERISTIC
/begin CHARACTERISTIC K_MD_NOISE_V_MAX2 "Exit condition [km/h] [verified]" VALUE 0x791BE RL_VAL_SW 0 CM_0010 -2048 2047.9375 /end CHARACTERISTIC
/begin CHARACTERISTIC K_MD_NOISE_V_MAX3 "Profile detection [km/h] [verified]" VALUE 0x791C2 RL_VAL_SW 0 CM_0010 -2048 2047.9375 /end CHARACTERISTIC
/begin CHARACTERISTIC K_MD_NOISE_V_MIN1 "Entry condition [km/h] [verified]" VALUE 0x791B8 RL_VAL_SW 0 CM_0010 -2048 2047.9375 /end CHARACTERISTIC
/begin CHARACTERISTIC K_MD_NOISE_V_MIN2 "Exit condition [km/h] [verified]" VALUE 0x791BC RL_VAL_SW 0 CM_0010 -2048 2047.9375 /end CHARACTERISTIC
/begin CHARACTERISTIC K_MD_NOISE_V_MIN3 "Profile detection [km/h] [verified]" VALUE 0x791C0 RL_VAL_SW 0 CM_0010 -2048 2047.9375 /end CHARACTERISTIC
/begin CHARACTERISTIC K_MD_N_ABTRIEB_MIN "Minimum output shaft speed [Upm] [verified]" VALUE 0x789F8 RL_VAL_SW 0 CM_0002 -32768 32767 /end CHARACTERISTIC
/begin CHARACTERISTIC K_MD_N_PVMAX "Engine speed for maximum power [Upm] [verified]" VALUE 0x789F6 RL_VAL_SW 0 CM_0002 -32768 32767 /end CHARACTERISTIC
/begin CHARACTERISTIC K_MD_PULS_AMP "Generator amplitude [Nm] [verified]" VALUE 0x76A8A RL_VAL_SW 0 CM_0017 -3276.8 3276.7 /end CHARACTERISTIC
/begin CHARACTERISTIC K_MD_PULS_EIN "Generator-Schalter [verified]" VALUE 0x76A86 RL_VAL_UB 0 CM_0000 0 255 /end CHARACTERISTIC
/begin CHARACTERISTIC K_MD_PULS_OFFS "Generator offset [Nm] [verified]" VALUE 0x76A8C RL_VAL_SW 0 CM_0017 -3276.8 3276.7 /end CHARACTERISTIC
/begin CHARACTERISTIC K_MD_PULS_RAMPE "Generator ramp [Nm/s] [verified]" VALUE 0x76A8E RL_VAL_SW 0 CM_0007 -655360 655340 /end CHARACTERISTIC
/begin CHARACTERISTIC K_MD_PULS_T "Generator period [s] [verified]" VALUE 0x76A88 RL_VAL_UW 0 CM_0020 0 327.675 /end CHARACTERISTIC
/begin CHARACTERISTIC K_MD_TAU_FW_DPFIL "Filter for dashpot weighting [s] [verified]" VALUE 0x77D81 RL_VAL_UB 0 CM_0027 0 255 /end CHARACTERISTIC
/begin CHARACTERISTIC K_MD_VERBR_MAX "Maximum consumer torque [Nm] [verified]" VALUE 0x76A94 RL_VAL_SW 0 CM_0017 -3276.8 3276.7 /end CHARACTERISTIC
/begin CHARACTERISTIC KL_PWG_BLS_BRP "Brake pressure limit [verified]" CURVE 0x7ACE4 RL_CUR_UW_UW 0 CM_0036 0 102.3984375 /begin AXIS_DESCR STD_AXIS NO_INPUT_QUANTITY CM_0085 5 0 65535 /end AXIS_DESCR /end CHARACTERISTIC
/begin CHARACTERISTIC KL_PWG_BLS_V "Vehicle speed limit [verified]" CURVE 0x7ACFA RL_CUR_SW_UW 0 CM_0036 0 102.3984375 /begin AXIS_DESCR STD_AXIS NO_INPUT_QUANTITY CM_0010 5 -2048 2047.9375 /end AXIS_DESCR /end CHARACTERISTIC
/begin CHARACTERISTIC KL_PWG_MAX_DIFF "Maximum pedal-sensor deviation [verified]" CURVE 0x7ACA2 RL_CUR_SW_SW 0 CM_0013 -3276.8 3276.7 /begin AXIS_DESCR STD_AXIS NO_INPUT_QUANTITY CM_0013 3 -3276.8 3276.7 /end AXIS_DESCR /end CHARACTERISTIC
/begin CHARACTERISTIC KL_PWG_SOLL "Measured value to pedal value [verified]" CURVE 0x7ACDA RL_CUR_SW_SW 0 CM_0013 -3276.8 3276.7 /begin AXIS_DESCR STD_AXIS NO_INPUT_QUANTITY CM_0013 2 -3276.8 3276.7 /end AXIS_DESCR /end CHARACTERISTIC
/begin CHARACTERISTIC KL_PWG_SOLL_NOTLAUF "Pedal value in fault case [verified]" CURVE 0x7ACB0 RL_CUR_SW_SW 0 CM_0013 -3276.8 3276.7 /begin AXIS_DESCR STD_AXIS NO_INPUT_QUANTITY CM_0013 10 -3276.8 3276.7 /end AXIS_DESCR /end CHARACTERISTIC
/begin CHARACTERISTIC K_PWG1_A0_INITINC "Upward adaptation of idle potentiometer voltage at start [V] [verified]" VALUE 0x7AC8E RL_VAL_SW 0 CM_0031 -160 159.9951172 /end CHARACTERISTIC
/begin CHARACTERISTIC K_PWG1_A0_MAX "Upper adaptation threshold, pedal sensor 1 [V] [verified]" VALUE 0x7AC86 RL_VAL_SW 0 CM_0031 -160 159.9951172 /end CHARACTERISTIC
/begin CHARACTERISTIC K_PWG1_INC_A0_ADAPT "Enable upward adaptation [V] [verified]" VALUE 0x7AC8A RL_VAL_SW 0 CM_0031 -160 159.9951172 /end CHARACTERISTIC
/begin CHARACTERISTIC K_PWG_A0_TAU "Filter constant for idle-angle downward adaptation 1 [s] [verified]" VALUE 0x7AC88 RL_VAL_UB 0 CM_0027 0 255 /end CHARACTERISTIC
/begin CHARACTERISTIC K_PWG_A0_ZAEHLER "Counter for upward adaptation [verified]" VALUE 0x7AC8C RL_VAL_UB 0 CM_0000 0 255 /end CHARACTERISTIC
/begin CHARACTERISTIC K_PWG_AB_RAMPE "Duration of ramp-down during power limitation [s] [verified]" VALUE 0x7AC90 RL_VAL_UW 0 CM_0027 0 65535 /end CHARACTERISTIC
/begin CHARACTERISTIC K_PWG_BLS_N_MAX_FSP "Engine-speed threshold for fault entry during power reduction [Upm] [verified]" VALUE 0x7AC76 RL_VAL_SW 0 CM_0002 -32768 32767 /end CHARACTERISTIC
/begin CHARACTERISTIC K_PWG_BLS_PWG_MAX "Pedal threshold to enable hill start [%] [verified]" VALUE 0x7AC70 RL_VAL_UW 0 CM_0036 0 102.3984375 /end CHARACTERISTIC
/begin CHARACTERISTIC K_PWG_BLS_PWG_MIN "Pedal threshold to block hill start [%] [verified]" VALUE 0x7AC74 RL_VAL_UW 0 CM_0036 0 102.3984375 /end CHARACTERISTIC
/begin CHARACTERISTIC K_PWG_BLS_V_MAX "Speed threshold to block hill start [Km/h] [verified]" VALUE 0x7AC72 RL_VAL_SW 0 CM_0010 -2048 2047.9375 /end CHARACTERISTIC
/begin CHARACTERISTIC K_PWG_BLS_V_MIN "Speed threshold to enable hill start [Km/h] [verified]" VALUE 0x7AC6E RL_VAL_SW 0 CM_0010 -2048 2047.9375 /end CHARACTERISTIC
/begin CHARACTERISTIC K_PWG_BLS_V_VORNE_MAX "Speed threshold for limitation [Km/h] [verified]" VALUE 0x7AC6C RL_VAL_SW 0 CM_0010 -2048 2047.9375 /end CHARACTERISTIC
/begin CHARACTERISTIC K_PWG_KD "Pedal value for kick-down [%] [verified]" VALUE 0x7AC94 RL_VAL_SW 0 CM_0013 -3276.8 3276.7 /end CHARACTERISTIC
/begin CHARACTERISTIC K_PWG_SOLL_2GANG_AUF "Step size for 2nd-gear pull-away [1/s] [verified]" VALUE 0x7AC9C RL_VAL_UW 0 CM_0086 0 12799.80469 /end CHARACTERISTIC
/begin CHARACTERISTIC K_PWG_SOLL_2GANG_FAK "Maximum factor for 2nd-gear pull-away [verified]" VALUE 0x7AC9A RL_VAL_UW 0 CM_0016 0 63.99902344 /end CHARACTERISTIC
/begin CHARACTERISTIC K_PWG_SOLL_2GANG_MAX "Maximum pedal value for 2nd-gear pull-away [%] [verified]" VALUE 0x7AC96 RL_VAL_SW 0 CM_0013 -3276.8 3276.7 /end CHARACTERISTIC
/begin CHARACTERISTIC K_PWG_SOLL_2GANG_VMAX "Maximum vehicle speed for 2nd-gear pull-away [Km/h] [verified]" VALUE 0x7AC98 RL_VAL_SW 0 CM_0010 -2048 2047.9375 /end CHARACTERISTIC
/begin CHARACTERISTIC KF_TABG_LW_STAT "Steady-state exhaust temperature after gas exchange [verified]" MAP 0x7D286 RL_MAP_SW_SW_SW 0 CM_0006 -3550 3003.5 /begin AXIS_DESCR STD_AXIS NO_INPUT_QUANTITY CM_0002 8 -32768 32767 /end AXIS_DESCR /begin AXIS_DESCR STD_AXIS NO_INPUT_QUANTITY CM_0003 8 -3.2768 3.2767 /end AXIS_DESCR /end CHARACTERISTIC
/begin CHARACTERISTIC KL_TABG_LW_F_ETA_ZW "Weighting factor, ignition angle [verified]" CURVE 0x7D18C RL_CUR_UW_UW 0 CM_0016 0 63.99902344 /begin AXIS_DESCR STD_AXIS NO_INPUT_QUANTITY CM_0050 6 0 199.9969474 /end AXIS_DESCR /end CHARACTERISTIC
/begin CHARACTERISTIC KL_TABG_LW_F_LAM "Weighting factor, lambda [verified]" CURVE 0x7D1A6 RL_CUR_UW_UW 0 CM_0016 0 63.99902344 /begin AXIS_DESCR STD_AXIS NO_INPUT_QUANTITY CM_0019 4 0 3.999941832 /end AXIS_DESCR /end CHARACTERISTIC
/begin CHARACTERISTIC KL_TABG_LW_TAU "Filter time constant [verified]" CURVE 0x7D22C RL_CUR_SW_UB 0 CM_0027 0 255 /begin AXIS_DESCR STD_AXIS NO_INPUT_QUANTITY CM_0102 4 -3276.8 3276.7 /end AXIS_DESCR /end CHARACTERISTIC
/begin CHARACTERISTIC KL_TABG_LW_VERH_WURZEL "Ratio of gas-exchange temperatures [verified]" CURVE 0x7D1B8 RL_CUR_UW_UW 0 CM_0016 0 63.99902344 /begin AXIS_DESCR STD_AXIS NO_INPUT_QUANTITY CM_0016 7 0 63.99902344 /end AXIS_DESCR /end CHARACTERISTIC
/begin CHARACTERISTIC KL_TABG_PT200 "Exhaust temperature curve [verified]" CURVE 0x7D142 RL_CUR_SW_SW 0 CM_0103 -1911.55 1365.2 /begin AXIS_DESCR STD_AXIS NO_INPUT_QUANTITY CM_0087 18 -32768 32767 /end AXIS_DESCR /end CHARACTERISTIC
/begin CHARACTERISTIC KL_TABG_VKAT_F_REAK "Reaction in the exhaust manifold [verified]" CURVE 0x7D262 RL_CUR_UW_UW 0 CM_0016 0 63.99902344 /begin AXIS_DESCR STD_AXIS NO_INPUT_QUANTITY CM_0019 4 0 3.999941832 /end AXIS_DESCR /end CHARACTERISTIC
/begin CHARACTERISTIC K_TABG_KAT_EXO_HYS "Hysteresis for enthalpy [verified]" VALUE 0x7D13C RL_VAL_SW 0 CM_0024 -3276.8 3276.7 /end CHARACTERISTIC
/begin CHARACTERISTIC K_TABG_KAT_EXO_MS_SCHWELLE "Stored oxygen mass in the catalyst [mg] [verified]" VALUE 0x7D140 RL_VAL_SW 0 CM_0104 -3276.8 3276.7 /end CHARACTERISTIC
/begin CHARACTERISTIC K_TABG_KAT_EXO_ON "Start value for enthalpy [?C] [verified]" VALUE 0x7D13E RL_VAL_SW 0 CM_0006 -3550 3003.5 /end CHARACTERISTIC
/begin CHARACTERISTIC K_TABG_KAT_T_OFFS_AB "Ramp-down for enthalpy [verified]" VALUE 0x7D13A RL_VAL_SW 0 CM_0105 -3276.8 3276.7 /end CHARACTERISTIC
/begin CHARACTERISTIC K_TABG_KAT_T_OFFS_AUF "Ramp-up for enthalpy [verified]" VALUE 0x7D138 RL_VAL_SW 0 CM_0105 -3276.8 3276.7 /end CHARACTERISTIC
/begin CHARACTERISTIC KF_TZ_DBGR_OFFS "Ignition offset over engine speed and intake air temperature (pressure-limit offset) [verified]" MAP 0x7E446 RL_MAP_SW_SW_SW 0 CM_0028 -3276.8 3276.7 /begin AXIS_DESCR STD_AXIS NO_INPUT_QUANTITY CM_0002 7 -32768 32767 /end AXIS_DESCR /begin AXIS_DESCR STD_AXIS NO_INPUT_QUANTITY CM_0006 5 -3550 3003.5 /end AXIS_DESCR /end CHARACTERISTIC
/begin CHARACTERISTIC KF_TZ_GRUND "Base ignition-angle map for part load [verified]" MAP 0x771E6 RL_MAP_SW_SW_SW 0 CM_0028 -3276.8 3276.7 /begin AXIS_DESCR STD_AXIS NO_INPUT_QUANTITY CM_0002 18 -32768 32767 /end AXIS_DESCR /begin AXIS_DESCR STD_AXIS NO_INPUT_QUANTITY CM_0003 12 -3.2768 3.2767 /end AXIS_DESCR /end CHARACTERISTIC
/begin CHARACTERISTIC KF_TZ_I "Coil-current map for dwell calculation [verified]" MAP 0x7DDF8 RL_MAP_SW_SW_SW 0 CM_0119 -32.768 32.767 /begin AXIS_DESCR STD_AXIS NO_INPUT_QUANTITY CM_0002 5 -32768 32767 /end AXIS_DESCR /begin AXIS_DESCR STD_AXIS NO_INPUT_QUANTITY CM_0003 7 -3.2768 3.2767 /end AXIS_DESCR /end CHARACTERISTIC
/begin CHARACTERISTIC KF_TZ_I_SZ "Dwell time map [verified]" MAP 0x7DE58 RL_MAP_SW_SW_SW 0 CM_0120 -26.2144 26.2136 /begin AXIS_DESCR STD_AXIS NO_INPUT_QUANTITY CM_0119 5 -32.768 32.767 /end AXIS_DESCR /begin AXIS_DESCR STD_AXIS NO_INPUT_QUANTITY CM_0021 7 -3276.8 3276.7 /end AXIS_DESCR /end CHARACTERISTIC
/begin CHARACTERISTIC KF_TZ_LL "Idle ignition angle vs engine speed and charge [verified]" MAP 0x7E13C RL_MAP_SW_SW_SW 0 CM_0028 -3276.8 3276.7 /begin AXIS_DESCR STD_AXIS NO_INPUT_QUANTITY CM_0002 10 -32768 32767 /end AXIS_DESCR /begin AXIS_DESCR STD_AXIS NO_INPUT_QUANTITY CM_0003 5 -3.2768 3.2767 /end AXIS_DESCR /end CHARACTERISTIC
/begin CHARACTERISTIC KF_TZ_MIN "Coil-current map for dwell calculation [verified]" MAP 0x7E040 RL_MAP_SW_SW_SW 0 CM_0028 -3276.8 3276.7 /begin AXIS_DESCR STD_AXIS NO_INPUT_QUANTITY CM_0002 8 -32768 32767 /end AXIS_DESCR /begin AXIS_DESCR STD_AXIS NO_INPUT_QUANTITY CM_0003 6 -3.2768 3.2767 /end AXIS_DESCR /end CHARACTERISTIC
/begin CHARACTERISTIC KF_TZ_MIN_DYN_GRAD "Rate limit for tz_min_dyn [verified]" MAP 0x7DF1A RL_MAP_SW_SW_UW 0 CM_0121 0 6553.5 /begin AXIS_DESCR STD_AXIS NO_INPUT_QUANTITY CM_0002 6 -32768 32767 /end AXIS_DESCR /begin AXIS_DESCR STD_AXIS NO_INPUT_QUANTITY CM_0003 6 -3.2768 3.2767 /end AXIS_DESCR /end CHARACTERISTIC
/begin CHARACTERISTIC KF_TZ_MIN_KH "Latest permitted ignition angle during catalyst heating [verified]" MAP 0x7E0BE RL_MAP_SW_SW_SW 0 CM_0028 -3276.8 3276.7 /begin AXIS_DESCR STD_AXIS NO_INPUT_QUANTITY CM_0002 8 -32768 32767 /end AXIS_DESCR /begin AXIS_DESCR STD_AXIS NO_INPUT_QUANTITY CM_0003 6 -3.2768 3.2767 /end AXIS_DESCR /end CHARACTERISTIC
/begin CHARACTERISTIC KF_TZ_NZ_ANZ "Number of re-ignitions (multi-spark) [verified]" MAP 0x7DDBE RL_MAP_SW_SW_UB 0 CM_0000 0 255 /begin AXIS_DESCR STD_AXIS NO_INPUT_QUANTITY CM_0003 8 -3.2768 3.2767 /end AXIS_DESCR /begin AXIS_DESCR STD_AXIS NO_INPUT_QUANTITY CM_0002 4 -32768 32767 /end AXIS_DESCR /end CHARACTERISTIC
/begin CHARACTERISTIC KF_TZ_NZ_CHARGE "Energising time for re-ignition pulses [verified]" MAP 0x7DD50 RL_MAP_SW_SW_SW 0 CM_0120 -26.2144 26.2136 /begin AXIS_DESCR STD_AXIS NO_INPUT_QUANTITY CM_0021 4 -3276.8 3276.7 /end AXIS_DESCR /begin AXIS_DESCR STD_AXIS NO_INPUT_QUANTITY CM_0002 4 -32768 32767 /end AXIS_DESCR /end CHARACTERISTIC
/begin CHARACTERISTIC KF_TZ_TKORR "Load- and speed-dependent ignition-angle correction [verified]" MAP 0x7DD82 RL_MAP_SW_SW_SW 0 CM_0028 -3276.8 3276.7 /begin AXIS_DESCR STD_AXIS NO_INPUT_QUANTITY CM_0002 4 -32768 32767 /end AXIS_DESCR /begin AXIS_DESCR STD_AXIS NO_INPUT_QUANTITY CM_0003 5 -3.2768 3.2767 /end AXIS_DESCR /end CHARACTERISTIC
/begin CHARACTERISTIC KF_TZ_VL "Full-load ignition angle [verified]" MAP 0x7E1C0 RL_MAP_SW_SW_SW 0 CM_0028 -3276.8 3276.7 /begin AXIS_DESCR STD_AXIS NO_INPUT_QUANTITY CM_0002 18 -32768 32767 /end AXIS_DESCR /begin AXIS_DESCR STD_AXIS NO_INPUT_QUANTITY CM_0022 3 -2048 2047.9375 /end AXIS_DESCR /end CHARACTERISTIC
/begin CHARACTERISTIC KL_TZ_DBGR_AQ_RF_FR "Trigger threshold for DBGR vs relative charge and engine speed [verified]" CURVE 0x7DC6C RL_CUR_SW_SW 0 CM_0003 -3.2768 3.2767 /begin AXIS_DESCR STD_AXIS NO_INPUT_QUANTITY CM_0002 4 -32768 32767 /end AXIS_DESCR /end CHARACTERISTIC
/begin CHARACTERISTIC KL_TZ_DBGR_TRIGGER "Ignition-angle offset at start vs engine temperature [verified]" CURVE 0x7DC5A RL_CUR_SW_SW 0 CM_0122 -163.84 163.835 /begin AXIS_DESCR STD_AXIS NO_INPUT_QUANTITY CM_0002 4 -32768 32767 /end AXIS_DESCR /end CHARACTERISTIC
/begin CHARACTERISTIC KL_TZ_MIN_TMOT "Offset of latest permitted ignition angle [verified]" CURVE 0x7DC90 RL_CUR_SW_SW 0 CM_0028 -3276.8 3276.7 /begin AXIS_DESCR STD_AXIS NO_INPUT_QUANTITY CM_0006 4 -3550 3003.5 /end AXIS_DESCR /end CHARACTERISTIC
/begin CHARACTERISTIC KL_TZ_MIN_TMOT_KH "Offset of latest permitted ignition angle during catalyst heating [verified]" CURVE 0x7DCA2 RL_CUR_SW_SW 0 CM_0028 -3276.8 3276.7 /begin AXIS_DESCR STD_AXIS NO_INPUT_QUANTITY CM_0006 4 -3550 3003.5 /end AXIS_DESCR /end CHARACTERISTIC
/begin CHARACTERISTIC KL_TZ_NZ_DISCHARGE "Spark burn-time limit before re-ignition pulses [verified]" CURVE 0x7DCB4 RL_CUR_SW_SW 0 CM_0120 -26.2144 26.2136 /begin AXIS_DESCR STD_AXIS NO_INPUT_QUANTITY CM_0002 5 -32768 32767 /end AXIS_DESCR /end CHARACTERISTIC
/begin CHARACTERISTIC KL_TZ_PHASE "Ignition angle during shift cut vs engine speed [verified]" CURVE 0x7DC7E RL_CUR_SW_SW 0 CM_0028 -3276.8 3276.7 /begin AXIS_DESCR STD_AXIS NO_INPUT_QUANTITY CM_0002 4 -32768 32767 /end AXIS_DESCR /end CHARACTERISTIC
/begin CHARACTERISTIC KL_TZ_START_N "Start ignition angle vs engine speed [verified]" CURVE 0x7DC3E RL_CUR_SW_SW 0 CM_0028 -3276.8 3276.7 /begin AXIS_DESCR STD_AXIS NO_INPUT_QUANTITY CM_0002 3 -32768 32767 /end AXIS_DESCR /end CHARACTERISTIC
/begin CHARACTERISTIC KL_TZ_START_TMOT "Ignition-angle offset at start vs engine temperature [verified]" CURVE 0x7DC4C RL_CUR_SW_SW 0 CM_0028 -3276.8 3276.7 /begin AXIS_DESCR STD_AXIS NO_INPUT_QUANTITY CM_0006 3 -3550 3003.5 /end AXIS_DESCR /end CHARACTERISTIC
/begin CHARACTERISTIC KL_TZ_SZ_LAM_OFFS "Dwell-time offset from lambda [verified]" CURVE 0x7DD32 RL_CUR_UW_SW 0 CM_0119 -32.768 32.767 /begin AXIS_DESCR STD_AXIS NO_INPUT_QUANTITY CM_0019 7 0 3.999941832 /end AXIS_DESCR /end CHARACTERISTIC
/begin CHARACTERISTIC KL_TZ_SZ_START_OFFS "Dwell-time offset during start [verified]" CURVE 0x7DCFE RL_CUR_SW_SW 0 CM_0119 -32.768 32.767 /begin AXIS_DESCR STD_AXIS NO_INPUT_QUANTITY CM_0006 6 -3550 3003.5 /end AXIS_DESCR /end CHARACTERISTIC
/begin CHARACTERISTIC KL_TZ_SZ_TMOT_OFFS "Dwell-time offset from engine temperature [verified]" CURVE 0x7DCCA RL_CUR_SW_SW 0 CM_0119 -32.768 32.767 /begin AXIS_DESCR STD_AXIS NO_INPUT_QUANTITY CM_0006 6 -3550 3003.5 /end AXIS_DESCR /end CHARACTERISTIC
/begin CHARACTERISTIC KL_TZ_TKORR_F "Controller correction factor [verified]" CURVE 0x7DD18 RL_CUR_SW_UW 0 CM_0016 0 63.99902344 /begin AXIS_DESCR STD_AXIS NO_INPUT_QUANTITY CM_0006 6 -3550 3003.5 /end AXIS_DESCR /end CHARACTERISTIC
/begin CHARACTERISTIC KF_TZ_MIN_DYN_INT_MAX "Max. integral threshold for dynamic tz_min intervention [degms, x/50] [verified]" MAP 0x7DEB8 RL_MAP_SW_SW_UW 0 CM_0000 0 65535 /begin AXIS_DESCR STD_AXIS NO_INPUT_QUANTITY CM_0235 6 -32768 32767 /end AXIS_DESCR /begin AXIS_DESCR STD_AXIS NO_INPUT_QUANTITY CM_0003 6 -3.2768 3.2767 /end AXIS_DESCR /end CHARACTERISTIC
/begin CHARACTERISTIC KF_TZ_MIN_DYN_OFFS "Change limit / offset for tz_min_dyn [degKW, x/10] [verified]" MAP 0x7DF7C RL_MAP_SW_SW_SW 0 CM_0013 -3276.8 3276.7 /begin AXIS_DESCR STD_AXIS NO_INPUT_QUANTITY CM_0235 6 -32768 32767 /end AXIS_DESCR /begin AXIS_DESCR STD_AXIS NO_INPUT_QUANTITY CM_0003 6 -3.2768 3.2767 /end AXIS_DESCR /end CHARACTERISTIC
/begin CHARACTERISTIC KF_TZ_MIN_DYN_T_SPERR "Lock time for tz_min_dyn [s, x/200] [verified]" MAP 0x7DFDE RL_MAP_SW_SW_UW 0 CM_0000 0 65535 /begin AXIS_DESCR STD_AXIS NO_INPUT_QUANTITY CM_0235 6 -32768 32767 /end AXIS_DESCR /begin AXIS_DESCR STD_AXIS NO_INPUT_QUANTITY CM_0003 6 -3.2768 3.2767 /end AXIS_DESCR /end CHARACTERISTIC
/begin CHARACTERISTIC KL_TZ_START_N_GTS "Start ignition angle vs speed, GTS (3 pts) [degKW x/10] [verified]" CURVE 0x7DC30 RL_CUR_SW_SW 0 CM_0013 -3276.8 3276.7 /begin AXIS_DESCR STD_AXIS NO_INPUT_QUANTITY CM_0235 3 -32768 32767 /end AXIS_DESCR /end CHARACTERISTIC
/begin CHARACTERISTIC KL_KA_TP_TAU "Low-pass tau for knock retard adaptation [s = 655.35/x] [verified]" CURVE 0x7394C RL_CUR_SW_UW 0 CM_0000 0 65535 /begin AXIS_DESCR STD_AXIS NO_INPUT_QUANTITY CM_0235 5 -32768 32767 /end AXIS_DESCR /end CHARACTERISTIC
/begin CHARACTERISTIC KL_KR_DTZ_WICHT "Weighting of adaptation share in knock retard [verified]" CURVE 0x74DE2 RL_CUR_SW_UW 0 CM_0236 0 3.999938965 /begin AXIS_DESCR STD_AXIS NO_INPUT_QUANTITY CM_0235 6 -32768 32767 /end AXIS_DESCR /end CHARACTERISTIC
/begin CHARACTERISTIC K_TZ_MAX "fruehester Zuendwinkel [verified]" VALUE 0x7DBF0 RL_VAL_SW 0 CM_0265 -3276.8 3276.7 /end CHARACTERISTIC
/begin CHARACTERISTIC K_TZ_MCS "Zuendwinkelkorrektur ueber MCS [verified]" VALUE 0x7DC04 RL_VAL_SW 0 CM_0265 -3276.8 3276.7 /end CHARACTERISTIC
/begin CHARACTERISTIC K_TZ_MCS_Z_ZYL "zyl.selektive Zuendwinkelko r-rektur ueber MCS [verified]" VALUE 0x7DC1C RL_VAL_SW 0 CM_0265 -3276.8 3276.7 /end CHARACTERISTIC
/begin CHARACTERISTIC K_TZ_MCS_Z_ZYL_1 "Cylinder-selective ignition correction, index 1 [verified]" VALUE 0x7DC1E RL_VAL_SW 0 CM_0265 -3276.8 3276.7 /end CHARACTERISTIC
/begin CHARACTERISTIC K_TZ_MCS_Z_ZYL_2 "Cylinder-selective ignition correction, index 2 [verified]" VALUE 0x7DC20 RL_VAL_SW 0 CM_0265 -3276.8 3276.7 /end CHARACTERISTIC
/begin CHARACTERISTIC K_TZ_MCS_Z_ZYL_3 "Cylinder-selective ignition correction, index 3 [verified]" VALUE 0x7DC22 RL_VAL_SW 0 CM_0265 -3276.8 3276.7 /end CHARACTERISTIC
/begin CHARACTERISTIC K_TZ_MCS_Z_ZYL_4 "Cylinder-selective ignition correction, index 4 [verified]" VALUE 0x7DC24 RL_VAL_SW 0 CM_0265 -3276.8 3276.7 /end CHARACTERISTIC
/begin CHARACTERISTIC K_TZ_MCS_Z_ZYL_5 "Cylinder-selective ignition correction, index 5 [verified]" VALUE 0x7DC26 RL_VAL_SW 0 CM_0265 -3276.8 3276.7 /end CHARACTERISTIC
/begin CHARACTERISTIC K_TZ_MCS_Z_ZYL_6 "Cylinder-selective ignition correction, index 6 [verified]" VALUE 0x7DC28 RL_VAL_SW 0 CM_0265 -3276.8 3276.7 /end CHARACTERISTIC
/begin CHARACTERISTIC K_TZ_MCS_Z_ZYL_7 "Cylinder-selective ignition correction, index 7 [verified]" VALUE 0x7DC2A RL_VAL_SW 0 CM_0265 -3276.8 3276.7 /end CHARACTERISTIC
/begin CHARACTERISTIC K_TZ_MCS_Z_ZYL_8 "Cylinder-selective ignition correction, index 8 [verified]" VALUE 0x7DC2C RL_VAL_SW 0 CM_0265 -3276.8 3276.7 /end CHARACTERISTIC
/begin CHARACTERISTIC K_TZ_MCS_Z_ZYL_9 "Cylinder-selective ignition correction, index 9 [verified]" VALUE 0x7DC2E RL_VAL_SW 0 CM_0265 -3276.8 3276.7 /end CHARACTERISTIC
/begin CHARACTERISTIC K_TZ_NZ_N_MAX "Maximale Drehzahl bei der noch Nachzuender ausgeg e- ben werden. [verified]" VALUE 0x7DC10 RL_VAL_SW 0 CM_0235 -32768 32767 /end CHARACTERISTIC
/begin CHARACTERISTIC K_TZ_MIN_DYN_TMOT "Tmot-Schwelle fuer tz_min_dyn_st [verified]" VALUE 0x7DC1A RL_VAL_SW 0 CM_0258 -3550 3003.5 /end CHARACTERISTIC
/begin CHARACTERISTIC K_TZ_MIN_DYN_CFG "0 aus 1 ein ohne DSC Konfigbyte fuer TZ-Eingriff 2 ein mit DSC 1 ELSE undef [verified]" VALUE 0x7DBE4 RL_VAL_UB 0 CM_0000 0 255 /end CHARACTERISTIC
/begin CHARACTERISTIC K_TZ_DBGR_TMOT "Schwelle fuer DBGR -Fkt. aktive [verified]" VALUE 0x7DC0E RL_VAL_SW 0 CM_0258 -3550 3003.5 /end CHARACTERISTIC
/begin CHARACTERISTIC K_TZ_DN_ZWB "Drehzahl Hysterese fuer ZWB [verified]" VALUE 0x7DC02 RL_VAL_SW 0 CM_0002 -32768 32767 /end CHARACTERISTIC
/begin CHARACTERISTIC KF_MD_ZW_TMOT_ML_FAK "Weighting factor for KF_MD_ZW_OFFSET vs start temperature and time since start [verified]" MAP 0x77B6A RL_MAP_SW_SW_UB 0 CM_0269 0 1.9921875 /begin AXIS_DESCR STD_AXIS NO_INPUT_QUANTITY CM_0006 6 -3550 3003.5 /end AXIS_DESCR /begin AXIS_DESCR STD_AXIS NO_INPUT_QUANTITY CM_0025 6 -327.68 327.67 /end AXIS_DESCR /end CHARACTERISTIC
/begin CHARACTERISTIC KF_MD_ZW_OPT_FAK_OFFS_RG "Weighting for optimum-ignition offset (exhaust VANOS deviation) [verified]" MAP 0x77BA8 RL_MAP_SW_SW_UB 0 CM_0269 0 1.9921875 /begin AXIS_DESCR STD_AXIS NO_INPUT_QUANTITY CM_0235 6 -32768 32767 /end AXIS_DESCR /begin AXIS_DESCR STD_AXIS NO_INPUT_QUANTITY CM_0003 6 -3.2768 3.2767 /end AXIS_DESCR /end CHARACTERISTIC
/begin CHARACTERISTIC KF_MD_IND_LW_FAK_OFFS_RG "Weighting for charge-exchange loss offset (exhaust VANOS deviation) [verified]" MAP 0x77BE6 RL_MAP_SW_SW_UB 0 CM_0269 0 1.9921875 /begin AXIS_DESCR STD_AXIS NO_INPUT_QUANTITY CM_0235 3 -32768 32767 /end AXIS_DESCR /begin AXIS_DESCR STD_AXIS NO_INPUT_QUANTITY CM_0003 3 -3.2768 3.2767 /end AXIS_DESCR /end CHARACTERISTIC
/begin CHARACTERISTIC KF_MD_ZW_OPT_OFFS_KH "Optimum ignition offset during cat heating [degKW x/10] [EST]" MAP 0x77410 RL_MAP_SW_SW_SW 0 CM_0013 -3276.8 3276.7 /begin AXIS_DESCR STD_AXIS NO_INPUT_QUANTITY CM_0235 12 -32768 32767 /end AXIS_DESCR /begin AXIS_DESCR STD_AXIS NO_INPUT_QUANTITY CM_0003 12 -3.2768 3.2767 /end AXIS_DESCR /end CHARACTERISTIC
/begin CHARACTERISTIC KF_MD_IND_LW_OFFS_KH "Charge-exchange loss offset during cat heating [verified]" MAP 0x771A0 RL_MAP_SW_SW_SW 0 CM_0017 -3276.8 3276.7 /begin AXIS_DESCR STD_AXIS NO_INPUT_QUANTITY CM_0235 6 -32768 32767 /end AXIS_DESCR /begin AXIS_DESCR STD_AXIS NO_INPUT_QUANTITY CM_0003 4 -3.2768 3.2767 /end AXIS_DESCR /end CHARACTERISTIC
/begin CHARACTERISTIC KF_MD_POLYNOM_A_KH "Polynomial A parameter for ignition-efficiency hook during cat heating [verified]" MAP 0x77750 RL_MAP_SW_SW_SW 0 CM_0000 -32768 32767 /begin AXIS_DESCR STD_AXIS NO_INPUT_QUANTITY CM_0235 18 -32768 32767 /end AXIS_DESCR /begin AXIS_DESCR STD_AXIS NO_INPUT_QUANTITY CM_0003 12 -3.2768 3.2767 /end AXIS_DESCR /end CHARACTERISTIC
/begin CHARACTERISTIC KL_MD_ZW_OPT_OFFS_RG "Optimum ignition offset vs exhaust VANOS deviation [degKW] [verified]" CURVE 0x76A9C RL_CUR_SW_SW 0 CM_0013 -3276.8 3276.7 /begin AXIS_DESCR STD_AXIS NO_INPUT_QUANTITY CM_0013 6 -3276.8 3276.7 /end AXIS_DESCR /end CHARACTERISTIC
/begin CHARACTERISTIC KL_MD_IND_LW_OFFS_RG "Charge-exchange loss offset vs exhaust VANOS deviation [verified]" CURVE 0x76AB6 RL_CUR_SW_SW 0 CM_0017 -3276.8 3276.7 /begin AXIS_DESCR STD_AXIS NO_INPUT_QUANTITY CM_0013 3 -3276.8 3276.7 /end AXIS_DESCR /end CHARACTERISTIC
/begin CHARACTERISTIC KF_MD_IND_MIN_SCHUB_DKG "Min. overrun torque - DKG [verified]" MAP 0x76F3C RL_MAP_SW_SW_SW 0 CM_0017 -3276.8 3276.7 /begin AXIS_DESCR STD_AXIS NO_INPUT_QUANTITY CM_0235 8 -32768 32767 /end AXIS_DESCR /begin AXIS_DESCR STD_AXIS NO_INPUT_QUANTITY CM_0006 6 -3550 3003.5 /end AXIS_DESCR /end CHARACTERISTIC
/begin CHARACTERISTIC KF_MD_START_OFFSET "Torque feed-forward for start [verified]" MAP 0x779CC RL_MAP_SW_SW_SW 0 CM_0017 -3276.8 3276.7 /begin AXIS_DESCR STD_AXIS NO_INPUT_QUANTITY CM_0235 5 -32768 32767 /end AXIS_DESCR /begin AXIS_DESCR STD_AXIS NO_INPUT_QUANTITY CM_0006 6 -3550 3003.5 /end AXIS_DESCR /end CHARACTERISTIC
/begin CHARACTERISTIC KF_MD_START_OFFSET_MSA "Torque feed-forward for MSA driver start [verified]" MAP 0x77984 RL_MAP_SW_SW_SW 0 CM_0017 -3276.8 3276.7 /begin AXIS_DESCR STD_AXIS NO_INPUT_QUANTITY CM_0235 5 -32768 32767 /end AXIS_DESCR /begin AXIS_DESCR STD_AXIS NO_INPUT_QUANTITY CM_0006 3 -3550 3003.5 /end AXIS_DESCR /end CHARACTERISTIC
/begin CHARACTERISTIC KF_MD_VERBR_FZG_DKG "Consumer torque offset - DKG vehicle [verified]" MAP 0x77A74 RL_MAP_SW_SW_SW 0 CM_0017 -3276.8 3276.7 /begin AXIS_DESCR STD_AXIS NO_INPUT_QUANTITY CM_0235 6 -32768 32767 /end AXIS_DESCR /begin AXIS_DESCR STD_AXIS NO_INPUT_QUANTITY CM_0006 5 -3550 3003.5 /end AXIS_DESCR /end CHARACTERISTIC
/begin CHARACTERISTIC KL_MD_IND_REIB_FAK "Friction torque weighting after start [verified]" CURVE 0x76C0A RL_CUR_UW_UW 0 CM_0016 0 63.99902344 /begin AXIS_DESCR STD_AXIS NO_INPUT_QUANTITY CM_0233 5 0 1092.25 /end AXIS_DESCR /end CHARACTERISTIC
/begin CHARACTERISTIC KL_EGAS_STM_DK_NP_TMOT "Throttle zero-point re-adaptation threshold vs tmot [verified]" CURVE 0x7248C RL_CUR_SW_SW 0 CM_0272 -3276.8 3276.7 /begin AXIS_DESCR STD_AXIS NO_INPUT_QUANTITY CM_0006 5 -3550 3003.5 /end AXIS_DESCR /end CHARACTERISTIC
/begin CHARACTERISTIC KL_EGAS_WDK_TMOT_OFFS "Throttle-pot voltage offset vs tmot [V, x*5/1024] [verified]" CURVE 0x718C6 RL_CUR_SW_SW 0 CM_0000 -32768 32767 /begin AXIS_DESCR STD_AXIS NO_INPUT_QUANTITY CM_0006 4 -3550 3003.5 /end AXIS_DESCR /end CHARACTERISTIC
/begin CHARACTERISTIC KL_EGAS_SOLL_AQ_ABS_SW "Threshold for gradient limit of target area vs speed [verified]" CURVE 0x718E2 RL_CUR_SW_UW 0 CM_0012 0 6553.5 /begin AXIS_DESCR STD_AXIS NO_INPUT_QUANTITY CM_0235 6 -32768 32767 /end AXIS_DESCR /end CHARACTERISTIC
/begin CHARACTERISTIC KF_EGAS_N_AQ_ML_NEG "Negative speed filter (tau) vs n and target area, engine running [verified]" MAP 0x7230A RL_MAP_SW_SW_UB 0 CM_0065 0.005019607843 1.28 /begin AXIS_DESCR STD_AXIS NO_INPUT_QUANTITY CM_0235 6 -32768 32767 /end AXIS_DESCR /begin AXIS_DESCR STD_AXIS NO_INPUT_QUANTITY CM_0012 5 -3276.8 3276.7 /end AXIS_DESCR /end CHARACTERISTIC
/begin CHARACTERISTIC K_EGAS_STM_DK_NP_TMOT_MIN "min. Temp fuer Nullpunktadaption [verified]" VALUE 0x7246C RL_VAL_SW 0 CM_0258 -3550 3003.5 /end CHARACTERISTIC
/begin CHARACTERISTIC K_EGAS_SOLL_START_MD_RAMP "Rampe fuer EGAS_SOLL rf nach Start in ML [verified]" VALUE 0x7188C RL_VAL_UW 0 CM_0025 0 655.35 /end CHARACTERISTIC
/begin CHARACTERISTIC K_EGAS_SOLL_AQ_TI_OFF "Notlaufquerschnitt bei Bankabschaltung [verified]" VALUE 0x71852 RL_VAL_UW 0 CM_0012 0 6553.5 /end CHARACTERISTIC
/begin CHARACTERISTIC K_EGAS_SOLL_MCS_DK "DK-Sollwert [verified]" VALUE 0x71858 RL_VAL_SW 0 CM_0013 -3276.8 3276.7 /end CHARACTERISTIC
/begin CHARACTERISTIC K_EGAS_SOLL_MCS_LLS "DK-Sollwert [verified]" VALUE 0x7185A RL_VAL_SW 0 CM_0013 -3276.8 3276.7 /end CHARACTERISTIC
/begin CHARACTERISTIC K_EGAS_SOLL_GT_OFF "Offsetsprung beim Gestaengetest [verified]" VALUE 0x71856 RL_VAL_SW 0 CM_0013 -3276.8 3276.7 /end CHARACTERISTIC
/begin CHARACTERISTIC K_MD_BLS_N_VMA "Schwelle Drehzahl [verified]" VALUE 0x79172 RL_VAL_SW 0 CM_0002 -32768 32767 /end CHARACTERISTIC
/begin CHARACTERISTIC K_MD_BLS_GANG_VMA "Schwelle Gang [verified]" VALUE 0x7917A RL_VAL_SB 0 CM_0015 -128 127 /end CHARACTERISTIC
/begin CHARACTERISTIC K_MD_BLS_DN_VMA "Schwelle Drehzahlgradient [verified]" VALUE 0x79176 RL_VAL_SW 0 CM_0067 -32768 32767 /end CHARACTERISTIC
/begin CHARACTERISTIC K_MD_BLS_BRP_VMA "Schwelle Bremsdruck [verified]" VALUE 0x7917C RL_VAL_UB 0 CM_0085 0 255 /end CHARACTERISTIC
/begin CHARACTERISTIC K_MD_BLS_N_VMA_DKG "Schwelle Drehzahl-DKG [verified]" VALUE 0x79174 RL_VAL_SW 0 CM_0002 -32768 32767 /end CHARACTERISTIC
/begin CHARACTERISTIC K_MD_BLS_GANG_VMA_DKG "Schwelle Gang-DKG [verified]" VALUE 0x7917B RL_VAL_SB 0 CM_0015 -128 127 /end CHARACTERISTIC
/begin CHARACTERISTIC K_MD_BLS_DN_VMA_DKG "Schwelle Drehzahlgradient-DKG [verified]" VALUE 0x79178 RL_VAL_SW 0 CM_0067 -32768 32767 /end CHARACTERISTIC
/begin CHARACTERISTIC K_MD_BLS_FW_REL_VMA_DKG "Schwelle Fahrerwunsch-DKG [verified]" VALUE 0x7917E RL_VAL_SW 0 CM_0276 -3276.8 3276.7 /end CHARACTERISTIC
/begin CHARACTERISTIC K_MD_BLS_BRP "Schwelle Bremsdruck [verified]" VALUE 0x7916D RL_VAL_UB 0 CM_0085 0 255 /end CHARACTERISTIC
/begin CHARACTERISTIC K_MD_BLS_FW_REL "Schwelle Bremsdruck [verified]" VALUE 0x79170 RL_VAL_SW 0 CM_0276 -3276.8 3276.7 /end CHARACTERISTIC
/begin CHARACTERISTIC K_MD_BLS_N "Schwelle Bremsdruck [verified]" VALUE 0x7916E RL_VAL_SW 0 CM_0002 -32768 32767 /end CHARACTERISTIC
/begin CHARACTERISTIC K_MD_LRW_RES_V "LRW-v-Schwelle [verified]" VALUE 0x77C4A RL_VAL_SW 0 CM_0260 -2048 2047.9375 /end CHARACTERISTIC
/begin CHARACTERISTIC K_MD_LRW_RES_V_HYS "LRW-v-Schwelle Hys [verified]" VALUE 0x77C4C RL_VAL_SW 0 CM_0260 -2048 2047.9375 /end CHARACTERISTIC
/begin CHARACTERISTIC K_MD_LRW_TAU "TAU KKOS-Aufregel [verified]" VALUE 0x77C47 RL_VAL_UB 0 CM_0277 0.01003921569 2.56 /end CHARACTERISTIC
/begin CHARACTERISTIC K_MD_LRW_RES_DELTA "LRW-Begrenzung [verified]" VALUE 0x77C48 RL_VAL_UB 0 CM_0088 0 2550 /end CHARACTERISTIC
/begin CHARACTERISTIC K_MD_RAD_STEIGUNG_TAU "Tau Steigung [verified]" VALUE 0x789EE RL_VAL_UB 0 CM_0065 0.005019607843 1.28 /end CHARACTERISTIC
/begin CHARACTERISTIC K_MD_KKOS_V_VL "Schwelle fuer VL [verified]" VALUE 0x77C20 RL_VAL_SW 0 CM_0260 -2048 2047.9375 /end CHARACTERISTIC
/begin CHARACTERISTIC K_MD_KKOS_V_VL_AUS "Schwelle fuer VL aus [verified]" VALUE 0x77C22 RL_VAL_SW 0 CM_0260 -2048 2047.9375 /end CHARACTERISTIC
/begin CHARACTERISTIC K_MD_KKOS_V_BA "Schwelle fuer Beschl. [verified]" VALUE 0x77C24 RL_VAL_SW 0 CM_0260 -2048 2047.9375 /end CHARACTERISTIC
/begin CHARACTERISTIC K_MD_KKOS_TIME_START "Schwelle Startfreigabe [verified]" VALUE 0x77C26 RL_VAL_UW 0 CM_0247 0 655.35 /end CHARACTERISTIC
/begin CHARACTERISTIC K_MD_KKOS_START "Faktor Startoffset [verified]" VALUE 0x77C2C RL_VAL_UW 0 CM_0245 0 63.99902344 /end CHARACTERISTIC
/begin CHARACTERISTIC K_MD_KKOS_TAU_ON "TAU KKOS-Aufregel [verified]" VALUE 0x77C2E RL_VAL_UB 0 CM_0065 0.005019607843 1.28 /end CHARACTERISTIC
/begin CHARACTERISTIC K_MD_KKOS_TAU_OFF "TAU KKOS-Aufregel [verified]" VALUE 0x77C2F RL_VAL_UB 0 CM_0065 0.005019607843 1.28 /end CHARACTERISTIC
/begin CHARACTERISTIC K_MD_KKOS_ZH_TMOT "Motortemp. fuer ZH-Reserve [verified]" VALUE 0x77C38 RL_VAL_SW 0 CM_0256 -3550 3003.5 /end CHARACTERISTIC
/begin CHARACTERISTIC K_MD_KKOS_ZH_TUMG "Umgebungstemp. fuer ZH-Reserve [verified]" VALUE 0x77C3A RL_VAL_SW 0 CM_0256 -3550 3003.5 /end CHARACTERISTIC
/begin CHARACTERISTIC K_MD_KKOS_ZH_RES_T_MAX "Maxzeit fuer ZH-Reserve [verified]" VALUE 0x77C3C RL_VAL_UW 0 CM_0247 0 655.35 /end CHARACTERISTIC
/begin CHARACTERISTIC K_MD_KKOS_RES_T_MAX "Maxzeit fuer Reserve [verified]" VALUE 0x77C36 RL_VAL_UW 0 CM_0247 0 655.35 /end CHARACTERISTIC
/begin CHARACTERISTIC K_MD_KKOS_MDRV "0 Komfort 1 Normal 2 Sport ELSE undef VL-/Beschl-Sperre ueber MDrv-Status [verified]" VALUE 0x77C50 RL_VAL_UB 0 CM_0000 0 255 /end CHARACTERISTIC
/begin CHARACTERISTIC K_MD_ANFF_PWG_ON "Anfahrfilter Pwg-Schwelle On [verified]" VALUE 0x77D86 RL_VAL_SW 0 CM_0276 -3276.8 3276.7 /end CHARACTERISTIC
/begin CHARACTERISTIC K_MD_ANFF_PWG_OFF "Anfahrfilter Pwg-Schwelle Off [verified]" VALUE 0x77D88 RL_VAL_SW 0 CM_0276 -3276.8 3276.7 /end CHARACTERISTIC
/begin CHARACTERISTIC K_KA_TZ_ROZ_RES "Reset Wert fue ROZ Adaption. [verified]" VALUE 0x738CC RL_VAL_SL 0 CM_0279 -13107.2 13107.19999 /end CHARACTERISTIC
/begin CHARACTERISTIC K_KA_ADAPT_MIN_ROZ "Min KA Zuendwinkeleingriff waehrend ROZ Adaption. [verified]" VALUE 0x738F6 RL_VAL_SW 0 CM_0280 -3276.8 3276.7 /end CHARACTERISTIC
/begin CHARACTERISTIC K_KA_ADAPT_MIN_ROZ_S "Min KA Zuendwinkeleingriff waehrend ROZ Adaption fuer minderwertigen Kraftstoff. [verified]" VALUE 0x738F8 RL_VAL_SW 0 CM_0280 -3276.8 3276.7 /end CHARACTERISTIC
/begin CHARACTERISTIC K_KA_ADAPT_MAX_ROZ "Max KA Zuendwinkeleingriff waehrend ROZ Adaption. [verified]" VALUE 0x738F4 RL_VAL_SW 0 CM_0280 -3276.8 3276.7 /end CHARACTERISTIC
/begin CHARACTERISTIC K_KA_TMOT_MIN "Maximaltemperatur fuer KA-Freigabe [verified]" VALUE 0x738DC RL_VAL_SW 0 CM_0256 -3550 3003.5 /end CHARACTERISTIC
/begin CHARACTERISTIC K_KR_TMOT_MIN "Maximaltemperatur fuer KR-Freigabe [verified]" VALUE 0x74D9C RL_VAL_SW 0 CM_0256 -3550 3003.5 /end CHARACTERISTIC
/begin CHARACTERISTIC K_KA_TZ_KF_AEB_SPAET "Aenderungsbegrenzung fuer KA Zuendwinkelkorrektur in Ric h- tung spaet. [verified]" VALUE 0x73900 RL_VAL_SW 0 CM_0281 -327.68 327.67 /end CHARACTERISTIC
/begin CHARACTERISTIC K_KA_TZ_KF_AEB_FRUEH "Aenderungsbegrenzung fuer KA Zuendwinkelkorrektur in Ric h- tung frueh. [verified]" VALUE 0x738FE RL_VAL_SW 0 CM_0281 -327.68 327.67 /end CHARACTERISTIC
/begin CHARACTERISTIC K_KA_B_N_HYST "Hysterese n-Schwelle. [verified]" VALUE 0x738F0 RL_VAL_SW 0 CM_0002 -32768 32767 /end CHARACTERISTIC
/begin CHARACTERISTIC K_KA_B_RF_HYST "Hysterese rf-Schwelle. [verified]" VALUE 0x738F2 RL_VAL_SW 0 CM_0282 -3.2768 3.2767 /end CHARACTERISTIC
/begin CHARACTERISTIC K_TZ_RF_ZWB "RF Umschaltschwelle fuer ZWB [verified]" VALUE 0x7DBFE RL_VAL_SW 0 CM_0282 -3.2768 3.2767 /end CHARACTERISTIC
/begin CHARACTERISTIC K_TZ_ZWB_B1 "Aenderungsbegrenzung B e-reich 1 [verified]" VALUE 0x7DBF2 RL_VAL_SW 0 CM_0296 -3276.8 3276.7 /end CHARACTERISTIC
/begin CHARACTERISTIC K_TZ_ZWB_B2 "Aenderungsbegrenzung B e-reich 2 [verified]" VALUE 0x7DBF4 RL_VAL_SW 0 CM_0296 -3276.8 3276.7 /end CHARACTERISTIC
/begin CHARACTERISTIC K_TZ_ZWB_B3 "Aenderungsbegrenzung B e-reich 3 [verified]" VALUE 0x7DBF6 RL_VAL_SW 0 CM_0296 -3276.8 3276.7 /end CHARACTERISTIC
/begin CHARACTERISTIC K_TZ_KH_RF_ZWB "RF Umschaltschwelle fuer ZWB im KH [verified]" VALUE 0x7DC00 RL_VAL_SW 0 CM_0282 -3.2768 3.2767 /end CHARACTERISTIC
/begin CHARACTERISTIC K_TZ_KH_ZWB_B1 "Aenderungsbegrenzung B e-reich 1 im KH [verified]" VALUE 0x7DBF8 RL_VAL_SW 0 CM_0296 -3276.8 3276.7 /end CHARACTERISTIC
/begin CHARACTERISTIC K_TZ_KH_ZWB_B2 "Aenderungsbegrenzung B e-reich 2 im KH [verified]" VALUE 0x7DBFA RL_VAL_SW 0 CM_0296 -3276.8 3276.7 /end CHARACTERISTIC
/begin CHARACTERISTIC K_TZ_KH_ZWB_B3 "Aenderungsbegrenzung B e-reich 3 im KH [verified]" VALUE 0x7DBFC RL_VAL_SW 0 CM_0296 -3276.8 3276.7 /end CHARACTERISTIC
/begin CHARACTERISTIC K_TZ_UB_ERSATZ "Ub-Ersatzwert fuer Schlies s-zeitberechnung [verified]" VALUE 0x7DC06 RL_VAL_SW 0 CM_0297 -3276.8 3276.7 /end CHARACTERISTIC
/begin CHARACTERISTIC K_TZ_SZ_CONTROL "Kontrollbits Bit1 - > Zyl1 (1: ueber K_TZ_SZ_MCS 0: ueber Funktion) [verified]" VALUE 0x7DBE6 RL_VAL_UW 0 CM_0000 0 65535 /end CHARACTERISTIC
/begin CHARACTERISTIC K_TZ_SZ_MCS "Festwert fuer Schliesszeit [verified]" VALUE 0x7DC0A RL_VAL_SW 0 CM_0298 -26.2144 26.2136 /end CHARACTERISTIC
/begin CHARACTERISTIC K_TZ_SZ_MAX "Maximaler Spulenstrom [verified]" VALUE 0x7DC08 RL_VAL_SW 0 CM_0299 -32.768 32.767 /end CHARACTERISTIC
/begin CHARACTERISTIC K_TZ_I_BEGR "Begrenzter Spulenstrom bei SA oder Zuendaussetzer [verified]" VALUE 0x7DC0C RL_VAL_SW 0 CM_0299 -32.768 32.767 /end CHARACTERISTIC
/begin CHARACTERISTIC K_TZ_NZ_ANZ_ST "Anzahl der Nachzuendungnen im Start [verified]" VALUE 0x7DBDE RL_VAL_UB 0 CM_0000 0 255 /end CHARACTERISTIC
/begin CHARACTERISTIC K_TZ_NZ_CHARGE_ST "Bestromungszeit f uer Nac h-zuendpulse im Start [verified]" VALUE 0x7DC12 RL_VAL_SW 0 CM_0298 -26.2144 26.2136 /end CHARACTERISTIC
/begin CHARACTERISTIC K_TZ_NZ_DISCHARGE_ST "Funkenbrenndauerbegrenzung vor Nachzuendpulsen im Start [verified]" VALUE 0x7DC14 RL_VAL_SW 0 CM_0298 -26.2144 26.2136 /end CHARACTERISTIC
/begin CHARACTERISTIC K_EGAS_STM_LLS_DK_HYS "DK-Hysterese fuer LLS -Adaption [verified]" VALUE 0x7244C RL_VAL_SW 0 CM_0276 -3276.8 3276.7 /end CHARACTERISTIC
/begin CHARACTERISTIC K_FR_IN_CFG "0 aus laz_md_rf_soll 1 aus laz_aq_rf Konfiguration fuer Reglereingang [verified]" VALUE 0x7311E RL_VAL_UB 0 CM_0000 0 255 /end CHARACTERISTIC
/begin CHARACTERISTIC K_FRA_LOLI_CFG "0 loli 1 prov 2 aus ELSE ungueltig Konfigbyte f?r FRA -Lolimot- KNN [verified]" VALUE 0x733FA RL_VAL_UB 0 CM_0000 0 255 /end CHARACTERISTIC
/begin CHARACTERISTIC K_FRA_AQ_SOLL_ABREG "Abregelgeschwindigkeit von fra_out bei Vollast [verified]" VALUE 0x7320C RL_VAL_UW 0 CM_0321 0 399.9938965 /end CHARACTERISTIC
/begin CHARACTERISTIC KL_KR_DTZ_MIN "Eintrittsschwelle Klopfru eck-ziehwinkel fuer Klopfadaption [verified]" CURVE 0x74E16 RL_CUR_SW_SW 0 CM_0280 -3276.8 3276.7 /begin AXIS_DESCR STD_AXIS NO_INPUT_QUANTITY CM_0002 6 -32768 32767 /end AXIS_DESCR /end CHARACTERISTIC
/begin CHARACTERISTIC KL_MD_VBEGR_KR_FAK "Faktor auf KR [verified]" CURVE 0x792FA RL_CUR_SW_UW 0 CM_0245 0 63.99902344 /begin AXIS_DESCR STD_AXIS NO_INPUT_QUANTITY CM_0260 5 -2048 2047.9375 /end AXIS_DESCR /end CHARACTERISTIC
/begin CHARACTERISTIC KF_MD_DKG_BEGR_NOTLAUF "max. Moment bei DKG-Notlauf [verified]" MAP 0x7A226 RL_MAP_SW_SW_SW 0 CM_0322 -3276.8 3276.7 /begin AXIS_DESCR STD_AXIS NO_INPUT_QUANTITY CM_0002 5 -32768 32767 /end AXIS_DESCR /begin AXIS_DESCR STD_AXIS NO_INPUT_QUANTITY CM_0260 5 -2048 2047.9375 /end AXIS_DESCR /end CHARACTERISTIC
/begin CHARACTERISTIC KF_MD_RES_LOLI_FAK "Wichtungs KF fuer Loli-Reserve [verified]" MAP 0x7A5B6 RL_MAP_SW_SW_UW 0 CM_0245 0 63.99902344 /begin AXIS_DESCR STD_AXIS NO_INPUT_QUANTITY CM_0002 4 -32768 32767 /end AXIS_DESCR /begin AXIS_DESCR STD_AXIS NO_INPUT_QUANTITY CM_0322 6 -3276.8 3276.7 /end AXIS_DESCR /end CHARACTERISTIC
/begin CHARACTERISTIC KL_SCHUFUKA_STRESS_FAK "Unidentified curve (chapter by calling function: unknown). Raw values. [verified]" CURVE 0x7BB10 RL_CUR_SW_UW 0 CM_0000 0 65535 /begin AXIS_DESCR STD_AXIS NO_INPUT_QUANTITY CM_0000 6 -32768 32767 /end AXIS_DESCR /end CHARACTERISTIC
/begin CHARACTERISTIC KF_SCHUFUKA_STRESS_INC_STAT "Unidentified map (chapter by calling function: SK-Manager). Raw values. [verified]" MAP 0x7BB34 RL_MAP_SW_SW_SW 0 CM_0000 -32768 32767 /begin AXIS_DESCR STD_AXIS NO_INPUT_QUANTITY CM_0000 10 -32768 32767 /end AXIS_DESCR /begin AXIS_DESCR STD_AXIS NO_INPUT_QUANTITY CM_0000 10 -32768 32767 /end AXIS_DESCR /end CHARACTERISTIC
/begin CHARACTERISTIC KL_MD_KUPP_MAX "Max. IPM-Kupplungsmoment [verified]" CURVE 0x78A28 RL_CUR_SW_SW 0 CM_0322 -3276.8 3276.7 /begin AXIS_DESCR STD_AXIS NO_INPUT_QUANTITY CM_0002 11 -32768 32767 /end AXIS_DESCR /end CHARACTERISTIC
/begin CHARACTERISTIC KL_MD_RF_SOLL_MAX_SK "maximale Sollfuellung bei Psau [verified]" CURVE 0x791E8 RL_CUR_SW_SW 0 CM_0282 -3.2768 3.2767 /begin AXIS_DESCR STD_AXIS NO_INPUT_QUANTITY CM_0002 8 -32768 32767 /end AXIS_DESCR /end CHARACTERISTIC
/begin CHARACTERISTIC KF_MD_LRW "LRW-Moment [verified]" MAP 0x77D0E RL_MAP_SW_SW_SW 0 CM_0322 -3276.8 3276.7 /begin AXIS_DESCR STD_AXIS NO_INPUT_QUANTITY CM_0220 6 -1440.1536 1440.10965 /end AXIS_DESCR /begin AXIS_DESCR STD_AXIS NO_INPUT_QUANTITY CM_0325 6 -1440.1536 1440.10965 /end AXIS_DESCR /end CHARACTERISTIC
/begin CHARACTERISTIC KL_MD_RAD_STEIGUNG "Steigungskorrektur [verified]" CURVE 0x78AE6 RL_CUR_SW_SW 0 CM_0322 -3276.8 3276.7 /begin AXIS_DESCR STD_AXIS NO_INPUT_QUANTITY CM_0322 6 -3276.8 3276.7 /end AXIS_DESCR /end CHARACTERISTIC
/begin CHARACTERISTIC KL_MD_RAD_STEIG_FAK "Steigungs-Faktor [verified]" CURVE 0x78B00 RL_CUR_SW_UW 0 CM_0245 0 63.99902344 /begin AXIS_DESCR STD_AXIS NO_INPUT_QUANTITY CM_0276 6 -3276.8 3276.7 /end AXIS_DESCR /end CHARACTERISTIC
/begin CHARACTERISTIC KL_MD_FAK_DP_B2 "DP-Faktor Bereich 2 [verified]" CURVE 0x77D8A RL_CUR_SW_UW 0 CM_0245 0 63.99902344 /begin AXIS_DESCR STD_AXIS NO_INPUT_QUANTITY CM_0322 6 -3276.8 3276.7 /end AXIS_DESCR /end CHARACTERISTIC
/begin CHARACTERISTIC KL_MD_FAK_LSD_B1 "LSD-Faktor Bereich 1 und LLMKS [verified]" CURVE 0x77DD8 RL_CUR_SW_UW 0 CM_0245 0 63.99902344 /begin AXIS_DESCR STD_AXIS NO_INPUT_QUANTITY CM_0322 6 -3276.8 3276.7 /end AXIS_DESCR /end CHARACTERISTIC
/begin CHARACTERISTIC KL_MD_VBEGR_KR_FAK_SK "Vmax limiter factor vs number of cylinders shut off [verified]" CURVE 0x7936C RL_CUR_UB_SW 0 CM_0016 -32 31.99902344 /begin AXIS_DESCR STD_AXIS NO_INPUT_QUANTITY CM_0000 4 0 255 /end AXIS_DESCR /end CHARACTERISTIC
/begin CHARACTERISTIC K_MD_ZYL_MASK_B1 "Zylindermaske Bank1 Ebene2 [verified]" VALUE 0x7E776 RL_VAL_UW 0 CM_0000 0 65535 /end CHARACTERISTIC
/begin CHARACTERISTIC K_MD_ZYL_MASK_B2 "Zylindermaske Bank2 Ebene2 [verified]" VALUE 0x7E778 RL_VAL_UW 0 CM_0000 0 65535 /end CHARACTERISTIC
/begin CHARACTERISTIC K_MD_KKOS_RES_RAMPE_ON "Steigung Res-Rampe an [verified]" VALUE 0x77C34 RL_VAL_UB 0 CM_0088 0 2550 /end CHARACTERISTIC
/begin CHARACTERISTIC K_MD_KKOS_RES_RAMPE_OFF "Nm/s 0p 0 -x*10 Steigung Res-Rampe aus [verified]" VALUE 0x77C35 RL_VAL_UB 0 CM_0327 -2550 0 /end CHARACTERISTIC
/begin CHARACTERISTIC K_MD_KKOS_ZH_RES_RAMPE "Steigung ZH-Reserve-Rampe [verified]" VALUE 0x77C46 RL_VAL_UB 0 CM_0088 0 2550 /end CHARACTERISTIC
/begin CHARACTERISTIC K_MD_KKOS_TIME_BA_VL "Schwelle BA-/VL-Freigabe [verified]" VALUE 0x77C28 RL_VAL_UW 0 CM_0247 0 655.35 /end CHARACTERISTIC
/begin CHARACTERISTIC K_MD_KKOS_TIME_WH "Schwelle WH-Freigabe [verified]" VALUE 0x77C2A RL_VAL_UW 0 CM_0247 0 655.35 /end CHARACTERISTIC
/begin CHARACTERISTIC K_MD_KKOS_MAX "KKOS-Begrenzung [verified]" VALUE 0x77C32 RL_VAL_SW 0 CM_0322 -3276.8 3276.7 /end CHARACTERISTIC
/begin CHARACTERISTIC K_MD_NBEGR_MD_HYS "Aktivierhysterese [verified]" VALUE 0x791B0 RL_VAL_SW 0 CM_0322 -3276.8 3276.7 /end CHARACTERISTIC
/begin CHARACTERISTIC K_MD_VBEGR_MD_HYS "Md-Abschalthysterese [verified]" VALUE 0x791B2 RL_VAL_SW 0 CM_0322 -3276.8 3276.7 /end CHARACTERISTIC
/begin CHARACTERISTIC K_KR_CFG "0 Aus 0x1 Ein ELSE undefiniert Schalter Freigabe Klopfregelung. [verified]" VALUE 0x74D88 RL_VAL_UB 0 CM_0000 0 255 /end CHARACTERISTIC
/begin CHARACTERISTIC K_KR_ETL_ADA_CFG "0 Aus 0x1 Ein ELSE undefiniert Schalter Freigabe KR -Ethanol Adaption. [verified]" VALUE 0x74D89 RL_VAL_UB 0 CM_0000 0 255 /end CHARACTERISTIC
/begin CHARACTERISTIC K_KR_FB_START_1 "Frequenzbandstart (Grundfr e-quenz). [verified]" VALUE 0x74D8A RL_VAL_UB 0 CM_0328 0 25.5 /end CHARACTERISTIC
/begin CHARACTERISTIC K_KR_FB_START_2 "Frequenzbandstart (1.Oberwelle). [verified]" VALUE 0x74D8B RL_VAL_UB 0 CM_0328 0 25.5 /end CHARACTERISTIC
/begin CHARACTERISTIC K_KR_FB_START_3 "Frequenzbandstart (Zwischenfr e-quenz). [verified]" VALUE 0x74D8C RL_VAL_UB 0 CM_0328 0 25.5 /end CHARACTERISTIC
/begin CHARACTERISTIC K_KR_FB_LEN_1 "Frequenzbandlaenge (Grundfr e-quenz). [verified]" VALUE 0x74D8D RL_VAL_UB 0 CM_0328 0 25.5 /end CHARACTERISTIC
/begin CHARACTERISTIC K_KR_FB_LEN_2 "Frequenzbandlaenge (1.Oberwelle). [verified]" VALUE 0x74D8E RL_VAL_UB 0 CM_0328 0 25.5 /end CHARACTERISTIC
/begin CHARACTERISTIC K_KR_FB_LEN_3 "Frequenzbandlaenge (Zwischenfr e-quenz). [verified]" VALUE 0x74D8F RL_VAL_UB 0 CM_0328 0 25.5 /end CHARACTERISTIC
/begin CHARACTERISTIC K_KR_FB_START_PRE "Frequenzbandstart Druck. [verified]" VALUE 0x74D90 RL_VAL_UB 0 CM_0328 0 25.5 /end CHARACTERISTIC
/begin CHARACTERISTIC K_KR_FB_LEN_PRE "Frequenzbandlaenge Druck. [verified]" VALUE 0x74D91 RL_VAL_UB 0 CM_0328 0 25.5 /end CHARACTERISTIC
/begin CHARACTERISTIC K_KR_FENSTER_CFG "0 Klopffenster 0x1 Suchfenster ELSE undefiniert Auswahl Ionen-Analyzer-Fenster. [verified]" VALUE 0x74D92 RL_VAL_UB 0 CM_0000 0 255 /end CHARACTERISTIC
/begin CHARACTERISTIC K_KR_APPL_CFG "0 Aus 0x1 Ein ELSE undefiniert Schalter Freigabe Applikationshilfe. [verified]" VALUE 0x74D93 RL_VAL_UB 0 CM_0000 0 255 /end CHARACTERISTIC
/begin CHARACTERISTIC K_KR_ETL_TIME "1 x/10 Dauer Ethanol-Adaption. [verified]" VALUE 0x74D94 RL_VAL_UB 0 CM_0027 0 255 /end CHARACTERISTIC
/begin CHARACTERISTIC K_KR_APPL_PER "Periode Applikationshilfe. [verified]" VALUE 0x74D95 RL_VAL_UB 0 CM_0000 0 255 /end CHARACTERISTIC
/begin CHARACTERISTIC K_KR_ETL_DEL "Einschaltverzoegerung KR -Ethanol Adaption Freigabe [verified]" VALUE 0x74D96 RL_VAL_UB 0 CM_0301 0 25.5 /end CHARACTERISTIC
/begin CHARACTERISTIC K_KR_ETL_SEG_TAU "Filterkonstante fuer Eingangsgroe s-sen KR-Ethanol Adaption [verified]" VALUE 0x74D97 RL_VAL_UB 0 CM_0329 0 0.99609375 /end CHARACTERISTIC
/begin CHARACTERISTIC K_KR_FBS_AVG_GRAD "2 x*0.12104034423828125 Aenderungsbegrenzung von kr_fbs_avg_zylx. [verified]" VALUE 0x74D98 RL_VAL_UW 0 CM_0330 0 65535 /end CHARACTERISTIC
/begin CHARACTERISTIC K_KR_ETL_E_MIN "Minimum fuer KR-Ethanol Adaption [verified]" VALUE 0x74DA0 RL_VAL_SW 0 CM_0331 -327.68 327.67 /end CHARACTERISTIC
/begin CHARACTERISTIC K_KR_ETL_E_MAX "Maximum fuer KR-Ethanol Adaption [verified]" VALUE 0x74DA2 RL_VAL_SW 0 CM_0331 -327.68 327.67 /end CHARACTERISTIC
/begin CHARACTERISTIC K_KR_ETL_E_MIN_S "Minimum fuer KR -Ethanol Adaption bei Schlecht-Sprit [verified]" VALUE 0x74DA4 RL_VAL_SW 0 CM_0331 -327.68 327.67 /end CHARACTERISTIC
/begin CHARACTERISTIC K_KR_ETL_E_MAX_S "Maximum fuer KR-Ethanol Adaption bei Schlecht-Sprit [verified]" VALUE 0x74DA6 RL_VAL_SW 0 CM_0331 -327.68 327.67 /end CHARACTERISTIC
/begin CHARACTERISTIC K_KR_ETL_E_HI "Verstaerkungsfaktor fuer KR -Ethanol Adaption [verified]" VALUE 0x74DA8 RL_VAL_SW 0 CM_0331 -327.68 327.67 /end CHARACTERISTIC
/begin CHARACTERISTIC K_KR_ETL_RF_MIN "untere rf -Schwelle fuer KR -Ethanol Adaption Freigabe [verified]" VALUE 0x74DAA RL_VAL_SW 0 CM_0282 -3.2768 3.2767 /end CHARACTERISTIC
/begin CHARACTERISTIC K_KR_ETL_RF_MAX "obere rf -Schwelle fuer KR -Ethanol Adaption Freigabe [verified]" VALUE 0x74DAC RL_VAL_SW 0 CM_0282 -3.2768 3.2767 /end CHARACTERISTIC
/begin CHARACTERISTIC K_KR_ETL_N_MIN "untere n -Schwelle fuer KR-Ethanol Adaption Freigabe [verified]" VALUE 0x74DAE RL_VAL_SW 0 CM_0002 -32768 32767 /end CHARACTERISTIC
/begin CHARACTERISTIC K_KR_ETL_N_MAX "obere n -Schwelle fuer KR -Ethanol Adaption Freigabe [verified]" VALUE 0x74DB0 RL_VAL_SW 0 CM_0002 -32768 32767 /end CHARACTERISTIC
/begin CHARACTERISTIC K_KR_ETL_TZ_DELTA_MIN "untere delta -tz-Schwelle fuer KR -Ethanol Adaption Freigabe [verified]" VALUE 0x74DB2 RL_VAL_SW 0 CM_0280 -3276.8 3276.7 /end CHARACTERISTIC
/begin CHARACTERISTIC K_KR_ETL_TZ_DELTA_MAX "obere delta -tz-Schwelle fuer KR -Ethanol Adaption Freigabe [verified]" VALUE 0x74DB4 RL_VAL_SW 0 CM_0280 -3276.8 3276.7 /end CHARACTERISTIC
/begin CHARACTERISTIC K_KR_ETL_VAN_MIN "untere relative- VANOS-Schwelle fuer KR-Ethanol Adaption Freigabe [verified]" VALUE 0x74DB6 RL_VAL_SW 0 CM_0280 -3276.8 3276.7 /end CHARACTERISTIC
/begin CHARACTERISTIC K_KR_ETL_VAN_MAX "obere relative- VANOS-Schwelle fuer KR-Ethanol Adaption Freigabe [verified]" VALUE 0x74DB8 RL_VAL_SW 0 CM_0280 -3276.8 3276.7 /end CHARACTERISTIC
/begin CHARACTERISTIC K_KR_ETL_LAM_MIN "untere Lambda -Schwelle fuer KR -Ethanol Adaption Freigabe [verified]" VALUE 0x74DBA RL_VAL_UW 0 CM_0259 0 3.999938965 /end CHARACTERISTIC
/begin CHARACTERISTIC K_KR_ETL_LAM_MAX "obere Lambda -Schwelle fuer KR -Ethanol Adaption Freigabe [verified]" VALUE 0x74DBC RL_VAL_UW 0 CM_0259 0 3.999938965 /end CHARACTERISTIC
/begin CHARACTERISTIC K_KR_ETL_ION_Q_MIN "mindest Ionen Quotient I(E_HI)/I(E0) fuer ETL-Adaptions Freigabe [verified]" VALUE 0x74DBE RL_VAL_SW 0 CM_0331 -327.68 327.67 /end CHARACTERISTIC
/begin CHARACTERISTIC K_KR_ANZ_ASP_HOLD "Anzahl der Arbeitsspiele in Halt e-phase. [verified]" VALUE 0x74DE0 RL_VAL_UB 0 CM_0000 0 255 /end CHARACTERISTIC
/begin CHARACTERISTIC K_KA_FILT_KK_KA "3 x/40960 Max Zuendwinkelgradient bei pos. ka_offs. [verified]" VALUE 0x738E6 RL_VAL_SW 0 CM_0332 -32768 32767 /end CHARACTERISTIC
/begin CHARACTERISTIC K_KA_FILT_KK_KKA "3 x/40960 Max Zuendwinkelgradient bei neg. ka_offs. [verified]" VALUE 0x738E8 RL_VAL_SW 0 CM_0332 -32768 32767 /end CHARACTERISTIC
/begin CHARACTERISTIC K_KA_FILT_KL "3 x/5120 Max Zuendwinkelgradient bei Klopfer. [verified]" VALUE 0x738EA RL_VAL_SW 0 CM_0332 -32768 32767 /end CHARACTERISTIC
/begin CHARACTERISTIC K_KA_FILT_KL_S "3 x/5120 Max Zuendwinkelgradient bei Klopfer fuer minderwertigen Kraftstoff. Klopfadaption Klopfschu [verified]" VALUE 0x738EC RL_VAL_SW 0 CM_0332 -32768 32767 /end CHARACTERISTIC
/begin CHARACTERISTIC K_KA_TZ_MIN_HYST "tz_min Hysterese. [verified]" VALUE 0x738E2 RL_VAL_SW 0 CM_0280 -3276.8 3276.7 /end CHARACTERISTIC
/begin CHARACTERISTIC K_KA_TZ_KS "Klopfschutzzuendwinkeloffset. [verified]" VALUE 0x738EE RL_VAL_SW 0 CM_0280 -3276.8 3276.7 /end CHARACTERISTIC
/begin CHARACTERISTIC K_KA_DTZ_MAX "Max Klopfadaptionsrueckzie h-winkel. [verified]" VALUE 0x738DE RL_VAL_SW 0 CM_0280 -3276.8 3276.7 /end CHARACTERISTIC
/begin CHARACTERISTIC K_KA_KF_ADAPT_MAX "Bereichsueberwachung Ken n-feldadaption. [verified]" VALUE 0x738E4 RL_VAL_SW 0 CM_0280 -3276.8 3276.7 /end CHARACTERISTIC
/begin CHARACTERISTIC KF_LLR_N_SOLL_KH_OFF "I-Anteil bei neg. Abweichung [verified]" MAP 0x768F4 RL_MAP_SW_SW_SW 0 CM_0002 -32768 32767 /begin AXIS_DESCR STD_AXIS NO_INPUT_QUANTITY CM_0006 10 -3550 3003.5 /end AXIS_DESCR /begin AXIS_DESCR STD_AXIS NO_INPUT_QUANTITY CM_0270 10 -163.84 163.835 /end AXIS_DESCR /end CHARACTERISTIC
/begin CHARACTERISTIC K_SCHUFUKA_CFG "0 Aus 1 Ein 3 Ein+Einf Schalter Konfiguration [verified]" VALUE 0x7BAF2 RL_VAL_UB 0 CM_0348 0 255 /end CHARACTERISTIC
/begin CHARACTERISTIC K_SCHUFUKA_FF_RESET "0 Aus 1 Ein FF-Reset [verified]" VALUE 0x7BAF3 RL_VAL_UB 0 CM_0348 0 255 /end CHARACTERISTIC
/begin CHARACTERISTIC K_SCHUFUKA_GMW_MAX "0 Anzahl fuer Mittelwertbildung [verified]" VALUE 0x7BAF4 RL_VAL_UB 0 CM_0348 0 255 /end CHARACTERISTIC
/begin CHARACTERISTIC K_SCHUFUKA_TAU "Filterkonstante fuer DynStress [verified]" VALUE 0x7BAF6 RL_VAL_UW 0 CM_0011 0.004999923705 327.67 /end CHARACTERISTIC
/begin CHARACTERISTIC K_SCHUFUKA_STRESS_STAT_MAX "Maximalwert [verified]" VALUE 0x7BAF8 RL_VAL_UW 0 CM_0349 0 65.535 /end CHARACTERISTIC
/begin CHARACTERISTIC K_SCHUFUKA_KM_APPL_OFFS "Applikationsoffset [verified]" VALUE 0x7BAFA RL_VAL_SW 0 CM_0082 -32768 32767 /end CHARACTERISTIC
/begin CHARACTERISTIC K_SCHUFUKA_KM_EINFAHR "Einfahrschwelle [verified]" VALUE 0x7BAFC RL_VAL_UW 0 CM_0082 0 65535 /end CHARACTERISTIC
/begin CHARACTERISTIC K_SCHUFUKA_KM_INTERVALL "MilesAndMore-Intervall [verified]" VALUE 0x7BAFE RL_VAL_UW 0 CM_0082 0 65535 /end CHARACTERISTIC
/begin CHARACTERISTIC K_SCHUFUKA_KM_MAX "MilesAndMore-Verfallsschwelle [verified]" VALUE 0x7BB00 RL_VAL_UW 0 CM_0082 0 65535 /end CHARACTERISTIC
/begin CHARACTERISTIC K_SCHUFUKA_KM_MAX_NV "max. MilesAndMore -Gutschrift [verified]" VALUE 0x7BB02 RL_VAL_UW 0 CM_0082 0 65535 /end CHARACTERISTIC
/begin CHARACTERISTIC K_SCHUFUKA_NBEGR_UP "Aenderungsbegrenzung - Up [verified]" VALUE 0x7BB04 RL_VAL_UW 0 CM_0081 0 655350 /end CHARACTERISTIC
/begin CHARACTERISTIC K_SCHUFUKA_NBEGR_DOWN "Aenderungsbegrenzung - Down [verified]" VALUE 0x7BB06 RL_VAL_UW 0 CM_0081 0 655350 /end CHARACTERISTIC
/begin CHARACTERISTIC K_SCHUFUKA_STRESS_MIN "Resetschwelle [verified]" VALUE 0x7BB08 RL_VAL_UW 0 CM_0349 0 65.535 /end CHARACTERISTIC
/begin CHARACTERISTIC K_SCHUFUKA_STRESS_MAX "Ausloeseschwelle [verified]" VALUE 0x7BB0A RL_VAL_UW 0 CM_0349 0 65.535 /end CHARACTERISTIC
/begin CHARACTERISTIC K_SCHUFUKA_STRESS_NBEGR "Begrenzerdrehzahl [verified]" VALUE 0x7BB0C RL_VAL_SW 0 CM_0002 -32768 32767 /end CHARACTERISTIC
/begin CHARACTERISTIC K_SCHUFUKA_STRESS_DYN_FAK "DKG-Faktor [verified]" VALUE 0x7BB0E RL_VAL_UW 0 CM_0245 0 63.99902344 /end CHARACTERISTIC
/begin CHARACTERISTIC KL_SCHUFUKA_STRESS_DYN_INC "Dynamic stress increment vs static stress increment [verified]" CURVE 0x7BB2A RL_CUR_SB_UB 0 CM_0000 0 255 /begin AXIS_DESCR STD_AXIS NO_INPUT_QUANTITY CM_0000 4 -128 127 /end AXIS_DESCR /end CHARACTERISTIC
/begin CHARACTERISTIC KL_TABG_LW_STAND_F "Faktor Standzeit [verified]" CURVE 0x7D21A RL_CUR_UW_UW 0 CM_0245 0 63.99902344 /begin AXIS_DESCR STD_AXIS NO_INPUT_QUANTITY CM_0233 4 0 1092.25 /end AXIS_DESCR /end CHARACTERISTIC
/begin CHARACTERISTIC KL_TABG_VKAT_K_TMOT "Waermeuebergangskoeffizient [verified]" CURVE 0x7D23E RL_CUR_SW_UW 0 CM_0374 0 65.535 /begin AXIS_DESCR STD_AXIS NO_INPUT_QUANTITY CM_0255 4 -3276.8 3276.7 /end AXIS_DESCR /end CHARACTERISTIC
/begin CHARACTERISTIC KL_TABG_KAT_EXO_MAX "Maximale Enthalpie [verified]" CURVE 0x7D274 RL_CUR_UW_SW 0 CM_0375 -327.68 327.67 /begin AXIS_DESCR STD_AXIS NO_INPUT_QUANTITY CM_0259 4 0 3.999938965 /end AXIS_DESCR /end CHARACTERISTIC
/begin CHARACTERISTIC KL_TABG_VKAT_STAND_F "Faktor Standzeit [verified]" CURVE 0x7D1D6 RL_CUR_UW_UW 0 CM_0245 0 63.99902344 /begin AXIS_DESCR STD_AXIS NO_INPUT_QUANTITY CM_0233 8 0 1092.25 /end AXIS_DESCR /end CHARACTERISTIC
/begin CHARACTERISTIC KL_TABG_KAT_STAND_F "Faktor Standzeit [verified]" CURVE 0x7D1F8 RL_CUR_UW_UW 0 CM_0245 0 63.99902344 /begin AXIS_DESCR STD_AXIS NO_INPUT_QUANTITY CM_0233 8 0 1092.25 /end AXIS_DESCR /end CHARACTERISTIC
/begin CHARACTERISTIC KL_KR_ETL_FAK_FBS_KOR "Korrekturfaktor fuer fbs -Werte aus Ethanoladaption [verified]" CURVE 0x74E64 RL_CUR_UW_UW 0 CM_0259 0 3.999938965 /begin AXIS_DESCR STD_AXIS NO_INPUT_QUANTITY CM_0259 6 0 3.999938965 /end AXIS_DESCR /end CHARACTERISTIC
/begin CHARACTERISTIC KL_TZ_SZ_STARTOFFS_TIME "Zeit fuer Schliesszeitoffset im Start [verified]" CURVE 0x7DCE4 RL_CUR_SW_UW 0 CM_0247 0 655.35 /begin AXIS_DESCR STD_AXIS NO_INPUT_QUANTITY CM_0006 6 -3550 3003.5 /end AXIS_DESCR /end CHARACTERISTIC
/begin CHARACTERISTIC KF_MD_FAK_GRAD_DP_B1 "DP-Wichtung Bereich 1 [verified]" MAP 0x78658 RL_MAP_SW_SW_UW 0 CM_0245 0 63.99902344 /begin AXIS_DESCR STD_AXIS NO_INPUT_QUANTITY CM_0007 4 -655360 655340 /end AXIS_DESCR /begin AXIS_DESCR STD_AXIS NO_INPUT_QUANTITY CM_0322 4 -3276.8 3276.7 /end AXIS_DESCR /end CHARACTERISTIC
/begin CHARACTERISTIC KF_MD_KUPP_GRENZ_LSD_O "?bergang Bereich 2 nach 3 [verified]" MAP 0x77ED8 RL_MAP_SW_SW_SW 0 CM_0322 -3276.8 3276.7 /begin AXIS_DESCR STD_AXIS NO_INPUT_QUANTITY CM_0015 7 -32768 32767 /end AXIS_DESCR /begin AXIS_DESCR STD_AXIS NO_INPUT_QUANTITY CM_0002 9 -32768 32767 /end AXIS_DESCR /end CHARACTERISTIC
/begin CHARACTERISTIC KF_MD_KUPP_GRENZ_LSD_U_OFFS "?bergang Bereich 1 nach 2 [verified]" MAP 0x77E38 RL_MAP_SW_SW_SW 0 CM_0322 -3276.8 3276.7 /begin AXIS_DESCR STD_AXIS NO_INPUT_QUANTITY CM_0015 7 -32768 32767 /end AXIS_DESCR /begin AXIS_DESCR STD_AXIS NO_INPUT_QUANTITY CM_0002 9 -32768 32767 /end AXIS_DESCR /end CHARACTERISTIC
/begin CHARACTERISTIC KF_MD_TAU_LSD_B3 "LSD-Filter Bereich 3 [verified]" MAP 0x7880E RL_MAP_SW_SW_UW 0 CM_0245 0 63.99902344 /begin AXIS_DESCR STD_AXIS NO_INPUT_QUANTITY CM_0015 7 -32768 32767 /end AXIS_DESCR /begin AXIS_DESCR STD_AXIS NO_INPUT_QUANTITY CM_0322 9 -3276.8 3276.7 /end AXIS_DESCR /end CHARACTERISTIC
/begin CHARACTERISTIC KL_LLR_MD_TZ_MKS "LLR TZ-Eingriff [verified]" CURVE 0x763A0 RL_CUR_SW_SW 0 CM_0322 -3276.8 3276.7 /begin AXIS_DESCR STD_AXIS NO_INPUT_QUANTITY CM_0002 9 -32768 32767 /end AXIS_DESCR /end CHARACTERISTIC
/begin CHARACTERISTIC KL_LLR_MD_TZ_OKS_KH "LLR TZ-Eingriff bei KH [verified]" CURVE 0x763C6 RL_CUR_SW_SW 0 CM_0322 -3276.8 3276.7 /begin AXIS_DESCR STD_AXIS NO_INPUT_QUANTITY CM_0002 9 -32768 32767 /end AXIS_DESCR /end CHARACTERISTIC
/begin CHARACTERISTIC KL_MD_ABTRIEB_SCHLEPP_FAK "Steigungs-Faktor [verified]" CURVE 0x78A84 RL_CUR_SW_UW 0 CM_0245 0 63.99902344 /begin AXIS_DESCR STD_AXIS NO_INPUT_QUANTITY CM_0245 6 -32 31.99902344 /end AXIS_DESCR /end CHARACTERISTIC
/begin CHARACTERISTIC KL_MD_LRW_RES "LRW-Reserve [verified]" CURVE 0x77CB4 RL_CUR_SW_SW 0 CM_0322 -3276.8 3276.7 /begin AXIS_DESCR STD_AXIS NO_INPUT_QUANTITY CM_0220 4 -1440.1536 1440.10965 /end AXIS_DESCR /end CHARACTERISTIC
/begin CHARACTERISTIC KL_TABG_VKAT_MC_F_TMOT "Waermekapazitaet vor Kat beim Start [verified]" CURVE 0x7D250 RL_CUR_SW_UW 0 CM_0245 0 63.99902344 /begin AXIS_DESCR STD_AXIS NO_INPUT_QUANTITY CM_0006 4 -3550 3003.5 /end AXIS_DESCR /end CHARACTERISTIC
/begin CHARACTERISTIC K_AQ_DK0_LLS_AQ_SCHW "AqLLS-Schwelle fuer DK0 -Erkennung [verified]" VALUE 0x702A8 RL_VAL_UW 0 CM_0012 0 6553.5 /end CHARACTERISTIC
/begin CHARACTERISTIC K_AT_MD_BEGR_A1 "Koeffizient a1, PID-Regler [A2L-ref]" VALUE 0x70566 RL_VAL_SW 0 CM_0039 -327.68 327.67 /end CHARACTERISTIC
/begin CHARACTERISTIC K_AT_N_MAX "Maximale Motordrehzahl fuer Anti-Trampeln Eingriff [A2L-ref]" VALUE 0x70552 RL_VAL_SW 0 CM_0002 -32768 32767 /end CHARACTERISTIC
/begin CHARACTERISTIC K_AT_TRAMPIN_SOLL_START "Startschwelle AT Eingriff [A2L-ref]" VALUE 0x70560 RL_VAL_SW 0 CM_0376 -2048 2047.9375 /end CHARACTERISTIC
/begin CHARACTERISTIC K_EGAS_CFG_AQ_SOLL "0 aus 1 KH 2 ML 3 KH+ML Filter-Konfiguration [A2L-ref]" VALUE 0x7184D RL_VAL_UB 0 CM_0000 0 255 /end CHARACTERISTIC
/begin CHARACTERISTIC K_EGAS_CFG_LLS "0 no Testmode 1 Testmode ELSE undef LLS-Konfiguration [verified]" VALUE 0x7184B RL_VAL_UB 0 CM_0000 0 255 /end CHARACTERISTIC
/begin CHARACTERISTIC K_EGAS_CFG_MCS_SOLL "0 Inaktiv 1 LLS1 2 LLS2 3 LLS1+2 4 DK1 5 LLS1+DK1 8 DK2 10 LLS2+DK2 12 DK1+2 15 Alle 16 Bowdenzug Ko [verified]" VALUE 0x7184E RL_VAL_UB 0 CM_0348 0 255 /end CHARACTERISTIC
/begin CHARACTERISTIC K_EGAS_CFG_WDK "0 Poti normal 1 Poti invers WDK-Konfiguration [verified]" VALUE 0x7184C RL_VAL_UB 0 CM_0000 0 255 /end CHARACTERISTIC
/begin CHARACTERISTIC K_EGAS_SOLL_AQ_KH_N_MAX "Drehzahlschwelle fuer KH-Querschnitt [A2L-ref]" VALUE 0x71854 RL_VAL_SW 0 CM_0002 -32768 32767 /end CHARACTERISTIC
/begin CHARACTERISTIC K_EGAS_SOLL_LLS_DELTA "Rampe fuer LLS-Schwebung [verified]" VALUE 0x7185E RL_VAL_UB 0 CM_0379 0 25.5 /end CHARACTERISTIC
/begin CHARACTERISTIC K_EGAS_SOLL_LLS_DK_SCHW "DK-Schwelle fuer LLS - Schwebung [verified]" VALUE 0x7185C RL_VAL_UB 0 CM_0013 0 25.5 /end CHARACTERISTIC
/begin CHARACTERISTIC K_EGAS_SOLL_LLS_OFF "Offset fuer LLS-Schwebung [verified]" VALUE 0x7185D RL_VAL_UB 0 CM_0013 0 25.5 /end CHARACTERISTIC
/begin CHARACTERISTIC K_EGAS_STM_LLS_DK_SCHW "DK-Schwelle fuer LLS - Adaption [verified]" VALUE 0x7244A RL_VAL_SW 0 CM_0013 -3276.8 3276.7 /end CHARACTERISTIC
/begin CHARACTERISTIC K_EGAS_STM_LLS_T_ADAPT "max. Zeit fuer LLS-Adaption [verified]" VALUE 0x7244E RL_VAL_UW 0 CM_0029 0 327.675 /end CHARACTERISTIC
/begin CHARACTERISTIC K_EGAS_STM_NOINIT_FAIL "Fail-Fehler ohne Neuinit [verified]" VALUE 0x72448 RL_VAL_UW 0 CM_0000 0 65535 /end CHARACTERISTIC
/begin CHARACTERISTIC K_EGAS_STM_NOINIT_SK "SK-Fehler ohne Neuinit [verified]" VALUE 0x72446 RL_VAL_UW 0 CM_0000 0 65535 /end CHARACTERISTIC
/begin CHARACTERISTIC K_EGAS_STM_T_ADAPT "Adaptionszyklus fuer LLS und DK [verified]" VALUE 0x72450 RL_VAL_UW 0 CM_0380 0 1092.25 /end CHARACTERISTIC
/begin CHARACTERISTIC K_ISS_MAX_DELTA "Max zul. Schwelle fuer Kurzschluss nach Masse zwischen Zylindern. [EST]" VALUE 0x7388A RL_VAL_UB 0 CM_0000 0 255 /end CHARACTERISTIC
/begin CHARACTERISTIC K_MD_BEZUG_HYS "Abschaltung der Eta-Bezugsrampe [verified]" VALUE 0x791A8 RL_VAL_UB 0 CM_0017 0 25.5 /end CHARACTERISTIC
/begin CHARACTERISTIC K_MD_BEZUG_RAMPE "Eta-Bezugsrampe [verified]" VALUE 0x791A9 RL_VAL_UB 0 CM_0007 0 5100 /end CHARACTERISTIC
/begin CHARACTERISTIC K_MD_CFG_FGR_EINGR "Cfg fuer Index [A2L-ref]" VALUE 0x789F0 RL_VAL_UB 0 CM_0000 0 255 /end CHARACTERISTIC
/begin CHARACTERISTIC K_MD_CFG_IDX "0x0 FP0 0x1 FP1 0x2 FP2 0x3 FP3 0x4 FP4 0x5 FP5 0x6 CAN 0x7 Mdrv Cfg f?r Index [verified]" VALUE 0x789EF RL_VAL_UB 0 CM_0000 0 255 /end CHARACTERISTIC
/begin CHARACTERISTIC K_MD_CFG_RG_KORR "Cfg fuer RG-Korrektur [verified]" VALUE 0x76A7D RL_VAL_UB 0 CM_0000 0 255 /end CHARACTERISTIC
/begin CHARACTERISTIC K_MD_ETA_EINGRIFF "ETA-Grenze [verified]" VALUE 0x79180 RL_VAL_UW 0 CM_0312 0 199.9969482 /end CHARACTERISTIC
/begin CHARACTERISTIC K_MD_ETA_GETR "Getriebewirkungsgrad [verified]" VALUE 0x789F2 RL_VAL_UW 0 CM_0312 0 199.9969482 /end CHARACTERISTIC
/begin CHARACTERISTIC K_MD_ETA_KH_TAU_LL "TAU KH-TZ [verified]" VALUE 0x791AA RL_VAL_UB 0 CM_0027 0 255 /end CHARACTERISTIC
/begin CHARACTERISTIC K_MD_ETA_LA_KOMP_MAX "ETA-Grenze [verified]" VALUE 0x79182 RL_VAL_UW 0 CM_0312 0 199.9969482 /end CHARACTERISTIC
/begin CHARACTERISTIC K_MD_ETA_LA_TAU "TAU LA [verified]" VALUE 0x791AC RL_VAL_UB 0 CM_0065 0.005019607843 1.28 /end CHARACTERISTIC
/begin CHARACTERISTIC K_MD_ETA_STAT_TAU "TAU stat. TZ [verified]" VALUE 0x79196 RL_VAL_UB 0 CM_0065 0.005019607843 1.28 /end CHARACTERISTIC
/begin CHARACTERISTIC K_MD_ETA_STAT_TAU_LL "TAU md_tz_stat_mw [verified]" VALUE 0x791AB RL_VAL_UB 0 CM_0065 0.005019607843 1.28 /end CHARACTERISTIC
/begin CHARACTERISTIC K_MD_GEN_FREISCHALT "0 gesperrt 1 frei ELSE ungueltig Genarator-Freigabe [verified]" VALUE 0x77C49 RL_VAL_UB 0 CM_0348 0 255 /end CHARACTERISTIC
/begin CHARACTERISTIC K_MD_GEN_MAX "max. Generatormoment [verified]" VALUE 0x77C4E RL_VAL_SW 0 CM_0017 -3276.8 3276.7 /end CHARACTERISTIC
/begin CHARACTERISTIC K_MD_HYP_VERH_NO_KRAFTS "Best. Schnittpunkt Brenngrenze mit Hyp.bei NO_Krafts. [verified]" VALUE 0x76A7B RL_VAL_UB 0 CM_0037 0 1.9921875 /end CHARACTERISTIC
/begin CHARACTERISTIC K_MD_HYP_VERH_START "Begrenzung Hyperbel ausserhalb Motor laeuft [verified]" VALUE 0x76A7A RL_VAL_UB 0 CM_0037 0 1.9921875 /end CHARACTERISTIC
/begin CHARACTERISTIC K_MD_IND_WUNSCH_TZ_MCS "TZ-Vorgabe per MCS [A2L-ref]" VALUE 0x79186 RL_VAL_SW 0 CM_0017 -3276.8 3276.7 /end CHARACTERISTIC
/begin CHARACTERISTIC K_MD_KKOS_CAN_MAX "KKOS-Begrenzung [verified]" VALUE 0x77C3E RL_VAL_SW 0 CM_0017 -3276.8 3276.7 /end CHARACTERISTIC
/begin CHARACTERISTIC K_MD_KKOS_MIN "Einschaltschwelle [verified]" VALUE 0x77C30 RL_VAL_SW 0 CM_0017 -3276.8 3276.7 /end CHARACTERISTIC
/begin CHARACTERISTIC K_MD_KUPP_BEGR_MCS "Wochenendfzg-Momentenbegrenzung [verified]" VALUE 0x791A6 RL_VAL_SW 0 CM_0017 -3276.8 3276.7 /end CHARACTERISTIC
/begin CHARACTERISTIC K_MD_NBEGR_N_DELTA "Begrenzung Abregelrampe [A2L-ref]" VALUE 0x791B4 RL_VAL_UB 0 CM_0382 0 51000 /end CHARACTERISTIC
/begin CHARACTERISTIC K_MD_N_PEMAX "Drehzahl fuer PeMax [verified]" VALUE 0x789F4 RL_VAL_SW 0 CM_0002 -32768 32767 /end CHARACTERISTIC
/begin CHARACTERISTIC K_MD_RESERVE_TST "Test-Reserve [verified]" VALUE 0x79184 RL_VAL_SW 0 CM_0017 -3276.8 3276.7 /end CHARACTERISTIC
/begin CHARACTERISTIC K_MD_RES_KATH_FAK "Faktor Katheitzreserve [A2L-ref]" VALUE 0x79194 RL_VAL_UW 0 CM_0016 0 63.99902344 /end CHARACTERISTIC
/begin CHARACTERISTIC K_MD_RES_ZW_RAMPE_NEG "KH-Rampe [verified]" VALUE 0x791A0 RL_VAL_SW 0 CM_0007 -655360 655340 /end CHARACTERISTIC
/begin CHARACTERISTIC K_MD_RES_ZW_RAMPE_POS "KH-Rampe [verified]" VALUE 0x7919E RL_VAL_SW 0 CM_0007 -655360 655340 /end CHARACTERISTIC
/begin CHARACTERISTIC K_MD_RF_SOLL_BS_CFG "0x0 alle mw 0x1 md_rf_soll_pt_fr_wicht 0x2 md_rf_soll_pt_rg_fr 0x3 alle bs ELSE ungueltig RF_SOLL Ba [verified]" VALUE 0x791CF RL_VAL_UB 0 CM_0000 0 255 /end CHARACTERISTIC
/begin CHARACTERISTIC K_MD_RG_RF_FAKTOR "Faktor fuer Rf-Rg-Korrektur [A2L-ref]" VALUE 0x791A4 RL_VAL_UW 0 CM_0016 0 63.99902344 /end CHARACTERISTIC
/begin CHARACTERISTIC K_MD_TAU_FW_GRAD "Filter fuer Fahrerwunsch [verified]" VALUE 0x791A3 RL_VAL_UB 0 CM_0065 0.005019607843 1.28 /end CHARACTERISTIC
/begin CHARACTERISTIC K_MD_TZ_SOLL_MCS "TZ-Sollvorgabe [verified]" VALUE 0x79192 RL_VAL_SW 0 CM_0384 -3276.8 3276.7 /end CHARACTERISTIC
/begin CHARACTERISTIC K_MD_VBEGR_A1 "Reglerfaktor A1 [verified]" VALUE 0x791CC RL_VAL_SW 0 CM_0039 -327.68 327.67 /end CHARACTERISTIC
/begin CHARACTERISTIC K_MD_VBEGR_HYS_AUS "n-Abschalthysterese [verified]" VALUE 0x791AE RL_VAL_SW 0 CM_0010 -2048 2047.9375 /end CHARACTERISTIC
/begin CHARACTERISTIC K_PCTRL_TIMEOUT "Timeout der Prozessorueberwachung [EST]" VALUE 0x7AC50 RL_VAL_UB 0 CM_0052 0 2550 /end CHARACTERISTIC
/begin CHARACTERISTIC K_PKS_CAN_ED_T_SPERR "Wartezeit fuer CAN-Diagnose [A2L-ref]" VALUE 0x7AC54 RL_VAL_UW 0 CM_0020 0 327.675 /end CHARACTERISTIC
/begin CHARACTERISTIC K_PKS_CAN_ED_UB_MIN "min. Ub fuer CAN-Diagnose [A2L-ref]" VALUE 0x7AC56 RL_VAL_SW 0 CM_0021 -3276.8 3276.7 /end CHARACTERISTIC
/begin CHARACTERISTIC K_PWG1_A0_MIN "Unter Adaptionschwelle Peda l-wertgeber 1 [verified]" VALUE 0x7AC84 RL_VAL_SW 0 CM_0031 -160 159.9951172 /end CHARACTERISTIC
/begin CHARACTERISTIC K_PWG1_NORM "Normierung Potentiometerspannung - %- Pedalwert 1 [verified]" VALUE 0x7AC7E RL_VAL_SW 0 CM_0385 -327.68 327.67 /end CHARACTERISTIC
/begin CHARACTERISTIC K_PWG1_NORM_HS "Normierung Potentiometerspannung - %- Pedalwert 1 [verified]" VALUE 0x7AC80 RL_VAL_SW 0 CM_0385 -327.68 327.67 /end CHARACTERISTIC
/begin CHARACTERISTIC K_PWG_BLS_CFG "0 Begr. ueber v 0x1 Begr. ueber Druck 0x2 keine Begrenzung Einschalten der Diagnose [verified]" VALUE 0x7AC68 RL_VAL_UB 0 CM_0000 0 255 /end CHARACTERISTIC
/begin CHARACTERISTIC K_PWG_BLS_HS_VERZ "Verzoegerungszeit der Begre n-zung beim Handschalter [verified]" VALUE 0x7AC78 RL_VAL_UW 0 CM_0032 0 327675 /end CHARACTERISTIC
/begin CHARACTERISTIC K_PWG_TAU "Filterkonstante fuer den absol u-ten Spannungswert [verified]" VALUE 0x7AC82 RL_VAL_UB 0 CM_0065 0.005019607843 1.28 /end CHARACTERISTIC
/begin CHARACTERISTIC K_RF_KOR_VAN_MIN "Minimaler Korrekturfaktor Vanos [A2L-ref]" VALUE 0x7AD16 RL_VAL_UW 0 CM_0016 0 63.99902344 /end CHARACTERISTIC
/begin CHARACTERISTIC K_START_RL_BEGINN "Maximale Motordrehzahl beim Anlassbeginn [A2L-ref]" VALUE 0x7D102 RL_VAL_SW 0 CM_0002 -32768 32767 /end CHARACTERISTIC
/begin CHARACTERISTIC K_TABG_C "Mittlere spezifische Waerm e-kapazitaet [verified]" VALUE 0x7D128 RL_VAL_UW 0 CM_0386 0 65535 /end CHARACTERISTIC
/begin CHARACTERISTIC K_TABG_KAT_MC "Waermekapazitaet des Kat a-lysatoranfangs [verified]" VALUE 0x7D12E RL_VAL_UW 0 CM_0387 0 65535 /end CHARACTERISTIC
/begin CHARACTERISTIC K_TABG_LW_AUSBLEND_OFFS "Temperaturoffset ausgeble n-deter Zylinder [verified]" VALUE 0x7D132 RL_VAL_SW 0 CM_0024 -3276.8 3276.7 /end CHARACTERISTIC
/begin CHARACTERISTIC K_TABG_NKAT_A "Katflaeche [verified]" VALUE 0x7D136 RL_VAL_UW 0 CM_0388 0 6.5535 /end CHARACTERISTIC
/begin CHARACTERISTIC K_TABG_NKAT_CFG "Schalter welche Nachkattemperatur [EST]" VALUE 0x7D115 RL_VAL_UB 0 CM_0000 0 255 /end CHARACTERISTIC
/begin CHARACTERISTIC K_TABG_NKAT_MC "Waermekapazitaet des Kat a-lysatorendes [verified]" VALUE 0x7D130 RL_VAL_UW 0 CM_0387 0 65535 /end CHARACTERISTIC
/begin CHARACTERISTIC K_TABG_VKAT_A "Kr?mmerflaeche [verified]" VALUE 0x7D134 RL_VAL_UW 0 CM_0388 0 6.5535 /end CHARACTERISTIC
/begin CHARACTERISTIC K_TABG_VKAT_K_V "Geschwindikeitsabhaengiger Waermeuebergangskoeffizient [verified]" VALUE 0x7D11A RL_VAL_UW 0 CM_0389 0 6.5535 /end CHARACTERISTIC
/begin CHARACTERISTIC K_TABG_VKAT_MC "Waermekapazitaet vor Kat [verified]" VALUE 0x7D12A RL_VAL_UW 0 CM_0387 0 65535 /end CHARACTERISTIC
/begin CHARACTERISTIC K_TABG_VKAT_REAK_SCHWELLE "Aktivierungsschwelle Kruemmerreaktion [verified]" VALUE 0x7D12C RL_VAL_SW 0 CM_0006 -3550 3003.5 /end CHARACTERISTIC
/begin CHARACTERISTIC K_TZ_GRAD_TAU "Filterkonstante fuer tz_grad [verified]" VALUE 0x7DBDD RL_VAL_UB 0 CM_0391 0 0.99609375 /end CHARACTERISTIC
/begin CHARACTERISTIC cfg.canmess "Konfigurationsparameter: CAN-Messtechnik [A2L-ref]" VALUE 0x7D111 RL_VAL_UB 0 CM_0000 0 255 /end CHARACTERISTIC
/begin CHARACTERISTIC cfg.canstand "Konfigurationsparameter: CAN Stand [A2L-ref]" VALUE 0x7D10C RL_VAL_UB 0 CM_0000 0 255 /end CHARACTERISTIC
/begin CHARACTERISTIC cfg.diagnose "Konfigurationsparameter: Diagnose [A2L-ref]" VALUE 0x7D10A RL_VAL_UB 0 CM_0000 0 255 /end CHARACTERISTIC
/begin CHARACTERISTIC cfg.hil "Konfigurationsparameter: HIL-Betrieb [A2L-ref]" VALUE 0x7D112 RL_VAL_UB 0 CM_0000 0 255 /end CHARACTERISTIC
/begin CHARACTERISTIC cfg.ipm "Konfigurationsparameter: IPM [A2L-ref]" VALUE 0x7D113 RL_VAL_UB 0 CM_0000 0 255 /end CHARACTERISTIC
/begin CHARACTERISTIC cfg.motortyp "Konfigurationsparameter: Motortyp [A2L-ref]" VALUE 0x7D104 RL_VAL_UW 0 CM_0000 0 65535 /end CHARACTERISTIC
/begin CHARACTERISTIC cfg.status "Konfigurationsparameter: SG Status [A2L-ref]" VALUE 0x7D10B RL_VAL_UB 0 CM_0000 0 255 /end CHARACTERISTIC
/begin CHARACTERISTIC K_EGAS_AQ_SOLL_GRAD_TAU "Tau fuer AQ-Soll [verified]" VALUE 0x71850 RL_VAL_UB 0 CM_0065 0.005019607843 1.28 /end CHARACTERISTIC
/begin CHARACTERISTIC K_FRA_LOLI_ANZ "Anzahl Modelle f?r FRA -Lolimot-KNN [verified]" VALUE 0x733F9 RL_VAL_UB 0 CM_0000 0 255 /end CHARACTERISTIC
/begin CHARACTERISTIC K_FRA_LOLI_LERN_CFG "0 sperren 1 aktive 2 reset 4 INIT DK neu ELSE undef Konfigbyte fuer Lernen [verified]" VALUE 0x733F8 RL_VAL_UB 0 CM_0000 0 255 /end CHARACTERISTIC
/begin CHARACTERISTIC K_FRA_LOLI_N_MIN "Minbegrenzung Lerneingang Lolimot n [verified]" VALUE 0x73404 RL_VAL_SW 0 CM_0002 -32768 32767 /end CHARACTERISTIC
/begin CHARACTERISTIC K_FRA_TE_C_AKF_MAX "max. Konzentration aus AKF [verified]" VALUE 0x73414 RL_VAL_UW 0 CM_0236 0 3.999938965 /end CHARACTERISTIC
/begin CHARACTERISTIC K_FRA_TMOT_MIN "Temperaturschwelle fuer TMOT-MIN [verified]" VALUE 0x73410 RL_VAL_SW 0 CM_0006 -3550 3003.5 /end CHARACTERISTIC
/begin CHARACTERISTIC K_MD_ETA_T_SPERR "Sperrzeit fuer TZ-Eingriff [verified]" VALUE 0x791D0 RL_VAL_UW 0 CM_0025 0 655.35 /end CHARACTERISTIC
/begin CHARACTERISTIC K_MD_RES_MIN "Reserveschwelle [verified]" VALUE 0x79198 RL_VAL_UB 0 CM_0017 0 25.5 /end CHARACTERISTIC
/begin CHARACTERISTIC K_MD_RES_MIN_HYS "Reserveschwelle Hystherse [verified]" VALUE 0x79199 RL_VAL_UB 0 CM_0017 0 25.5 /end CHARACTERISTIC
/begin CHARACTERISTIC K_MD_TAU_IND_TZ_GRAD "TAU Sollmoment [verified]" VALUE 0x79197 RL_VAL_UB 0 CM_0065 0.005019607843 1.28 /end CHARACTERISTIC
/begin CHARACTERISTIC K_RF_KOR_VAN_MAX "Maximaler Korrekturfaktor Vanos [A2L-ref]" VALUE 0x7AD14 RL_VAL_UW 0 CM_0016 0 63.99902344 /end CHARACTERISTIC
/begin CHARACTERISTIC K_SCHALTER_KS_M_AUF "Schwelle fuer kein Kraftschluss [EST]" VALUE 0x7BAE0 RL_VAL_SW 0 CM_0017 -3276.8 3276.7 /end CHARACTERISTIC
/begin CHARACTERISTIC K_SCHALTER_KS_M_ZU "Schwelle fuer Kraftschluss [EST]" VALUE 0x7BAE2 RL_VAL_SW 0 CM_0017 -3276.8 3276.7 /end CHARACTERISTIC
/begin CHARACTERISTIC K_TABG_STAND_MAX "Maximale Abstellabgastempe-ratur [verified]" VALUE 0x7D11E RL_VAL_SW 0 CM_0024 -3276.8 3276.7 /end CHARACTERISTIC
/begin CHARACTERISTIC K_MD_NBEGR_A1 "Reglerfaktor A1 [verified]" VALUE 0x791CA RL_VAL_SW 0 CM_0331 -327.68 327.67 /end CHARACTERISTIC
/begin CHARACTERISTIC KL_AQ_IST_RF_TAU "Tau fuer aq_rf Filter [verified]" CURVE 0x7033C RL_CUR_SW_UW 0 CM_0011 0.004999923705 327.67 /begin AXIS_DESCR STD_AXIS NO_INPUT_QUANTITY CM_0049 5 -655360 655340 /end AXIS_DESCR /end CHARACTERISTIC
/begin CHARACTERISTIC KL_EGAS_SOLL_AQ_MSA_STOPP "Aq f?r MSA_Stopp [verified]" CURVE 0x718D8 RL_CUR_SW_UW 0 CM_0429 0 6553.5 /begin AXIS_DESCR STD_AXIS NO_INPUT_QUANTITY CM_0002 2 -32768 32767 /end AXIS_DESCR /end CHARACTERISTIC
/begin CHARACTERISTIC KL_MD_RF_TABG_KOR "Korrektur ueber tabg_rf_kor [verified]" CURVE 0x7943E RL_CUR_UW_UW 0 CM_0245 0 63.99902344 /begin AXIS_DESCR STD_AXIS NO_INPUT_QUANTITY CM_0245 8 0 63.99902344 /end AXIS_DESCR /end CHARACTERISTIC
/begin CHARACTERISTIC KF_MD_KH_DP "Wichtungsfaktor Katheizen [verified]" MAP 0x7892E RL_MAP_UW_SW_UW 0 CM_0430 0 63.99902344 /begin AXIS_DESCR STD_AXIS NO_INPUT_QUANTITY CM_0000 3 0 65535 /end AXIS_DESCR /begin AXIS_DESCR STD_AXIS NO_INPUT_QUANTITY CM_0015 7 -32768 32767 /end AXIS_DESCR /end CHARACTERISTIC
/begin CHARACTERISTIC KF_MD_SPORT_LSD "Wichtungsfaktor Sport [verified]" MAP 0x7896E RL_MAP_SW_SW_UW 0 CM_0245 0 63.99902344 /begin AXIS_DESCR STD_AXIS NO_INPUT_QUANTITY CM_0431 3 -32767 32768 /end AXIS_DESCR /begin AXIS_DESCR STD_AXIS NO_INPUT_QUANTITY CM_0015 7 -32768 32767 /end AXIS_DESCR /end CHARACTERISTIC
/begin CHARACTERISTIC K_MD_KKOS_CAN_PASSIV "KKOS-Passivschwelle [verified]" VALUE 0x79190 RL_VAL_SW 0 CM_0322 -3276.8 3276.7 /end CHARACTERISTIC
/begin CHARACTERISTIC K_MD_TZ_EINGR_T_SPERR "Sperrzeit fuer TZ-Eingriff [verified]" VALUE 0x791D8 RL_VAL_UW 0 CM_0247 0 655.35 /end CHARACTERISTIC
/begin CHARACTERISTIC KL_LLR_N_SOLL_ABSE_ "TUMG_MIN Tan-Schwelle fuer Absenkung [verified]" CURVE 0x76412 RL_CUR_SW_SW 0 CM_0006 -3550 3003.5 /begin AXIS_DESCR STD_AXIS NO_INPUT_QUANTITY CM_0291 4 -2048 2047.9375 /end AXIS_DESCR /end CHARACTERISTIC
/begin CHARACTERISTIC KL_LLR_N_SOLL_KH_FAK_KS "KH-Faktor bei Kraftschluss [verified]" CURVE 0x7630E RL_CUR_SW_UW 0 CM_0245 0 63.99902344 /begin AXIS_DESCR STD_AXIS NO_INPUT_QUANTITY CM_0006 6 -3550 3003.5 /end AXIS_DESCR /end CHARACTERISTIC
/begin CHARACTERISTIC K_KA_EINGR_T_SPERR "Sperrzeit f?r KA -Eingriff im LL nach Start [verified]" VALUE 0x738CA RL_VAL_UB 0 CM_0247 0 2.55 /end CHARACTERISTIC
/begin CHARACTERISTIC K_KR_ETL_TMOT_MIN "MotorTemperatur Schwelle fuer KR-Ethanol Adaptions Freigabe [verified]" VALUE 0x74D9E RL_VAL_SW 0 CM_0256 -3550 3003.5 /end CHARACTERISTIC
/begin CHARACTERISTIC K_KA_ADA_INST_CFG "0 Aus 0x1 Ein ELSE undef i- niert Instantan Adaption Freigabe. [verified]" VALUE 0x738C8 RL_VAL_UB 0 CM_0000 0 255 /end CHARACTERISTIC
/begin CHARACTERISTIC K_KA_ROZ_RESET_CFG "0 Aus 0x1 Reset ELSE undef i- niert Reset ROZ-Adaption. [verified]" VALUE 0x738CB RL_VAL_UB 0 CM_0000 0 255 /end CHARACTERISTIC
/begin CHARACTERISTIC K_KA_KF_RESET_CFG "0 Aus 0x1 Reset ELSE undef i- niert Reset Kennfeldadaption. [verified]" VALUE 0x738D0 RL_VAL_UB 0 CM_0000 0 255 /end CHARACTERISTIC
/begin CHARACTERISTIC K_KA_KF_NORM_CFG "0 Aus 0x1 Nach Tanken 0x2 Bei n=0 ELSE undef i- niert Kennfeldnormierung. [verified]" VALUE 0x738D1 RL_VAL_UB 0 CM_0000 0 255 /end CHARACTERISTIC
/begin CHARACTERISTIC K_KA_FST_NACHTANK_CFG "0 Aus 0x1 Nachge- tankt ELSE undef i- niert Simulation Nachtanken. [verified]" VALUE 0x738D2 RL_VAL_UB 0 CM_0000 0 255 /end CHARACTERISTIC
/begin CHARACTERISTIC K_KA_KLIPPING_MAX "Klopfschutzschwelle fuer Klipping im Klopffenster. [verified]" VALUE 0x738D3 RL_VAL_UB 0 CM_0000 0 255 /end CHARACTERISTIC
/begin CHARACTERISTIC K_KA_TIME_ROZ "1 x/10 Dauer ROZ-Adaption. [verified]" VALUE 0x738D4 RL_VAL_UW 0 CM_0301 0 6553.5 /end CHARACTERISTIC
/begin CHARACTERISTIC K_KA_MIN_VERBR_ROZ "Mindest verbrauchte Spritmenge vor ROZ-Adaption. [verified]" VALUE 0x738D6 RL_VAL_UW 0 CM_0441 0 65.535 /end CHARACTERISTIC
/begin CHARACTERISTIC K_KA_AQ_GRAD_SEGM_CNT "Anzahl Segmente Deaktivi erung nach Dynamik. [verified]" VALUE 0x738DA RL_VAL_UW 0 CM_0000 0 65535 /end CHARACTERISTIC
/begin CHARACTERISTIC K_KA_AQ_GRAD_MAX "Trigger Dynamik Deaktivierung. [verified]" VALUE 0x738E0 RL_VAL_SW 0 CM_0049 -655360 655340 /end CHARACTERISTIC
/begin CHARACTERISTIC K_KA_NGRAD_TAU "Tau Drehzahlgradient fuer KA. [verified]" VALUE 0x738FC RL_VAL_UB 0 CM_0329 0 0.99609375 /end CHARACTERISTIC
/begin CHARACTERISTIC K_KA_KS_CFG "0 Klopf schutz Aus 0x1 Klopf- schutz Ein ELSE undef i- niert Freigabe Klopfschutz. [verified]" VALUE 0x738C9 RL_VAL_UB 0 CM_0000 0 255 /end CHARACTERISTIC
/begin CHARACTERISTIC KL_KA_ADAPT_MIN_KF "Min Zuendwinkeleingriff Klop f-adaption. [verified]" CURVE 0x739C8 RL_GRP_SW_R 0 CM_0280 -3276.8 3276.7
 /begin AXIS_DESCR COM_AXIS NO_INPUT_QUANTITY CM_0069 5 1 256 AXIS_PTS_REF GAX_139C0 /end AXIS_DESCR
/end CHARACTERISTIC
/begin CHARACTERISTIC KF_KA_ADAPT_MAX_KF "Max Zuendwinkeleingriff Klopfadaption. [verified] (axes fixed/not stored)" VAL_BLK 0x7405C RL_BLK_SW 0 CM_0280 -3276.8 3276.7 MATRIX_DIM 5 4 1 /end CHARACTERISTIC
/begin CHARACTERISTIC KL_KA_KR_DTZ_MIN "Eintrittsschwelle Klopfruec k-ziehwinkel fuer Klopfadaption [verified]" CURVE 0x7397C RL_CUR_SW_SW 0 CM_0280 -3276.8 3276.7 /begin AXIS_DESCR STD_AXIS NO_INPUT_QUANTITY CM_0002 6 -32768 32767 /end AXIS_DESCR /end CHARACTERISTIC
/begin CHARACTERISTIC KL_KA_BTKORR "Brennraumtemperaturkorrektur Klopfadaption. [verified]" CURVE 0x739D2 RL_CUR_SW_SW 0 CM_0280 -3276.8 3276.7 /begin AXIS_DESCR STD_AXIS NO_INPUT_QUANTITY CM_0067 6 -32768 32767 /end AXIS_DESCR /end CHARACTERISTIC
/begin CHARACTERISTIC K_MD_ANFF_V_OFF "Anfahrfilter v-Schwelle Off [verified]" VALUE 0x77D84 RL_VAL_SW 0 CM_0260 -2048 2047.9375 /end CHARACTERISTIC
/begin CHARACTERISTIC K_MD_CFG_RES "0 vor DKG 1 nach DKG ELSE undef Position reserve- Einrechnung [verified]" VALUE 0x7916C RL_VAL_UB 0 CM_0000 0 255 /end CHARACTERISTIC
/begin CHARACTERISTIC K_MD_RES_EINGR_MIN "min. Reserve fuer TZ-Eingriff aktiv [verified]" VALUE 0x791A2 RL_VAL_UB 0 CM_0322 0 25.5 /end CHARACTERISTIC
/begin CHARACTERISTIC K_MD_NOISE_RAMPE_AUS "Noiseschwelle PWG [verified]" VALUE 0x791C8 RL_VAL_SW 0 CM_0068 -32768 32767 /end CHARACTERISTIC
/begin CHARACTERISTIC K_MD_RF_SOLL_SEK_CFG "0x0 Inaktiv 0x1 mit TE 0x2 mit MVAC 0x3 mit TE+MVAC Konfig uber Einrechnung sek. Fuellungseinfluss [verified]" VALUE 0x791CE RL_VAL_UB 0 CM_0000 0 255 /end CHARACTERISTIC
/begin CHARACTERISTIC K_MD_KUPP_GANG_RAMPE "Eta-Bezugsrampe [verified]" VALUE 0x791D2 RL_VAL_SW 0 CM_0007 -655360 655340 /end CHARACTERISTIC
/begin CHARACTERISTIC K_MD_RFMAX_RAMPE "Begrenzung RfMax beim Umschalten [verified]" VALUE 0x791D4 RL_VAL_UW 0 CM_0442 0 1310.7 /end CHARACTERISTIC
/begin CHARACTERISTIC K_TZ_DBGR_CFG "0 aq_rf 0x1 aq_rf_fr ELSE undefiniert Auswahl Quelle fuer tz_aq_rf_grad_roh. [verified]" VALUE 0x7DBDC RL_VAL_UB 0 CM_0000 0 255 /end CHARACTERISTIC
/begin CHARACTERISTIC K_TZ_DBGR_AQ_RF_TAU "Druckbegrenzung AQ Filter Tau [verified]" VALUE 0x7DBE0 RL_VAL_UB 0 CM_0065 0.005019607843 1.28 /end CHARACTERISTIC
/begin CHARACTERISTIC K_TZ_DBGR_ANZ_SEG "Anz. Segmente bis rueckse t-zen [verified]" VALUE 0x7DBE1 RL_VAL_UB 0 CM_0443 1 256 /end CHARACTERISTIC
/begin CHARACTERISTIC K_TZ_DBGR_AUFREG "Aufregelrampe Druckbegren-zung [verified]" VALUE 0x7DBE2 RL_VAL_UB 0 CM_0444 0 25.5 /end CHARACTERISTIC
/begin CHARACTERISTIC K_TZ_DLY "Verzoegerungszeit fuer tz_stat [verified]" VALUE 0x7DBE3 RL_VAL_UB 0 CM_0445 0 255 /end CHARACTERISTIC
/begin CHARACTERISTIC K_TZ_SZ_AUSS_DELAY "Delay fuer Abschaltung der Stromanhebung [verified]" VALUE 0x7DBE8 RL_VAL_UW 0 CM_0270 0 327.675 /end CHARACTERISTIC
/begin CHARACTERISTIC K_TZ_SZ_SA_TIME_MAX "Maximalzeit von Nachzue n- dern waerend laengere SA - Phasen. [verified]" VALUE 0x7DBEA RL_VAL_UW 0 CM_0247 0 655.35 /end CHARACTERISTIC
/begin CHARACTERISTIC K_TZ_I_SA_DELAY "Delay fuer SA Abschaltung [verified]" VALUE 0x7DBEC RL_VAL_UW 0 CM_0270 0 327.675 /end CHARACTERISTIC
/begin CHARACTERISTIC K_TZ_MIN_DYN_T_HYST "Hysteresezeit fuer tz_min_md_dyn_eingr [verified]" VALUE 0x7DBEE RL_VAL_UW 0 CM_0270 0 327.675 /end CHARACTERISTIC
/begin CHARACTERISTIC K_TZ_MIN_STAT_GRAD "Aenderungsbegrenzung tz_min_stat [verified]" VALUE 0x7DC16 RL_VAL_UW 0 CM_0446 0 6553.5 /end CHARACTERISTIC
/begin CHARACTERISTIC K_TZ_MIN_KATS_T_HYST "Hysterese fuer S icherheitsab-stand tz_min [verified]" VALUE 0x7DC18 RL_VAL_SW 0 CM_0323 -3276.8 3276.7 /end CHARACTERISTIC
/begin CHARACTERISTIC K_EGAS_SOLL_AQ_GRAD_MAX "Gradintenbegrenzung von egas_aq_soll [verified]" VALUE 0x71848 RL_VAL_SW 0 CM_0049 -655360 655340 /end CHARACTERISTIC
/begin CHARACTERISTIC K_EGAS_SOLL_START_MD_RAMP_GTS "Rampe GTS fuer EGAS_SOLL rf nach Start in ML [verified]" VALUE 0x7188E RL_VAL_UW 0 CM_0247 0 655.35 /end CHARACTERISTIC
/begin CHARACTERISTIC KL_EGAS_SOLL_AQ_START_GTS "Faktor bei GTS_Start [verified]" CURVE 0x71890 RL_CUR_SW_UW 0 CM_0245 0 63.99902344 /begin AXIS_DESCR STD_AXIS NO_INPUT_QUANTITY CM_0002 3 -32768 32767 /end AXIS_DESCR /end CHARACTERISTIC
/begin CHARACTERISTIC K_TABG_PST_V "Ersatzgeschwindigkeit am Pruefstand [verified]" VALUE 0x7D116 RL_VAL_SW 0 CM_0260 -2048 2047.9375 /end CHARACTERISTIC
/begin CHARACTERISTIC K_TABG_TAU "Filterkonstante fuer die A b-gastemperaturerfassung [verified]" VALUE 0x7D120 RL_VAL_UB 0 CM_0306 0.1003921569 25.6 /end CHARACTERISTIC
/begin CHARACTERISTIC K_TABG_RF_KOR_TAU "Filterkonstante fuer Faktor Fuellungskorektur [verified]" VALUE 0x7D121 RL_VAL_UB 0 CM_0306 0.1003921569 25.6 /end CHARACTERISTIC
/begin CHARACTERISTIC K_TABG_LW_LAM_TAU "Filterkonstante fuer Lambd a-einfluss [verified]" VALUE 0x7D122 RL_VAL_UB 0 CM_0306 0.1003921569 25.6 /end CHARACTERISTIC
/begin CHARACTERISTIC K_TABG_KAT_AEBG_MS "Gradient bei Motor steht [verified]" VALUE 0x7D126 RL_VAL_SW 0 CM_0449 -2048 2047.9375 /end CHARACTERISTIC
/begin CHARACTERISTIC K_TABG_NKAT_K_TUMG "Waermeuebergangskoeffizient [verified]" VALUE 0x7D118 RL_VAL_UW 0 CM_0374 0 65.535 /end CHARACTERISTIC
/begin CHARACTERISTIC K_TABG_NKAT_K_V "Geschwindikeitsabhaengiger Waermeuebergangskoeffizient [verified]" VALUE 0x7D11C RL_VAL_UW 0 CM_0450 0 6.5535 /end CHARACTERISTIC
/begin CHARACTERISTIC K_MD_TAU_START_OFF_MSA_HS "MSA Filter f?r Startoffset [verified]" VALUE 0x76A90 RL_VAL_UW 0 CM_0011 0.004999923705 327.67 /end CHARACTERISTIC
/begin CHARACTERISTIC K_MD_TAU_START_OFF_MSA_DKG "MSA Filter f?r Startoffset [verified]" VALUE 0x76A92 RL_VAL_UW 0 CM_0011 0.004999923705 327.67 /end CHARACTERISTIC
/begin CHARACTERISTIC KL_MD_TAU_START_OFF_GTS "Filter fuer Startoffset (GTS / md_st bit 0x200) [verified]" CURVE 0x76CEE RL_CUR_SW_UW 0 CM_0011 0.004999923705 327.67 /begin AXIS_DESCR STD_AXIS NO_INPUT_QUANTITY CM_0006 3 -3550 3003.5 /end AXIS_DESCR /end CHARACTERISTIC
/begin CHARACTERISTIC GKL_KR_DTZ_MAX "Max. permitted knock-control retard over n [verified]" CURVE 0x74E98 RL_GRP_SW_R 0 CM_0280 -3276.8 3276.7
 /begin AXIS_DESCR COM_AXIS NO_INPUT_QUANTITY CM_0235 10 -32768 32767 AXIS_PTS_REF GAX_136C0 /end AXIS_DESCR
/end CHARACTERISTIC
/begin CHARACTERISTIC GKL_KR_DTZ_AVG_MAX "Max. deviation from the mean knock retard over n [verified]" CURVE 0x74EAC RL_GRP_SW_R 0 CM_0280 -3276.8 3276.7
 /begin AXIS_DESCR COM_AXIS NO_INPUT_QUANTITY CM_0235 10 -32768 32767 AXIS_PTS_REF GAX_136C0 /end AXIS_DESCR
/end CHARACTERISTIC
/begin CHARACTERISTIC GKL_KR_RF_MIN "Minimum relative filling for knock-control release over n [verified]" CURVE 0x74EC0 RL_GRP_SW_R 0 CM_0282 -3.2768 3.2767
 /begin AXIS_DESCR COM_AXIS NO_INPUT_QUANTITY CM_0235 12 -32768 32767 AXIS_PTS_REF GAX_136D6 /end AXIS_DESCR
/end CHARACTERISTIC
/begin CHARACTERISTIC GKL_KR_FBS_MAX_1 "Permitted knock-frequency amplitude at full load, band 1 [verified]" CURVE 0x74EFE RL_GRP_UW_R 0 CM_0462 0 7932.37896
 /begin AXIS_DESCR COM_AXIS NO_INPUT_QUANTITY CM_0002 16 -32768 32767 AXIS_PTS_REF GAX_136F0 /end AXIS_DESCR
/end CHARACTERISTIC
/begin CHARACTERISTIC GKL_KR_FBS_MAX_2 "Permitted knock-frequency amplitude at full load, band 2 [verified]" CURVE 0x74F1E RL_GRP_UW_R 0 CM_0462 0 7932.37896
 /begin AXIS_DESCR COM_AXIS NO_INPUT_QUANTITY CM_0002 16 -32768 32767 AXIS_PTS_REF GAX_136F0 /end AXIS_DESCR
/end CHARACTERISTIC
/begin CHARACTERISTIC GKL_KR_FBS_RATIO "Minimum FBS1/FBS2 ratio for knock detection over n [verified]" CURVE 0x74F3E RL_GRP_UW_R 0 CM_0245 0 63.99902344
 /begin AXIS_DESCR COM_AXIS NO_INPUT_QUANTITY CM_0002 16 -32768 32767 AXIS_PTS_REF GAX_136F0 /end AXIS_DESCR
/end CHARACTERISTIC
/begin CHARACTERISTIC GKL_KR_FBS_RATIO31_MAX "Maximum FBS3/FBS1 ratio for knock detection over n [verified]" CURVE 0x74F5E RL_GRP_UW_R 0 CM_0245 0 63.99902344
 /begin AXIS_DESCR COM_AXIS NO_INPUT_QUANTITY CM_0002 16 -32768 32767 AXIS_PTS_REF GAX_136F0 /end AXIS_DESCR
/end CHARACTERISTIC
/begin CHARACTERISTIC K_FRA_LOLI_MAX "Lolimot max limit (FRA) [verified]" VALUE 0x733FC RL_VAL_F32 0 CM_0000 -1e+30 1e+30 /end CHARACTERISTIC
/begin CHARACTERISTIC K_FRA_LOLI_MIN "Lolimot min limit (FRA) [verified]" VALUE 0x73400 RL_VAL_F32 0 CM_0000 -1e+30 1e+30 /end CHARACTERISTIC
/begin CHARACTERISTIC K_FRA_LOLI_GEW_MAX "Max. weight of the FRA LOLIMOT net [verified]" VALUE 0x73408 RL_VAL_F32 0 CM_0000 -1e+30 1e+30 /end CHARACTERISTIC
/begin CHARACTERISTIC K_FRA_LOLI_LERN_BIAS "Learning rate of the FRA LOLIMOT net [EST]" VALUE 0x7340C RL_VAL_F32 0 CM_0000 -1e+30 1e+30 /end CHARACTERISTIC
/begin CHARACTERISTIC K_FRA_LOLI_X_NORM "Input normalisation of the FRA LOLIMOT net (n, rf) [verified] (axes fixed/not stored)" VAL_BLK 0x73418 RL_BLK_F32 0 CM_0000 -1e+30 1e+30 NUMBER 2 /end CHARACTERISTIC
/begin CHARACTERISTIC K_FRA_LOLI_OUT_MAX "Maxbegr. Lolimot Ausgang [verified]" VALUE 0x73420 RL_VAL_UW 0 CM_0307 0 1.999969482 /end CHARACTERISTIC
/begin CHARACTERISTIC K_FRA_LOLI_OUT_MIN "Minbegr. Lolimot Ausgang [verified]" VALUE 0x73422 RL_VAL_UW 0 CM_0307 0 1.999969482 /end CHARACTERISTIC
/begin CHARACTERISTIC K_FRA_TABG_KOR_MAX "tabg_kor-Schwelle fuer Lolimot-Lernen [verified]" VALUE 0x73412 RL_VAL_UW 0 CM_0245 0 63.99902344 /end CHARACTERISTIC
/begin CHARACTERISTIC K_FRA_TE_X_ML_SOLL_MAX "Sperrschwelle fra_loli_lern_st fuer max te_x_ml_soll [verified]" VALUE 0x73424 RL_VAL_UW 0 CM_0307 0 1.999969482 /end CHARACTERISTIC
/begin CHARACTERISTIC K_FRA_LOLI_RESET_KM "Sperrschwelle fra_loli_lern_st fuer max te_x_ml_soll [verified]" VALUE 0x73426 RL_VAL_UW 0 CM_0082 0 65535 /end CHARACTERISTIC
/begin CHARACTERISTIC K_FRA_LOLI_PSAU_REL_MAX "Max psau_rel Schwelle fuer Grundleckluftlernen [verified]" VALUE 0x73428 RL_VAL_SW 0 CM_0463 -200 199.9938965 /end CHARACTERISTIC
/begin CHARACTERISTIC KL_MD_RAD_BREMSE "Bremsmoment [verified]" CURVE 0x78B1A RL_CUR_UB_UW 0 CM_0078 0 65535 /begin AXIS_DESCR STD_AXIS NO_INPUT_QUANTITY CM_0085 6 0 255 /end AXIS_DESCR /end CHARACTERISTIC
/begin CHARACTERISTIC K_AQ_DK0_DK_IST_SCHW "DkIst-Schwelle fuer DK0 -Erkennung [verified]" VALUE 0x702A2 RL_VAL_UB 0 CM_0276 0 25.5 /end CHARACTERISTIC
/begin CHARACTERISTIC K_AQ_LLS_ABW_T_MIN "Zeitschwelle fuer LLS eingeregelt [verified]" VALUE 0x702A3 RL_VAL_UB 0 CM_0270 0 1.275 /end CHARACTERISTIC
/begin CHARACTERISTIC K_AQ_DK_ABW_T_MIN "Zeitschwelle fuer DK eingeregelt [verified]" VALUE 0x702A4 RL_VAL_UB 0 CM_0270 0 1.275 /end CHARACTERISTIC
/begin CHARACTERISTIC KL_FRA_LOLI_C_N "Centres of the LOLIMOT models, input n (FRA) [verified] (axes fixed/not stored)" VAL_BLK 0x7343C RL_BLK_SW 0 CM_0235 -32768 32767 NUMBER 15 /end CHARACTERISTIC
/begin CHARACTERISTIC KL_FRA_LOLI_C_RF "Centres of the LOLIMOT models, input rf (FRA) [verified] (axes fixed/not stored)" VAL_BLK 0x7345A RL_BLK_SW 0 CM_0282 -3.2768 3.2767 NUMBER 15 /end CHARACTERISTIC
/begin CHARACTERISTIC KL_FRA_LOLI_S_N "Widths of the LOLIMOT models, input n (FRA) [verified] (axes fixed/not stored)" VAL_BLK 0x73478 RL_BLK_SW 0 CM_0235 -32768 32767 NUMBER 15 /end CHARACTERISTIC
/begin CHARACTERISTIC KL_FRA_LOLI_S_RF "Widths of the LOLIMOT models, input rf (FRA) [verified] (axes fixed/not stored)" VAL_BLK 0x73496 RL_BLK_SW 0 CM_0282 -3.2768 3.2767 NUMBER 15 /end CHARACTERISTIC
/begin CHARACTERISTIC KL_FRA_LOLI_DEF_W_N "Default LOLIMOT weights for input N [EST] (axes fixed/not stored)" VAL_BLK 0x734B4 RL_BLK_F32 0 CM_0000 -1e+30 1e+30 NUMBER 15 /end CHARACTERISTIC
/begin CHARACTERISTIC KL_FRA_LOLI_DEF_W_RF "Default LOLIMOT weights for input RF [EST] (axes fixed/not stored)" VAL_BLK 0x734F0 RL_BLK_F32 0 CM_0000 -1e+30 1e+30 NUMBER 15 /end CHARACTERISTIC
/begin CHARACTERISTIC KL_FRA_LOLI_DEF_W_BIAS "Default LOLIMOT weights for the bias [EST] (axes fixed/not stored)" VAL_BLK 0x7352C RL_BLK_F32 0 CM_0000 -1e+30 1e+30 NUMBER 15 /end CHARACTERISTIC
/begin CHARACTERISTIC K_FRA_LOLI_EINLERN_TIME "Gesamte Lernzeit fuers Lolimot [verified]" VALUE 0x7342A RL_VAL_UW 0 CM_0301 0 6553.5 /end CHARACTERISTIC
/begin CHARACTERISTIC K_FRA_LOLI_LECKL_ANZ "Einfluss Grundleckluft fuer die Lernausgaenge [EST]" VALUE 0x733FB RL_VAL_UB 0 CM_0000 0 255 /end CHARACTERISTIC
/begin CHARACTERISTIC KF_FRA_LOLI_MDRF_MAX "Begrenzung beim Zwangsle r-nen [verified]" MAP 0x735E4 RL_MAP_UW_SW_SW 0 CM_0282 -3.2768 3.2767 /begin AXIS_DESCR STD_AXIS NO_INPUT_QUANTITY CM_0301 4 0 6553.5 /end AXIS_DESCR /begin AXIS_DESCR STD_AXIS NO_INPUT_QUANTITY CM_0002 4 -32768 32767 /end AXIS_DESCR /end CHARACTERISTIC
/begin CHARACTERISTIC KF_FRA_LOLI_LERN_GRAD "KF fuer Gewichtung Lernei n-gaenge [verified]" MAP 0x73582 RL_MAP_SW_SW_UW 0 CM_0245 0 63.99902344 /begin AXIS_DESCR STD_AXIS NO_INPUT_QUANTITY CM_0002 6 -32768 32767 /end AXIS_DESCR /begin AXIS_DESCR STD_AXIS NO_INPUT_QUANTITY CM_0282 6 -3.2768 3.2767 /end AXIS_DESCR /end CHARACTERISTIC
/begin CHARACTERISTIC KL_FRA_LOLI_MDRF_MIN "Minbegrenzung Lerneingang Lolimot mdrf [verified]" CURVE 0x73568 RL_CUR_SW_SW 0 CM_0282 -3.2768 3.2767 /begin AXIS_DESCR STD_AXIS NO_INPUT_QUANTITY CM_0002 6 -32768 32767 /end AXIS_DESCR /end CHARACTERISTIC
/begin CHARACTERISTIC KF_MD_RF_TABG_KOR "Wichtungs KF fuer tabg [verified]" MAP 0x7A51C RL_MAP_SW_SW_UW 0 CM_0245 0 63.99902344 /begin AXIS_DESCR STD_AXIS NO_INPUT_QUANTITY CM_0002 10 -32768 32767 /end AXIS_DESCR /begin AXIS_DESCR STD_AXIS NO_INPUT_QUANTITY CM_0282 6 -3.2768 3.2767 /end AXIS_DESCR /end CHARACTERISTIC
/begin CHARACTERISTIC KL_MD_RES_LOLI "Reserve fuer Loli-Einlernphase [verified]" CURVE 0x79498 RL_CUR_UW_SW 0 CM_0322 -3276.8 3276.7 /begin AXIS_DESCR STD_AXIS NO_INPUT_QUANTITY CM_0301 4 0 6553.5 /end AXIS_DESCR /end CHARACTERISTIC
/begin CHARACTERISTIC K_MD_RES_T_SPERR "Sperrzeit Reserve [verified]" VALUE 0x7919C RL_VAL_UW 0 CM_0247 0 655.35 /end CHARACTERISTIC
/begin CHARACTERISTIC K_MD_RES_T_SPERR_GTS "Sperrzeit Reserve [verified]" VALUE 0x7919A RL_VAL_UW 0 CM_0247 0 655.35 /end CHARACTERISTIC
/begin COMPU_METHOD CM_0000 "X" RAT_FUNC "%.4g" "-" COEFFS 0 1 0 0 0 1 /end COMPU_METHOD
/begin COMPU_METHOD CM_0002 "X" RAT_FUNC "%.4g" "Upm" COEFFS 0 1 0 0 0 1 /end COMPU_METHOD
/begin COMPU_METHOD CM_0003 "X*0.0001" RAT_FUNC "%.4g" "-" COEFFS 0 1 0 0 0 0.0001 /end COMPU_METHOD
/begin COMPU_METHOD CM_0005 "X*0.0061035156" RAT_FUNC "%.4g" "%" COEFFS 0 1 0 0 0 0.0061035156 /end COMPU_METHOD
/begin COMPU_METHOD CM_0006 "X*0.1-273.2" RAT_FUNC "%.4g" "?C" COEFFS 0 1 273.2 0 0 0.1 /end COMPU_METHOD
/begin COMPU_METHOD CM_0007 "X*20.0" RAT_FUNC "%.4g" "Nm/s" COEFFS 0 1 0 0 0 20 /end COMPU_METHOD
/begin COMPU_METHOD CM_0010 "X*0.0625" RAT_FUNC "%.4g" "km/h" COEFFS 0 1 0 0 0 0.0625 /end COMPU_METHOD
/begin COMPU_METHOD CM_0011 "327.67/X" RAT_FUNC "%.4g" "s" COEFFS 0 0 -327.67 0 -1 0 /end COMPU_METHOD
/begin COMPU_METHOD CM_0012 "X*0.1" RAT_FUNC "%.4g" "qmm" COEFFS 0 1 0 0 0 0.1 /end COMPU_METHOD
/begin COMPU_METHOD CM_0013 "X*0.1" RAT_FUNC "%.4g" "%" COEFFS 0 1 0 0 0 0.1 /end COMPU_METHOD
/begin COMPU_METHOD CM_0014 "X*0.0001953125" RAT_FUNC "%.4g" "Nm/Upm" COEFFS 0 1 0 0 0 0.0001953125 /end COMPU_METHOD
/begin COMPU_METHOD CM_0015 "X" RAT_FUNC "%.4g" ".Gang" COEFFS 0 1 0 0 0 1 /end COMPU_METHOD
/begin COMPU_METHOD CM_0016 "X*0.0009765625" RAT_FUNC "%.4g" "-" COEFFS 0 1 0 0 0 0.0009765625 /end COMPU_METHOD
/begin COMPU_METHOD CM_0017 "X*0.1" RAT_FUNC "%.4g" "Nm" COEFFS 0 1 0 0 0 0.1 /end COMPU_METHOD
/begin COMPU_METHOD CM_0018 "X*0.0000009537" RAT_FUNC "%.4g" "-" COEFFS 0 1 0 0 0 9.537e-07 /end COMPU_METHOD
/begin COMPU_METHOD CM_0019 "X*0.0000610352" RAT_FUNC "%.4g" "-" COEFFS 0 1 0 0 0 6.10352e-05 /end COMPU_METHOD
/begin COMPU_METHOD CM_0020 "X*0.005" RAT_FUNC "%.4g" "s" COEFFS 0 1 0 0 0 0.005 /end COMPU_METHOD
/begin COMPU_METHOD CM_0021 "X*0.1" RAT_FUNC "%.4g" "V" COEFFS 0 1 0 0 0 0.1 /end COMPU_METHOD
/begin COMPU_METHOD CM_0022 "X*0.0625" RAT_FUNC "%.4g" "mbar" COEFFS 0 1 0 0 0 0.0625 /end COMPU_METHOD
/begin COMPU_METHOD CM_0023 "X*0.1" RAT_FUNC "%.4g" "s" COEFFS 0 1 0 0 0 0.1 /end COMPU_METHOD
/begin COMPU_METHOD CM_0024 "X*0.1" RAT_FUNC "%.4g" "Kelvin" COEFFS 0 1 0 0 0 0.1 /end COMPU_METHOD
/begin COMPU_METHOD CM_0025 "X*0.01" RAT_FUNC "%.4g" "s" COEFFS 0 1 0 0 0 0.01 /end COMPU_METHOD
/begin COMPU_METHOD CM_0027 "X" RAT_FUNC "%.4g" "s" COEFFS 0 1 0 0 0 1 /end COMPU_METHOD
/begin COMPU_METHOD CM_0028 "X*0.1" RAT_FUNC "%.4g" "?KW" COEFFS 0 1 0 0 0 0.1 /end COMPU_METHOD
/begin COMPU_METHOD CM_0029 "X*0.005" RAT_FUNC "%.4g" "sec" COEFFS 0 1 0 0 0 0.005 /end COMPU_METHOD
/begin COMPU_METHOD CM_0030 "X" RAT_FUNC "%.4g" "mal" COEFFS 0 1 0 0 0 1 /end COMPU_METHOD
/begin COMPU_METHOD CM_0031 "X*0.0048828125" RAT_FUNC "%.4g" "V" COEFFS 0 1 0 0 0 0.0048828125 /end COMPU_METHOD
/begin COMPU_METHOD CM_0032 "X*5.0" RAT_FUNC "%.4g" "ms" COEFFS 0 1 0 0 0 5 /end COMPU_METHOD
/begin COMPU_METHOD CM_0033 "X*0.0099902344" RAT_FUNC "%.4g" "%/V" COEFFS 0 1 0 0 0 0.0099902344 /end COMPU_METHOD
/begin COMPU_METHOD CM_0036 "X*0.0015625" RAT_FUNC "%.4g" "%" COEFFS 0 1 0 0 0 0.0015625 /end COMPU_METHOD
/begin COMPU_METHOD CM_0037 "X*0.0078125" RAT_FUNC "%.4g" "-" COEFFS 0 1 0 0 0 0.0078125 /end COMPU_METHOD
/begin COMPU_METHOD CM_0039 "X*0.01" RAT_FUNC "%.4g" "-" COEFFS 0 1 0 0 0 0.01 /end COMPU_METHOD
/begin COMPU_METHOD CM_0047 "X*0.0000305185" RAT_FUNC "%.4g" "-" COEFFS 0 1 0 0 0 3.05185e-05 /end COMPU_METHOD
/begin COMPU_METHOD CM_0048 "X*0.0030517578" RAT_FUNC "%.4g" "1/s" COEFFS 0 1 0 0 0 0.0030517578 /end COMPU_METHOD
/begin COMPU_METHOD CM_0049 "X*20.0" RAT_FUNC "%.4g" "qmm/s" COEFFS 0 1 0 0 0 20 /end COMPU_METHOD
/begin COMPU_METHOD CM_0050 "X*0.0030517578" RAT_FUNC "%.4g" "%" COEFFS 0 1 0 0 0 0.0030517578 /end COMPU_METHOD
/begin COMPU_METHOD CM_0051 "X*0.0000305176" RAT_FUNC "%.4g" "-" COEFFS 0 1 0 0 0 3.05176e-05 /end COMPU_METHOD
/begin COMPU_METHOD CM_0052 "X*10.0" RAT_FUNC "%.4g" "ms" COEFFS 0 1 0 0 0 10 /end COMPU_METHOD
/begin COMPU_METHOD CM_0053 "X*0.001953125" RAT_FUNC "%.4g" "*" COEFFS 0 1 0 0 0 0.001953125 /end COMPU_METHOD
/begin COMPU_METHOD CM_0055 "X*0.0244140625" RAT_FUNC "%.4g" "%" COEFFS 0 1 0 0 0 0.0244140625 /end COMPU_METHOD
/begin COMPU_METHOD CM_0056 "X" RAT_FUNC "%.4g" "*" COEFFS 0 1 0 0 0 1 /end COMPU_METHOD
/begin COMPU_METHOD CM_0058 "X*0.001953125" RAT_FUNC "%.4g" "Nms2" COEFFS 0 1 0 0 0 0.001953125 /end COMPU_METHOD
/begin COMPU_METHOD CM_0062 "X*0.0008056640625" RAT_FUNC "%.4g" "V" COEFFS 0 1 0 0 0 0.0008056640625 /end COMPU_METHOD
/begin COMPU_METHOD CM_0063 "X*0.01" RAT_FUNC "%.4g" "Nm/Upm" COEFFS 0 1 0 0 0 0.01 /end COMPU_METHOD
/begin COMPU_METHOD CM_0064 "X*0.001" RAT_FUNC "%.4g" "s" COEFFS 0 1 0 0 0 0.001 /end COMPU_METHOD
/begin COMPU_METHOD CM_0065 "1.28/X" RAT_FUNC "%.4g" "s" COEFFS 0 0 -1.28 0 -1 0 /end COMPU_METHOD
/begin COMPU_METHOD CM_0066 "X*0.2" RAT_FUNC "%.4g" "Nm/s" COEFFS 0 1 0 0 0 0.2 /end COMPU_METHOD
/begin COMPU_METHOD CM_0067 "X" RAT_FUNC "%.4g" "Upm/s" COEFFS 0 1 0 0 0 1 /end COMPU_METHOD
/begin COMPU_METHOD CM_0068 "X" RAT_FUNC "%.4g" "Nm/s" COEFFS 0 1 0 0 0 1 /end COMPU_METHOD
/begin COMPU_METHOD CM_0069 "X*1.0+1.0" RAT_FUNC "%.4g" "-" COEFFS 0 1 -1 0 0 1 /end COMPU_METHOD
/begin COMPU_METHOD CM_0070 "X*0.001" RAT_FUNC "%.4g" "sec" COEFFS 0 1 0 0 0 0.001 /end COMPU_METHOD
/begin COMPU_METHOD CM_0071 "X*0.01" RAT_FUNC "%.4g" "10E-4" COEFFS 0 1 0 0 0 0.01 /end COMPU_METHOD
/begin COMPU_METHOD CM_0072 "X*0.01" RAT_FUNC "%.4g" "Nm/kmh" COEFFS 0 1 0 0 0 0.01 /end COMPU_METHOD
/begin COMPU_METHOD CM_0073 "X*0.1" RAT_FUNC "%.4g" "Nm/s" COEFFS 0 1 0 0 0 0.1 /end COMPU_METHOD
/begin COMPU_METHOD CM_0074 "X*0.01" RAT_FUNC "%.4g" "Nm" COEFFS 0 1 0 0 0 0.01 /end COMPU_METHOD
/begin COMPU_METHOD CM_0075 "X*20.0" RAT_FUNC "%.4g" "?/sec" COEFFS 0 1 0 0 0 20 /end COMPU_METHOD
/begin COMPU_METHOD CM_0076 "X*12.5" RAT_FUNC "%.4g" "Upm/s" COEFFS 0 1 0 0 0 12.5 /end COMPU_METHOD
/begin COMPU_METHOD CM_0077 "X*(-1.0)" RAT_FUNC "%.4g" "Nm" COEFFS 0 1 0 0 0 -1 /end COMPU_METHOD
/begin COMPU_METHOD CM_0078 "X" RAT_FUNC "%.4g" "Nm" COEFFS 0 1 0 0 0 1 /end COMPU_METHOD
/begin COMPU_METHOD CM_0079 "X*0.1953125" RAT_FUNC "%.4g" "1/sec" COEFFS 0 1 0 0 0 0.1953125 /end COMPU_METHOD
/begin COMPU_METHOD CM_0080 "X" RAT_FUNC "%.4g" "Gang" COEFFS 0 1 0 0 0 1 /end COMPU_METHOD
/begin COMPU_METHOD CM_0081 "X*10" RAT_FUNC "%.4g" "Upm/s" COEFFS 0 1 0 0 0 10 /end COMPU_METHOD
/begin COMPU_METHOD CM_0082 "X" RAT_FUNC "%.4g" "km" COEFFS 0 1 0 0 0 1 /end COMPU_METHOD
/begin COMPU_METHOD CM_0085 "X" RAT_FUNC "%.4g" "bar" COEFFS 0 1 0 0 0 1 /end COMPU_METHOD
/begin COMPU_METHOD CM_0086 "X*0.1953125" RAT_FUNC "%.4g" "1/s" COEFFS 0 1 0 0 0 0.1953125 /end COMPU_METHOD
/begin COMPU_METHOD CM_0087 "X" RAT_FUNC "%.4g" "digit" COEFFS 0 1 0 0 0 1 /end COMPU_METHOD
/begin COMPU_METHOD CM_0088 "X*10.0" RAT_FUNC "%.4g" "Nm/s" COEFFS 0 1 0 0 0 10 /end COMPU_METHOD
/begin COMPU_METHOD CM_0102 "X*0.1" RAT_FUNC "%.4g" "kg/h" COEFFS 0 1 0 0 0 0.1 /end COMPU_METHOD
/begin COMPU_METHOD CM_0103 "X*0.05-273.15" RAT_FUNC "%.4g" "?C" COEFFS 0 1 273.15 0 0 0.05 /end COMPU_METHOD
/begin COMPU_METHOD CM_0104 "X*0.1" RAT_FUNC "%.4g" "mg" COEFFS 0 1 0 0 0 0.1 /end COMPU_METHOD
/begin COMPU_METHOD CM_0105 "X*0.1" RAT_FUNC "%.4g" "Kelvin/s" COEFFS 0 1 0 0 0 0.1 /end COMPU_METHOD
/begin COMPU_METHOD CM_0119 "X*0.001" RAT_FUNC "%.4g" "A" COEFFS 0 1 0 0 0 0.001 /end COMPU_METHOD
/begin COMPU_METHOD CM_0120 "X*0.0008" RAT_FUNC "%.4g" "ms" COEFFS 0 1 0 0 0 0.0008 /end COMPU_METHOD
/begin COMPU_METHOD CM_0121 "X*0.1" RAT_FUNC "%.4g" "?/5ms" COEFFS 0 1 0 0 0 0.1 /end COMPU_METHOD
/begin COMPU_METHOD CM_0122 "X*0.005" RAT_FUNC "%.4g" "1/s" COEFFS 0 1 0 0 0 0.005 /end COMPU_METHOD
/begin COMPU_METHOD CM_0220 "X*0.04395" RAT_FUNC "%.4g" "Grad" COEFFS 0 1 0 0 0 0.04395 /end COMPU_METHOD
/begin COMPU_METHOD CM_0233 "X/60" RAT_FUNC "%.4g" "min" COEFFS 0 60 0 0 0 1 /end COMPU_METHOD
/begin COMPU_METHOD CM_0235 "X" RAT_FUNC "%.4g" "rpm" COEFFS 0 1 0 0 0 1 /end COMPU_METHOD
/begin COMPU_METHOD CM_0236 "X*0.00006103515625" RAT_FUNC "%.4g" "-" COEFFS 0 1 0 0 0 6.103515625e-05 /end COMPU_METHOD
/begin COMPU_METHOD CM_0245 "X*32/32768" RAT_FUNC "%.4g" "-" COEFFS 0 1024 0 0 0 1 /end COMPU_METHOD
/begin COMPU_METHOD CM_0247 "X/100" RAT_FUNC "%.4g" "s" COEFFS 0 100 0 0 0 1 /end COMPU_METHOD
/begin COMPU_METHOD CM_0255 "X/10" RAT_FUNC "%.4g" "kg/h" COEFFS 0 10 0 0 0 1 /end COMPU_METHOD
/begin COMPU_METHOD CM_0256 "(X-2732)/10" RAT_FUNC "%.4g" "?C" COEFFS 0 10 2732 0 0 1 /end COMPU_METHOD
/begin COMPU_METHOD CM_0258 "X*0.1-273.2" RAT_FUNC "%.4g" "degC" COEFFS 0 1 273.2 0 0 0.1 /end COMPU_METHOD
/begin COMPU_METHOD CM_0259 "X/16384" RAT_FUNC "%.4g" "-" COEFFS 0 16384 0 0 0 1 /end COMPU_METHOD
/begin COMPU_METHOD CM_0260 "X/16" RAT_FUNC "%.4g" "km/h" COEFFS 0 16 0 0 0 1 /end COMPU_METHOD
/begin COMPU_METHOD CM_0265 "X*0.1" RAT_FUNC "%.4g" "degKW" COEFFS 0 1 0 0 0 0.1 /end COMPU_METHOD
/begin COMPU_METHOD CM_0269 "X/128" RAT_FUNC "%.4g" "-" COEFFS 0 128 0 0 0 1 /end COMPU_METHOD
/begin COMPU_METHOD CM_0270 "X/200" RAT_FUNC "%.4g" "s" COEFFS 0 200 0 0 0 1 /end COMPU_METHOD
/begin COMPU_METHOD CM_0272 "X*0.1" RAT_FUNC "%.4g" "K" COEFFS 0 1 0 0 0 0.1 /end COMPU_METHOD
/begin COMPU_METHOD CM_0276 "X/10" RAT_FUNC "%.4g" "%" COEFFS 0 10 0 0 0 1 /end COMPU_METHOD
/begin COMPU_METHOD CM_0277 "2.56/X" RAT_FUNC "%.4g" "s" COEFFS 0 0 -2.56 0 -1 0 /end COMPU_METHOD
/begin COMPU_METHOD CM_0279 "X/163840" RAT_FUNC "%.4g" "?KW" COEFFS 0 163840 0 0 0 1 /end COMPU_METHOD
/begin COMPU_METHOD CM_0280 "X/10" RAT_FUNC "%.4g" "?KW" COEFFS 0 10 0 0 0 1 /end COMPU_METHOD
/begin COMPU_METHOD CM_0281 "X/100" RAT_FUNC "%.4g" "?KW/Segment" COEFFS 0 100 0 0 0 1 /end COMPU_METHOD
/begin COMPU_METHOD CM_0282 "X/10000" RAT_FUNC "%.4g" "-" COEFFS 0 10000 0 0 0 1 /end COMPU_METHOD
/begin COMPU_METHOD CM_0291 "X/16" RAT_FUNC "%.4g" "mbar" COEFFS 0 16 0 0 0 1 /end COMPU_METHOD
/begin COMPU_METHOD CM_0296 "X/10" RAT_FUNC "%.4g" "?/seg" COEFFS 0 10 0 0 0 1 /end COMPU_METHOD
/begin COMPU_METHOD CM_0297 "X/10" RAT_FUNC "%.4g" "V" COEFFS 0 10 0 0 0 1 /end COMPU_METHOD
/begin COMPU_METHOD CM_0298 "X*8/10000" RAT_FUNC "%.4g" "ms" COEFFS 0 1250 0 0 0 1 /end COMPU_METHOD
/begin COMPU_METHOD CM_0299 "X/1000" RAT_FUNC "%.4g" "A" COEFFS 0 1000 0 0 0 1 /end COMPU_METHOD
/begin COMPU_METHOD CM_0301 "X/10" RAT_FUNC "%.4g" "s" COEFFS 0 10 0 0 0 1 /end COMPU_METHOD
/begin COMPU_METHOD CM_0306 "25.6/X" RAT_FUNC "%.4g" "s" COEFFS 0 0 -25.6 0 -1 0 /end COMPU_METHOD
/begin COMPU_METHOD CM_0307 "X/32768" RAT_FUNC "%.4g" "-" COEFFS 0 32768 0 0 0 1 /end COMPU_METHOD
/begin COMPU_METHOD CM_0312 "X/327.68" RAT_FUNC "%.4g" "%" COEFFS 0 1 0 0 0 0.003051757812 /end COMPU_METHOD
/begin COMPU_METHOD CM_0321 "(X*200)/32768" RAT_FUNC "%.4g" "1/s" COEFFS 0 4096 0 0 0 25 /end COMPU_METHOD
/begin COMPU_METHOD CM_0322 "X/10" RAT_FUNC "%.4g" "Nm" COEFFS 0 10 0 0 0 1 /end COMPU_METHOD
/begin COMPU_METHOD CM_0323 "X/10" RAT_FUNC "%.4g" "Kelvin" COEFFS 0 10 0 0 0 1 /end COMPU_METHOD
/begin COMPU_METHOD CM_0325 "X*0.04395" RAT_FUNC "%.4g" "-" COEFFS 0 1 0 0 0 0.04395 /end COMPU_METHOD
/begin COMPU_METHOD CM_0327 "-X*10" RAT_FUNC "%.4g" "Nm/s" COEFFS 0 1 0 0 0 -10 /end COMPU_METHOD
/begin COMPU_METHOD CM_0328 "X*0.1" RAT_FUNC "%.4g" "kHz" COEFFS 0 1 0 0 0 0.1 /end COMPU_METHOD
/begin COMPU_METHOD CM_0329 "X/256" RAT_FUNC "%.4g" "-/segment" COEFFS 0 256 0 0 0 1 /end COMPU_METHOD
/begin COMPU_METHOD CM_0330 "0X0000" RAT_FUNC "%.4g" "nS" COEFFS 0 1 0 0 0 1 /end COMPU_METHOD
/begin COMPU_METHOD CM_0331 "X/100" RAT_FUNC "%.4g" "-" COEFFS 0 100 0 0 0 1 /end COMPU_METHOD
/begin COMPU_METHOD CM_0332 "0X0000" RAT_FUNC "%.4g" "?KW/Segm" COEFFS 0 1 0 0 0 1 /end COMPU_METHOD
/begin COMPU_METHOD CM_0348 "X" RAT_FUNC "%.4g" "0" COEFFS 0 1 0 0 0 1 /end COMPU_METHOD
/begin COMPU_METHOD CM_0349 "X/1000" RAT_FUNC "%.4g" "kDoens" COEFFS 0 1000 0 0 0 1 /end COMPU_METHOD
/begin COMPU_METHOD CM_0374 "X/1000" RAT_FUNC "%.4g" "W/Km?" COEFFS 0 1000 0 0 0 1 /end COMPU_METHOD
/begin COMPU_METHOD CM_0375 "X/100" RAT_FUNC "%.4g" "Kelvin" COEFFS 0 100 0 0 0 1 /end COMPU_METHOD
/begin COMPU_METHOD CM_0376 "X*0.0625" RAT_FUNC "%.4g" "trmp" COEFFS 0 1 0 0 0 0.0625 /end COMPU_METHOD
/begin COMPU_METHOD CM_0379 "X*0.1" RAT_FUNC "%.4g" "%/s" COEFFS 0 1 0 0 0 0.1 /end COMPU_METHOD
/begin COMPU_METHOD CM_0380 "X*0.01666666667" RAT_FUNC "%.4g" "min" COEFFS 0 1 0 0 0 0.01666666667 /end COMPU_METHOD
/begin COMPU_METHOD CM_0382 "X*200" RAT_FUNC "%.4g" "Upm/s" COEFFS 0 1 0 0 0 200 /end COMPU_METHOD
/begin COMPU_METHOD CM_0384 "X*0.1" RAT_FUNC "%.4g" "???KW" COEFFS 0 1 0 0 0 0.1 /end COMPU_METHOD
/begin COMPU_METHOD CM_0385 "X*0.01" RAT_FUNC "%.4g" "%/V" COEFFS 0 1 0 0 0 0.01 /end COMPU_METHOD
/begin COMPU_METHOD CM_0386 "X" RAT_FUNC "%.4g" "J/(kg*K)" COEFFS 0 1 0 0 0 1 /end COMPU_METHOD
/begin COMPU_METHOD CM_0387 "X" RAT_FUNC "%.4g" "J/Kelvin" COEFFS 0 1 0 0 0 1 /end COMPU_METHOD
/begin COMPU_METHOD CM_0388 "X*0.0001" RAT_FUNC "%.4g" "m???" COEFFS 0 1 0 0 0 0.0001 /end COMPU_METHOD
/begin COMPU_METHOD CM_0389 "X*0.0001" RAT_FUNC "%.4g" "Wh/Km???km" COEFFS 0 1 0 0 0 0.0001 /end COMPU_METHOD
/begin COMPU_METHOD CM_0391 "X*0.00390625" RAT_FUNC "%.4g" "-/segment" COEFFS 0 1 0 0 0 0.00390625 /end COMPU_METHOD
/begin COMPU_METHOD CM_0429 "X/10" RAT_FUNC "%.4g" "qmm" COEFFS 0 10 0 0 0 1 /end COMPU_METHOD
/begin COMPU_METHOD CM_0430 "X/1024" RAT_FUNC "%.4g" "0p" COEFFS 0 1024 0 0 0 1 /end COMPU_METHOD
/begin COMPU_METHOD CM_0431 "X+1" RAT_FUNC "%.4g" "0" COEFFS 0 1 -1 0 0 1 /end COMPU_METHOD
/begin COMPU_METHOD CM_0441 "X/1000" RAT_FUNC "%.4g" "l" COEFFS 0 1000 0 0 0 1 /end COMPU_METHOD
/begin COMPU_METHOD CM_0442 "X/50" RAT_FUNC "%.4g" "1/s" COEFFS 0 50 0 0 0 1 /end COMPU_METHOD
/begin COMPU_METHOD CM_0443 "X+1" RAT_FUNC "%.4g" "seg" COEFFS 0 1 -1 0 0 1 /end COMPU_METHOD
/begin COMPU_METHOD CM_0444 "X/10" RAT_FUNC "%.4g" "?KW/seg" COEFFS 0 10 0 0 0 1 /end COMPU_METHOD
/begin COMPU_METHOD CM_0445 "X" RAT_FUNC "%.4g" "seg" COEFFS 0 1 0 0 0 1 /end COMPU_METHOD
/begin COMPU_METHOD CM_0446 "X/10" RAT_FUNC "%.4g" "?/5ms" COEFFS 0 10 0 0 0 1 /end COMPU_METHOD
/begin COMPU_METHOD CM_0449 "X/16" RAT_FUNC "%.4g" "K/s" COEFFS 0 16 0 0 0 1 /end COMPU_METHOD
/begin COMPU_METHOD CM_0450 "X/10000" RAT_FUNC "%.4g" "Wh/Km?km" COEFFS 0 10000 0 0 0 1 /end COMPU_METHOD
/begin COMPU_METHOD CM_0462 "X*0.12104034423828125" RAT_FUNC "%.4g" "nS" COEFFS 0 1 0 0 0 0.1210403442 /end COMPU_METHOD
/begin COMPU_METHOD CM_0463 "X*100/16384" RAT_FUNC "%.4g" "%" COEFFS 0 4096 0 0 0 25 /end COMPU_METHOD
/begin RECORD_LAYOUT RL_AXP_SW NO_AXIS_PTS_X 1 UBYTE RESERVED 2 BYTE AXIS_PTS_X 3 SWORD INDEX_INCR DIRECT /end RECORD_LAYOUT
/begin RECORD_LAYOUT RL_AXP_UB NO_AXIS_PTS_X 1 UBYTE RESERVED 2 BYTE AXIS_PTS_X 3 UBYTE INDEX_INCR DIRECT /end RECORD_LAYOUT
/begin RECORD_LAYOUT RL_BLK_F32 FNC_VALUES 1 FLOAT32_IEEE ROW_DIR DIRECT /end RECORD_LAYOUT
/begin RECORD_LAYOUT RL_BLK_SW FNC_VALUES 1 SWORD ROW_DIR DIRECT /end RECORD_LAYOUT
/begin RECORD_LAYOUT RL_CUR_SB_UB FNC_VALUES 4 UBYTE COLUMN_DIR DIRECT AXIS_PTS_X 3 SBYTE INDEX_INCR DIRECT NO_AXIS_PTS_X 1 UBYTE RESERVED 2 BYTE /end RECORD_LAYOUT
/begin RECORD_LAYOUT RL_CUR_SW_SW FNC_VALUES 4 SWORD COLUMN_DIR DIRECT AXIS_PTS_X 3 SWORD INDEX_INCR DIRECT NO_AXIS_PTS_X 1 UBYTE RESERVED 2 BYTE /end RECORD_LAYOUT
/begin RECORD_LAYOUT RL_CUR_SW_UB FNC_VALUES 4 UBYTE COLUMN_DIR DIRECT AXIS_PTS_X 3 SWORD INDEX_INCR DIRECT NO_AXIS_PTS_X 1 UBYTE RESERVED 2 BYTE /end RECORD_LAYOUT
/begin RECORD_LAYOUT RL_CUR_SW_UW FNC_VALUES 4 UWORD COLUMN_DIR DIRECT AXIS_PTS_X 3 SWORD INDEX_INCR DIRECT NO_AXIS_PTS_X 1 UBYTE RESERVED 2 BYTE /end RECORD_LAYOUT
/begin RECORD_LAYOUT RL_CUR_UB_SW FNC_VALUES 4 SWORD COLUMN_DIR DIRECT AXIS_PTS_X 3 UBYTE INDEX_INCR DIRECT NO_AXIS_PTS_X 1 UBYTE RESERVED 2 BYTE /end RECORD_LAYOUT
/begin RECORD_LAYOUT RL_CUR_UB_UB FNC_VALUES 4 UBYTE COLUMN_DIR DIRECT AXIS_PTS_X 3 UBYTE INDEX_INCR DIRECT NO_AXIS_PTS_X 1 UBYTE RESERVED 2 BYTE /end RECORD_LAYOUT
/begin RECORD_LAYOUT RL_CUR_UB_UW FNC_VALUES 4 UWORD COLUMN_DIR DIRECT AXIS_PTS_X 3 UBYTE INDEX_INCR DIRECT NO_AXIS_PTS_X 1 UBYTE RESERVED 2 BYTE /end RECORD_LAYOUT
/begin RECORD_LAYOUT RL_CUR_UW_SW FNC_VALUES 4 SWORD COLUMN_DIR DIRECT AXIS_PTS_X 3 UWORD INDEX_INCR DIRECT NO_AXIS_PTS_X 1 UBYTE RESERVED 2 BYTE /end RECORD_LAYOUT
/begin RECORD_LAYOUT RL_CUR_UW_UW FNC_VALUES 4 UWORD COLUMN_DIR DIRECT AXIS_PTS_X 3 UWORD INDEX_INCR DIRECT NO_AXIS_PTS_X 1 UBYTE RESERVED 2 BYTE /end RECORD_LAYOUT
/begin RECORD_LAYOUT RL_GRP_SW_C FNC_VALUES 1 SWORD COLUMN_DIR DIRECT /end RECORD_LAYOUT
/begin RECORD_LAYOUT RL_GRP_SW_R FNC_VALUES 1 SWORD ROW_DIR DIRECT /end RECORD_LAYOUT
/begin RECORD_LAYOUT RL_GRP_UW_R FNC_VALUES 1 UWORD ROW_DIR DIRECT /end RECORD_LAYOUT
/begin RECORD_LAYOUT RL_MAP_SW_SW_SW FNC_VALUES 5 SWORD COLUMN_DIR DIRECT AXIS_PTS_X 3 SWORD INDEX_INCR DIRECT AXIS_PTS_Y 4 SWORD INDEX_INCR DIRECT NO_AXIS_PTS_X 1 UBYTE NO_AXIS_PTS_Y 2 UBYTE /end RECORD_LAYOUT
/begin RECORD_LAYOUT RL_MAP_SW_SW_UB FNC_VALUES 5 UBYTE COLUMN_DIR DIRECT AXIS_PTS_X 3 SWORD INDEX_INCR DIRECT AXIS_PTS_Y 4 SWORD INDEX_INCR DIRECT NO_AXIS_PTS_X 1 UBYTE NO_AXIS_PTS_Y 2 UBYTE /end RECORD_LAYOUT
/begin RECORD_LAYOUT RL_MAP_SW_SW_UW FNC_VALUES 5 UWORD COLUMN_DIR DIRECT AXIS_PTS_X 3 SWORD INDEX_INCR DIRECT AXIS_PTS_Y 4 SWORD INDEX_INCR DIRECT NO_AXIS_PTS_X 1 UBYTE NO_AXIS_PTS_Y 2 UBYTE /end RECORD_LAYOUT
/begin RECORD_LAYOUT RL_MAP_SW_UW_UW FNC_VALUES 5 UWORD COLUMN_DIR DIRECT AXIS_PTS_X 3 SWORD INDEX_INCR DIRECT AXIS_PTS_Y 4 UWORD INDEX_INCR DIRECT NO_AXIS_PTS_X 1 UBYTE NO_AXIS_PTS_Y 2 UBYTE /end RECORD_LAYOUT
/begin RECORD_LAYOUT RL_MAP_UW_SW_SW FNC_VALUES 5 SWORD COLUMN_DIR DIRECT AXIS_PTS_X 3 UWORD INDEX_INCR DIRECT AXIS_PTS_Y 4 SWORD INDEX_INCR DIRECT NO_AXIS_PTS_X 1 UBYTE NO_AXIS_PTS_Y 2 UBYTE /end RECORD_LAYOUT
/begin RECORD_LAYOUT RL_MAP_UW_SW_UW FNC_VALUES 5 UWORD COLUMN_DIR DIRECT AXIS_PTS_X 3 UWORD INDEX_INCR DIRECT AXIS_PTS_Y 4 SWORD INDEX_INCR DIRECT NO_AXIS_PTS_X 1 UBYTE NO_AXIS_PTS_Y 2 UBYTE /end RECORD_LAYOUT
/begin RECORD_LAYOUT RL_VAL_F32 FNC_VALUES 1 FLOAT32_IEEE COLUMN_DIR DIRECT /end RECORD_LAYOUT
/begin RECORD_LAYOUT RL_VAL_SB FNC_VALUES 1 SBYTE COLUMN_DIR DIRECT /end RECORD_LAYOUT
/begin RECORD_LAYOUT RL_VAL_SL FNC_VALUES 1 SLONG COLUMN_DIR DIRECT /end RECORD_LAYOUT
/begin RECORD_LAYOUT RL_VAL_SW FNC_VALUES 1 SWORD COLUMN_DIR DIRECT /end RECORD_LAYOUT
/begin RECORD_LAYOUT RL_VAL_UB FNC_VALUES 1 UBYTE COLUMN_DIR DIRECT /end RECORD_LAYOUT
/begin RECORD_LAYOUT RL_VAL_UW FNC_VALUES 1 UWORD COLUMN_DIR DIRECT /end RECORD_LAYOUT
/begin GROUP G_1_Fuel___maps "1 Fuel - maps" ROOT
 /begin REF_CHARACTERISTIC KF_FR_RF_DELTA_REL_HYS KF_FR_SA_DELAY KL_FR_IANT KL_FR_MDRFSOLLPT_MAX_N KL_FR_PANT KF_FRA_PROV_B1 KF_FRA_PROV_B2 K_FRA_LOLI_X_NORM KL_FRA_LOLI_C_N KL_FRA_LOLI_C_RF KL_FRA_LOLI_S_N KL_FRA_LOLI_S_RF KL_FRA_LOLI_DEF_W_N KL_FRA_LOLI_DEF_W_RF KL_FRA_LOLI_DEF_W_BIAS KF_FRA_LOLI_MDRF_MAX KF_FRA_LOLI_LERN_GRAD KL_FRA_LOLI_MDRF_MIN /end REF_CHARACTERISTIC
/end GROUP
/begin GROUP G_1_Fuel___settings "1 Fuel - settings" ROOT
 /begin REF_CHARACTERISTIC K_FR_AQGRAD_MAX K_FR_EDK_DIFF K_FR_EINGER_HYS K_FR_EINGER_SCHW K_FR_IMAX K_FR_IMIN K_FR_MAX K_FR_MIN K_FR_MVAC_RF_MAX K_FR_PUMG_MAX K_FR_PUMG_MIN K_FR_START_DELAY K_FR_TAN_MAX K_FR_TAN_MIN K_FR_TE_C_AKF_MAX K_FR_TE_X_ML_MIN K_FR_TKSM_MAX K_FR_TKSM_MIN K_FR_TMOT_MAX K_FR_TMOT_MIN K_FR_T_ABREG K_FR_IN_CFG K_FRA_LOLI_CFG K_FRA_AQ_SOLL_ABREG K_PCTRL_TIMEOUT K_PKS_CAN_ED_T_SPERR K_PKS_CAN_ED_UB_MIN K_RF_KOR_VAN_MIN K_FRA_LOLI_ANZ K_FRA_LOLI_LERN_CFG K_FRA_LOLI_N_MIN K_FRA_TE_C_AKF_MAX K_FRA_TMOT_MIN K_RF_KOR_VAN_MAX K_FRA_LOLI_MAX K_FRA_LOLI_MIN K_FRA_LOLI_GEW_MAX K_FRA_LOLI_LERN_BIAS K_FRA_LOLI_OUT_MAX K_FRA_LOLI_OUT_MIN K_FRA_TABG_KOR_MAX K_FRA_TE_X_ML_SOLL_MAX K_FRA_LOLI_RESET_KM K_FRA_LOLI_PSAU_REL_MAX K_FRA_LOLI_EINLERN_TIME K_FRA_LOLI_LECKL_ANZ /end REF_CHARACTERISTIC
/end GROUP
/begin GROUP G_2_Lambda___exhaust_temp___maps "2 Lambda & exhaust temp - maps" ROOT
 /begin REF_CHARACTERISTIC KF_TABG_LW_STAT KL_TABG_LW_F_ETA_ZW KL_TABG_LW_F_LAM KL_TABG_LW_TAU KL_TABG_LW_VERH_WURZEL KL_TABG_PT200 KL_TABG_VKAT_F_REAK KL_SCHUFUKA_STRESS_FAK KF_SCHUFUKA_STRESS_INC_STAT KL_SCHUFUKA_STRESS_DYN_INC KL_TABG_LW_STAND_F KL_TABG_VKAT_K_TMOT KL_TABG_KAT_EXO_MAX KL_TABG_VKAT_STAND_F KL_TABG_KAT_STAND_F KL_TABG_VKAT_MC_F_TMOT /end REF_CHARACTERISTIC
/end GROUP
/begin GROUP G_2_Lambda___exhaust_temp___settings "2 Lambda & exhaust temp - settings" ROOT
 /begin REF_CHARACTERISTIC K_TABG_KAT_EXO_HYS K_TABG_KAT_EXO_MS_SCHWELLE K_TABG_KAT_EXO_ON K_TABG_KAT_T_OFFS_AB K_TABG_KAT_T_OFFS_AUF K_SCHUFUKA_CFG K_SCHUFUKA_FF_RESET K_SCHUFUKA_GMW_MAX K_SCHUFUKA_TAU K_SCHUFUKA_STRESS_STAT_MAX K_SCHUFUKA_KM_APPL_OFFS K_SCHUFUKA_KM_EINFAHR K_SCHUFUKA_KM_INTERVALL K_SCHUFUKA_KM_MAX K_SCHUFUKA_KM_MAX_NV K_SCHUFUKA_NBEGR_UP K_SCHUFUKA_NBEGR_DOWN K_SCHUFUKA_STRESS_MIN K_SCHUFUKA_STRESS_MAX K_SCHUFUKA_STRESS_NBEGR K_SCHUFUKA_STRESS_DYN_FAK K_START_RL_BEGINN K_TABG_C K_TABG_KAT_MC K_TABG_LW_AUSBLEND_OFFS K_TABG_NKAT_A K_TABG_NKAT_CFG K_TABG_NKAT_MC K_TABG_VKAT_A K_TABG_VKAT_K_V K_TABG_VKAT_MC K_TABG_VKAT_REAK_SCHWELLE cfg.diagnose cfg.status K_SCHALTER_KS_M_AUF K_SCHALTER_KS_M_ZU K_TABG_STAND_MAX K_TABG_PST_V K_TABG_TAU K_TABG_RF_KOR_TAU K_TABG_LW_LAM_TAU K_TABG_KAT_AEBG_MS K_TABG_NKAT_K_TUMG K_TABG_NKAT_K_V /end REF_CHARACTERISTIC
/end GROUP
/begin GROUP G_3_Ignition___maps "3 Ignition - maps" ROOT
 /begin REF_CHARACTERISTIC GKF_VR_VORST_BAS KL_VR_VORST_DTZ KF_TZ_DBGR_OFFS KF_TZ_GRUND KF_TZ_I KF_TZ_I_SZ KF_TZ_LL KF_TZ_MIN KF_TZ_MIN_DYN_GRAD KF_TZ_MIN_KH KF_TZ_NZ_ANZ KF_TZ_NZ_CHARGE KF_TZ_TKORR KF_TZ_VL KL_TZ_DBGR_AQ_RF_FR KL_TZ_DBGR_TRIGGER KL_TZ_MIN_TMOT KL_TZ_MIN_TMOT_KH KL_TZ_NZ_DISCHARGE KL_TZ_PHASE KL_TZ_START_N KL_TZ_START_TMOT KL_TZ_SZ_LAM_OFFS KL_TZ_SZ_START_OFFS KL_TZ_SZ_TMOT_OFFS KL_TZ_TKORR_F KF_TZ_MIN_DYN_INT_MAX KF_TZ_MIN_DYN_OFFS KF_TZ_MIN_DYN_T_SPERR KL_TZ_START_N_GTS KL_TZ_SZ_STARTOFFS_TIME /end REF_CHARACTERISTIC
/end GROUP
/begin GROUP G_3_Ignition___settings "3 Ignition - settings" ROOT
 /begin REF_CHARACTERISTIC K_VR_HYST K_VR_MESS_ED K_VR_SET_INI K_VR_SET_MAX K_VR_SET_MIN K_VR_SOLL K_VR_VORST_MAX K_VR_VORST_MIN K_TZ_MAX K_TZ_MCS K_TZ_MCS_Z_ZYL K_TZ_MCS_Z_ZYL_1 K_TZ_MCS_Z_ZYL_2 K_TZ_MCS_Z_ZYL_3 K_TZ_MCS_Z_ZYL_4 K_TZ_MCS_Z_ZYL_5 K_TZ_MCS_Z_ZYL_6 K_TZ_MCS_Z_ZYL_7 K_TZ_MCS_Z_ZYL_8 K_TZ_MCS_Z_ZYL_9 K_TZ_NZ_N_MAX K_TZ_MIN_DYN_TMOT K_TZ_MIN_DYN_CFG K_TZ_DBGR_TMOT K_TZ_DN_ZWB K_TZ_RF_ZWB K_TZ_ZWB_B1 K_TZ_ZWB_B2 K_TZ_ZWB_B3 K_TZ_KH_RF_ZWB K_TZ_KH_ZWB_B1 K_TZ_KH_ZWB_B2 K_TZ_KH_ZWB_B3 K_TZ_UB_ERSATZ K_TZ_SZ_CONTROL K_TZ_SZ_MCS K_TZ_SZ_MAX K_TZ_I_BEGR K_TZ_NZ_ANZ_ST K_TZ_NZ_CHARGE_ST K_TZ_NZ_DISCHARGE_ST K_TZ_GRAD_TAU K_TZ_DBGR_CFG K_TZ_DBGR_AQ_RF_TAU K_TZ_DBGR_ANZ_SEG K_TZ_DBGR_AUFREG K_TZ_DLY K_TZ_SZ_AUSS_DELAY K_TZ_SZ_SA_TIME_MAX K_TZ_I_SA_DELAY K_TZ_MIN_DYN_T_HYST K_TZ_MIN_STAT_GRAD K_TZ_MIN_KATS_T_HYST /end REF_CHARACTERISTIC
/end GROUP
/begin GROUP G_4_Knock___maps "4 Knock - maps" ROOT
 /begin REF_CHARACTERISTIC KF_KA_F KF_KA_OFFS KF_KA_OFFS_VL KF_KA_T_KOMP KL_KA_F_VL KL_KA_PUMG_VL KL_KA_RF_MIN KL_KA_TP_TAU KL_KR_DTZ_WICHT KL_KR_DTZ_MIN KL_KR_ETL_FAK_FBS_KOR KL_KA_ADAPT_MIN_KF KF_KA_ADAPT_MAX_KF KL_KA_KR_DTZ_MIN KL_KA_BTKORR GKL_KR_DTZ_MAX GKL_KR_DTZ_AVG_MAX GKL_KR_RF_MIN GKL_KR_FBS_MAX_1 GKL_KR_FBS_MAX_2 GKL_KR_FBS_RATIO GKL_KR_FBS_RATIO31_MAX /end REF_CHARACTERISTIC
/end GROUP
/begin GROUP G_4_Knock___settings "4 Knock - settings" ROOT
 /begin REF_CHARACTERISTIC K_KR_APPL_DTZ_ZYL1 K_KR_APPL_DTZ_ZYL10 K_KR_APPL_DTZ_ZYL2 K_KR_APPL_DTZ_ZYL3 K_KR_APPL_DTZ_ZYL4 K_KR_APPL_DTZ_ZYL5 K_KR_APPL_DTZ_ZYL6 K_KR_APPL_DTZ_ZYL7 K_KR_APPL_DTZ_ZYL8 K_KR_APPL_DTZ_ZYL9 K_KR_APPL_NUM_ZYL1 K_KR_APPL_NUM_ZYL10 K_KR_APPL_NUM_ZYL2 K_KR_APPL_NUM_ZYL3 K_KR_APPL_NUM_ZYL4 K_KR_APPL_NUM_ZYL5 K_KR_APPL_NUM_ZYL6 K_KR_APPL_NUM_ZYL7 K_KR_APPL_NUM_ZYL8 K_KR_APPL_NUM_ZYL9 K_KR_KLIPPING_MAX K_KA_TZ_ROZ_RES K_KA_ADAPT_MIN_ROZ K_KA_ADAPT_MIN_ROZ_S K_KA_ADAPT_MAX_ROZ K_KA_TMOT_MIN K_KR_TMOT_MIN K_KA_TZ_KF_AEB_SPAET K_KA_TZ_KF_AEB_FRUEH K_KA_B_N_HYST K_KA_B_RF_HYST K_KR_CFG K_KR_ETL_ADA_CFG K_KR_FB_START_1 K_KR_FB_START_2 K_KR_FB_START_3 K_KR_FB_LEN_1 K_KR_FB_LEN_2 K_KR_FB_LEN_3 K_KR_FB_START_PRE K_KR_FB_LEN_PRE K_KR_FENSTER_CFG K_KR_APPL_CFG K_KR_ETL_TIME K_KR_APPL_PER K_KR_ETL_DEL K_KR_ETL_SEG_TAU K_KR_FBS_AVG_GRAD K_KR_ETL_E_MIN K_KR_ETL_E_MAX K_KR_ETL_E_MIN_S K_KR_ETL_E_MAX_S K_KR_ETL_E_HI K_KR_ETL_RF_MIN K_KR_ETL_RF_MAX K_KR_ETL_N_MIN K_KR_ETL_N_MAX K_KR_ETL_TZ_DELTA_MIN K_KR_ETL_TZ_DELTA_MAX K_KR_ETL_VAN_MIN K_KR_ETL_VAN_MAX K_KR_ETL_LAM_MIN K_KR_ETL_LAM_MAX K_KR_ETL_ION_Q_MIN K_KR_ANZ_ASP_HOLD K_KA_FILT_KK_KA K_KA_FILT_KK_KKA K_KA_FILT_KL K_KA_FILT_KL_S K_KA_TZ_MIN_HYST K_KA_TZ_KS K_KA_DTZ_MAX K_KA_KF_ADAPT_MAX K_KA_EINGR_T_SPERR K_KR_ETL_TMOT_MIN K_KA_ADA_INST_CFG K_KA_ROZ_RESET_CFG K_KA_KF_RESET_CFG K_KA_KF_NORM_CFG K_KA_FST_NACHTANK_CFG K_KA_KLIPPING_MAX K_KA_TIME_ROZ K_KA_MIN_VERBR_ROZ K_KA_AQ_GRAD_SEGM_CNT K_KA_AQ_GRAD_MAX K_KA_NGRAD_TAU K_KA_KS_CFG /end REF_CHARACTERISTIC
/end GROUP
/begin GROUP G_6_Torque___throttle___maps "6 Torque & throttle - maps" ROOT
 /begin REF_CHARACTERISTIC KF_AQ_IST_RF_TAU_NEG KF_AQ_IST_RF_TAU_POS KL_AQ_ABS_DK KL_AQ_ABS_DK_ABW_MAX KL_AQ_ABS_LLS KL_AQ_ABS_LLS_ABW_MAX KL_AQ_MAX KF_AR_MD_FAKTOR KF_EGAS_SOLL_AQ KF_EGAS_SOLL_AQ_NOTL KF_EGAS_SOLL_AQ_START KF_EGAS_SOLL_WL_GEW_F KF_EGAS_SOLL_WL_OFFS KL_EGAS_N_AQ_START_NEG KL_EGAS_N_AQ_START_POS KF_MD_KUS_KR KF_MD_KUS_TV KL_MD_KUS_KR_FAK KL_MD_KUS_KUPP_MIN KL_MD_KUS_TN_FAK KL_MD_KUS_TV_FAK KF_LAZ_TAU KF_MD_DELTA_DP_ON KF_MD_DYN_FIL_RES KF_MD_DYN_FIL_RES_FAK KF_MD_ETA_LA KF_MD_FAHRER_KOMFORT KF_MD_FAHRER_KOMFORT_DKG KF_MD_FAHRER_MUEDE KF_MD_FAHRER_MUEDE_DKG KF_MD_FAHRER_MUNTER KF_MD_FAHRER_NORMAL KF_MD_FAHRER_NORMAL_DKG KF_MD_FAHRER_PST KF_MD_FAHRER_SPORT KF_MD_FAHRER_SPORT_DKG KF_MD_FAK_GRAD_DP_B2 KF_MD_FAK_GRAD_DP_B3 KF_MD_FR_WICHT KF_MD_GRAD_DP_B1 KF_MD_GRAD_DP_B2 KF_MD_GRAD_DP_B3 KF_MD_GRAD_DP_LLMKS KF_MD_GRAD_LSD_B1 KF_MD_GRAD_LSD_B2 KF_MD_GRAD_LSD_B3 KF_MD_GRAD_LSD_LLMKS KF_MD_IND_LW_VERLUSTE KF_MD_IND_MIN_SCHUB KF_MD_IND_OPT KF_MD_IND_REIB KF_MD_KKOS_KORR KF_MD_KOMFORT_DP KF_MD_KOMFORT_LSD KF_MD_KUPP_GRENZ_DP_O KF_MD_KUPP_GRENZ_DP_U_OFFS KF_MD_NBEGR_KR KF_MD_NBEGR_TN KF_MD_NBEGR_TV KF_MD_POLYNOM_A KF_MD_POLYNOM_B KF_MD_SMG_BEGR_OFF KF_MD_SPORT_DP KF_MD_VBEGR_KR KF_MD_VBEGR_TN KF_MD_VBEGR_TV KF_MD_VERBR_FZG KF_MD_WUNSCH_REL_KOMFORT KF_MD_WUNSCH_REL_NORMAL KF_MD_WUNSCH_REL_SPORT KF_MD_ZW_OFFSET KF_MD_ZW_OPT KL_MD_ABTRIEB_NULL_KOMFORT KL_MD_ABTRIEB_NULL_SPORT KL_MD_ABTRIEB_SCHLEPP_MAX KL_MD_BEGR_NOISE KL_MD_ETA_LA KL_MD_FAHRER_FAK_KOMFORT KL_MD_FAHRER_FAK_KOMFORT_DKG KL_MD_FAHRER_FAK_NORMAL KL_MD_FAHRER_FAK_SPORT KL_MD_FAK_DP_B1 KL_MD_FAK_DP_B3 KL_MD_FAK_LSD_ANFF KL_MD_FAK_LSD_B2 KL_MD_FAK_LSD_B3 KL_MD_HYP_DN KL_MD_HYP_VERH_KRAFTS KL_MD_IDX_FP KL_MD_IND_REIB_ABREG KL_MD_IND_REIB_OFFSET KL_MD_IND_RF_MIN_OFFS KL_MD_KKOS_DELAY_OFF KL_MD_KKOS_DELAY_ON KL_MD_KKOS_RES_MAX KL_MD_KKOS_ZH_RES_MAX KL_MD_KR_DTZ_DOWN KL_MD_KR_DTZ_UP KL_MD_KUPP_MAX_CAN KL_MD_KUPP_MAX_GANG KL_MD_KUPP_MIN KL_MD_KUPP_MIN_ASC KL_MD_LRW_FAK KL_MD_MAX_FAK_POWER KL_MD_MAX_N_OFFS KL_MD_MAX_TMOT KL_MD_NBEGR_ABSTAND KL_MD_NBEGR_GANG KL_MD_NBEGR_KR_FAK KL_MD_NBEGR_KR_FAK_SK KL_MD_NBEGR_N_MAX KL_MD_NBEGR_RAMPE KL_MD_NBEGR_TN_FAK KL_MD_NBEGR_TN_FAK_SK KL_MD_NBEGR_TV_FAK KL_MD_RAD_BREMSE_TAU KL_MD_RAD_STEIG_BREMS KL_MD_RES_MIN KL_MD_RF_MAX_ROH KL_MD_RF_TABG_VO_KOR KL_MD_SCHW_TAU KL_MD_TAU_START_OFF KL_MD_VBEGR_ABSTAND KL_MD_VBEGR_RAMPE KL_MD_VBEGR_TAU KL_MD_VBEGR_TN_FAK KL_MD_VBEGR_TN_FAK_SK KL_MD_VBEGR_TV_FAK KL_MD_ZW_LA KL_PWG_BLS_BRP KL_PWG_BLS_V KL_PWG_MAX_DIFF KL_PWG_SOLL KL_PWG_SOLL_NOTLAUF KF_MD_ZW_TMOT_ML_FAK KF_MD_ZW_OPT_FAK_OFFS_RG KF_MD_IND_LW_FAK_OFFS_RG KF_MD_ZW_OPT_OFFS_KH KF_MD_IND_LW_OFFS_KH KF_MD_POLYNOM_A_KH KL_MD_ZW_OPT_OFFS_RG KL_MD_IND_LW_OFFS_RG KF_MD_IND_MIN_SCHUB_DKG KF_MD_START_OFFSET KF_MD_START_OFFSET_MSA KF_MD_VERBR_FZG_DKG KL_MD_IND_REIB_FAK KL_EGAS_STM_DK_NP_TMOT KL_EGAS_WDK_TMOT_OFFS KL_EGAS_SOLL_AQ_ABS_SW KF_EGAS_N_AQ_ML_NEG KL_MD_VBEGR_KR_FAK KF_MD_DKG_BEGR_NOTLAUF KF_MD_RES_LOLI_FAK KL_MD_KUPP_MAX KL_MD_RF_SOLL_MAX_SK KF_MD_LRW KL_MD_RAD_STEIGUNG KL_MD_RAD_STEIG_FAK KL_MD_FAK_DP_B2 KL_MD_FAK_LSD_B1 KL_MD_VBEGR_KR_FAK_SK KF_MD_FAK_GRAD_DP_B1 KF_MD_KUPP_GRENZ_LSD_O KF_MD_KUPP_GRENZ_LSD_U_OFFS KF_MD_TAU_LSD_B3 KL_MD_ABTRIEB_SCHLEPP_FAK KL_MD_LRW_RES KL_AQ_IST_RF_TAU KL_EGAS_SOLL_AQ_MSA_STOPP KL_MD_RF_TABG_KOR KF_MD_KH_DP KF_MD_SPORT_LSD KL_EGAS_SOLL_AQ_START_GTS KL_MD_TAU_START_OFF_GTS KL_MD_RAD_BREMSE KF_MD_RF_TABG_KOR KL_MD_RES_LOLI /end REF_CHARACTERISTIC
/end GROUP
/begin GROUP G_6_Torque___throttle___settings "6 Torque & throttle - settings" ROOT
 /begin REF_CHARACTERISTIC K_AR_CFG K_AR_FAK_KOMFORT K_AR_FAK_SPORT K_AR_KORR_P_1 K_AR_KORR_P_2 K_AR_KORR_P_3 K_AR_KORR_P_4 K_AR_KORR_P_5 K_AR_KORR_P_6 K_AR_KORR_P_7 K_AR_KORR_P_N K_AR_KORR_P_R K_AR_MD_MAX K_AR_MD_MIN K_AR_N_DIF_BESCHL_1 K_AR_N_DIF_BESCHL_2 K_AR_N_DIF_REF_MAX K_AR_N_DIF_REF_MIN K_AR_N_DIF_VERZ_1 K_AR_N_DIF_VERZ_2 K_AR_N_FIL_0 K_AR_N_FIL_1 K_AR_N_FIL_2 K_AR_N_FIL_3 K_AR_N_FIL_4 K_AR_N_MAX K_AR_N_MIN K_AR_T_MAX K_AR_T_PAS_DELAY K_AT_CFG K_EGAS_CAN_ED_TSPERR K_EGAS_CAN_ED_UB_MIN K_EGAS_CFG_DK K_EGAS_SOLL_BOWDEN_LLS_F K_EGAS_SOLL_BOWDEN_MIN K_EGAS_STM_DK_FT_TMOT K_EGAS_STM_DK_GT_MAX K_EGAS_STM_DK_GT_MIN K_EGAS_STM_DK_GT_TIME K_EGAS_STM_DK_GT_TMOT K_EGAS_STM_DK_GT_UB K_EGAS_STM_DK_MODE_HW K_EGAS_STM_DK_NP_NMAX K_EGAS_STM_DK_NP_PMAX K_EGAS_STM_DK_NP_PMIN K_EGAS_STM_DK_NP_UB K_EGAS_STM_DK_N_FAST K_EGAS_STM_DK_N_KL50 K_EGAS_STM_DK_WAIT_DIS K_EGAS_T_KL50 K_EGAS_WDK_A0_ANZAHL K_EGAS_WDK_A0_DELTA_MAX K_EGAS_WDK_A0_DFT K_EGAS_WDK_A0_KONST K_EGAS_WDK_A0_MAX K_EGAS_WDK_A0_MIN K_EGAS_WDK_A0_OFF_B1 K_EGAS_WDK_A0_OFF_B2 K_EGAS_WDK_A0_TIME K_EGAS_WDK_MAX K_EGAS_WDK_MIN K_EGAS_WDK_NORM K_J_AC K_J_FZG_DKG_1 K_J_FZG_DKG_2 K_J_FZG_DKG_3 K_J_FZG_DKG_4 K_J_FZG_DKG_5 K_J_FZG_DKG_6 K_J_FZG_DKG_7 K_J_FZG_DKG_N K_J_FZG_DKG_R K_J_FZG_HSG_1 K_J_FZG_HSG_2 K_J_FZG_HSG_3 K_J_FZG_HSG_4 K_J_FZG_HSG_5 K_J_FZG_HSG_6 K_J_FZG_HSG_7 K_J_FZG_HSG_N K_J_FZG_HSG_R K_J_FZG_SMG_1 K_J_FZG_SMG_2 K_J_FZG_SMG_3 K_J_FZG_SMG_4 K_J_FZG_SMG_5 K_J_FZG_SMG_6 K_J_FZG_SMG_7 K_J_FZG_SMG_N K_J_FZG_SMG_R K_J_MOTOR K_MD_KUS_BEGR_TAU1_AUS K_MD_KUS_BEGR_TAU1_EIN K_MD_KUS_BEGR_TAU_AUS K_MD_KUS_BEGR_TAU_EIN K_MD_KUS_PID_A1 K_LAZ_ANZ_SEG K_MD_ANFF_V_ON K_MD_ASC_AUSBLEND_HYS K_MD_ASC_ENABLE K_MD_ASC_M_AEBEGR K_MD_ASC_M_RAMPE K_MD_ASC_T_WAIT K_MD_CAN_BEGR_ST K_MD_CAN_ETA_ZW_OFF K_MD_CFG_DYN_FIL K_MD_CFG_FW_BLS K_MD_CFG_MCS K_MD_CFG_TZ_EINGR K_MD_CFG_ZW_BEZUG K_MD_DYN_FIL_RES_TAU K_MD_ETA_ZW_MIN K_MD_GRAD_DP_OKS K_MD_GRAD_LSD_OKS K_MD_GRAD_SA K_MD_GRAD_SA_CUF K_MD_GRAD_SA_VMA K_MD_HYS_RICHTUNG K_MD_HYS_SA K_MD_HYS_SA_TZ K_MD_KKOS_DYN_ST K_MD_KKOS_ELU_TMOT_MAX K_MD_KKOS_ELU_TMOT_MAX_HYS K_MD_KKOS_N K_MD_KKOS_N_MAX K_MD_KKOS_N_MAX_HYS K_MD_KKOS_TMOT_MAX K_MD_KKOS_TMOT_MAX_HYS K_MD_MAX_FAK K_MD_MAX_POWER_NEG K_MD_MAX_POWER_POS K_MD_MSR_ENABLE K_MD_MSR_MAX K_MD_MSR_M_RAMPE K_MD_MSR_T_WAIT K_MD_NOISE_CFG K_MD_NOISE_PWG_SOLL K_MD_NOISE_RAMPE K_MD_NOISE_T K_MD_NOISE_V_MAX1 K_MD_NOISE_V_MAX2 K_MD_NOISE_V_MAX3 K_MD_NOISE_V_MIN1 K_MD_NOISE_V_MIN2 K_MD_NOISE_V_MIN3 K_MD_N_ABTRIEB_MIN K_MD_N_PVMAX K_MD_PULS_AMP K_MD_PULS_EIN K_MD_PULS_OFFS K_MD_PULS_RAMPE K_MD_PULS_T K_MD_TAU_FW_DPFIL K_MD_VERBR_MAX K_PWG1_A0_INITINC K_PWG1_A0_MAX K_PWG1_INC_A0_ADAPT K_PWG_A0_TAU K_PWG_A0_ZAEHLER K_PWG_AB_RAMPE K_PWG_BLS_N_MAX_FSP K_PWG_BLS_PWG_MAX K_PWG_BLS_PWG_MIN K_PWG_BLS_V_MAX K_PWG_BLS_V_MIN K_PWG_BLS_V_VORNE_MAX K_PWG_KD K_PWG_SOLL_2GANG_AUF K_PWG_SOLL_2GANG_FAK K_PWG_SOLL_2GANG_MAX K_PWG_SOLL_2GANG_VMAX K_EGAS_STM_DK_NP_TMOT_MIN K_EGAS_SOLL_START_MD_RAMP K_EGAS_SOLL_AQ_TI_OFF K_EGAS_SOLL_MCS_DK K_EGAS_SOLL_MCS_LLS K_EGAS_SOLL_GT_OFF K_MD_BLS_N_VMA K_MD_BLS_GANG_VMA K_MD_BLS_DN_VMA K_MD_BLS_BRP_VMA K_MD_BLS_N_VMA_DKG K_MD_BLS_GANG_VMA_DKG K_MD_BLS_DN_VMA_DKG K_MD_BLS_FW_REL_VMA_DKG K_MD_BLS_BRP K_MD_BLS_FW_REL K_MD_BLS_N K_MD_LRW_RES_V K_MD_LRW_RES_V_HYS K_MD_LRW_TAU K_MD_LRW_RES_DELTA K_MD_RAD_STEIGUNG_TAU K_MD_KKOS_V_VL K_MD_KKOS_V_VL_AUS K_MD_KKOS_V_BA K_MD_KKOS_TIME_START K_MD_KKOS_START K_MD_KKOS_TAU_ON K_MD_KKOS_TAU_OFF K_MD_KKOS_ZH_TMOT K_MD_KKOS_ZH_TUMG K_MD_KKOS_ZH_RES_T_MAX K_MD_KKOS_RES_T_MAX K_MD_KKOS_MDRV K_MD_ANFF_PWG_ON K_MD_ANFF_PWG_OFF K_EGAS_STM_LLS_DK_HYS K_MD_ZYL_MASK_B1 K_MD_ZYL_MASK_B2 K_MD_KKOS_RES_RAMPE_ON K_MD_KKOS_RES_RAMPE_OFF K_MD_KKOS_ZH_RES_RAMPE K_MD_KKOS_TIME_BA_VL K_MD_KKOS_TIME_WH K_MD_KKOS_MAX K_MD_NBEGR_MD_HYS K_MD_VBEGR_MD_HYS K_AQ_DK0_LLS_AQ_SCHW K_AT_MD_BEGR_A1 K_AT_N_MAX K_AT_TRAMPIN_SOLL_START K_EGAS_CFG_AQ_SOLL K_EGAS_CFG_LLS K_EGAS_CFG_MCS_SOLL K_EGAS_CFG_WDK K_EGAS_SOLL_AQ_KH_N_MAX K_EGAS_SOLL_LLS_DELTA K_EGAS_SOLL_LLS_DK_SCHW K_EGAS_SOLL_LLS_OFF K_EGAS_STM_LLS_DK_SCHW K_EGAS_STM_LLS_T_ADAPT K_EGAS_STM_NOINIT_FAIL K_EGAS_STM_NOINIT_SK K_EGAS_STM_T_ADAPT K_ISS_MAX_DELTA K_MD_BEZUG_HYS K_MD_BEZUG_RAMPE K_MD_CFG_FGR_EINGR K_MD_CFG_IDX K_MD_CFG_RG_KORR K_MD_ETA_EINGRIFF K_MD_ETA_GETR K_MD_ETA_KH_TAU_LL K_MD_ETA_LA_KOMP_MAX K_MD_ETA_LA_TAU K_MD_ETA_STAT_TAU K_MD_ETA_STAT_TAU_LL K_MD_GEN_FREISCHALT K_MD_GEN_MAX K_MD_HYP_VERH_NO_KRAFTS K_MD_HYP_VERH_START K_MD_IND_WUNSCH_TZ_MCS K_MD_KKOS_CAN_MAX K_MD_KKOS_MIN K_MD_KUPP_BEGR_MCS K_MD_NBEGR_N_DELTA K_MD_N_PEMAX K_MD_RESERVE_TST K_MD_RES_KATH_FAK K_MD_RES_ZW_RAMPE_NEG K_MD_RES_ZW_RAMPE_POS K_MD_RF_SOLL_BS_CFG K_MD_RG_RF_FAKTOR K_MD_TAU_FW_GRAD K_MD_TZ_SOLL_MCS K_MD_VBEGR_A1 K_MD_VBEGR_HYS_AUS K_PWG1_A0_MIN K_PWG1_NORM K_PWG1_NORM_HS K_PWG_BLS_CFG K_PWG_BLS_HS_VERZ K_PWG_TAU cfg.canmess cfg.canstand cfg.hil cfg.ipm cfg.motortyp K_EGAS_AQ_SOLL_GRAD_TAU K_MD_ETA_T_SPERR K_MD_RES_MIN K_MD_RES_MIN_HYS K_MD_TAU_IND_TZ_GRAD K_MD_NBEGR_A1 K_MD_KKOS_CAN_PASSIV K_MD_TZ_EINGR_T_SPERR K_MD_ANFF_V_OFF K_MD_CFG_RES K_MD_RES_EINGR_MIN K_MD_NOISE_RAMPE_AUS K_MD_RF_SOLL_SEK_CFG K_MD_KUPP_GANG_RAMPE K_MD_RFMAX_RAMPE K_EGAS_SOLL_AQ_GRAD_MAX K_EGAS_SOLL_START_MD_RAMP_GTS K_MD_TAU_START_OFF_MSA_HS K_MD_TAU_START_OFF_MSA_DKG K_AQ_DK0_DK_IST_SCHW K_AQ_LLS_ABW_T_MIN K_AQ_DK_ABW_T_MIN K_MD_RES_T_SPERR K_MD_RES_T_SPERR_GTS /end REF_CHARACTERISTIC
/end GROUP
/begin GROUP G_7_Idle___maps "7 Idle - maps" ROOT
 /begin REF_CHARACTERISTIC KF_LLR_MD_I_NEG_MKS KF_LLR_MD_I_NEG_OKS KF_LLR_MD_I_POS_MKS KF_LLR_MD_I_POS_OKS KL_LLR_D_FAK_TOEL KL_LLR_MD_RES_TMOT KL_LLR_MD_TZ_MKS_KH KL_LLR_MD_TZ_OKS KL_LLR_N_SOLL_KH3 KL_LLR_N_SOLL_TMOT KL_LLR_N_SOLL_TOEL_OFF KF_LLR_N_SOLL_KH_OFF KL_LLR_MD_TZ_MKS KL_LLR_MD_TZ_OKS_KH KL_LLR_N_SOLL_ABSE_ KL_LLR_N_SOLL_KH_FAK_KS /end REF_CHARACTERISTIC
/end GROUP
/end MODULE
/end PROJECT
