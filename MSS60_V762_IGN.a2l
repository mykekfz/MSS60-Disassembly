ASAP2_VERSION 1 60
/begin PROJECT MSS60_V762_IGN "MSS60 (S65) V762 IGN CPU - production calibration 7848136 (V762.01-B500.02)"
/begin HEADER "Calibration description. Measurements: V530 RAM names transferred to V762 addresses (confidence in each long identifier). Status tag in every long identifier: verified (checked against the code) / A2L-ref (placed from the V530 A2L) / EST (estimated) / unassigned (unidentified)." VERSION "V762-RE-04112026" /end HEADER
/begin MODULE IGN "MSS60 V762 IGN"
/begin MOD_COMMON "" BYTE_ORDER MSB_FIRST ALIGNMENT_BYTE 1 ALIGNMENT_WORD 2 ALIGNMENT_LONG 4 /end MOD_COMMON
/begin MEASUREMENT ed_fil_auss_abg_mult.fehler_aufrufe_nv "Gesamtzahl der Fehleraufrufe [RAM name from V530, interpolated]" UBYTE M_FORMULA_0003 0 0 0 255 ECU_ADDRESS 0x3F99BD /end MEASUREMENT
/begin MEASUREMENT ed_fil_auss_abg_mult.filter_max_nv "Maximaler Fehlerfilterwert [RAM name from V530, interpolated]" UBYTE M_FORMULA_0003 0 0 0 255 ECU_ADDRESS 0x3F99BC /end MEASUREMENT
/begin MEASUREMENT ed_fil_dkg_eingr.art_aktuell_nv "Fehlerart und Statusbits [RAM name from V530, interpolated]" UWORD NO_COMPU_METHOD 0 0 0 65535 ECU_ADDRESS 0x3F99C6 FORMAT "%.4g" /end MEASUREMENT
/begin MEASUREMENT ed_fil_dkg_eingr.fehler_aufrufe_nv "Gesamtzahl der Fehleraufrufe [RAM name from V530, interpolated]" UBYTE M_FORMULA_0003 0 0 0 255 ECU_ADDRESS 0x3F99C9 /end MEASUREMENT
/begin MEASUREMENT ed_fil_dkg_eingr.filter_max_nv "Maximaler Fehlerfilterwert [RAM name from V530, interpolated]" UBYTE M_FORMULA_0003 0 0 0 255 ECU_ADDRESS 0x3F99C8 /end MEASUREMENT
/begin MEASUREMENT ed_fil_dkg_eingr.filter_nv "Filterwert vor und nach Eintrag [RAM name from V530, interpolated]" UBYTE M_FORMULA_0003 0 0 0 255 ECU_ADDRESS 0x3F99C4 /end MEASUREMENT
/begin MEASUREMENT ed_fil_dkg_eingr.zyklus_filter_nv "Vorwaertsfilter zur Fehlerzustandsbestaetigung [RAM name from V530, interpolated]" UBYTE M_FORMULA_0003 0 0 0 255 ECU_ADDRESS 0x3F99C5 /end MEASUREMENT
/begin MEASUREMENT ed_fil_sc_pks.filter_nv "Filterwert vor und nach Eintrag [RAM name from V530, interpolated]" UBYTE M_FORMULA_0003 0 0 0 255 ECU_ADDRESS 0x3F99CA /end MEASUREMENT
/begin MEASUREMENT ed_fil_sc_pks.zyklus_filter_nv "Vorwaertsfilter zur Fehlerzustandsbestaetigung [RAM name from V530, interpolated]" UBYTE M_FORMULA_0003 0 0 0 255 ECU_ADDRESS 0x3F99CB /end MEASUREMENT
/begin MEASUREMENT ed_fil_tan_obd_b1.art_aktuell_nv "Fehlerart und Statusbits [RAM name from V530, interpolated]" UWORD NO_COMPU_METHOD 0 0 0 65535 ECU_ADDRESS 0x3F99C0 FORMAT "%.4g" /end MEASUREMENT
/begin MEASUREMENT ed_fil_tan_obd_b1.fehler_aufrufe_nv "Gesamtzahl der Fehleraufrufe [RAM name from V530, interpolated]" UBYTE M_FORMULA_0003 0 0 0 255 ECU_ADDRESS 0x3F99C3 /end MEASUREMENT
/begin MEASUREMENT ed_fil_tan_obd_b1.filter_max_nv "Maximaler Fehlerfilterwert [RAM name from V530, interpolated]" UBYTE M_FORMULA_0003 0 0 0 255 ECU_ADDRESS 0x3F99C2 /end MEASUREMENT
/begin MEASUREMENT ed_fil_tan_obd_b1.filter_nv "Filterwert vor und nach Eintrag [RAM name from V530, interpolated]" UBYTE M_FORMULA_0003 0 0 0 255 ECU_ADDRESS 0x3F99BE /end MEASUREMENT
/begin MEASUREMENT ed_fil_tan_obd_b1.zyklus_filter_nv "Vorwaertsfilter zur Fehlerzustandsbestaetigung [RAM name from V530, interpolated]" UBYTE M_FORMULA_0003 0 0 0 255 ECU_ADDRESS 0x3F99BF /end MEASUREMENT
/begin MEASUREMENT ed_fil_sc_pks.fehler_aufrufe_nv "Gesamtzahl der Fehleraufrufe [RAM name from V530, interpolated]" UBYTE M_FORMULA_0003 0 0 0 255 ECU_ADDRESS 0x3F99CF /end MEASUREMENT
/begin MEASUREMENT ed_fil_sc_pks.filter_max_nv "Maximaler Fehlerfilterwert [RAM name from V530, interpolated]" UBYTE M_FORMULA_0003 0 0 0 255 ECU_ADDRESS 0x3F99CE /end MEASUREMENT
/begin MEASUREMENT ed_fil_zoelp1.filter_nv "Filterwert vor und nach Eintrag [RAM name from V530, interpolated]" UBYTE M_FORMULA_0003 0 0 0 255 ECU_ADDRESS 0x3F99D0 /end MEASUREMENT
/begin MEASUREMENT ed_fil_zoelp1.zyklus_filter_nv "Vorwaertsfilter zur Fehlerzustandsbestaetigung [RAM name from V530, interpolated]" UBYTE M_FORMULA_0003 0 0 0 255 ECU_ADDRESS 0x3F99D1 /end MEASUREMENT
/begin MEASUREMENT ed_fil_e2_ign.filter_nv "Filterwert vor und nach Eintrag [RAM name from V530, interpolated]" UBYTE M_FORMULA_0003 0 0 0 255 ECU_ADDRESS 0x3F99E2 /end MEASUREMENT
/begin MEASUREMENT ed_fil_e2_ign.zyklus_filter_nv "Vorwaertsfilter zur Fehlerzustandsbestaetigung [RAM name from V530, interpolated]" UBYTE M_FORMULA_0003 0 0 0 255 ECU_ADDRESS 0x3F99E3 /end MEASUREMENT
/begin MEASUREMENT ed_fil_sg_ign.art_aktuell_nv "Fehlerart und Statusbits [RAM name from V530, interpolated]" UWORD NO_COMPU_METHOD 0 0 0 65535 ECU_ADDRESS 0x3F99DE FORMAT "%.4g" /end MEASUREMENT
/begin MEASUREMENT ed_fil_sg_ign.fehler_aufrufe_nv "Gesamtzahl der Fehleraufrufe [RAM name from V530, interpolated]" UBYTE M_FORMULA_0003 0 0 0 255 ECU_ADDRESS 0x3F99E1 /end MEASUREMENT
/begin MEASUREMENT ed_fil_sg_ign.filter_max_nv "Maximaler Fehlerfilterwert [RAM name from V530, interpolated]" UBYTE M_FORMULA_0003 0 0 0 255 ECU_ADDRESS 0x3F99E0 /end MEASUREMENT
/begin MEASUREMENT ed_fil_sg_ign.filter_nv "Filterwert vor und nach Eintrag [RAM name from V530, interpolated]" UBYTE M_FORMULA_0003 0 0 0 255 ECU_ADDRESS 0x3F99DC /end MEASUREMENT
/begin MEASUREMENT ed_fil_sg_ign.zyklus_filter_nv "Vorwaertsfilter zur Fehlerzustandsbestaetigung [RAM name from V530, interpolated]" UBYTE M_FORMULA_0003 0 0 0 255 ECU_ADDRESS 0x3F99DD /end MEASUREMENT
/begin MEASUREMENT ed_fil_zoelp1.fehler_aufrufe_nv "Gesamtzahl der Fehleraufrufe [RAM name from V530, interpolated]" UBYTE M_FORMULA_0003 0 0 0 255 ECU_ADDRESS 0x3F99D5 /end MEASUREMENT
/begin MEASUREMENT ed_fil_zoelp1.filter_max_nv "Maximaler Fehlerfilterwert [RAM name from V530, interpolated]" UBYTE M_FORMULA_0003 0 0 0 255 ECU_ADDRESS 0x3F99D4 /end MEASUREMENT
/begin MEASUREMENT ed_fil_zoelp2.art_aktuell_nv "Fehlerart und Statusbits [RAM name from V530, interpolated]" UWORD NO_COMPU_METHOD 0 0 0 65535 ECU_ADDRESS 0x3F99D8 FORMAT "%.4g" /end MEASUREMENT
/begin MEASUREMENT ed_fil_zoelp2.fehler_aufrufe_nv "Gesamtzahl der Fehleraufrufe [RAM name from V530, interpolated]" UBYTE M_FORMULA_0003 0 0 0 255 ECU_ADDRESS 0x3F99DB /end MEASUREMENT
/begin MEASUREMENT ed_fil_zoelp2.filter_max_nv "Maximaler Fehlerfilterwert [RAM name from V530, interpolated]" UBYTE M_FORMULA_0003 0 0 0 255 ECU_ADDRESS 0x3F99DA /end MEASUREMENT
/begin MEASUREMENT ed_fil_zoelp2.filter_nv "Filterwert vor und nach Eintrag [RAM name from V530, interpolated]" UBYTE M_FORMULA_0003 0 0 0 255 ECU_ADDRESS 0x3F99D6 /end MEASUREMENT
/begin MEASUREMENT ed_fil_zoelp2.zyklus_filter_nv "Vorwaertsfilter zur Fehlerzustandsbestaetigung [RAM name from V530, interpolated]" UBYTE M_FORMULA_0003 0 0 0 255 ECU_ADDRESS 0x3F99D7 /end MEASUREMENT
/begin MEASUREMENT ed_fil_bls_plau.filter_nv "Filterwert vor und nach Eintrag [RAM name from V530, interpolated]" UBYTE M_FORMULA_0003 0 0 0 255 ECU_ADDRESS 0x3F99E8 /end MEASUREMENT
/begin MEASUREMENT ed_fil_bls_plau.zyklus_filter_nv "Vorwaertsfilter zur Fehlerzustandsbestaetigung [RAM name from V530, interpolated]" UBYTE M_FORMULA_0003 0 0 0 255 ECU_ADDRESS 0x3F99E9 /end MEASUREMENT
/begin MEASUREMENT ed_fil_e2_ign.fehler_aufrufe_nv "Gesamtzahl der Fehleraufrufe [RAM name from V530, interpolated]" UBYTE M_FORMULA_0003 0 0 0 255 ECU_ADDRESS 0x3F99E7 /end MEASUREMENT
/begin MEASUREMENT ed_fil_e2_ign.filter_max_nv "Maximaler Fehlerfilterwert [RAM name from V530, interpolated]" UBYTE M_FORMULA_0003 0 0 0 255 ECU_ADDRESS 0x3F99E6 /end MEASUREMENT
/begin MEASUREMENT ed_fil_bls_plau.fehler_aufrufe_nv "Gesamtzahl der Fehleraufrufe [RAM name from V530, interpolated]" UBYTE M_FORMULA_0003 0 0 0 255 ECU_ADDRESS 0x3F99ED /end MEASUREMENT
/begin MEASUREMENT ed_fil_bls_plau.filter_max_nv "Maximaler Fehlerfilterwert [RAM name from V530, interpolated]" UBYTE M_FORMULA_0003 0 0 0 255 ECU_ADDRESS 0x3F99EC /end MEASUREMENT
/begin MEASUREMENT ed_fil_llr_diag.art_aktuell_nv "Fehlerart und Statusbits [RAM name from V530, interpolated]" UWORD NO_COMPU_METHOD 0 0 0 65535 ECU_ADDRESS 0x3F99F6 FORMAT "%.4g" /end MEASUREMENT
/begin MEASUREMENT ed_fil_llr_diag.fehler_aufrufe_nv "Gesamtzahl der Fehleraufrufe [RAM name from V530, interpolated]" UBYTE M_FORMULA_0003 0 0 0 255 ECU_ADDRESS 0x3F99F9 /end MEASUREMENT
/begin MEASUREMENT ed_fil_llr_diag.filter_max_nv "Maximaler Fehlerfilterwert [RAM name from V530, interpolated]" UBYTE M_FORMULA_0003 0 0 0 255 ECU_ADDRESS 0x3F99F8 /end MEASUREMENT
/begin MEASUREMENT ed_fil_llr_diag.filter_nv "Filterwert vor und nach Eintrag [RAM name from V530, interpolated]" UBYTE M_FORMULA_0003 0 0 0 255 ECU_ADDRESS 0x3F99F4 /end MEASUREMENT
/begin MEASUREMENT ed_fil_llr_diag.zyklus_filter_nv "Vorwaertsfilter zur Fehlerzustandsbestaetigung [RAM name from V530, interpolated]" UBYTE M_FORMULA_0003 0 0 0 255 ECU_ADDRESS 0x3F99F5 /end MEASUREMENT
/begin MEASUREMENT ed_fil_sk_manager_ign.art_aktuell_nv "Fehlerart und Statusbits [RAM name from V530, interpolated]" UWORD NO_COMPU_METHOD 0 0 0 65535 ECU_ADDRESS 0x3F99F0 FORMAT "%.4g" /end MEASUREMENT
/begin MEASUREMENT ed_fil_sk_manager_ign.fehler_aufrufe_nv "Gesamtzahl der Fehleraufrufe [RAM name from V530, interpolated]" UBYTE M_FORMULA_0003 0 0 0 255 ECU_ADDRESS 0x3F99F3 /end MEASUREMENT
/begin MEASUREMENT ed_fil_sk_manager_ign.filter_max_nv "Maximaler Fehlerfilterwert [RAM name from V530, interpolated]" UBYTE M_FORMULA_0003 0 0 0 255 ECU_ADDRESS 0x3F99F2 /end MEASUREMENT
/begin MEASUREMENT ed_fil_sk_manager_ign.filter_nv "Filterwert vor und nach Eintrag [RAM name from V530, interpolated]" UBYTE M_FORMULA_0003 0 0 0 255 ECU_ADDRESS 0x3F99EE /end MEASUREMENT
/begin MEASUREMENT ed_fil_sk_manager_ign.zyklus_filter_nv "Vorwaertsfilter zur Fehlerzustandsbestaetigung [RAM name from V530, interpolated]" UBYTE M_FORMULA_0003 0 0 0 255 ECU_ADDRESS 0x3F99EF /end MEASUREMENT
/begin MEASUREMENT ed_fil_thermostat.filter_nv "Filterwert vor und nach Eintrag [RAM name from V530, interpolated]" UBYTE M_FORMULA_0003 0 0 0 255 ECU_ADDRESS 0x3F99FA /end MEASUREMENT
/begin MEASUREMENT ed_fil_thermostat.zyklus_filter_nv "Vorwaertsfilter zur Fehlerzustandsbestaetigung [RAM name from V530, interpolated]" UBYTE M_FORMULA_0003 0 0 0 255 ECU_ADDRESS 0x3F99FB /end MEASUREMENT
/begin MEASUREMENT ed_fil_dk1_zust.art_aktuell_nv "Fehlerart und Statusbits [RAM name from V530, interpolated]" UWORD NO_COMPU_METHOD 0 0 0 65535 ECU_ADDRESS 0x3F9A08 FORMAT "%.4g" /end MEASUREMENT
/begin MEASUREMENT ed_fil_dk1_zust.fehler_aufrufe_nv "Gesamtzahl der Fehleraufrufe [RAM name from V530, interpolated]" UBYTE M_FORMULA_0003 0 0 0 255 ECU_ADDRESS 0x3F9A0B /end MEASUREMENT
/begin MEASUREMENT ed_fil_dk1_zust.filter_max_nv "Maximaler Fehlerfilterwert [RAM name from V530, interpolated]" UBYTE M_FORMULA_0003 0 0 0 255 ECU_ADDRESS 0x3F9A0A /end MEASUREMENT
/begin MEASUREMENT ed_fil_dk1_zust.filter_nv "Filterwert vor und nach Eintrag [RAM name from V530, interpolated]" UBYTE M_FORMULA_0003 0 0 0 255 ECU_ADDRESS 0x3F9A06 /end MEASUREMENT
/begin MEASUREMENT ed_fil_dk1_zust.zyklus_filter_nv "Vorwaertsfilter zur Fehlerzustandsbestaetigung [RAM name from V530, interpolated]" UBYTE M_FORMULA_0003 0 0 0 255 ECU_ADDRESS 0x3F9A07 /end MEASUREMENT
/begin MEASUREMENT ed_fil_dk2_zust.art_aktuell_nv "Fehlerart und Statusbits [RAM name from V530, interpolated]" UWORD NO_COMPU_METHOD 0 0 0 65535 ECU_ADDRESS 0x3F9A0E FORMAT "%.4g" /end MEASUREMENT
/begin MEASUREMENT ed_fil_dk2_zust.fehler_aufrufe_nv "Gesamtzahl der Fehleraufrufe [RAM name from V530, interpolated]" UBYTE M_FORMULA_0003 0 0 0 255 ECU_ADDRESS 0x3F9A11 /end MEASUREMENT
/begin MEASUREMENT ed_fil_dk2_zust.filter_max_nv "Maximaler Fehlerfilterwert [RAM name from V530, interpolated]" UBYTE M_FORMULA_0003 0 0 0 255 ECU_ADDRESS 0x3F9A10 /end MEASUREMENT
/begin MEASUREMENT ed_fil_dk2_zust.filter_nv "Filterwert vor und nach Eintrag [RAM name from V530, interpolated]" UBYTE M_FORMULA_0003 0 0 0 255 ECU_ADDRESS 0x3F9A0C /end MEASUREMENT
/begin MEASUREMENT ed_fil_dk2_zust.zyklus_filter_nv "Vorwaertsfilter zur Fehlerzustandsbestaetigung [RAM name from V530, interpolated]" UBYTE M_FORMULA_0003 0 0 0 255 ECU_ADDRESS 0x3F9A0D /end MEASUREMENT
/begin MEASUREMENT ed_fil_fgr_abwurf.art_aktuell_nv "Fehlerart und Statusbits [RAM name from V530, interpolated]" UWORD NO_COMPU_METHOD 0 0 0 65535 ECU_ADDRESS 0x3F9A14 FORMAT "%.4g" /end MEASUREMENT
/begin MEASUREMENT ed_fil_fgr_abwurf.fehler_aufrufe_nv "Gesamtzahl der Fehleraufrufe [RAM name from V530, interpolated]" UBYTE M_FORMULA_0003 0 0 0 255 ECU_ADDRESS 0x3F9A17 /end MEASUREMENT
/begin MEASUREMENT ed_fil_fgr_abwurf.filter_max_nv "Maximaler Fehlerfilterwert [RAM name from V530, interpolated]" UBYTE M_FORMULA_0003 0 0 0 255 ECU_ADDRESS 0x3F9A16 /end MEASUREMENT
/begin MEASUREMENT ed_fil_fgr_abwurf.filter_nv "Filterwert vor und nach Eintrag [RAM name from V530, interpolated]" UBYTE M_FORMULA_0003 0 0 0 255 ECU_ADDRESS 0x3F9A12 /end MEASUREMENT
/begin MEASUREMENT ed_fil_fgr_abwurf.zyklus_filter_nv "Vorwaertsfilter zur Fehlerzustandsbestaetigung [RAM name from V530, interpolated]" UBYTE M_FORMULA_0003 0 0 0 255 ECU_ADDRESS 0x3F9A13 /end MEASUREMENT
/begin MEASUREMENT ed_fil_pwg_bls.filter_nv "Filterwert vor und nach Eintrag [RAM name from V530, interpolated]" UBYTE M_FORMULA_0003 0 0 0 255 ECU_ADDRESS 0x3F9A18 /end MEASUREMENT
/begin MEASUREMENT ed_fil_pwg_bls.zyklus_filter_nv "Vorwaertsfilter zur Fehlerzustandsbestaetigung [RAM name from V530, interpolated]" UBYTE M_FORMULA_0003 0 0 0 255 ECU_ADDRESS 0x3F9A19 /end MEASUREMENT
/begin MEASUREMENT ed_fil_tan_obd_b2.art_aktuell_nv "Fehlerart und Statusbits [RAM name from V530, interpolated]" UWORD NO_COMPU_METHOD 0 0 0 65535 ECU_ADDRESS 0x3F9A02 FORMAT "%.4g" /end MEASUREMENT
/begin MEASUREMENT ed_fil_tan_obd_b2.fehler_aufrufe_nv "Gesamtzahl der Fehleraufrufe [RAM name from V530, interpolated]" UBYTE M_FORMULA_0003 0 0 0 255 ECU_ADDRESS 0x3F9A05 /end MEASUREMENT
/begin MEASUREMENT ed_fil_tan_obd_b2.filter_max_nv "Maximaler Fehlerfilterwert [RAM name from V530, interpolated]" UBYTE M_FORMULA_0003 0 0 0 255 ECU_ADDRESS 0x3F9A04 /end MEASUREMENT
/begin MEASUREMENT ed_fil_tan_obd_b2.filter_nv "Filterwert vor und nach Eintrag [RAM name from V530, interpolated]" UBYTE M_FORMULA_0003 0 0 0 255 ECU_ADDRESS 0x3F9A00 /end MEASUREMENT
/begin MEASUREMENT ed_fil_tan_obd_b2.zyklus_filter_nv "Vorwaertsfilter zur Fehlerzustandsbestaetigung [RAM name from V530, interpolated]" UBYTE M_FORMULA_0003 0 0 0 255 ECU_ADDRESS 0x3F9A01 /end MEASUREMENT
/begin MEASUREMENT ed_fil_thermostat.fehler_aufrufe_nv "Gesamtzahl der Fehleraufrufe [RAM name from V530, interpolated]" UBYTE M_FORMULA_0003 0 0 0 255 ECU_ADDRESS 0x3F99FF /end MEASUREMENT
/begin MEASUREMENT ed_fil_thermostat.filter_max_nv "Maximaler Fehlerfilterwert [RAM name from V530, interpolated]" UBYTE M_FORMULA_0003 0 0 0 255 ECU_ADDRESS 0x3F99FE /end MEASUREMENT
/begin MEASUREMENT ed_fil_pwg_bls.fehler_aufrufe_nv "Gesamtzahl der Fehleraufrufe [RAM name from V530, interpolated]" UBYTE M_FORMULA_0003 0 0 0 255 ECU_ADDRESS 0x3F9A1D /end MEASUREMENT
/begin MEASUREMENT ed_fil_pwg_bls.filter_max_nv "Maximaler Fehlerfilterwert [RAM name from V530, interpolated]" UBYTE M_FORMULA_0003 0 0 0 255 ECU_ADDRESS 0x3F9A1C /end MEASUREMENT
/begin MEASUREMENT ed_fil_start_rl.filter_nv "Filterwert vor und nach Eintrag [RAM name from V530, interpolated]" UBYTE M_FORMULA_0003 0 0 0 255 ECU_ADDRESS 0x3F9A1E /end MEASUREMENT
/begin MEASUREMENT ed_fil_start_rl.zyklus_filter_nv "Vorwaertsfilter zur Fehlerzustandsbestaetigung [RAM name from V530, interpolated]" UBYTE M_FORMULA_0003 0 0 0 255 ECU_ADDRESS 0x3F9A1F /end MEASUREMENT
/begin MEASUREMENT ed_fil_afz_hs.art_aktuell_nv "Fehlerart und Statusbits [RAM name from V530, interpolated]" UWORD NO_COMPU_METHOD 0 0 0 65535 ECU_ADDRESS 0x3F9A26 FORMAT "%.4g" /end MEASUREMENT
/begin MEASUREMENT ed_fil_afz_hs.fehler_aufrufe_nv "Gesamtzahl der Fehleraufrufe [RAM name from V530, interpolated]" UBYTE M_FORMULA_0003 0 0 0 255 ECU_ADDRESS 0x3F9A29 /end MEASUREMENT
/begin MEASUREMENT ed_fil_afz_hs.filter_max_nv "Maximaler Fehlerfilterwert [RAM name from V530, interpolated]" UBYTE M_FORMULA_0003 0 0 0 255 ECU_ADDRESS 0x3F9A28 /end MEASUREMENT
/begin MEASUREMENT ed_fil_afz_hs.filter_nv "Filterwert vor und nach Eintrag [RAM name from V530, interpolated]" UBYTE M_FORMULA_0003 0 0 0 255 ECU_ADDRESS 0x3F9A24 /end MEASUREMENT
/begin MEASUREMENT ed_fil_afz_hs.zyklus_filter_nv "Vorwaertsfilter zur Fehlerzustandsbestaetigung [RAM name from V530, interpolated]" UBYTE M_FORMULA_0003 0 0 0 255 ECU_ADDRESS 0x3F9A25 /end MEASUREMENT
/begin MEASUREMENT ed_fil_n_getr_ein_hs.filter_nv "Filterwert vor und nach Eintrag [RAM name from V530, interpolated]" UBYTE M_FORMULA_0003 0 0 0 255 ECU_ADDRESS 0x3F9A2A /end MEASUREMENT
/begin MEASUREMENT ed_fil_n_getr_ein_hs.zyklus_filter_nv "Vorwaertsfilter zur Fehlerzustandsbestaetigung [RAM name from V530, interpolated]" UBYTE M_FORMULA_0003 0 0 0 255 ECU_ADDRESS 0x3F9A2B /end MEASUREMENT
/begin MEASUREMENT ed_fil_start_rl.fehler_aufrufe_nv "Gesamtzahl der Fehleraufrufe [RAM name from V530, interpolated]" UBYTE M_FORMULA_0003 0 0 0 255 ECU_ADDRESS 0x3F9A23 /end MEASUREMENT
/begin MEASUREMENT ed_fil_start_rl.filter_max_nv "Maximaler Fehlerfilterwert [RAM name from V530, interpolated]" UBYTE M_FORMULA_0003 0 0 0 255 ECU_ADDRESS 0x3F9A22 /end MEASUREMENT
/begin MEASUREMENT ed_fil_n_getr_ein_hs.fehler_aufrufe_nv "Gesamtzahl der Fehleraufrufe [RAM name from V530, interpolated]" UBYTE M_FORMULA_0003 0 0 0 255 ECU_ADDRESS 0x3F9A2F /end MEASUREMENT
/begin MEASUREMENT ed_fil_n_getr_ein_hs.filter_max_nv "Maximaler Fehlerfilterwert [RAM name from V530, interpolated]" UBYTE M_FORMULA_0003 0 0 0 255 ECU_ADDRESS 0x3F9A2E /end MEASUREMENT
/begin MEASUREMENT ed_fil_servo_i.art_aktuell_nv "Fehlerart und Statusbits [RAM name from V530, interpolated]" UWORD NO_COMPU_METHOD 0 0 0 65535 ECU_ADDRESS 0x3F9A32 FORMAT "%.4g" /end MEASUREMENT
/begin MEASUREMENT ed_fil_servo_i.fehler_aufrufe_nv "Gesamtzahl der Fehleraufrufe [RAM name from V530, interpolated]" UBYTE M_FORMULA_0003 0 0 0 255 ECU_ADDRESS 0x3F9A35 /end MEASUREMENT
/begin MEASUREMENT ed_fil_servo_i.filter_max_nv "Maximaler Fehlerfilterwert [RAM name from V530, interpolated]" UBYTE M_FORMULA_0003 0 0 0 255 ECU_ADDRESS 0x3F9A34 /end MEASUREMENT
/begin MEASUREMENT ed_fil_servo_i.filter_nv "Filterwert vor und nach Eintrag [RAM name from V530, interpolated]" UBYTE M_FORMULA_0003 0 0 0 255 ECU_ADDRESS 0x3F9A30 /end MEASUREMENT
/begin MEASUREMENT ed_fil_servo_i.zyklus_filter_nv "Vorwaertsfilter zur Fehlerzustandsbestaetigung [RAM name from V530, interpolated]" UBYTE M_FORMULA_0003 0 0 0 255 ECU_ADDRESS 0x3F9A31 /end MEASUREMENT
/begin MEASUREMENT ed_fil_servo_v.filter_nv "Filterwert vor und nach Eintrag [RAM name from V530, interpolated]" UBYTE M_FORMULA_0003 0 0 0 255 ECU_ADDRESS 0x3F9A36 /end MEASUREMENT
/begin MEASUREMENT ed_fil_servo_v.zyklus_filter_nv "Vorwaertsfilter zur Fehlerzustandsbestaetigung [RAM name from V530, interpolated]" UBYTE M_FORMULA_0003 0 0 0 255 ECU_ADDRESS 0x3F9A37 /end MEASUREMENT
/begin MEASUREMENT ed_fil_llr_diag_css.art_aktuell_nv "Fehlerart und Statusbits [RAM name from V530, interpolated]" UWORD NO_COMPU_METHOD 0 0 0 65535 ECU_ADDRESS 0x3F9A44 FORMAT "%.4g" /end MEASUREMENT
/begin MEASUREMENT ed_fil_llr_diag_css.fehler_aufrufe_nv "Gesamtzahl der Fehleraufrufe [RAM name from V530, interpolated]" UBYTE M_FORMULA_0003 0 0 0 255 ECU_ADDRESS 0x3F9A47 /end MEASUREMENT
/begin MEASUREMENT ed_fil_llr_diag_css.filter_max_nv "Maximaler Fehlerfilterwert [RAM name from V530, interpolated]" UBYTE M_FORMULA_0003 0 0 0 255 ECU_ADDRESS 0x3F9A46 /end MEASUREMENT
/begin MEASUREMENT ed_fil_llr_diag_css.filter_nv "Filterwert vor und nach Eintrag [RAM name from V530, interpolated]" UBYTE M_FORMULA_0003 0 0 0 255 ECU_ADDRESS 0x3F9A42 /end MEASUREMENT
/begin MEASUREMENT ed_fil_llr_diag_css.zyklus_filter_nv "Vorwaertsfilter zur Fehlerzustandsbestaetigung [RAM name from V530, interpolated]" UBYTE M_FORMULA_0003 0 0 0 255 ECU_ADDRESS 0x3F9A43 /end MEASUREMENT
/begin MEASUREMENT ed_fil_servo_v.fehler_aufrufe_nv "Gesamtzahl der Fehleraufrufe [RAM name from V530, interpolated]" UBYTE M_FORMULA_0003 0 0 0 255 ECU_ADDRESS 0x3F9A3B /end MEASUREMENT
/begin MEASUREMENT ed_fil_servo_v.filter_max_nv "Maximaler Fehlerfilterwert [RAM name from V530, interpolated]" UBYTE M_FORMULA_0003 0 0 0 255 ECU_ADDRESS 0x3F9A3A /end MEASUREMENT
/begin MEASUREMENT ed_fil_tmot_obd_high.filter_nv "Filterwert vor und nach Eintrag [RAM name from V530, interpolated]" UBYTE M_FORMULA_0003 0 0 0 255 ECU_ADDRESS 0x3F9A48 /end MEASUREMENT
/begin MEASUREMENT ed_fil_tmot_obd_high.zyklus_filter_nv "Vorwaertsfilter zur Fehlerzustandsbestaetigung [RAM name from V530, interpolated]" UBYTE M_FORMULA_0003 0 0 0 255 ECU_ADDRESS 0x3F9A49 /end MEASUREMENT
/begin MEASUREMENT ed_fil_tumg.art_aktuell_nv "Fehlerart und Statusbits [RAM name from V530, interpolated]" UWORD NO_COMPU_METHOD 0 0 0 65535 ECU_ADDRESS 0x3F9A3E FORMAT "%.4g" /end MEASUREMENT
/begin MEASUREMENT ed_fil_tumg.fehler_aufrufe_nv "Gesamtzahl der Fehleraufrufe [RAM name from V530, interpolated]" UBYTE M_FORMULA_0003 0 0 0 255 ECU_ADDRESS 0x3F9A41 /end MEASUREMENT
/begin MEASUREMENT ed_fil_tumg.filter_max_nv "Maximaler Fehlerfilterwert [RAM name from V530, interpolated]" UBYTE M_FORMULA_0003 0 0 0 255 ECU_ADDRESS 0x3F9A40 /end MEASUREMENT
/begin MEASUREMENT ed_fil_tumg.filter_nv "Filterwert vor und nach Eintrag [RAM name from V530, interpolated]" UBYTE M_FORMULA_0003 0 0 0 255 ECU_ADDRESS 0x3F9A3C /end MEASUREMENT
/begin MEASUREMENT ed_fil_tumg.zyklus_filter_nv "Vorwaertsfilter zur Fehlerzustandsbestaetigung [RAM name from V530, interpolated]" UBYTE M_FORMULA_0003 0 0 0 255 ECU_ADDRESS 0x3F9A3D /end MEASUREMENT
/begin MEASUREMENT egas_wdk_a0_b1 "WDK-Nullpunkt [RAM name from V530, interpolated]" SWORD M_FORMULA_0250 0 0 -160 159.9951172 ECU_ADDRESS 0x3FA326 /end MEASUREMENT
/begin MEASUREMENT egas_wdk_a0_b2 "WDK-Nullpunkt [RAM name from V530, interpolated]" SWORD M_FORMULA_0250 0 0 -160 159.9951172 ECU_ADDRESS 0x3FA328 /end MEASUREMENT
/begin MEASUREMENT tabg_lw_stand_nv_b2 "Offset zu TUMG beim Abstellen [RAM name from V530, interpolated]" SWORD M_FORMULA_0074 0 0 -3276.8 3276.7 ECU_ADDRESS 0x3FA32C /end MEASUREMENT
/begin MEASUREMENT tabg_vkat_stand_nv_b2 "Offset zu TUMG beim Abstellen [RAM name from V530, interpolated]" SWORD M_FORMULA_0074 0 0 -3276.8 3276.7 ECU_ADDRESS 0x3FA330 /end MEASUREMENT
/begin MEASUREMENT tabg_nkat_stand_nv_b2 "Offset zu TUMG beim Abstellen [RAM name from V530, interpolated]" SWORD M_FORMULA_0074 0 0 -3276.8 3276.7 ECU_ADDRESS 0x3FA334 /end MEASUREMENT
/begin MEASUREMENT tabg_nkat_max_nv_b2 "Maximale Nachkattemperatur [RAM name from V530, interpolated]" SWORD M_FORMULA_0023 0 0 -3550 3003.5 ECU_ADDRESS 0x3FA338 /end MEASUREMENT
/begin MEASUREMENT auss_erk_nv_zyl10 "Zaehler Zuendaussetzer. [RAM name from V530, interpolated]" UWORD M_FORMULA_0010 0 0 0 65535 ECU_ADDRESS 0x3FA368 /end MEASUREMENT
/begin MEASUREMENT auss_erk_nv_zyl2 "Zaehler Zuendaussetzer. [RAM name from V530, interpolated]" UWORD M_FORMULA_0010 0 0 0 65535 ECU_ADDRESS 0x3FA358 /end MEASUREMENT
/begin MEASUREMENT auss_erk_nv_zyl3 "Zaehler Zuendaussetzer. [RAM name from V530, interpolated]" UWORD M_FORMULA_0010 0 0 0 65535 ECU_ADDRESS 0x3FA35A /end MEASUREMENT
/begin MEASUREMENT auss_erk_nv_zyl4 "Zaehler Zuendaussetzer. [RAM name from V530, interpolated]" UWORD M_FORMULA_0010 0 0 0 65535 ECU_ADDRESS 0x3FA35C /end MEASUREMENT
/begin MEASUREMENT auss_erk_nv_zyl5 "Zaehler Zuendaussetzer. [RAM name from V530, interpolated]" UWORD M_FORMULA_0010 0 0 0 65535 ECU_ADDRESS 0x3FA35E /end MEASUREMENT
/begin MEASUREMENT auss_erk_nv_zyl6 "Zaehler Zuendaussetzer. [RAM name from V530, interpolated]" UWORD M_FORMULA_0010 0 0 0 65535 ECU_ADDRESS 0x3FA360 /end MEASUREMENT
/begin MEASUREMENT auss_erk_nv_zyl7 "Zaehler Zuendaussetzer. [RAM name from V530, interpolated]" UWORD M_FORMULA_0010 0 0 0 65535 ECU_ADDRESS 0x3FA362 /end MEASUREMENT
/begin MEASUREMENT auss_erk_nv_zyl8 "Zaehler Zuendaussetzer. [RAM name from V530, interpolated]" UWORD M_FORMULA_0010 0 0 0 65535 ECU_ADDRESS 0x3FA364 /end MEASUREMENT
/begin MEASUREMENT auss_erk_nv_zyl9 "Zaehler Zuendaussetzer. [RAM name from V530, interpolated]" UWORD M_FORMULA_0010 0 0 0 65535 ECU_ADDRESS 0x3FA366 /end MEASUREMENT
/begin MEASUREMENT auss_erk_ti_nv_zyl10 "Zaehler Verbrennungsaussetzererkennung. [RAM name from V530, interpolated]" UWORD M_FORMULA_0010 0 0 0 65535 ECU_ADDRESS 0x3FA37C /end MEASUREMENT
/begin MEASUREMENT auss_erk_ti_nv_zyl2 "Zaehler Verbrennungsaussetzererkennung. [RAM name from V530, interpolated]" UWORD M_FORMULA_0010 0 0 0 65535 ECU_ADDRESS 0x3FA36C /end MEASUREMENT
/begin MEASUREMENT auss_erk_ti_nv_zyl3 "Zaehler Verbrennungsaussetzererkennung. [RAM name from V530, interpolated]" UWORD M_FORMULA_0010 0 0 0 65535 ECU_ADDRESS 0x3FA36E /end MEASUREMENT
/begin MEASUREMENT auss_erk_ti_nv_zyl4 "Zaehler Verbrennungsaussetzererkennung. [RAM name from V530, interpolated]" UWORD M_FORMULA_0010 0 0 0 65535 ECU_ADDRESS 0x3FA370 /end MEASUREMENT
/begin MEASUREMENT auss_erk_ti_nv_zyl5 "Zaehler Verbrennungsaussetzererkennung. [RAM name from V530, interpolated]" UWORD M_FORMULA_0010 0 0 0 65535 ECU_ADDRESS 0x3FA372 /end MEASUREMENT
/begin MEASUREMENT auss_erk_ti_nv_zyl6 "Zaehler Verbrennungsaussetzererkennung. [RAM name from V530, interpolated]" UWORD M_FORMULA_0010 0 0 0 65535 ECU_ADDRESS 0x3FA374 /end MEASUREMENT
/begin MEASUREMENT auss_erk_ti_nv_zyl7 "Zaehler Verbrennungsaussetzererkennung. [RAM name from V530, interpolated]" UWORD M_FORMULA_0010 0 0 0 65535 ECU_ADDRESS 0x3FA376 /end MEASUREMENT
/begin MEASUREMENT auss_erk_ti_nv_zyl8 "Zaehler Verbrennungsaussetzererkennung. [RAM name from V530, interpolated]" UWORD M_FORMULA_0010 0 0 0 65535 ECU_ADDRESS 0x3FA378 /end MEASUREMENT
/begin MEASUREMENT auss_erk_ti_nv_zyl9 "Zaehler Verbrennungsaussetzererkennung. [RAM name from V530, interpolated]" UWORD M_FORMULA_0010 0 0 0 65535 ECU_ADDRESS 0x3FA37A /end MEASUREMENT
/begin MEASUREMENT auss_ff.tz "Zuendwinkel [RAM name from V530, interpolated]" SWORD M_FORMULA_0102 0 0 -3276.8 3276.7 ECU_ADDRESS 0x3FA86E /end MEASUREMENT
/begin MEASUREMENT pwg_bls_ff.sk_md_begr_nv "SK-Begrenzungsstufe [RAM name from V530, interpolated]" UBYTE NO_COMPU_METHOD 0 0 0 255 ECU_ADDRESS 0x3FA8BE FORMAT "%.4g" /end MEASUREMENT
/begin MEASUREMENT pwg_bls_ff.n_nv "Drehzahl [RAM name from V530, interpolated]" SWORD M_FORMULA_0006 0 0 -32768 32767 ECU_ADDRESS 0x3FA8C6 /end MEASUREMENT
/begin MEASUREMENT pwg_bls_ff.pwg_filter_nv "Gefilterter Messwert der Pedalwerterfassung [RAM name from V530, interpolated]" UWORD M_FORMULA_0448 0 0 0 102.3984375 ECU_ADDRESS 0x3FA8C2 /end MEASUREMENT
/begin MEASUREMENT pwg_bls_ff.rf_m_nv "relative Fuellung Mittel zwischen Bank 1 und 2 [RAM name from V530, interpolated]" SWORD M_FORMULA_0007 0 0 -3.2768 3.2767 ECU_ADDRESS 0x3FA8C4 /end MEASUREMENT
/begin MEASUREMENT ccp_checksum "CCP ChkSum [RAM name from V530, interpolated]" UWORD M_FORMULA_0010 0 0 0 65535 ECU_ADDRESS 0x3FB1A4 /end MEASUREMENT
/begin MEASUREMENT aq_abs_dk_b1 "Abs. Oeffnungsquerschnitt Drosselklappen [RAM name from V530, interpolated]" UWORD M_FORMULA_0143 0 0 0 6553.5 ECU_ADDRESS 0x3FBC00 /end MEASUREMENT
/begin MEASUREMENT aq_abs_dk_b2 "Abs. Oeffnungsquerschnitt Drosselklappen [RAM name from V530, interpolated]" UWORD M_FORMULA_0143 0 0 0 6553.5 ECU_ADDRESS 0x3FBC02 /end MEASUREMENT
/begin MEASUREMENT aq_abs_lls_b1 "Abs. Oeffnungsquerschnitt Leerlaufsystem [RAM name from V530, interpolated]" UWORD M_FORMULA_0143 0 0 0 6553.5 ECU_ADDRESS 0x3FBC04 /end MEASUREMENT
/begin MEASUREMENT aq_abs_lls_b2 "Abs. Oeffnungsquerschnitt Leerlaufsystem [RAM name from V530, interpolated]" UWORD M_FORMULA_0143 0 0 0 6553.5 ECU_ADDRESS 0x3FBC06 /end MEASUREMENT
/begin MEASUREMENT aq_abs_roh_b2 "Abs.roh Oeffnungsquerschnitt ohne sek. Einfluesse [RAM name from V530, interpolated]" UWORD M_FORMULA_0143 0 0 0 6553.5 ECU_ADDRESS 0x3FBBFE /end MEASUREMENT
/begin MEASUREMENT aq_rf_roh_inv_b2 "Fuellung aus Inv. Ipol.nicht gefiltert und keine korrektur [RAM name from V530, interpolated]" SWORD M_FORMULA_0007 0 0 -3.2768 3.2767 ECU_ADDRESS 0x3FBC1E /end MEASUREMENT
/begin MEASUREMENT aq_rf_inv_b2 "Istfuellung Korrigiert mit FR+FRA+EGAS_AQ_WL [RAM name from V530, interpolated]" SWORD M_FORMULA_0007 0 0 -3.2768 3.2767 ECU_ADDRESS 0x3FBC22 /end MEASUREMENT
/begin MEASUREMENT auss_erk_ns "Status Nebenschluss Zuendkerze. [RAM name from V530, interpolated]" UWORD NO_COMPU_METHOD 0 0 0 65535 ECU_ADDRESS 0x3FBD28 FORMAT "%.4g" /end MEASUREMENT
/begin MEASUREMENT auss_erk_ns_zyl1 "Status Nebenschluss Zuendkerze 1. [RAM name from V530, interpolated]" UWORD NO_COMPU_METHOD 0 0 0 65535 ECU_ADDRESS 0x3FBD28 FORMAT "%.4g" /end MEASUREMENT
/begin MEASUREMENT auss_erk_ns_zyl10 "Status Nebenschluss Zuendkerze 10. [RAM name from V530, interpolated]" UWORD NO_COMPU_METHOD 0 0 0 65535 ECU_ADDRESS 0x3FBD28 FORMAT "%.4g" /end MEASUREMENT
/begin MEASUREMENT auss_erk_ns_zyl2 "Status Nebenschluss Zuendkerze 2. [RAM name from V530, interpolated]" UWORD NO_COMPU_METHOD 0 0 0 65535 ECU_ADDRESS 0x3FBD28 FORMAT "%.4g" /end MEASUREMENT
/begin MEASUREMENT auss_erk_ns_zyl3 "Status Nebenschluss Zuendkerze 3. [RAM name from V530, interpolated]" UWORD NO_COMPU_METHOD 0 0 0 65535 ECU_ADDRESS 0x3FBD28 FORMAT "%.4g" /end MEASUREMENT
/begin MEASUREMENT auss_erk_ns_zyl4 "Status Nebenschluss Zuendkerze 4. [RAM name from V530, interpolated]" UWORD NO_COMPU_METHOD 0 0 0 65535 ECU_ADDRESS 0x3FBD28 FORMAT "%.4g" /end MEASUREMENT
/begin MEASUREMENT auss_erk_ns_zyl5 "Status Nebenschluss Zuendkerze 5. [RAM name from V530, interpolated]" UWORD NO_COMPU_METHOD 0 0 0 65535 ECU_ADDRESS 0x3FBD28 FORMAT "%.4g" /end MEASUREMENT
/begin MEASUREMENT auss_erk_ns_zyl6 "Status Nebenschluss Zuendkerze 6. [RAM name from V530, interpolated]" UWORD NO_COMPU_METHOD 0 0 0 65535 ECU_ADDRESS 0x3FBD28 FORMAT "%.4g" /end MEASUREMENT
/begin MEASUREMENT auss_erk_ns_zyl7 "Status Nebenschluss Zuendkerze 7. [RAM name from V530, interpolated]" UWORD NO_COMPU_METHOD 0 0 0 65535 ECU_ADDRESS 0x3FBD28 FORMAT "%.4g" /end MEASUREMENT
/begin MEASUREMENT auss_erk_ns_zyl8 "Status Nebenschluss Zuendkerze 8. [RAM name from V530, interpolated]" UWORD NO_COMPU_METHOD 0 0 0 65535 ECU_ADDRESS 0x3FBD28 FORMAT "%.4g" /end MEASUREMENT
/begin MEASUREMENT auss_erk_ns_zyl9 "Status Nebenschluss Zuendkerze 9. [RAM name from V530, interpolated]" UWORD NO_COMPU_METHOD 0 0 0 65535 ECU_ADDRESS 0x3FBD28 FORMAT "%.4g" /end MEASUREMENT
/begin MEASUREMENT auss_erk_ti "Status Verbrennungsaussetzer. [RAM name from V530, interpolated]" UWORD NO_COMPU_METHOD 0 0 0 65535 ECU_ADDRESS 0x3FBD26 FORMAT "%.4g" /end MEASUREMENT
/begin MEASUREMENT auss_erk_ti_zyl1 "Status Verbrennung Zylinder 1. [RAM name from V530, interpolated]" UWORD NO_COMPU_METHOD 0 0 0 65535 ECU_ADDRESS 0x3FBD26 FORMAT "%.4g" /end MEASUREMENT
/begin MEASUREMENT auss_erk_ti_zyl10 "Status Verbrennung Zylinder 10. [RAM name from V530, interpolated]" UWORD NO_COMPU_METHOD 0 0 0 65535 ECU_ADDRESS 0x3FBD26 FORMAT "%.4g" /end MEASUREMENT
/begin MEASUREMENT auss_erk_ti_zyl2 "Status Verbrennung Zylinder 2. [RAM name from V530, interpolated]" UWORD NO_COMPU_METHOD 0 0 0 65535 ECU_ADDRESS 0x3FBD26 FORMAT "%.4g" /end MEASUREMENT
/begin MEASUREMENT auss_erk_ti_zyl3 "Status Verbrennung Zylinder 3. [RAM name from V530, interpolated]" UWORD NO_COMPU_METHOD 0 0 0 65535 ECU_ADDRESS 0x3FBD26 FORMAT "%.4g" /end MEASUREMENT
/begin MEASUREMENT auss_erk_ti_zyl4 "Status Verbrennung Zylinder 4. [RAM name from V530, interpolated]" UWORD NO_COMPU_METHOD 0 0 0 65535 ECU_ADDRESS 0x3FBD26 FORMAT "%.4g" /end MEASUREMENT
/begin MEASUREMENT auss_erk_ti_zyl5 "Status Verbrennung Zylinder 5. [RAM name from V530, interpolated]" UWORD NO_COMPU_METHOD 0 0 0 65535 ECU_ADDRESS 0x3FBD26 FORMAT "%.4g" /end MEASUREMENT
/begin MEASUREMENT auss_erk_ti_zyl6 "Status Verbrennung Zylinder 6. [RAM name from V530, interpolated]" UWORD NO_COMPU_METHOD 0 0 0 65535 ECU_ADDRESS 0x3FBD26 FORMAT "%.4g" /end MEASUREMENT
/begin MEASUREMENT auss_erk_ti_zyl7 "Status Verbrennung Zylinder 7. [RAM name from V530, interpolated]" UWORD NO_COMPU_METHOD 0 0 0 65535 ECU_ADDRESS 0x3FBD26 FORMAT "%.4g" /end MEASUREMENT
/begin MEASUREMENT auss_erk_ti_zyl8 "Status Verbrennung Zylinder 8. [RAM name from V530, interpolated]" UWORD NO_COMPU_METHOD 0 0 0 65535 ECU_ADDRESS 0x3FBD26 FORMAT "%.4g" /end MEASUREMENT
/begin MEASUREMENT auss_erk_ti_zyl9 "Status Verbrennung Zylinder 9. [RAM name from V530, interpolated]" UWORD NO_COMPU_METHOD 0 0 0 65535 ECU_ADDRESS 0x3FBD26 FORMAT "%.4g" /end MEASUREMENT
/begin MEASUREMENT auss_erk_tz "Status Ausschwingen Zuendspule. [RAM name from V530, interpolated]" UWORD NO_COMPU_METHOD 0 0 0 65535 ECU_ADDRESS 0x3FBD24 FORMAT "%.4g" /end MEASUREMENT
/begin MEASUREMENT auss_erk_tz_zyl1 "Status Ausschwingen Zuendspule 1. [RAM name from V530, interpolated]" UWORD NO_COMPU_METHOD 0 0 0 65535 ECU_ADDRESS 0x3FBD24 FORMAT "%.4g" /end MEASUREMENT
/begin MEASUREMENT auss_erk_tz_zyl10 "Status Ausschwingen Zuendspule 10. [RAM name from V530, interpolated]" UWORD NO_COMPU_METHOD 0 0 0 65535 ECU_ADDRESS 0x3FBD24 FORMAT "%.4g" /end MEASUREMENT
/begin MEASUREMENT auss_erk_tz_zyl2 "Status Ausschwingen Zuendspule 2. [RAM name from V530, interpolated]" UWORD NO_COMPU_METHOD 0 0 0 65535 ECU_ADDRESS 0x3FBD24 FORMAT "%.4g" /end MEASUREMENT
/begin MEASUREMENT auss_erk_tz_zyl3 "Status Ausschwingen Zuendspule 3. [RAM name from V530, interpolated]" UWORD NO_COMPU_METHOD 0 0 0 65535 ECU_ADDRESS 0x3FBD24 FORMAT "%.4g" /end MEASUREMENT
/begin MEASUREMENT auss_erk_tz_zyl4 "Status Ausschwingen Zuendspule 4. [RAM name from V530, interpolated]" UWORD NO_COMPU_METHOD 0 0 0 65535 ECU_ADDRESS 0x3FBD24 FORMAT "%.4g" /end MEASUREMENT
/begin MEASUREMENT auss_erk_tz_zyl5 "Status Ausschwingen Zuendspule 5. [RAM name from V530, interpolated]" UWORD NO_COMPU_METHOD 0 0 0 65535 ECU_ADDRESS 0x3FBD24 FORMAT "%.4g" /end MEASUREMENT
/begin MEASUREMENT auss_erk_tz_zyl6 "Status Ausschwingen Zuendspule 6. [RAM name from V530, interpolated]" UWORD NO_COMPU_METHOD 0 0 0 65535 ECU_ADDRESS 0x3FBD24 FORMAT "%.4g" /end MEASUREMENT
/begin MEASUREMENT auss_erk_tz_zyl7 "Status Ausschwingen Zuendspule 7. [RAM name from V530, interpolated]" UWORD NO_COMPU_METHOD 0 0 0 65535 ECU_ADDRESS 0x3FBD24 FORMAT "%.4g" /end MEASUREMENT
/begin MEASUREMENT auss_erk_tz_zyl8 "Status Ausschwingen Zuendspule 8. [RAM name from V530, interpolated]" UWORD NO_COMPU_METHOD 0 0 0 65535 ECU_ADDRESS 0x3FBD24 FORMAT "%.4g" /end MEASUREMENT
/begin MEASUREMENT auss_erk_tz_zyl9 "Status Ausschwingen Zuendspule 9. [RAM name from V530, interpolated]" UWORD NO_COMPU_METHOD 0 0 0 65535 ECU_ADDRESS 0x3FBD24 FORMAT "%.4g" /end MEASUREMENT
/begin MEASUREMENT auss_obd_wicht_kat_b2 "Gewichtungsfaktors fuer Katschaedigung. [RAM name from V530, interpolated]" UBYTE M_FORMULA_0493 0 0 0 1 ECU_ADDRESS 0x3FBD22 /end MEASUREMENT
/begin MEASUREMENT auss_dtz_st "Status delta Rueckziehwinkel. [RAM name from V530, interpolated]" UWORD NO_COMPU_METHOD 0 0 0 65535 ECU_ADDRESS 0x3FBD2E FORMAT "%.4g" /end MEASUREMENT
/begin MEASUREMENT auss_dtz_st_zyl1 "dtz Zylinder 1. [RAM name from V530, interpolated]" UWORD NO_COMPU_METHOD 0 0 0 65535 ECU_ADDRESS 0x3FBD2E FORMAT "%.4g" /end MEASUREMENT
/begin MEASUREMENT auss_dtz_st_zyl10 "dtz Zylinder 10. [RAM name from V530, interpolated]" UWORD NO_COMPU_METHOD 0 0 0 65535 ECU_ADDRESS 0x3FBD2E FORMAT "%.4g" /end MEASUREMENT
/begin MEASUREMENT auss_dtz_st_zyl2 "dtz Zylinder 2. [RAM name from V530, interpolated]" UWORD NO_COMPU_METHOD 0 0 0 65535 ECU_ADDRESS 0x3FBD2E FORMAT "%.4g" /end MEASUREMENT
/begin MEASUREMENT auss_dtz_st_zyl3 "dtz Zylinder 3. [RAM name from V530, interpolated]" UWORD NO_COMPU_METHOD 0 0 0 65535 ECU_ADDRESS 0x3FBD2E FORMAT "%.4g" /end MEASUREMENT
/begin MEASUREMENT auss_dtz_st_zyl4 "dtz Zylinder 4. [RAM name from V530, interpolated]" UWORD NO_COMPU_METHOD 0 0 0 65535 ECU_ADDRESS 0x3FBD2E FORMAT "%.4g" /end MEASUREMENT
/begin MEASUREMENT auss_dtz_st_zyl5 "dtz Zylinder 5. [RAM name from V530, interpolated]" UWORD NO_COMPU_METHOD 0 0 0 65535 ECU_ADDRESS 0x3FBD2E FORMAT "%.4g" /end MEASUREMENT
/begin MEASUREMENT auss_dtz_st_zyl6 "dtz Zylinder 6. [RAM name from V530, interpolated]" UWORD NO_COMPU_METHOD 0 0 0 65535 ECU_ADDRESS 0x3FBD2E FORMAT "%.4g" /end MEASUREMENT
/begin MEASUREMENT auss_dtz_st_zyl7 "dtz Zylinder 7. [RAM name from V530, interpolated]" UWORD NO_COMPU_METHOD 0 0 0 65535 ECU_ADDRESS 0x3FBD2E FORMAT "%.4g" /end MEASUREMENT
/begin MEASUREMENT auss_dtz_st_zyl8 "dtz Zylinder 8. [RAM name from V530, interpolated]" UWORD NO_COMPU_METHOD 0 0 0 65535 ECU_ADDRESS 0x3FBD2E FORMAT "%.4g" /end MEASUREMENT
/begin MEASUREMENT auss_dtz_st_zyl9 "dtz Zylinder 9. [RAM name from V530, interpolated]" UWORD NO_COMPU_METHOD 0 0 0 65535 ECU_ADDRESS 0x3FBD2E FORMAT "%.4g" /end MEASUREMENT
/begin MEASUREMENT auss_obd_pos_md_dyn_b2 "Maximal zul. pos. Dynamik. [RAM name from V530, interpolated]" SWORD M_FORMULA_0562 0 0 -655360 655340 ECU_ADDRESS 0x3FBD50 /end MEASUREMENT
/begin MEASUREMENT auss_obd_neg_md_dyn_b2 "Maximal zul. neg. Dynamik. [RAM name from V530, interpolated]" SWORD M_FORMULA_0562 0 0 -655360 655340 ECU_ADDRESS 0x3FBD54 /end MEASUREMENT
/begin MEASUREMENT auss_obd_t_idle_b1 "Zeit seit Deaktivierungsbedingung. [RAM name from V530, interpolated]" UWORD M_FORMULA_0021 0 0 0 655.35 ECU_ADDRESS 0x3FBD56 /end MEASUREMENT
/begin MEASUREMENT auss_obd_t_idle_b2 "Zeit seit Deaktivierungsbedingung. [RAM name from V530, interpolated]" UWORD M_FORMULA_0021 0 0 0 655.35 ECU_ADDRESS 0x3FBD58 /end MEASUREMENT
/begin MEASUREMENT auss_lp_int_min_zyl1 "Minimale TP-Leitwertintegralschwelle. [RAM name from V530, interpolated]" SWORD M_FORMULA_0227 0 0 -639.6988621 639.67934 ECU_ADDRESS 0x3FBD5E /end MEASUREMENT
/begin MEASUREMENT auss_lp_int_min_zyl10 "Minimale TP-Leitwertintegralschwelle. [RAM name from V530, interpolated]" SWORD M_FORMULA_0227 0 0 -639.6988621 639.67934 ECU_ADDRESS 0x3FBD70 /end MEASUREMENT
/begin MEASUREMENT auss_lp_int_min_zyl2 "Minimale TP-Leitwertintegralschwelle. [RAM name from V530, interpolated]" SWORD M_FORMULA_0227 0 0 -639.6988621 639.67934 ECU_ADDRESS 0x3FBD60 /end MEASUREMENT
/begin MEASUREMENT auss_lp_int_min_zyl3 "Minimale TP-Leitwertintegralschwelle. [RAM name from V530, interpolated]" SWORD M_FORMULA_0227 0 0 -639.6988621 639.67934 ECU_ADDRESS 0x3FBD62 /end MEASUREMENT
/begin MEASUREMENT auss_lp_int_min_zyl4 "Minimale TP-Leitwertintegralschwelle. [RAM name from V530, interpolated]" SWORD M_FORMULA_0227 0 0 -639.6988621 639.67934 ECU_ADDRESS 0x3FBD64 /end MEASUREMENT
/begin MEASUREMENT auss_lp_int_min_zyl5 "Minimale TP-Leitwertintegralschwelle. [RAM name from V530, interpolated]" SWORD M_FORMULA_0227 0 0 -639.6988621 639.67934 ECU_ADDRESS 0x3FBD66 /end MEASUREMENT
/begin MEASUREMENT auss_lp_int_min_zyl6 "Minimale TP-Leitwertintegralschwelle. [RAM name from V530, interpolated]" SWORD M_FORMULA_0227 0 0 -639.6988621 639.67934 ECU_ADDRESS 0x3FBD68 /end MEASUREMENT
/begin MEASUREMENT auss_lp_int_min_zyl7 "Minimale TP-Leitwertintegralschwelle. [RAM name from V530, interpolated]" SWORD M_FORMULA_0227 0 0 -639.6988621 639.67934 ECU_ADDRESS 0x3FBD6A /end MEASUREMENT
/begin MEASUREMENT auss_lp_int_min_zyl8 "Minimale TP-Leitwertintegralschwelle. [RAM name from V530, interpolated]" SWORD M_FORMULA_0227 0 0 -639.6988621 639.67934 ECU_ADDRESS 0x3FBD6C /end MEASUREMENT
/begin MEASUREMENT auss_lp_int_min_zyl9 "Minimale TP-Leitwertintegralschwelle. [RAM name from V530, interpolated]" SWORD M_FORMULA_0227 0 0 -639.6988621 639.67934 ECU_ADDRESS 0x3FBD6E /end MEASUREMENT
/begin MEASUREMENT auss_ns_time_zyl1 "Nebenschlusszeit im Aussetzerfenster. [RAM name from V530, interpolated]" UWORD M_FORMULA_0446 0 0 0 262.14 ECU_ADDRESS 0x3FBD72 /end MEASUREMENT
/begin MEASUREMENT auss_ns_time_zyl10 "Nebenschlusszeit im Aussetzerfenster. [RAM name from V530, interpolated]" UWORD M_FORMULA_0446 0 0 0 262.14 ECU_ADDRESS 0x3FBD84 /end MEASUREMENT
/begin MEASUREMENT auss_ns_time_zyl2 "Nebenschlusszeit im Aussetzerfenster. [RAM name from V530, interpolated]" UWORD M_FORMULA_0446 0 0 0 262.14 ECU_ADDRESS 0x3FBD74 /end MEASUREMENT
/begin MEASUREMENT auss_ns_time_zyl3 "Nebenschlusszeit im Aussetzerfenster. [RAM name from V530, interpolated]" UWORD M_FORMULA_0446 0 0 0 262.14 ECU_ADDRESS 0x3FBD76 /end MEASUREMENT
/begin MEASUREMENT auss_ns_time_zyl4 "Nebenschlusszeit im Aussetzerfenster. [RAM name from V530, interpolated]" UWORD M_FORMULA_0446 0 0 0 262.14 ECU_ADDRESS 0x3FBD78 /end MEASUREMENT
/begin MEASUREMENT auss_ns_time_zyl5 "Nebenschlusszeit im Aussetzerfenster. [RAM name from V530, interpolated]" UWORD M_FORMULA_0446 0 0 0 262.14 ECU_ADDRESS 0x3FBD7A /end MEASUREMENT
/begin MEASUREMENT auss_ns_time_zyl6 "Nebenschlusszeit im Aussetzerfenster. [RAM name from V530, interpolated]" UWORD M_FORMULA_0446 0 0 0 262.14 ECU_ADDRESS 0x3FBD7C /end MEASUREMENT
/begin MEASUREMENT auss_ns_time_zyl7 "Nebenschlusszeit im Aussetzerfenster. [RAM name from V530, interpolated]" UWORD M_FORMULA_0446 0 0 0 262.14 ECU_ADDRESS 0x3FBD7E /end MEASUREMENT
/begin MEASUREMENT auss_ns_time_zyl8 "Nebenschlusszeit im Aussetzerfenster. [RAM name from V530, interpolated]" UWORD M_FORMULA_0446 0 0 0 262.14 ECU_ADDRESS 0x3FBD80 /end MEASUREMENT
/begin MEASUREMENT auss_ns_time_zyl9 "Nebenschlusszeit im Aussetzerfenster. [RAM name from V530, interpolated]" UWORD M_FORMULA_0446 0 0 0 262.14 ECU_ADDRESS 0x3FBD82 /end MEASUREMENT
/begin MEASUREMENT auss_obd_t_min_lam_b2 "Abschaltzeit wegen Lamda-Unterschreitung. [RAM name from V530, interpolated]" UWORD M_FORMULA_0021 0 0 0 655.35 ECU_ADDRESS 0x3FBD5C /end MEASUREMENT
/begin MEASUREMENT auss_tz_ed_zyl10 "tz fuer Fehlereintrag. [RAM name from V530, interpolated]" SWORD M_FORMULA_0102 0 0 -3276.8 3276.7 ECU_ADDRESS 0x3FBD98 /end MEASUREMENT
/begin MEASUREMENT auss_tz_ed_zyl2 "tz fuer Fehlereintrag. [RAM name from V530, interpolated]" SWORD M_FORMULA_0102 0 0 -3276.8 3276.7 ECU_ADDRESS 0x3FBD88 /end MEASUREMENT
/begin MEASUREMENT auss_tz_ed_zyl3 "tz fuer Fehlereintrag. [RAM name from V530, interpolated]" SWORD M_FORMULA_0102 0 0 -3276.8 3276.7 ECU_ADDRESS 0x3FBD8A /end MEASUREMENT
/begin MEASUREMENT auss_tz_ed_zyl4 "tz fuer Fehlereintrag. [RAM name from V530, interpolated]" SWORD M_FORMULA_0102 0 0 -3276.8 3276.7 ECU_ADDRESS 0x3FBD8C /end MEASUREMENT
/begin MEASUREMENT auss_tz_ed_zyl5 "tz fuer Fehlereintrag. [RAM name from V530, interpolated]" SWORD M_FORMULA_0102 0 0 -3276.8 3276.7 ECU_ADDRESS 0x3FBD8E /end MEASUREMENT
/begin MEASUREMENT auss_tz_ed_zyl6 "tz fuer Fehlereintrag. [RAM name from V530, interpolated]" SWORD M_FORMULA_0102 0 0 -3276.8 3276.7 ECU_ADDRESS 0x3FBD90 /end MEASUREMENT
/begin MEASUREMENT auss_tz_ed_zyl7 "tz fuer Fehlereintrag. [RAM name from V530, interpolated]" SWORD M_FORMULA_0102 0 0 -3276.8 3276.7 ECU_ADDRESS 0x3FBD92 /end MEASUREMENT
/begin MEASUREMENT auss_tz_ed_zyl8 "tz fuer Fehlereintrag. [RAM name from V530, interpolated]" SWORD M_FORMULA_0102 0 0 -3276.8 3276.7 ECU_ADDRESS 0x3FBD94 /end MEASUREMENT
/begin MEASUREMENT auss_tz_ed_zyl9 "tz fuer Fehlereintrag. [RAM name from V530, interpolated]" SWORD M_FORMULA_0102 0 0 -3276.8 3276.7 ECU_ADDRESS 0x3FBD96 /end MEASUREMENT
/begin MEASUREMENT auss_tz_ed_ns_zyl1 "tz fuer Fehlereintrag Nebenschluss. [RAM name from V530, interpolated]" SWORD M_FORMULA_0102 0 0 -3276.8 3276.7 ECU_ADDRESS 0x3FBDAE /end MEASUREMENT
/begin MEASUREMENT auss_tz_ed_ns_zyl10 "tz fuer Fehlereintrag Nebenschluss. [RAM name from V530, interpolated]" SWORD M_FORMULA_0102 0 0 -3276.8 3276.7 ECU_ADDRESS 0x3FBDC0 /end MEASUREMENT
/begin MEASUREMENT auss_tz_ed_ns_zyl2 "tz fuer Fehlereintrag Nebenschluss. [RAM name from V530, interpolated]" SWORD M_FORMULA_0102 0 0 -3276.8 3276.7 ECU_ADDRESS 0x3FBDB0 /end MEASUREMENT
/begin MEASUREMENT auss_tz_ed_ns_zyl3 "tz fuer Fehlereintrag Nebenschluss. [RAM name from V530, interpolated]" SWORD M_FORMULA_0102 0 0 -3276.8 3276.7 ECU_ADDRESS 0x3FBDB2 /end MEASUREMENT
/begin MEASUREMENT auss_tz_ed_ns_zyl4 "tz fuer Fehlereintrag Nebenschluss. [RAM name from V530, interpolated]" SWORD M_FORMULA_0102 0 0 -3276.8 3276.7 ECU_ADDRESS 0x3FBDB4 /end MEASUREMENT
/begin MEASUREMENT auss_tz_ed_ns_zyl5 "tz fuer Fehlereintrag Nebenschluss. [RAM name from V530, interpolated]" SWORD M_FORMULA_0102 0 0 -3276.8 3276.7 ECU_ADDRESS 0x3FBDB6 /end MEASUREMENT
/begin MEASUREMENT auss_tz_ed_ns_zyl6 "tz fuer Fehlereintrag Nebenschluss. [RAM name from V530, interpolated]" SWORD M_FORMULA_0102 0 0 -3276.8 3276.7 ECU_ADDRESS 0x3FBDB8 /end MEASUREMENT
/begin MEASUREMENT auss_tz_ed_ns_zyl7 "tz fuer Fehlereintrag Nebenschluss. [RAM name from V530, interpolated]" SWORD M_FORMULA_0102 0 0 -3276.8 3276.7 ECU_ADDRESS 0x3FBDBA /end MEASUREMENT
/begin MEASUREMENT auss_tz_ed_ns_zyl8 "tz fuer Fehlereintrag Nebenschluss. [RAM name from V530, interpolated]" SWORD M_FORMULA_0102 0 0 -3276.8 3276.7 ECU_ADDRESS 0x3FBDBC /end MEASUREMENT
/begin MEASUREMENT auss_tz_ed_ns_zyl9 "tz fuer Fehlereintrag Nebenschluss. [RAM name from V530, interpolated]" SWORD M_FORMULA_0102 0 0 -3276.8 3276.7 ECU_ADDRESS 0x3FBDBE /end MEASUREMENT
/begin MEASUREMENT auss_tz_ed_ti_zyl10 "tz fuer Fehlereintrag Verbrennungsaussetzer. [RAM name from V530, interpolated]" SWORD M_FORMULA_0102 0 0 -3276.8 3276.7 ECU_ADDRESS 0x3FBDAC /end MEASUREMENT
/begin MEASUREMENT auss_tz_ed_ti_zyl2 "tz fuer Fehlereintrag Verbrennungsaussetzer. [RAM name from V530, interpolated]" SWORD M_FORMULA_0102 0 0 -3276.8 3276.7 ECU_ADDRESS 0x3FBD9C /end MEASUREMENT
/begin MEASUREMENT auss_tz_ed_ti_zyl3 "tz fuer Fehlereintrag Verbrennungsaussetzer. [RAM name from V530, interpolated]" SWORD M_FORMULA_0102 0 0 -3276.8 3276.7 ECU_ADDRESS 0x3FBD9E /end MEASUREMENT
/begin MEASUREMENT auss_tz_ed_ti_zyl4 "tz fuer Fehlereintrag Verbrennungsaussetzer. [RAM name from V530, interpolated]" SWORD M_FORMULA_0102 0 0 -3276.8 3276.7 ECU_ADDRESS 0x3FBDA0 /end MEASUREMENT
/begin MEASUREMENT auss_tz_ed_ti_zyl5 "tz fuer Fehlereintrag Verbrennungsaussetzer. [RAM name from V530, interpolated]" SWORD M_FORMULA_0102 0 0 -3276.8 3276.7 ECU_ADDRESS 0x3FBDA2 /end MEASUREMENT
/begin MEASUREMENT auss_tz_ed_ti_zyl6 "tz fuer Fehlereintrag Verbrennungsaussetzer. [RAM name from V530, interpolated]" SWORD M_FORMULA_0102 0 0 -3276.8 3276.7 ECU_ADDRESS 0x3FBDA4 /end MEASUREMENT
/begin MEASUREMENT auss_tz_ed_ti_zyl7 "tz fuer Fehlereintrag Verbrennungsaussetzer. [RAM name from V530, interpolated]" SWORD M_FORMULA_0102 0 0 -3276.8 3276.7 ECU_ADDRESS 0x3FBDA6 /end MEASUREMENT
/begin MEASUREMENT auss_tz_ed_ti_zyl8 "tz fuer Fehlereintrag Verbrennungsaussetzer. [RAM name from V530, interpolated]" SWORD M_FORMULA_0102 0 0 -3276.8 3276.7 ECU_ADDRESS 0x3FBDA8 /end MEASUREMENT
/begin MEASUREMENT auss_tz_ed_ti_zyl9 "tz fuer Fehlereintrag Verbrennungsaussetzer. [RAM name from V530, interpolated]" SWORD M_FORMULA_0102 0 0 -3276.8 3276.7 ECU_ADDRESS 0x3FBDAA /end MEASUREMENT
/begin MEASUREMENT auss_lp_int_ed_zyl10 "Integral fuer Fehlereintrag. [RAM name from V530, interpolated]" SWORD M_FORMULA_0227 0 0 -639.6988621 639.67934 ECU_ADDRESS 0x3FBDD4 /end MEASUREMENT
/begin MEASUREMENT auss_lp_int_ed_zyl2 "Integral fuer Fehlereintrag. [RAM name from V530, interpolated]" SWORD M_FORMULA_0227 0 0 -639.6988621 639.67934 ECU_ADDRESS 0x3FBDC4 /end MEASUREMENT
/begin MEASUREMENT auss_lp_int_ed_zyl3 "Integral fuer Fehlereintrag. [RAM name from V530, interpolated]" SWORD M_FORMULA_0227 0 0 -639.6988621 639.67934 ECU_ADDRESS 0x3FBDC6 /end MEASUREMENT
/begin MEASUREMENT auss_lp_int_ed_zyl4 "Integral fuer Fehlereintrag. [RAM name from V530, interpolated]" SWORD M_FORMULA_0227 0 0 -639.6988621 639.67934 ECU_ADDRESS 0x3FBDC8 /end MEASUREMENT
/begin MEASUREMENT auss_lp_int_ed_zyl5 "Integral fuer Fehlereintrag. [RAM name from V530, interpolated]" SWORD M_FORMULA_0227 0 0 -639.6988621 639.67934 ECU_ADDRESS 0x3FBDCA /end MEASUREMENT
/begin MEASUREMENT auss_lp_int_ed_zyl6 "Integral fuer Fehlereintrag. [RAM name from V530, interpolated]" SWORD M_FORMULA_0227 0 0 -639.6988621 639.67934 ECU_ADDRESS 0x3FBDCC /end MEASUREMENT
/begin MEASUREMENT auss_lp_int_ed_zyl7 "Integral fuer Fehlereintrag. [RAM name from V530, interpolated]" SWORD M_FORMULA_0227 0 0 -639.6988621 639.67934 ECU_ADDRESS 0x3FBDCE /end MEASUREMENT
/begin MEASUREMENT auss_lp_int_ed_zyl8 "Integral fuer Fehlereintrag. [RAM name from V530, interpolated]" SWORD M_FORMULA_0227 0 0 -639.6988621 639.67934 ECU_ADDRESS 0x3FBDD0 /end MEASUREMENT
/begin MEASUREMENT auss_lp_int_ed_zyl9 "Integral fuer Fehlereintrag. [RAM name from V530, interpolated]" SWORD M_FORMULA_0227 0 0 -639.6988621 639.67934 ECU_ADDRESS 0x3FBDD2 /end MEASUREMENT
/begin MEASUREMENT auss_lp_int_ed_ti_zyl10 "Integral fuer Fehlereintrag Verbrennungsaussetzer. [RAM name from V530, interpolated]" SWORD M_FORMULA_0227 0 0 -639.6988621 639.67934 ECU_ADDRESS 0x3FBDE8 /end MEASUREMENT
/begin MEASUREMENT auss_lp_int_ed_ti_zyl2 "Integral fuer Fehlereintrag Verbrennungsaussetzer. [RAM name from V530, interpolated]" SWORD M_FORMULA_0227 0 0 -639.6988621 639.67934 ECU_ADDRESS 0x3FBDD8 /end MEASUREMENT
/begin MEASUREMENT auss_lp_int_ed_ti_zyl3 "Integral fuer Fehlereintrag Verbrennungsaussetzer. [RAM name from V530, interpolated]" SWORD M_FORMULA_0227 0 0 -639.6988621 639.67934 ECU_ADDRESS 0x3FBDDA /end MEASUREMENT
/begin MEASUREMENT auss_lp_int_ed_ti_zyl4 "Integral fuer Fehlereintrag Verbrennungsaussetzer. [RAM name from V530, interpolated]" SWORD M_FORMULA_0227 0 0 -639.6988621 639.67934 ECU_ADDRESS 0x3FBDDC /end MEASUREMENT
/begin MEASUREMENT auss_lp_int_ed_ti_zyl5 "Integral fuer Fehlereintrag Verbrennungsaussetzer. [RAM name from V530, interpolated]" SWORD M_FORMULA_0227 0 0 -639.6988621 639.67934 ECU_ADDRESS 0x3FBDDE /end MEASUREMENT
/begin MEASUREMENT auss_lp_int_ed_ti_zyl6 "Integral fuer Fehlereintrag Verbrennungsaussetzer. [RAM name from V530, interpolated]" SWORD M_FORMULA_0227 0 0 -639.6988621 639.67934 ECU_ADDRESS 0x3FBDE0 /end MEASUREMENT
/begin MEASUREMENT auss_lp_int_ed_ti_zyl7 "Integral fuer Fehlereintrag Verbrennungsaussetzer. [RAM name from V530, interpolated]" SWORD M_FORMULA_0227 0 0 -639.6988621 639.67934 ECU_ADDRESS 0x3FBDE2 /end MEASUREMENT
/begin MEASUREMENT auss_lp_int_ed_ti_zyl8 "Integral fuer Fehlereintrag Verbrennungsaussetzer. [RAM name from V530, interpolated]" SWORD M_FORMULA_0227 0 0 -639.6988621 639.67934 ECU_ADDRESS 0x3FBDE4 /end MEASUREMENT
/begin MEASUREMENT auss_lp_int_ed_ti_zyl9 "Integral fuer Fehlereintrag Verbrennungsaussetzer. [RAM name from V530, interpolated]" SWORD M_FORMULA_0227 0 0 -639.6988621 639.67934 ECU_ADDRESS 0x3FBDE6 /end MEASUREMENT
/begin MEASUREMENT auss_obd_sum_abg_spark_zyl10 "Summe Zuendauss. Abgas in 1000 Umdrehungen. [RAM name from V530, interpolated]" UWORD M_FORMULA_0010 0 0 0 65535 ECU_ADDRESS 0x3FBE60 /end MEASUREMENT
/begin MEASUREMENT auss_obd_sum_abg_spark_zyl2 "Summe Zuendauss. Abgas in 1000 Umdrehungen. [RAM name from V530, interpolated]" UWORD M_FORMULA_0010 0 0 0 65535 ECU_ADDRESS 0x3FBE50 /end MEASUREMENT
/begin MEASUREMENT auss_obd_sum_abg_spark_zyl3 "Summe Zuendauss. Abgas in 1000 Umdrehungen. [RAM name from V530, interpolated]" UWORD M_FORMULA_0010 0 0 0 65535 ECU_ADDRESS 0x3FBE52 /end MEASUREMENT
/begin MEASUREMENT auss_obd_sum_abg_spark_zyl4 "Summe Zuendauss. Abgas in 1000 Umdrehungen. [RAM name from V530, interpolated]" UWORD M_FORMULA_0010 0 0 0 65535 ECU_ADDRESS 0x3FBE54 /end MEASUREMENT
/begin MEASUREMENT auss_obd_sum_abg_spark_zyl5 "Summe Zuendauss. Abgas in 1000 Umdrehungen. [RAM name from V530, interpolated]" UWORD M_FORMULA_0010 0 0 0 65535 ECU_ADDRESS 0x3FBE56 /end MEASUREMENT
/begin MEASUREMENT auss_obd_sum_abg_spark_zyl6 "Summe Zuendauss. Abgas in 1000 Umdrehungen. [RAM name from V530, interpolated]" UWORD M_FORMULA_0010 0 0 0 65535 ECU_ADDRESS 0x3FBE58 /end MEASUREMENT
/begin MEASUREMENT auss_obd_sum_abg_spark_zyl7 "Summe Zuendauss. Abgas in 1000 Umdrehungen. [RAM name from V530, interpolated]" UWORD M_FORMULA_0010 0 0 0 65535 ECU_ADDRESS 0x3FBE5A /end MEASUREMENT
/begin MEASUREMENT auss_obd_sum_abg_spark_zyl8 "Summe Zuendauss. Abgas in 1000 Umdrehungen. [RAM name from V530, interpolated]" UWORD M_FORMULA_0010 0 0 0 65535 ECU_ADDRESS 0x3FBE5C /end MEASUREMENT
/begin MEASUREMENT auss_obd_sum_abg_spark_zyl9 "Summe Zuendauss. Abgas in 1000 Umdrehungen. [RAM name from V530, interpolated]" UWORD M_FORMULA_0010 0 0 0 65535 ECU_ADDRESS 0x3FBE5E /end MEASUREMENT
/begin MEASUREMENT auss_obd_sum_abg_ev_zyl10 "Summe Einspritzauss. Abgas in 1000 Umdrehungen. [RAM name from V530, interpolated]" UWORD M_FORMULA_0010 0 0 0 65535 ECU_ADDRESS 0x3FBE74 /end MEASUREMENT
/begin MEASUREMENT auss_obd_sum_abg_ev_zyl2 "Summe Einspritzauss. Abgas in 1000 Umdrehungen. [RAM name from V530, interpolated]" UWORD M_FORMULA_0010 0 0 0 65535 ECU_ADDRESS 0x3FBE64 /end MEASUREMENT
/begin MEASUREMENT auss_obd_sum_abg_ev_zyl3 "Summe Einspritzauss. Abgas in 1000 Umdrehungen. [RAM name from V530, interpolated]" UWORD M_FORMULA_0010 0 0 0 65535 ECU_ADDRESS 0x3FBE66 /end MEASUREMENT
/begin MEASUREMENT auss_obd_sum_abg_ev_zyl4 "Summe Einspritzauss. Abgas in 1000 Umdrehungen. [RAM name from V530, interpolated]" UWORD M_FORMULA_0010 0 0 0 65535 ECU_ADDRESS 0x3FBE68 /end MEASUREMENT
/begin MEASUREMENT auss_obd_sum_abg_ev_zyl5 "Summe Einspritzauss. Abgas in 1000 Umdrehungen. [RAM name from V530, interpolated]" UWORD M_FORMULA_0010 0 0 0 65535 ECU_ADDRESS 0x3FBE6A /end MEASUREMENT
/begin MEASUREMENT auss_obd_sum_abg_ev_zyl6 "Summe Einspritzauss. Abgas in 1000 Umdrehungen. [RAM name from V530, interpolated]" UWORD M_FORMULA_0010 0 0 0 65535 ECU_ADDRESS 0x3FBE6C /end MEASUREMENT
/begin MEASUREMENT auss_obd_sum_abg_ev_zyl7 "Summe Einspritzauss. Abgas in 1000 Umdrehungen. [RAM name from V530, interpolated]" UWORD M_FORMULA_0010 0 0 0 65535 ECU_ADDRESS 0x3FBE6E /end MEASUREMENT
/begin MEASUREMENT auss_obd_sum_abg_ev_zyl8 "Summe Einspritzauss. Abgas in 1000 Umdrehungen. [RAM name from V530, interpolated]" UWORD M_FORMULA_0010 0 0 0 65535 ECU_ADDRESS 0x3FBE70 /end MEASUREMENT
/begin MEASUREMENT auss_obd_sum_abg_ev_zyl9 "Summe Einspritzauss. Abgas in 1000 Umdrehungen. [RAM name from V530, interpolated]" UWORD M_FORMULA_0010 0 0 0 65535 ECU_ADDRESS 0x3FBE72 /end MEASUREMENT
/begin MEASUREMENT auss_obd_sum_kat_spark_zyl1 "Gew. Summe kat. Zuendauss. in 200 Umdrehungen. [RAM name from V530, interpolated]" UWORD M_FORMULA_0563 0 0 0 257 ECU_ADDRESS 0x3FBE76 /end MEASUREMENT
/begin MEASUREMENT auss_obd_sum_kat_spark_zyl10 "Gew. Summe kat. Zuendauss. in 200 Umdrehungen. [RAM name from V530, interpolated]" UWORD M_FORMULA_0563 0 0 0 257 ECU_ADDRESS 0x3FBE88 /end MEASUREMENT
/begin MEASUREMENT auss_obd_sum_kat_spark_zyl2 "Gew. Summe kat. Zuendauss. in 200 Umdrehungen. [RAM name from V530, interpolated]" UWORD M_FORMULA_0563 0 0 0 257 ECU_ADDRESS 0x3FBE78 /end MEASUREMENT
/begin MEASUREMENT auss_obd_sum_kat_spark_zyl3 "Gew. Summe kat. Zuendauss. in 200 Umdrehungen. [RAM name from V530, interpolated]" UWORD M_FORMULA_0563 0 0 0 257 ECU_ADDRESS 0x3FBE7A /end MEASUREMENT
/begin MEASUREMENT auss_obd_sum_kat_spark_zyl4 "Gew. Summe kat. Zuendauss. in 200 Umdrehungen. [RAM name from V530, interpolated]" UWORD M_FORMULA_0563 0 0 0 257 ECU_ADDRESS 0x3FBE7C /end MEASUREMENT
/begin MEASUREMENT auss_obd_sum_kat_spark_zyl5 "Gew. Summe kat. Zuendauss. in 200 Umdrehungen. [RAM name from V530, interpolated]" UWORD M_FORMULA_0563 0 0 0 257 ECU_ADDRESS 0x3FBE7E /end MEASUREMENT
/begin MEASUREMENT auss_obd_sum_kat_spark_zyl6 "Gew. Summe kat. Zuendauss. in 200 Umdrehungen. [RAM name from V530, interpolated]" UWORD M_FORMULA_0563 0 0 0 257 ECU_ADDRESS 0x3FBE80 /end MEASUREMENT
/begin MEASUREMENT auss_obd_sum_kat_spark_zyl7 "Gew. Summe kat. Zuendauss. in 200 Umdrehungen. [RAM name from V530, interpolated]" UWORD M_FORMULA_0563 0 0 0 257 ECU_ADDRESS 0x3FBE82 /end MEASUREMENT
/begin MEASUREMENT auss_obd_sum_kat_spark_zyl8 "Gew. Summe kat. Zuendauss. in 200 Umdrehungen. [RAM name from V530, interpolated]" UWORD M_FORMULA_0563 0 0 0 257 ECU_ADDRESS 0x3FBE84 /end MEASUREMENT
/begin MEASUREMENT auss_obd_sum_kat_spark_zyl9 "Gew. Summe kat. Zuendauss. in 200 Umdrehungen. [RAM name from V530, interpolated]" UWORD M_FORMULA_0563 0 0 0 257 ECU_ADDRESS 0x3FBE86 /end MEASUREMENT
/begin MEASUREMENT auss_erk_kl15_zyl1 "Zaehler Aussetzer waerend KL15-Zyklus. [RAM name from V530, interpolated]" UWORD M_FORMULA_0010 0 0 0 65535 ECU_ADDRESS 0x3FBEB2 /end MEASUREMENT
/begin MEASUREMENT auss_erk_kl15_zyl10 "Zaehler Aussetzer waerend KL15-Zyklus. [RAM name from V530, interpolated]" UWORD M_FORMULA_0010 0 0 0 65535 ECU_ADDRESS 0x3FBEC4 /end MEASUREMENT
/begin MEASUREMENT auss_erk_kl15_zyl2 "Zaehler Aussetzer waerend KL15-Zyklus. [RAM name from V530, interpolated]" UWORD M_FORMULA_0010 0 0 0 65535 ECU_ADDRESS 0x3FBEB4 /end MEASUREMENT
/begin MEASUREMENT auss_erk_kl15_zyl3 "Zaehler Aussetzer waerend KL15-Zyklus. [RAM name from V530, interpolated]" UWORD M_FORMULA_0010 0 0 0 65535 ECU_ADDRESS 0x3FBEB6 /end MEASUREMENT
/begin MEASUREMENT auss_erk_kl15_zyl4 "Zaehler Aussetzer waerend KL15-Zyklus. [RAM name from V530, interpolated]" UWORD M_FORMULA_0010 0 0 0 65535 ECU_ADDRESS 0x3FBEB8 /end MEASUREMENT
/begin MEASUREMENT auss_erk_kl15_zyl5 "Zaehler Aussetzer waerend KL15-Zyklus. [RAM name from V530, interpolated]" UWORD M_FORMULA_0010 0 0 0 65535 ECU_ADDRESS 0x3FBEBA /end MEASUREMENT
/begin MEASUREMENT auss_erk_kl15_zyl6 "Zaehler Aussetzer waerend KL15-Zyklus. [RAM name from V530, interpolated]" UWORD M_FORMULA_0010 0 0 0 65535 ECU_ADDRESS 0x3FBEBC /end MEASUREMENT
/begin MEASUREMENT auss_erk_kl15_zyl7 "Zaehler Aussetzer waerend KL15-Zyklus. [RAM name from V530, interpolated]" UWORD M_FORMULA_0010 0 0 0 65535 ECU_ADDRESS 0x3FBEBE /end MEASUREMENT
/begin MEASUREMENT auss_erk_kl15_zyl8 "Zaehler Aussetzer waerend KL15-Zyklus. [RAM name from V530, interpolated]" UWORD M_FORMULA_0010 0 0 0 65535 ECU_ADDRESS 0x3FBEC0 /end MEASUREMENT
/begin MEASUREMENT auss_erk_kl15_zyl9 "Zaehler Aussetzer waerend KL15-Zyklus. [RAM name from V530, interpolated]" UWORD M_FORMULA_0010 0 0 0 65535 ECU_ADDRESS 0x3FBEC2 /end MEASUREMENT
/begin MEASUREMENT auss_obd_sum_kat_ev_zyl1 "Gew. Summe kat. Einspritzauss. in 200 Umdrehungen. [RAM name from V530, interpolated]" UWORD M_FORMULA_0563 0 0 0 257 ECU_ADDRESS 0x3FBE9E /end MEASUREMENT
/begin MEASUREMENT auss_obd_sum_kat_ev_zyl10 "Gew. Summe kat. Einspritzauss. in 200 Umdrehungen. [RAM name from V530, interpolated]" UWORD M_FORMULA_0563 0 0 0 257 ECU_ADDRESS 0x3FBEB0 /end MEASUREMENT
/begin MEASUREMENT auss_obd_sum_kat_ev_zyl2 "Gew. Summe kat. Einspritzauss. in 200 Umdrehungen. [RAM name from V530, interpolated]" UWORD M_FORMULA_0563 0 0 0 257 ECU_ADDRESS 0x3FBEA0 /end MEASUREMENT
/begin MEASUREMENT auss_obd_sum_kat_ev_zyl3 "Gew. Summe kat. Einspritzauss. in 200 Umdrehungen. [RAM name from V530, interpolated]" UWORD M_FORMULA_0563 0 0 0 257 ECU_ADDRESS 0x3FBEA2 /end MEASUREMENT
/begin MEASUREMENT auss_obd_sum_kat_ev_zyl4 "Gew. Summe kat. Einspritzauss. in 200 Umdrehungen. [RAM name from V530, interpolated]" UWORD M_FORMULA_0563 0 0 0 257 ECU_ADDRESS 0x3FBEA4 /end MEASUREMENT
/begin MEASUREMENT auss_obd_sum_kat_ev_zyl5 "Gew. Summe kat. Einspritzauss. in 200 Umdrehungen. [RAM name from V530, interpolated]" UWORD M_FORMULA_0563 0 0 0 257 ECU_ADDRESS 0x3FBEA6 /end MEASUREMENT
/begin MEASUREMENT auss_obd_sum_kat_ev_zyl6 "Gew. Summe kat. Einspritzauss. in 200 Umdrehungen. [RAM name from V530, interpolated]" UWORD M_FORMULA_0563 0 0 0 257 ECU_ADDRESS 0x3FBEA8 /end MEASUREMENT
/begin MEASUREMENT auss_obd_sum_kat_ev_zyl7 "Gew. Summe kat. Einspritzauss. in 200 Umdrehungen. [RAM name from V530, interpolated]" UWORD M_FORMULA_0563 0 0 0 257 ECU_ADDRESS 0x3FBEAA /end MEASUREMENT
/begin MEASUREMENT auss_obd_sum_kat_ev_zyl8 "Gew. Summe kat. Einspritzauss. in 200 Umdrehungen. [RAM name from V530, interpolated]" UWORD M_FORMULA_0563 0 0 0 257 ECU_ADDRESS 0x3FBEAC /end MEASUREMENT
/begin MEASUREMENT auss_obd_sum_kat_ev_zyl9 "Gew. Summe kat. Einspritzauss. in 200 Umdrehungen. [RAM name from V530, interpolated]" UWORD M_FORMULA_0563 0 0 0 257 ECU_ADDRESS 0x3FBEAE /end MEASUREMENT
/begin MEASUREMENT auss_obd_sum_kat_ns_zyl10 "Gew. Summe kat. Nebenschlussauss. in 200 Umdrehungen. [RAM name from V530, interpolated]" UWORD M_FORMULA_0563 0 0 0 257 ECU_ADDRESS 0x3FBE9C /end MEASUREMENT
/begin MEASUREMENT auss_obd_sum_kat_ns_zyl2 "Gew. Summe kat. Nebenschlussauss. in 200 Umdrehungen. [RAM name from V530, interpolated]" UWORD M_FORMULA_0563 0 0 0 257 ECU_ADDRESS 0x3FBE8C /end MEASUREMENT
/begin MEASUREMENT auss_obd_sum_kat_ns_zyl3 "Gew. Summe kat. Nebenschlussauss. in 200 Umdrehungen. [RAM name from V530, interpolated]" UWORD M_FORMULA_0563 0 0 0 257 ECU_ADDRESS 0x3FBE8E /end MEASUREMENT
/begin MEASUREMENT auss_obd_sum_kat_ns_zyl4 "Gew. Summe kat. Nebenschlussauss. in 200 Umdrehungen. [RAM name from V530, interpolated]" UWORD M_FORMULA_0563 0 0 0 257 ECU_ADDRESS 0x3FBE90 /end MEASUREMENT
/begin MEASUREMENT auss_obd_sum_kat_ns_zyl5 "Gew. Summe kat. Nebenschlussauss. in 200 Umdrehungen. [RAM name from V530, interpolated]" UWORD M_FORMULA_0563 0 0 0 257 ECU_ADDRESS 0x3FBE92 /end MEASUREMENT
/begin MEASUREMENT auss_obd_sum_kat_ns_zyl6 "Gew. Summe kat. Nebenschlussauss. in 200 Umdrehungen. [RAM name from V530, interpolated]" UWORD M_FORMULA_0563 0 0 0 257 ECU_ADDRESS 0x3FBE94 /end MEASUREMENT
/begin MEASUREMENT auss_obd_sum_kat_ns_zyl7 "Gew. Summe kat. Nebenschlussauss. in 200 Umdrehungen. [RAM name from V530, interpolated]" UWORD M_FORMULA_0563 0 0 0 257 ECU_ADDRESS 0x3FBE96 /end MEASUREMENT
/begin MEASUREMENT auss_obd_sum_kat_ns_zyl8 "Gew. Summe kat. Nebenschlussauss. in 200 Umdrehungen. [RAM name from V530, interpolated]" UWORD M_FORMULA_0563 0 0 0 257 ECU_ADDRESS 0x3FBE98 /end MEASUREMENT
/begin MEASUREMENT auss_obd_sum_kat_ns_zyl9 "Gew. Summe kat. Nebenschlussauss. in 200 Umdrehungen. [RAM name from V530, interpolated]" UWORD M_FORMULA_0563 0 0 0 257 ECU_ADDRESS 0x3FBE9A /end MEASUREMENT
/begin MEASUREMENT debug_rw_result "Result Read/-Write Operation [RAM name from V530, interpolated]" ULONG M_FORMULA_0000 0 0 0 4294967295 ECU_ADDRESS 0x3FBF38 /end MEASUREMENT
/begin MEASUREMENT diag_st_atic29_ion1_spg "Diagnosestatus ATIC29 Treiber Queue IGN [RAM name from V530, interpolated]" UBYTE NO_COMPU_METHOD 0 0 0 255 ECU_ADDRESS 0x3FBF41 FORMAT "%.4g" /end MEASUREMENT
/begin MEASUREMENT diag_st_atic29_ion1_verst "Diagnosestatus ATIC29 Treiber Queue IGN [RAM name from V530, interpolated]" UBYTE NO_COMPU_METHOD 0 0 0 255 ECU_ADDRESS 0x3FBF40 FORMAT "%.4g" /end MEASUREMENT
/begin MEASUREMENT diag_st_atic29_ion2_spg "Diagnosestatus ATIC29 Treiber Queue IGN [RAM name from V530, interpolated]" UBYTE NO_COMPU_METHOD 0 0 0 255 ECU_ADDRESS 0x3FBF43 FORMAT "%.4g" /end MEASUREMENT
/begin MEASUREMENT diag_st_atic29_ion2_verst "Diagnosestatus ATIC29 Treiber Queue IGN [RAM name from V530, interpolated]" UBYTE NO_COMPU_METHOD 0 0 0 255 ECU_ADDRESS 0x3FBF42 FORMAT "%.4g" /end MEASUREMENT
/begin MEASUREMENT diag_st_atic29_nn "Diagnosestatus ATIC29 Treiber Queue IGN [RAM name from V530, interpolated]" UBYTE NO_COMPU_METHOD 0 0 0 255 ECU_ADDRESS 0x3FBF3F FORMAT "%.4g" /end MEASUREMENT
/begin MEASUREMENT diag_tr_atic29_error "Error Zaheler Atic29 [RAM name from V530, interpolated]" UBYTE M_FORMULA_0037 0 0 0 255 ECU_ADDRESS 0x3FBF3E /end MEASUREMENT
/begin MEASUREMENT diag_tr_atic29_st "Diagnosetreiberstatus [RAM name from V530, interpolated]" UBYTE NO_COMPU_METHOD 0 0 0 255 ECU_ADDRESS 0x3FBF44 FORMAT "%.4g" /end MEASUREMENT
/begin MEASUREMENT diag_tr_atic29_tx_cnt "Checkbyte fuer die Queue [RAM name from V530, interpolated]" UBYTE M_FORMULA_0037 0 0 0 255 ECU_ADDRESS 0x3FBF3D /end MEASUREMENT
/begin MEASUREMENT dkg_kupp_schleif "Verlustmoment der Kupplung [RAM name from V530, interpolated]" SWORD M_FORMULA_0009 0 0 -3276.8 3276.7 ECU_ADDRESS 0x3FBF54 /end MEASUREMENT
/begin MEASUREMENT dkg_md_kupp_begr "DKG-Begrenzung [RAM name from V530, interpolated]" SWORD M_FORMULA_0009 0 0 -3276.8 3276.7 ECU_ADDRESS 0x3FBF52 /end MEASUREMENT
/begin MEASUREMENT dkg_md_ml_erh "DKG-Eingriff Luft erh. [RAM name from V530, interpolated]" SWORD M_FORMULA_0009 0 0 -3276.8 3276.7 ECU_ADDRESS 0x3FBF4E /end MEASUREMENT
/begin MEASUREMENT dkg_md_ml_red "DKG-Eingriff Luft red. [RAM name from V530, interpolated]" SWORD M_FORMULA_0009 0 0 -3276.8 3276.7 ECU_ADDRESS 0x3FBF4A /end MEASUREMENT
/begin MEASUREMENT dkg_md_n_reg_ml "DKG-nRegler Luft [RAM name from V530, interpolated]" SWORD M_FORMULA_0009 0 0 -3276.8 3276.7 ECU_ADDRESS 0x3FBF46 /end MEASUREMENT
/begin MEASUREMENT dkg_md_n_reg_tz "DKG-nRegler TZ [RAM name from V530, interpolated]" SWORD M_FORMULA_0009 0 0 -3276.8 3276.7 ECU_ADDRESS 0x3FBF48 /end MEASUREMENT
/begin MEASUREMENT dkg_md_tz_erh "DKG-Eingriff TZ erh. [RAM name from V530, interpolated]" SWORD M_FORMULA_0009 0 0 -3276.8 3276.7 ECU_ADDRESS 0x3FBF50 /end MEASUREMENT
/begin MEASUREMENT dkg_md_tz_red "DKG-Eingriff TZ red. [RAM name from V530, interpolated]" SWORD M_FORMULA_0009 0 0 -3276.8 3276.7 ECU_ADDRESS 0x3FBF4C /end MEASUREMENT
/begin MEASUREMENT ed_debug_laufzeit "Laufzeitmessung [RAM name from V530, interpolated]" ULONG M_FORMULA_0072 0 0 0 4294967295 ECU_ADDRESS 0x3FC040 /end MEASUREMENT
/begin MEASUREMENT egas_aq_soll_fil_b1 "AQ-Soll gefilteret [RAM name from V530, interpolated]" UWORD M_FORMULA_0143 0 0 0 6553.5 ECU_ADDRESS 0x3FC05A /end MEASUREMENT
/begin MEASUREMENT egas_aq_soll_fil_b2 "AQ-Soll gefilteret [RAM name from V530, interpolated]" UWORD M_FORMULA_0143 0 0 0 6553.5 ECU_ADDRESS 0x3FC05C /end MEASUREMENT
/begin MEASUREMENT egas_aq_soll_lls_b2 "AQ-Soll fuer LLS [RAM name from V530, interpolated]" UWORD M_FORMULA_0143 0 0 0 6553.5 ECU_ADDRESS 0x3FC060 /end MEASUREMENT
/begin MEASUREMENT egas_aq_soll_dk_b2 "AQ-Soll fuer DK [RAM name from V530, interpolated]" UWORD M_FORMULA_0143 0 0 0 6553.5 ECU_ADDRESS 0x3FC064 /end MEASUREMENT
/begin MEASUREMENT egas_wdk_b1.a0_max "max. Wert der Adaption [RAM name from V530, interpolated]" SWORD M_FORMULA_0250 0 0 -160 159.9951172 ECU_ADDRESS 0x3FC06E /end MEASUREMENT
/begin MEASUREMENT egas_wdk_b1.a0_min "min. Wert der Adaption [RAM name from V530, interpolated]" SWORD M_FORMULA_0250 0 0 -160 159.9951172 ECU_ADDRESS 0x3FC06C /end MEASUREMENT
/begin MEASUREMENT egas_wdk_b1.a0_vgl "Vergleichswert der Adaption [RAM name from V530, interpolated]" SWORD M_FORMULA_0250 0 0 -160 159.9951172 ECU_ADDRESS 0x3FC070 /end MEASUREMENT
/begin MEASUREMENT egas_wdk_b1.a0_sum "Adaptionssumme [RAM name from V530, interpolated]" SLONG M_FORMULA_0583 0 0 -10485760 10485760 ECU_ADDRESS 0x3FC074 /end MEASUREMENT
/begin MEASUREMENT egas_wdk_b1.a0_time "Timer fuer Vgl-Wert [RAM name from V530, interpolated]" UBYTE M_FORMULA_0584 0 0 0 1275 ECU_ADDRESS 0x3FC079 /end MEASUREMENT
/begin MEASUREMENT egas_wdk_b2.a0_max "max. Wert der Adaption [RAM name from V530, interpolated]" SWORD M_FORMULA_0250 0 0 -160 159.9951172 ECU_ADDRESS 0x3FC082 /end MEASUREMENT
/begin MEASUREMENT egas_wdk_b2.a0_min "min. Wert der Adaption [RAM name from V530, interpolated]" SWORD M_FORMULA_0250 0 0 -160 159.9951172 ECU_ADDRESS 0x3FC080 /end MEASUREMENT
/begin MEASUREMENT egas_wdk_b2.a0_vgl "Vergleichswert der Adaption [RAM name from V530, interpolated]" SWORD M_FORMULA_0250 0 0 -160 159.9951172 ECU_ADDRESS 0x3FC084 /end MEASUREMENT
/begin MEASUREMENT egas_wdk_b2.abs "korr. U_WDK [RAM name from V530, interpolated]" SWORD M_FORMULA_0250 0 0 -160 159.9951172 ECU_ADDRESS 0x3FC07E /end MEASUREMENT
/begin MEASUREMENT egas_wdk_b2.abs_roh "nicht korr. U_WDK [RAM name from V530, interpolated]" SWORD M_FORMULA_0250 0 0 -160 159.9951172 ECU_ADDRESS 0x3FC07C /end MEASUREMENT
/begin MEASUREMENT egas_wdk_b2.a0_cnt "Adaptionszaehler [RAM name from V530, interpolated]" UBYTE M_FORMULA_0003 0 0 0 255 ECU_ADDRESS 0x3FC08C /end MEASUREMENT
/begin MEASUREMENT egas_wdk_b2.a0_sum "Adaptionssumme [RAM name from V530, interpolated]" SLONG M_FORMULA_0583 0 0 -10485760 10485760 ECU_ADDRESS 0x3FC088 /end MEASUREMENT
/begin MEASUREMENT egas_wdk_b2.a0_time "Timer fuer Vgl-Wert [RAM name from V530, interpolated]" UBYTE M_FORMULA_0584 0 0 0 1275 ECU_ADDRESS 0x3FC08D /end MEASUREMENT
/begin MEASUREMENT egas_dk_b1.r_adapt_st "R-Adaption [RAM name from V530, interpolated]" UBYTE NO_COMPU_METHOD 0 0 0 255 ECU_ADDRESS 0x3FC091 FORMAT "%.4g" /end MEASUREMENT
/begin MEASUREMENT egas_dk_b1.state_time "Zeit im akt. State [RAM name from V530, interpolated]" UWORD M_FORMULA_0590 0 0 0 327.675 ECU_ADDRESS 0x3FC0A0 /end MEASUREMENT
/begin MEASUREMENT egas_dk_b1.alive_err "Zaehler Aliveerror [RAM name from V530, interpolated]" UBYTE M_FORMULA_0003 0 0 0 255 ECU_ADDRESS 0x3FC0A3 /end MEASUREMENT
/begin MEASUREMENT egas_dk_b2.r_adapt_st "R-Adaption [RAM name from V530, interpolated]" UBYTE NO_COMPU_METHOD 0 0 0 255 ECU_ADDRESS 0x3FC0AD FORMAT "%.4g" /end MEASUREMENT
/begin MEASUREMENT egas_dk_b2.mode "Mode [RAM name from V530, interpolated]" UBYTE NO_COMPU_METHOD 0 0 0 255 ECU_ADDRESS 0x3FC0B8 FORMAT "%.4g" /end MEASUREMENT
/begin MEASUREMENT egas_dk_b2.state_time "Zeit im akt. State [RAM name from V530, interpolated]" UWORD M_FORMULA_0590 0 0 0 327.675 ECU_ADDRESS 0x3FC0BC /end MEASUREMENT
/begin MEASUREMENT egas_dk_b2.alive_err "Zaehler Aliveerror [RAM name from V530, interpolated]" UBYTE M_FORMULA_0003 0 0 0 255 ECU_ADDRESS 0x3FC0BF /end MEASUREMENT
/begin MEASUREMENT egas_lls_b1.r_adapt_st "Adaptionsstatus [RAM name from V530, interpolated]" UBYTE NO_COMPU_METHOD 0 0 0 255 ECU_ADDRESS 0x3FC0C9 FORMAT "%.4g" /end MEASUREMENT
/begin MEASUREMENT egas_lls_b1.state_time "Zeit im akt. State [RAM name from V530, interpolated]" UWORD M_FORMULA_0590 0 0 0 327.675 ECU_ADDRESS 0x3FC0D8 /end MEASUREMENT
/begin MEASUREMENT egas_lls_b1.alive_err "Zaehler Aliveerror [RAM name from V530, interpolated]" UBYTE M_FORMULA_0003 0 0 0 255 ECU_ADDRESS 0x3FC0DB /end MEASUREMENT
/begin MEASUREMENT egas_lls_b2.r_gpos "Istwert (roh) [RAM name from V530, interpolated]" SWORD M_FORMULA_0001 0 0 -3276.8 3276.7 ECU_ADDRESS 0x3FC0B2 /end MEASUREMENT
/begin MEASUREMENT egas_lls_b2.state_time "Zeit im akt. State [RAM name from V530, interpolated]" UWORD M_FORMULA_0590 0 0 0 327.675 ECU_ADDRESS 0x3FC0F4 /end MEASUREMENT
/begin MEASUREMENT egas_lls_b2.alive_err "Zaehler Aliveerror [RAM name from V530, interpolated]" UBYTE M_FORMULA_0003 0 0 0 255 ECU_ADDRESS 0x3FC0F7 /end MEASUREMENT
/begin MEASUREMENT egas_snd_lls.cmd_b1_fifo_2of5_ "CMD-B2 [RAM name from V530, interpolated]" UBYTE NO_COMPU_METHOD 0 0 0 255 ECU_ADDRESS 0x3FC107 FORMAT "%.4g" /end MEASUREMENT
/begin MEASUREMENT egas_snd_lls.cmd_b1_fifo_3of5_ "CMD-B2 [RAM name from V530, interpolated]" UBYTE NO_COMPU_METHOD 0 0 0 255 ECU_ADDRESS 0x3FC108 FORMAT "%.4g" /end MEASUREMENT
/begin MEASUREMENT egas_snd_lls.cmd_b1_fifo_4of5_ "CMD-B2 [RAM name from V530, interpolated]" UBYTE NO_COMPU_METHOD 0 0 0 255 ECU_ADDRESS 0x3FC109 FORMAT "%.4g" /end MEASUREMENT
/begin MEASUREMENT egas_snd_lls.cmd_b2_fifo_2of5_ "CMD-B2 [RAM name from V530, interpolated]" UBYTE NO_COMPU_METHOD 0 0 0 255 ECU_ADDRESS 0x3FC10C FORMAT "%.4g" /end MEASUREMENT
/begin MEASUREMENT egas_snd_lls.cmd_b2_fifo_3of5_ "CMD-B2 [RAM name from V530, interpolated]" UBYTE NO_COMPU_METHOD 0 0 0 255 ECU_ADDRESS 0x3FC10D FORMAT "%.4g" /end MEASUREMENT
/begin MEASUREMENT egas_snd_lls.cmd_b2_fifo_4of5_ "CMD-B2 [RAM name from V530, interpolated]" UBYTE NO_COMPU_METHOD 0 0 0 255 ECU_ADDRESS 0x3FC10E FORMAT "%.4g" /end MEASUREMENT
/begin MEASUREMENT egas_rec_lls_b1.r_bank "Zylinder [RAM name from V530, interpolated]" UBYTE M_FORMULA_0003 0 0 0 255 ECU_ADDRESS 0x3FC11C /end MEASUREMENT
/begin MEASUREMENT egas_rec_lls_b1.r_cmd "R-CMD-B1 [RAM name from V530, interpolated]" UBYTE NO_COMPU_METHOD 0 0 0 255 ECU_ADDRESS 0x3FC11B FORMAT "%.4g" /end MEASUREMENT
/begin MEASUREMENT egas_rec_lls_b1.r_hw_vers "HW-Version [RAM name from V530, interpolated]" UWORD M_FORMULA_0010 0 0 0 65535 ECU_ADDRESS 0x3FC11E /end MEASUREMENT
/begin MEASUREMENT egas_rec_lls_b1.cs_err "CS-Error [RAM name from V530, interpolated]" UBYTE M_FORMULA_0003 0 0 0 255 ECU_ADDRESS 0x3FC125 /end MEASUREMENT
/begin MEASUREMENT egas_rec_lls_b1.r_diag_st "Diagnosestatus [RAM name from V530, interpolated]" UWORD M_FORMULA_0010 0 0 0 65535 ECU_ADDRESS 0x3FC122 /end MEASUREMENT
/begin MEASUREMENT egas_rec_lls_b1.r_set_vers "Kommunikationsversion [RAM name from V530, interpolated]" UBYTE M_FORMULA_0003 0 0 0 255 ECU_ADDRESS 0x3FC124 /end MEASUREMENT
/begin MEASUREMENT egas_rec_lls_b1.ed "ED-Status [RAM name from V530, interpolated]" UWORD NO_COMPU_METHOD 0 0 0 65535 ECU_ADDRESS 0x3FC12C FORMAT "%.4g" /end MEASUREMENT
/begin MEASUREMENT egas_rec_lls_b2.cs_err "CS-Error [RAM name from V530, interpolated]" UBYTE M_FORMULA_0003 0 0 0 255 ECU_ADDRESS 0x3FC139 /end MEASUREMENT
/begin MEASUREMENT egas_rec_lls_b2.r_bank "Zylinder [RAM name from V530, interpolated]" UBYTE M_FORMULA_0003 0 0 0 255 ECU_ADDRESS 0x3FC130 /end MEASUREMENT
/begin MEASUREMENT egas_rec_lls_b2.r_cmd "R-CMD-B1 [RAM name from V530, interpolated]" UBYTE NO_COMPU_METHOD 0 0 0 255 ECU_ADDRESS 0x3FC12F FORMAT "%.4g" /end MEASUREMENT
/begin MEASUREMENT egas_rec_lls_b2.r_diag_st "Diagnosestatus [RAM name from V530, interpolated]" UWORD M_FORMULA_0010 0 0 0 65535 ECU_ADDRESS 0x3FC136 /end MEASUREMENT
/begin MEASUREMENT egas_rec_lls_b2.r_hw_vers "HW-Version [RAM name from V530, interpolated]" UWORD M_FORMULA_0010 0 0 0 65535 ECU_ADDRESS 0x3FC132 /end MEASUREMENT
/begin MEASUREMENT egas_rec_lls_b2.r_ko_vers "Kommunikationsversion [RAM name from V530, interpolated]" UBYTE M_FORMULA_0003 0 0 0 255 ECU_ADDRESS 0x3FC131 /end MEASUREMENT
/begin MEASUREMENT egas_rec_lls_b2.r_set_vers "Kommunikationsversion [RAM name from V530, interpolated]" UBYTE M_FORMULA_0003 0 0 0 255 ECU_ADDRESS 0x3FC138 /end MEASUREMENT
/begin MEASUREMENT egas_rec_lls_b2.r_sw_vers "SW-Version [RAM name from V530, interpolated]" UWORD M_FORMULA_0010 0 0 0 65535 ECU_ADDRESS 0x3FC134 /end MEASUREMENT
/begin MEASUREMENT egas_rec_lls_b2.ed "ED-Status [RAM name from V530, interpolated]" UWORD NO_COMPU_METHOD 0 0 0 65535 ECU_ADDRESS 0x3FC140 FORMAT "%.4g" /end MEASUREMENT
/begin MEASUREMENT egas_rec_lls_bX.cs_err "CS-Error [RAM name from V530, interpolated]" UBYTE M_FORMULA_0003 0 0 0 255 ECU_ADDRESS 0x3FC14D /end MEASUREMENT
/begin MEASUREMENT egas_rec_lls_bX.r_bank "Zylinder [RAM name from V530, interpolated]" UBYTE M_FORMULA_0003 0 0 0 255 ECU_ADDRESS 0x3FC144 /end MEASUREMENT
/begin MEASUREMENT egas_rec_lls_bX.r_cmd "R-CMD-B1 [RAM name from V530, interpolated]" UBYTE NO_COMPU_METHOD 0 0 0 255 ECU_ADDRESS 0x3FC143 FORMAT "%.4g" /end MEASUREMENT
/begin MEASUREMENT egas_rec_lls_bX.r_diag_st "Diagnosestatus [RAM name from V530, interpolated]" UWORD M_FORMULA_0010 0 0 0 65535 ECU_ADDRESS 0x3FC14A /end MEASUREMENT
/begin MEASUREMENT egas_rec_lls_bX.r_hw_vers "HW-Version [RAM name from V530, interpolated]" UWORD M_FORMULA_0010 0 0 0 65535 ECU_ADDRESS 0x3FC146 /end MEASUREMENT
/begin MEASUREMENT egas_rec_lls_bX.r_ko_vers "Kommunikationsversion [RAM name from V530, interpolated]" UBYTE M_FORMULA_0003 0 0 0 255 ECU_ADDRESS 0x3FC145 /end MEASUREMENT
/begin MEASUREMENT egas_rec_lls_bX.r_set_vers "Kommunikationsversion [RAM name from V530, interpolated]" UBYTE M_FORMULA_0003 0 0 0 255 ECU_ADDRESS 0x3FC14C /end MEASUREMENT
/begin MEASUREMENT egas_rec_lls_bX.r_sw_vers "SW-Version [RAM name from V530, interpolated]" UWORD M_FORMULA_0010 0 0 0 65535 ECU_ADDRESS 0x3FC148 /end MEASUREMENT
/begin MEASUREMENT egas_rec_lls_bX.ed "ED-Status [RAM name from V530, interpolated]" UWORD NO_COMPU_METHOD 0 0 0 65535 ECU_ADDRESS 0x3FC154 FORMAT "%.4g" /end MEASUREMENT
/begin MEASUREMENT egas_rec_lls_bX.rec_err "Receive-Error [RAM name from V530, interpolated]" UWORD M_FORMULA_0080 0 0 0 65535 ECU_ADDRESS 0x3FC152 /end MEASUREMENT
/begin MEASUREMENT egas_snd_dk.cmd_b1_fifo_2of5_ "CMD-B2 [RAM name from V530, interpolated]" UBYTE NO_COMPU_METHOD 0 0 0 255 ECU_ADDRESS 0x3FC159 FORMAT "%.4g" /end MEASUREMENT
/begin MEASUREMENT egas_snd_dk.cmd_b1_fifo_3of5_ "CMD-B2 [RAM name from V530, interpolated]" UBYTE NO_COMPU_METHOD 0 0 0 255 ECU_ADDRESS 0x3FC15A FORMAT "%.4g" /end MEASUREMENT
/begin MEASUREMENT egas_snd_dk.cmd_b1_fifo_4of5_ "CMD-B2 [RAM name from V530, interpolated]" UBYTE NO_COMPU_METHOD 0 0 0 255 ECU_ADDRESS 0x3FC15B FORMAT "%.4g" /end MEASUREMENT
/begin MEASUREMENT egas_snd_dk.cmd_b2_fifo_2of5_ "CMD-B2 [RAM name from V530, interpolated]" UBYTE NO_COMPU_METHOD 0 0 0 255 ECU_ADDRESS 0x3FC15E FORMAT "%.4g" /end MEASUREMENT
/begin MEASUREMENT egas_snd_dk.cmd_b2_fifo_3of5_ "CMD-B2 [RAM name from V530, interpolated]" UBYTE NO_COMPU_METHOD 0 0 0 255 ECU_ADDRESS 0x3FC15F FORMAT "%.4g" /end MEASUREMENT
/begin MEASUREMENT egas_snd_dk.cmd_b2_fifo_4of5_ "CMD-B2 [RAM name from V530, interpolated]" UBYTE NO_COMPU_METHOD 0 0 0 255 ECU_ADDRESS 0x3FC160 FORMAT "%.4g" /end MEASUREMENT
/begin MEASUREMENT egas_rec_dk_b1.r_cmd "R-CMD-B1 [RAM name from V530, interpolated]" UBYTE NO_COMPU_METHOD 0 0 0 255 ECU_ADDRESS 0x3FC16D FORMAT "%.4g" /end MEASUREMENT
/begin MEASUREMENT egas_rec_dk_b1.r_diag_st "Diagnosestatus [RAM name from V530, interpolated]" UWORD NO_COMPU_METHOD 0 0 0 65535 ECU_ADDRESS 0x3FC174 FORMAT "%.4g" /end MEASUREMENT
/begin MEASUREMENT egas_rec_dk_b1.cs_err "CS-Error [RAM name from V530, interpolated]" UBYTE M_FORMULA_0003 0 0 0 255 ECU_ADDRESS 0x3FC177 /end MEASUREMENT
/begin MEASUREMENT egas_rec_dk_b1.ed "ED-Status [RAM name from V530, interpolated]" UWORD NO_COMPU_METHOD 0 0 0 65535 ECU_ADDRESS 0x3FC17E FORMAT "%.4g" /end MEASUREMENT
/begin MEASUREMENT egas_rec_dk_b2.r_cmd "R-CMD-B1 [RAM name from V530, interpolated]" UBYTE NO_COMPU_METHOD 0 0 0 255 ECU_ADDRESS 0x3FC181 FORMAT "%.4g" /end MEASUREMENT
/begin MEASUREMENT egas_rec_dk_b2.r_diag_st "Diagnosestatus [RAM name from V530, interpolated]" UWORD NO_COMPU_METHOD 0 0 0 65535 ECU_ADDRESS 0x3FC188 FORMAT "%.4g" /end MEASUREMENT
/begin MEASUREMENT egas_rec_dk_b2.r_sw_vers "SW-Version [RAM name from V530, interpolated]" UWORD M_FORMULA_0010 0 0 0 65535 ECU_ADDRESS 0x3FC186 /end MEASUREMENT
/begin MEASUREMENT egas_rec_dk_b2.cs_err "CS-Error [RAM name from V530, interpolated]" UBYTE M_FORMULA_0003 0 0 0 255 ECU_ADDRESS 0x3FC18B /end MEASUREMENT
/begin MEASUREMENT egas_rec_dk_b2.ed "ED-Status [RAM name from V530, interpolated]" UWORD NO_COMPU_METHOD 0 0 0 65535 ECU_ADDRESS 0x3FC192 FORMAT "%.4g" /end MEASUREMENT
/begin MEASUREMENT egas_rec_dk_bX.cs_err "CS-Error [RAM name from V530, interpolated]" UBYTE M_FORMULA_0003 0 0 0 255 ECU_ADDRESS 0x3FC19F /end MEASUREMENT
/begin MEASUREMENT egas_rec_dk_bX.r_bank "Zylinder [RAM name from V530, interpolated]" UBYTE M_FORMULA_0003 0 0 0 255 ECU_ADDRESS 0x3FC196 /end MEASUREMENT
/begin MEASUREMENT egas_rec_dk_bX.r_cmd "R-CMD-B1 [RAM name from V530, interpolated]" UBYTE NO_COMPU_METHOD 0 0 0 255 ECU_ADDRESS 0x3FC195 FORMAT "%.4g" /end MEASUREMENT
/begin MEASUREMENT egas_rec_dk_bX.r_diag_st "Diagnosestatus [RAM name from V530, interpolated]" UWORD NO_COMPU_METHOD 0 0 0 65535 ECU_ADDRESS 0x3FC19C FORMAT "%.4g" /end MEASUREMENT
/begin MEASUREMENT egas_rec_dk_bX.r_hw_vers "HW-Version [RAM name from V530, interpolated]" UWORD M_FORMULA_0010 0 0 0 65535 ECU_ADDRESS 0x3FC198 /end MEASUREMENT
/begin MEASUREMENT egas_rec_dk_bX.r_ko_vers "Kommunikationsversion [RAM name from V530, interpolated]" UBYTE M_FORMULA_0003 0 0 0 255 ECU_ADDRESS 0x3FC197 /end MEASUREMENT
/begin MEASUREMENT egas_rec_dk_bX.r_set_vers "Kommunikationsversion [RAM name from V530, interpolated]" UBYTE M_FORMULA_0003 0 0 0 255 ECU_ADDRESS 0x3FC19E /end MEASUREMENT
/begin MEASUREMENT egas_rec_dk_bX.r_sw_vers "SW-Version [RAM name from V530, interpolated]" UWORD M_FORMULA_0010 0 0 0 65535 ECU_ADDRESS 0x3FC19A /end MEASUREMENT
/begin MEASUREMENT egas_rec_dk_bX.ed "ED-Status [RAM name from V530, interpolated]" UWORD NO_COMPU_METHOD 0 0 0 65535 ECU_ADDRESS 0x3FC1A6 FORMAT "%.4g" /end MEASUREMENT
/begin MEASUREMENT egas_rec_dk_bX.rec_err "Receive-Error [RAM name from V530, interpolated]" UWORD M_FORMULA_0080 0 0 0 65535 ECU_ADDRESS 0x3FC1A4 /end MEASUREMENT
/begin MEASUREMENT egas_sk_b1.dk_diff_max "max. Differenz Soll/Ist [RAM name from V530, interpolated]" SWORD M_FORMULA_0001 0 0 -3276.8 3276.7 ECU_ADDRESS 0x3FC1AA /end MEASUREMENT
/begin MEASUREMENT egas_sk_b1.t_dk_offen_1 "Zeit fuer Spalt offen [RAM name from V530, interpolated]" UWORD M_FORMULA_0021 0 0 0 655.35 ECU_ADDRESS 0x3FC1BC /end MEASUREMENT
/begin MEASUREMENT egas_sk_b1.t_dk_offen_2 "Zeit fuer Klemmen offen [RAM name from V530, interpolated]" UWORD M_FORMULA_0021 0 0 0 655.35 ECU_ADDRESS 0x3FC1BE /end MEASUREMENT
/begin MEASUREMENT egas_sk_b1.t_ist_dk "Zeit Soll-/Istabweichung [RAM name from V530, interpolated]" UWORD M_FORMULA_0021 0 0 0 655.35 ECU_ADDRESS 0x3FC1B2 /end MEASUREMENT
/begin MEASUREMENT egas_sk_b1.t_ist_lls "Zeit Soll-/Istabweichung [RAM name from V530, interpolated]" UWORD M_FORMULA_0021 0 0 0 655.35 ECU_ADDRESS 0x3FC1B4 /end MEASUREMENT
/begin MEASUREMENT egas_sk_b1.t_mode_dk "Zeit DK-Modeabweichung [RAM name from V530, interpolated]" UWORD M_FORMULA_0021 0 0 0 655.35 ECU_ADDRESS 0x3FC1BA /end MEASUREMENT
/begin MEASUREMENT egas_sk_b1.t_mode_lls "Zeit LLS-Modeabweichung [RAM name from V530, interpolated]" UWORD M_FORMULA_0021 0 0 0 655.35 ECU_ADDRESS 0x3FC1B8 /end MEASUREMENT
/begin MEASUREMENT egas_sk_b1.t_soll_dk "Zeit Sollwertabweichung [RAM name from V530, interpolated]" UWORD M_FORMULA_0021 0 0 0 655.35 ECU_ADDRESS 0x3FC1AE /end MEASUREMENT
/begin MEASUREMENT egas_sk_b1.t_soll_lls "Zeit Sollwertabweichung [RAM name from V530, interpolated]" UWORD M_FORMULA_0021 0 0 0 655.35 ECU_ADDRESS 0x3FC1B0 /end MEASUREMENT
/begin MEASUREMENT egas_sk_b1.t_wdk "Zeit Analog-/CAN-Abweichung [RAM name from V530, interpolated]" UWORD M_FORMULA_0021 0 0 0 655.35 ECU_ADDRESS 0x3FC1B6 /end MEASUREMENT
/begin MEASUREMENT egas_sk_b1.wdk_diff_max "max. Differenz CAN/WDK [RAM name from V530, interpolated]" SWORD M_FORMULA_0001 0 0 -3276.8 3276.7 ECU_ADDRESS 0x3FC1AC /end MEASUREMENT
/begin MEASUREMENT egas_dk_fil_fail "DK-Fehlerfilter [RAM name from V530, interpolated]" UBYTE NO_COMPU_METHOD 0 0 0 255 ECU_ADDRESS 0x3FC204 FORMAT "%.4g" /end MEASUREMENT
/begin MEASUREMENT egas_exd_dk_state "Status ext. DK-Diagnose [RAM name from V530, interpolated]" UBYTE NO_COMPU_METHOD 0 0 0 255 ECU_ADDRESS 0x3FC205 FORMAT "%.4g" /end MEASUREMENT
/begin MEASUREMENT egas_exd_lls_state "Status ext. LLS-Diagnose [RAM name from V530, interpolated]" UBYTE NO_COMPU_METHOD 0 0 0 255 ECU_ADDRESS 0x3FC206 FORMAT "%.4g" /end MEASUREMENT
/begin MEASUREMENT egas_exd_ks_time_dn_b2 "Zeit Kleinsprung Down [RAM name from V530, interpolated]" UWORD M_FORMULA_0623 0 0 0 327.675 ECU_ADDRESS 0x3FC214 /end MEASUREMENT
/begin MEASUREMENT egas_exd_gs_time_dn_b1 "Zeit Grosssprung Down [RAM name from V530, interpolated]" UWORD M_FORMULA_0623 0 0 0 327.675 ECU_ADDRESS 0x3FC21A /end MEASUREMENT
/begin MEASUREMENT egas_exd_gs_time_dn_b2 "Zeit Grosssprung Down [RAM name from V530, interpolated]" UWORD M_FORMULA_0623 0 0 0 327.675 ECU_ADDRESS 0x3FC21C /end MEASUREMENT
/begin MEASUREMENT egas_exd_gs_time_up_b2 "Zeit Grosssprung Up [RAM name from V530, interpolated]" UWORD M_FORMULA_0623 0 0 0 327.675 ECU_ADDRESS 0x3FC218 /end MEASUREMENT
/begin MEASUREMENT egas_exd_r2_ra_max_b2 "max. Regeldifferenz Oeffnen 2 [RAM name from V530, interpolated]" SWORD M_FORMULA_0001 0 0 -3276.8 3276.7 ECU_ADDRESS 0x3FC224 /end MEASUREMENT
/begin MEASUREMENT egas_exd_r1_tv_sum_b2 "Integral Tastverhaeltnis Oeffnen 1 [RAM name from V530, interpolated]" ULONG M_FORMULA_0624 0 0 0 3355443199 ECU_ADDRESS 0x3FC230 /end MEASUREMENT
/begin MEASUREMENT egas_exd_r2_tv_sum_b2 "Integral Tastverhaeltnis Oeffnen 2 [RAM name from V530, interpolated]" ULONG M_FORMULA_0624 0 0 0 3355443199 ECU_ADDRESS 0x3FC238 /end MEASUREMENT
/begin MEASUREMENT egas_exd_r1_tv_mw_b2 "Mittelwert Tastverhaeltnis Oeffnen 1 [RAM name from V530, interpolated]" SLONG M_FORMULA_0624 0 0 -1677721600 1677721599 ECU_ADDRESS 0x3FC248 /end MEASUREMENT
/begin MEASUREMENT egas_exd_r2_tv_mw_b2 "Mittelwert Tastverhaeltnis Oeffnen 2 [RAM name from V530, interpolated]" SLONG M_FORMULA_0624 0 0 -1677721600 1677721599 ECU_ADDRESS 0x3FC250 /end MEASUREMENT
/begin MEASUREMENT egas_exd_r2_ra_sum_b2 "Integral Regelabweichung Oeffnen 1 [RAM name from V530, interpolated]" ULONG M_FORMULA_0625 0 0 0 429496729.5 ECU_ADDRESS 0x3FC268 /end MEASUREMENT
/begin MEASUREMENT fgr_b_dsc_reg_eingriff "DSC Regelung/Eingriff [RAM name from V530, interpolated]" UBYTE NO_COMPU_METHOD 0 0 0 255 ECU_ADDRESS 0x3FC50C FORMAT "%.4g" /end MEASUREMENT
/begin MEASUREMENT fr_iant_b2 "I-Anteil [RAM name from V530, interpolated]" SWORD M_FORMULA_0671 0 0 -100 99.99694824 ECU_ADDRESS 0x3FC602 /end MEASUREMENT
/begin MEASUREMENT fr_pant_b2 "P-Anteil [RAM name from V530, interpolated]" SWORD M_FORMULA_0672 0 0 -1.000030519 1 ECU_ADDRESS 0x3FC606 /end MEASUREMENT
/begin MEASUREMENT fr_reg_out_b2 "Korrekturfaktor FR-Regler [RAM name from V530, interpolated]" UWORD M_FORMULA_0024 0 0 0 1.999969482 ECU_ADDRESS 0x3FC60E /end MEASUREMENT
/begin MEASUREMENT fr_abs_abw_b1 "Regelabweichung absolut [RAM name from V530, interpolated]" SWORD M_FORMULA_0670 0 0 -1.000030519 1 ECU_ADDRESS 0x3FC612 /end MEASUREMENT
/begin MEASUREMENT fr_abs_abw_b2 "Regelabweichung absolut [RAM name from V530, interpolated]" SWORD M_FORMULA_0670 0 0 -1.000030519 1 ECU_ADDRESS 0x3FC614 /end MEASUREMENT
/begin MEASUREMENT fr_in_b2 "Fuellungsregler Eingang [RAM name from V530, interpolated]" UWORD M_FORMULA_0024 0 0 0 1.999969482 ECU_ADDRESS 0x3FC618 /end MEASUREMENT
/begin MEASUREMENT fr_rf_delta_b2 "Regelabweichung (Soll-Ist) [RAM name from V530, interpolated]" SWORD M_FORMULA_0024 0 0 -1 0.9999694824 ECU_ADDRESS 0x3FC622 /end MEASUREMENT
/begin MEASUREMENT fra_loli_lern_f_b1 "FRA Lolimot Lernausgang [RAM name from V530, interpolated]" FLOAT32_IEEE M_FORMULA_0044 0 0 -1e+30 1e+30 ECU_ADDRESS 0x3FC6D4 /end MEASUREMENT
/begin MEASUREMENT fra_loli_lern_f_b2 "FRA Lolimot Lernausgang [RAM name from V530, interpolated]" FLOAT32_IEEE M_FORMULA_0044 0 0 -1e+30 1e+30 ECU_ADDRESS 0x3FC6D8 /end MEASUREMENT
/begin MEASUREMENT fra_loli_out_f_b2 "FRA Lolimot Ausgang [RAM name from V530, interpolated]" FLOAT32_IEEE M_FORMULA_0044 0 0 -1e+30 1e+30 ECU_ADDRESS 0x3FC6E0 /end MEASUREMENT
/begin MEASUREMENT sst_rf5_b2 "SST [RAM name from V530, interpolated]" ULONG M_FORMULA_0000 0 0 0 4294967295 ECU_ADDRESS 0x3FC778 /end MEASUREMENT
/begin MEASUREMENT ipk_error_100ms.cnt "Fehlerzaehler [RAM name from V530, interpolated]" UBYTE M_FORMULA_0003 0 0 0 255 ECU_ADDRESS 0x3FC7F4 /end MEASUREMENT
/begin MEASUREMENT ipk_error_100ms.type "Fehlertype [RAM name from V530, interpolated]" UBYTE NO_COMPU_METHOD 0 0 0 255 ECU_ADDRESS 0x3FC7F3 FORMAT "%.4g" /end MEASUREMENT
/begin MEASUREMENT ipk_error_10ms.cnt "Fehlerzaehler [RAM name from V530, interpolated]" UBYTE M_FORMULA_0003 0 0 0 255 ECU_ADDRESS 0x3FC7F2 /end MEASUREMENT
/begin MEASUREMENT ipk_error_10ms.type "Fehlertype [RAM name from V530, interpolated]" UBYTE NO_COMPU_METHOD 0 0 0 255 ECU_ADDRESS 0x3FC7F1 FORMAT "%.4g" /end MEASUREMENT
/begin MEASUREMENT ipk_error_5ms.cnt "Fehlerzaehler [RAM name from V530, interpolated]" UBYTE M_FORMULA_0003 0 0 0 255 ECU_ADDRESS 0x3FC7F0 /end MEASUREMENT
/begin MEASUREMENT ipk_error_5ms.type "Fehlertype [RAM name from V530, interpolated]" UBYTE NO_COMPU_METHOD 0 0 0 255 ECU_ADDRESS 0x3FC7EF FORMAT "%.4g" /end MEASUREMENT
/begin MEASUREMENT ipk_error_bgnd.cnt "Fehlerzaehler [RAM name from V530, interpolated]" UBYTE M_FORMULA_0003 0 0 0 255 ECU_ADDRESS 0x3FC7F6 /end MEASUREMENT
/begin MEASUREMENT ipk_error_bgnd.type "Fehlertype [RAM name from V530, interpolated]" UBYTE NO_COMPU_METHOD 0 0 0 255 ECU_ADDRESS 0x3FC7F5 FORMAT "%.4g" /end MEASUREMENT
/begin MEASUREMENT ipk_error_kwp.cnt "Fehlerzaehler [RAM name from V530, interpolated]" UBYTE M_FORMULA_0003 0 0 0 255 ECU_ADDRESS 0x3FC7F8 /end MEASUREMENT
/begin MEASUREMENT ipk_error_kwp.type "Fehlertype [RAM name from V530, interpolated]" UBYTE NO_COMPU_METHOD 0 0 0 255 ECU_ADDRESS 0x3FC7F7 FORMAT "%.4g" /end MEASUREMENT
/begin MEASUREMENT ipk_error_segm.cnt "Fehlerzaehler [RAM name from V530, interpolated]" UBYTE M_FORMULA_0003 0 0 0 255 ECU_ADDRESS 0x3FC7EE /end MEASUREMENT
/begin MEASUREMENT kr_ab_st "Status Klopfregelung. [RAM name from V530, interpolated]" UWORD M_FORMULA_0010 0 0 0 65535 ECU_ADDRESS 0x3FCC2E /end MEASUREMENT
/begin MEASUREMENT kr_ab_st_zyl1 "Klopfregelung Zylinder 1 aktiv. [RAM name from V530, interpolated]" UWORD NO_COMPU_METHOD 0 0 0 65535 ECU_ADDRESS 0x3FCC2E FORMAT "%.4g" /end MEASUREMENT
/begin MEASUREMENT kr_ab_st_zyl10 "Klopfregelung Zylinder 10 aktiv. [RAM name from V530, interpolated]" UWORD NO_COMPU_METHOD 0 0 0 65535 ECU_ADDRESS 0x3FCC2E FORMAT "%.4g" /end MEASUREMENT
/begin MEASUREMENT kr_ab_st_zyl2 "Klopfregelung Zylinder 2 aktiv. [RAM name from V530, interpolated]" UWORD NO_COMPU_METHOD 0 0 0 65535 ECU_ADDRESS 0x3FCC2E FORMAT "%.4g" /end MEASUREMENT
/begin MEASUREMENT kr_ab_st_zyl3 "Klopfregelung Zylinder 3 aktiv. [RAM name from V530, interpolated]" UWORD NO_COMPU_METHOD 0 0 0 65535 ECU_ADDRESS 0x3FCC2E FORMAT "%.4g" /end MEASUREMENT
/begin MEASUREMENT kr_ab_st_zyl4 "Klopfregelung Zylinder 4 aktiv. [RAM name from V530, interpolated]" UWORD NO_COMPU_METHOD 0 0 0 65535 ECU_ADDRESS 0x3FCC2E FORMAT "%.4g" /end MEASUREMENT
/begin MEASUREMENT kr_ab_st_zyl5 "Klopfregelung Zylinder 5 aktiv. [RAM name from V530, interpolated]" UWORD NO_COMPU_METHOD 0 0 0 65535 ECU_ADDRESS 0x3FCC2E FORMAT "%.4g" /end MEASUREMENT
/begin MEASUREMENT kr_ab_st_zyl6 "Klopfregelung Zylinder 6 aktiv. [RAM name from V530, interpolated]" UWORD NO_COMPU_METHOD 0 0 0 65535 ECU_ADDRESS 0x3FCC2E FORMAT "%.4g" /end MEASUREMENT
/begin MEASUREMENT kr_ab_st_zyl7 "Klopfregelung Zylinder 7 aktiv. [RAM name from V530, interpolated]" UWORD NO_COMPU_METHOD 0 0 0 65535 ECU_ADDRESS 0x3FCC2E FORMAT "%.4g" /end MEASUREMENT
/begin MEASUREMENT kr_ab_st_zyl8 "Klopfregelung Zylinder 8 aktiv. [RAM name from V530, interpolated]" UWORD NO_COMPU_METHOD 0 0 0 65535 ECU_ADDRESS 0x3FCC2E FORMAT "%.4g" /end MEASUREMENT
/begin MEASUREMENT kr_ab_st_zyl9 "Klopfregelung Zylinder 9 aktiv. [RAM name from V530, interpolated]" UWORD NO_COMPU_METHOD 0 0 0 65535 ECU_ADDRESS 0x3FCC2E FORMAT "%.4g" /end MEASUREMENT
/begin MEASUREMENT llr_md_res "LLR-Reserve [RAM name from V530, interpolated]" SWORD M_FORMULA_0009 0 0 -3276.8 3276.7 ECU_ADDRESS 0x3FCFF8 /end MEASUREMENT
/begin MEASUREMENT llr_md_tz "LLR TZ-Eingriff [RAM name from V530, interpolated]" SWORD M_FORMULA_0009 0 0 -3276.8 3276.7 ECU_ADDRESS 0x3FCFFA /end MEASUREMENT
/begin MEASUREMENT llr_md_schw_ist "Istmoment [RAM name from V530, interpolated]" SWORD M_FORMULA_0009 0 0 -3276.8 3276.7 ECU_ADDRESS 0x3FCFFE /end MEASUREMENT
/begin MEASUREMENT llr_md_tz_fil "LLR TZ-Eingriff gefiltert [RAM name from V530, interpolated]" SWORD M_FORMULA_0009 0 0 -3276.8 3276.7 ECU_ADDRESS 0x3FD000 /end MEASUREMENT
/begin MEASUREMENT md_hyp_faktor "Hyp-Faktor [RAM name from V530, interpolated]" UBYTE M_FORMULA_0757 0 0 0 1.9921875 ECU_ADDRESS 0x3FD058 /end MEASUREMENT
/begin MEASUREMENT md_rf_tl_vl "rf_max [RAM name from V530, interpolated]" SWORD M_FORMULA_0007 0 0 -3.2768 3.2767 ECU_ADDRESS 0x3FD056 /end MEASUREMENT
/begin MEASUREMENT md_ind_lw_min "LW-Verluste bei MIN [RAM name from V530, interpolated]" SWORD M_FORMULA_0009 0 0 -3276.8 3276.7 ECU_ADDRESS 0x3FD066 /end MEASUREMENT
/begin MEASUREMENT md_ind_reib "Reibverluste (Summe) [RAM name from V530, interpolated]" SWORD M_FORMULA_0009 0 0 -3276.8 3276.7 ECU_ADDRESS 0x3FD064 /end MEASUREMENT
/begin MEASUREMENT md_ind_reib_abreg "Reibverluste (Abregelung nach Start) [RAM name from V530, interpolated]" SWORD M_FORMULA_0759 0 0 -3276.8 3276.7 ECU_ADDRESS 0x3FD062 /end MEASUREMENT
/begin MEASUREMENT md_ind_min "indiziertes Minimalmoment [RAM name from V530, interpolated]" SWORD M_FORMULA_0009 0 0 -3276.8 3276.7 ECU_ADDRESS 0x3FD07C /end MEASUREMENT
/begin MEASUREMENT md_ind_min_roh "indiziertes Minimalmoment ohne Verbraucher [RAM name from V530, interpolated]" SWORD M_FORMULA_0009 0 0 -3276.8 3276.7 ECU_ADDRESS 0x3FD07A /end MEASUREMENT
/begin MEASUREMENT md_ind_ve "ind. Moment vor Eingriff [RAM name from V530, interpolated]" SWORD M_FORMULA_0009 0 0 -3276.8 3276.7 ECU_ADDRESS 0x3FD086 /end MEASUREMENT
/begin MEASUREMENT md_eta_zw_ve "Wirkungsgrad tz_ve [RAM name from V530, interpolated]" UWORD M_FORMULA_0437 0 0 0 199.9969482 ECU_ADDRESS 0x3FD092 /end MEASUREMENT
/begin MEASUREMENT md_kupp_ist_schw "schwules Istmoment [RAM name from V530, interpolated]" SWORD M_FORMULA_0009 0 0 -3276.8 3276.7 ECU_ADDRESS 0x3FD0B2 /end MEASUREMENT
/begin MEASUREMENT md_kupp_min_schub "min. Kupplungsschubmoment [RAM name from V530, interpolated]" SWORD M_FORMULA_0009 0 0 -3276.8 3276.7 ECU_ADDRESS 0x3FD0B6 /end MEASUREMENT
/begin MEASUREMENT md_kkos_time_res "MaxZeit fuer KKOS-Reserve [RAM name from V530, interpolated]" UWORD M_FORMULA_0021 0 0 0 655.35 ECU_ADDRESS 0x3FD0D4 /end MEASUREMENT
/begin MEASUREMENT md_grad_lsd "LSD-Maximalgradient [RAM name from V530, interpolated]" SWORD M_FORMULA_0786 0 0 -32768 32767 ECU_ADDRESS 0x3FD0F4 /end MEASUREMENT
/begin MEASUREMENT md_grad "Istgradient [RAM name from V530, interpolated]" SWORD M_FORMULA_0786 0 0 -32768 32767 ECU_ADDRESS 0x3FD0FA /end MEASUREMENT
/begin MEASUREMENT md_kupp_grenz_lsd_u "untere Grenze fuer LSD-Bereichsauswahl [RAM name from V530, interpolated]" SWORD M_FORMULA_0009 0 0 -3276.8 3276.7 ECU_ADDRESS 0x3FD0FC /end MEASUREMENT
/begin MEASUREMENT md_abtrieb_bremse "Bremsabtriebsmoment [RAM name from V530, interpolated]" SLONG M_FORMULA_0272 0 0 -214748364.8 214748364.7 ECU_ADDRESS 0x3FD140 /end MEASUREMENT
/begin MEASUREMENT md_kupp_wunsch_ipm "Kupplungswunschmoment IPM [RAM name from V530, interpolated]" SWORD M_FORMULA_0009 0 0 -3276.8 3276.7 ECU_ADDRESS 0x3FD144 /end MEASUREMENT
/begin MEASUREMENT md_sk_pwg "gefilteter Pedalwert [RAM name from V530, interpolated]" SWORD M_FORMULA_0001 0 0 -3276.8 3276.7 ECU_ADDRESS 0x3FD16C /end MEASUREMENT
/begin MEASUREMENT md_ind_ist_skmin "minimal erreichbares Istmoment bei tz_min [RAM name from V530, interpolated]" SWORD M_FORMULA_0009 0 0 -3276.8 3276.7 ECU_ADDRESS 0x3FD184 /end MEASUREMENT
/begin MEASUREMENT md_res_min "min. Momentenreserve fuer OBD [RAM name from V530, interpolated]" SWORD M_FORMULA_0009 0 0 -3276.8 3276.7 ECU_ADDRESS 0x3FD1B4 /end MEASUREMENT
/begin MEASUREMENT md_mzyl_soll_asp_b2 "Soll-Mzyl [RAM name from V530, interpolated]" SWORD M_FORMULA_0104 0 0 -3276.8 3276.7 ECU_ADDRESS 0x3FD1CC /end MEASUREMENT
/begin MEASUREMENT md_rf_rg_korr_b1 "Korrekturwert ???ber RG [RAM name from V530, interpolated]" UWORD M_FORMULA_0073 0 0 0 63.99902344 ECU_ADDRESS 0x3FD1DA /end MEASUREMENT
/begin MEASUREMENT md_rf_rg_korr_b2 "Korrekturwert ???ber RG [RAM name from V530, interpolated]" UWORD M_FORMULA_0073 0 0 0 63.99902344 ECU_ADDRESS 0x3FD1DC /end MEASUREMENT
/begin MEASUREMENT md_rf_soll_pt_fr_b1 "Soll-rf mit pt-,fr,fra-Korr [RAM name from V530, interpolated]" SWORD M_FORMULA_0007 0 0 -3.2768 3.2767 ECU_ADDRESS 0x3FD1D6 /end MEASUREMENT
/begin MEASUREMENT md_rf_soll_pt_fr_b2 "Soll-rf mit pt-,fr,fra-Korr [RAM name from V530, interpolated]" SWORD M_FORMULA_0007 0 0 -3.2768 3.2767 ECU_ADDRESS 0x3FD1D8 /end MEASUREMENT
/begin MEASUREMENT md_rf_soll_pt_rg_fr_b2 "Soll-rf mit pt-,rg-,fr-Korr [RAM name from V530, interpolated]" SWORD M_FORMULA_0007 0 0 -3.2768 3.2767 ECU_ADDRESS 0x3FD1D0 /end MEASUREMENT
/begin MEASUREMENT md_rf_soll_pt_rg_fr_wl_b1 "Soll-rf mit pt-,rg-,fr-Korr,wl-Korr [RAM name from V530, interpolated]" SWORD M_FORMULA_0007 0 0 -3.2768 3.2767 ECU_ADDRESS 0x3FD1D2 /end MEASUREMENT
/begin MEASUREMENT md_rf_soll_pt_rg_fr_wl_b2 "Soll-rf mit pt-,rg-,fr-Korr,wl-Korr [RAM name from V530, interpolated]" SWORD M_FORMULA_0007 0 0 -3.2768 3.2767 ECU_ADDRESS 0x3FD1D4 /end MEASUREMENT
/begin MEASUREMENT md_tz_soll_zyl10 "Soll-TZ [RAM name from V530, interpolated]" SWORD M_FORMULA_0102 0 0 -3276.8 3276.7 ECU_ADDRESS 0x3FD1F4 /end MEASUREMENT
/begin MEASUREMENT md_tz_soll_zyl2 "Soll-TZ [RAM name from V530, interpolated]" SWORD M_FORMULA_0102 0 0 -3276.8 3276.7 ECU_ADDRESS 0x3FD1E4 /end MEASUREMENT
/begin MEASUREMENT md_tz_soll_zyl3 "Soll-TZ [RAM name from V530, interpolated]" SWORD M_FORMULA_0102 0 0 -3276.8 3276.7 ECU_ADDRESS 0x3FD1E6 /end MEASUREMENT
/begin MEASUREMENT md_tz_soll_zyl4 "Soll-TZ [RAM name from V530, interpolated]" SWORD M_FORMULA_0102 0 0 -3276.8 3276.7 ECU_ADDRESS 0x3FD1E8 /end MEASUREMENT
/begin MEASUREMENT md_tz_soll_zyl5 "Soll-TZ [RAM name from V530, interpolated]" SWORD M_FORMULA_0102 0 0 -3276.8 3276.7 ECU_ADDRESS 0x3FD1EA /end MEASUREMENT
/begin MEASUREMENT md_tz_soll_zyl6 "Soll-TZ [RAM name from V530, interpolated]" SWORD M_FORMULA_0102 0 0 -3276.8 3276.7 ECU_ADDRESS 0x3FD1EC /end MEASUREMENT
/begin MEASUREMENT md_tz_soll_zyl7 "Soll-TZ [RAM name from V530, interpolated]" SWORD M_FORMULA_0102 0 0 -3276.8 3276.7 ECU_ADDRESS 0x3FD1EE /end MEASUREMENT
/begin MEASUREMENT md_tz_soll_zyl8 "Soll-TZ [RAM name from V530, interpolated]" SWORD M_FORMULA_0102 0 0 -3276.8 3276.7 ECU_ADDRESS 0x3FD1F0 /end MEASUREMENT
/begin MEASUREMENT md_tz_soll_zyl9 "Soll-TZ [RAM name from V530, interpolated]" SWORD M_FORMULA_0102 0 0 -3276.8 3276.7 ECU_ADDRESS 0x3FD1F2 /end MEASUREMENT
/begin MEASUREMENT md_nbegr_abstand "Abstand zur Begrenzerdrehzahl [RAM name from V530, interpolated]" SWORD M_FORMULA_0006 0 0 -32768 32767 ECU_ADDRESS 0x3FD20E /end MEASUREMENT
/begin MEASUREMENT md_nbegr_egas "Aenderungsbegrenztes n_begr_egas [RAM name from V530, interpolated]" SWORD M_FORMULA_0006 0 0 -32768 32767 ECU_ADDRESS 0x3FD208 /end MEASUREMENT
/begin MEASUREMENT md_nbegr_n_offset "Abregelung Maxdrehzahl [RAM name from V530, interpolated]" SWORD M_FORMULA_0006 0 0 -32768 32767 ECU_ADDRESS 0x3FD20A /end MEASUREMENT
/begin MEASUREMENT md_nbegr_soll "Solldrehzahl inkl. Abregelung [RAM name from V530, interpolated]" SWORD M_FORMULA_0006 0 0 -32768 32767 ECU_ADDRESS 0x3FD20C /end MEASUREMENT
/begin MEASUREMENT n_timer_stoerung_b "Zeitzaehler fuer Freeze Drehzahlerfassung [RAM name from V530, interpolated]" SBYTE M_FORMULA_0306 0 0 -1.28 1.27 ECU_ADDRESS 0x3FD383 /end MEASUREMENT
/begin MEASUREMENT n_zahn_b "Drehzahl aus Zahnabstand [RAM name from V530, interpolated]" SWORD M_FORMULA_0006 0 0 -32768 32767 ECU_ADDRESS 0x3FD388 /end MEASUREMENT
/begin MEASUREMENT n_t_segm_b "Segmentzeit. [RAM name from V530, interpolated]" UWORD M_FORMULA_0354 0 0 0 104.856 ECU_ADDRESS 0x3FD390 /end MEASUREMENT
/begin MEASUREMENT os_err.id.task "OS-Err: ID [RAM name from V530, interpolated]" UBYTE NO_COMPU_METHOD 0 0 0 255 ECU_ADDRESS 0x3FD411 FORMAT "%.4g" /end MEASUREMENT
/begin MEASUREMENT os_err.limit.task "OS-Err: Limit [RAM name from V530, interpolated]" UBYTE NO_COMPU_METHOD 0 0 0 255 ECU_ADDRESS 0x3FD413 FORMAT "%.4g" /end MEASUREMENT
/begin MEASUREMENT os_err.no_fnc.cnt "OS-Err: No Fkt [RAM name from V530, interpolated]" UBYTE M_FORMULA_0003 0 0 0 255 ECU_ADDRESS 0x3FD416 /end MEASUREMENT
/begin MEASUREMENT os_err.no_fnc.task "OS-Err: No Fkt [RAM name from V530, interpolated]" UBYTE NO_COMPU_METHOD 0 0 0 255 ECU_ADDRESS 0x3FD417 FORMAT "%.4g" /end MEASUREMENT
/begin MEASUREMENT os_err.tt_act.task "OS-Err: TT aktiv [RAM name from V530, interpolated]" UBYTE NO_COMPU_METHOD 0 0 0 255 ECU_ADDRESS 0x3FD415 FORMAT "%.4g" /end MEASUREMENT
/begin MEASUREMENT os_err.tt_miss.task "OS-Err: TT missing [RAM name from V530, interpolated]" UBYTE NO_COMPU_METHOD 0 0 0 255 ECU_ADDRESS 0x3FD419 FORMAT "%.4g" /end MEASUREMENT
/begin MEASUREMENT os_err.fifo.cnt "OS-Err: FIFO full [RAM name from V530, interpolated]" UBYTE M_FORMULA_0003 0 0 0 255 ECU_ADDRESS 0x3FD41C /end MEASUREMENT
/begin MEASUREMENT os_err.fifo.task "OS-Err: FIFO full [RAM name from V530, interpolated]" UBYTE NO_COMPU_METHOD 0 0 0 255 ECU_ADDRESS 0x3FD41D FORMAT "%.4g" /end MEASUREMENT
/begin MEASUREMENT os_err.stack.task "OS-Err: Stack [RAM name from V530, interpolated]" UBYTE NO_COMPU_METHOD 0 0 0 255 ECU_ADDRESS 0x3FD41B FORMAT "%.4g" /end MEASUREMENT
/begin MEASUREMENT os_err.value.cnt "OS-Err: Value [RAM name from V530, interpolated]" UBYTE M_FORMULA_0003 0 0 0 255 ECU_ADDRESS 0x3FD41E /end MEASUREMENT
/begin MEASUREMENT os_err.value.task "OS-Err: Value [RAM name from V530, interpolated]" UBYTE NO_COMPU_METHOD 0 0 0 255 ECU_ADDRESS 0x3FD41F FORMAT "%.4g" /end MEASUREMENT
/begin MEASUREMENT os_err.deadline.task "OS-Err: Deadline [RAM name from V530, interpolated]" UBYTE NO_COMPU_METHOD 0 0 0 255 ECU_ADDRESS 0x3FD421 FORMAT "%.4g" /end MEASUREMENT
/begin MEASUREMENT pwg "Erfasster gefilterter relativer Pedalwert [RAM name from V530, interpolated]" SWORD M_FORMULA_0001 0 0 -3276.8 3276.7 ECU_ADDRESS 0x3FD474 /end MEASUREMENT
/begin MEASUREMENT qadc_check_ccw_adr "CCW Check Adresse des Fehlers [RAM name from V530, interpolated]" UBYTE M_FORMULA_0037 0 0 0 255 ECU_ADDRESS 0x3FD47E /end MEASUREMENT
/begin MEASUREMENT qadc_check_ccw_st "CCW Check Status [RAM name from V530, interpolated]" UBYTE NO_COMPU_METHOD 0 0 0 255 ECU_ADDRESS 0x3FD47C FORMAT "%.4g" /end MEASUREMENT
/begin MEASUREMENT qadc_err_cnt "CCW Check Fehlerzaehler [RAM name from V530, interpolated]" UBYTE M_FORMULA_0037 0 0 0 255 ECU_ADDRESS 0x3FD47D /end MEASUREMENT
/begin MEASUREMENT rf_kor_van_ist_roh_b2 "Korrekturfaktor van_ist [RAM name from V530, interpolated]" UWORD M_FORMULA_0073 0 0 0 63.99902344 ECU_ADDRESS 0x3FD4E6 /end MEASUREMENT
/begin MEASUREMENT schalter_st_ign_old "schalter_st_ign_old [RAM name from V530, interpolated]" UWORD M_FORMULA_0080 0 0 0 65535 ECU_ADDRESS 0x3FD518 /end MEASUREMENT
/begin MEASUREMENT sk_fm_ti "Eingang TI-Matrix [RAM name from V530, interpolated]" UBYTE NO_COMPU_METHOD 0 0 0 255 ECU_ADDRESS 0x3FD5A9 FORMAT "%.4g" /end MEASUREMENT
/begin MEASUREMENT sk_t_reset_delay_os "Timer fuer Verzoegerung sk_reset bei OS Fehlern [RAM name from V530, interpolated]" UWORD M_FORMULA_0021 0 0 0 655.35 ECU_ADDRESS 0x3FD5BC /end MEASUREMENT
/begin MEASUREMENT smg_n_diff_ziel "Differenz Getriebeziel - Motor [RAM name from V530, interpolated]" SWORD M_FORMULA_0006 0 0 -32768 32767 ECU_ADDRESS 0x3FD5FC /end MEASUREMENT
/begin MEASUREMENT smg_n_getr_ziel "gerechnete Ziel-Drehzahl am Getriebeeingang [RAM name from V530, interpolated]" SWORD M_FORMULA_0006 0 0 -32768 32767 ECU_ADDRESS 0x3FD612 /end MEASUREMENT
/begin MEASUREMENT smg_mot_m_res_pos "min. pos. Momentenreserve [RAM name from V530, interpolated]" SWORD M_FORMULA_0009 0 0 -3276.8 3276.7 ECU_ADDRESS 0x3FD682 /end MEASUREMENT
/begin MEASUREMENT smg_mot_t_regler "Regler-Zeit [RAM name from V530, interpolated]" UWORD M_FORMULA_0109 0 0 0 327.675 ECU_ADDRESS 0x3FD680 /end MEASUREMENT
/begin MEASUREMENT sys_ed_st "ED Status [RAM name from V530, interpolated]" UWORD NO_COMPU_METHOD 0 0 0 65535 ECU_ADDRESS 0x3FD778 FORMAT "%.4g" /end MEASUREMENT
/begin MEASUREMENT tan_filter_b1 "Gefilterter Messwert der Ansauglufttemperatur [RAM name from V530, interpolated]" SWORD M_FORMULA_0975 0 0 -1092.35 546.025 ECU_ADDRESS 0x3FD808 /end MEASUREMENT
/begin MEASUREMENT tan_filter_b2 "Gefilterter Messwert der Ansauglufttemperatur [RAM name from V530, interpolated]" SWORD M_FORMULA_0975 0 0 -1092.35 546.025 ECU_ADDRESS 0x3FD80A /end MEASUREMENT
/begin MEASUREMENT tan_roh_b1 "Ungefilterter Messwert der Ansauglufttemperatur [RAM name from V530, interpolated]" SWORD M_FORMULA_0975 0 0 -1092.35 546.025 ECU_ADDRESS 0x3FD804 /end MEASUREMENT
/begin MEASUREMENT tan_roh_b2 "Ungefilterter Messwert der Ansauglufttemperatur [RAM name from V530, interpolated]" SWORD M_FORMULA_0975 0 0 -1092.35 546.025 ECU_ADDRESS 0x3FD806 /end MEASUREMENT
/begin MEASUREMENT tan_modell_raw_b2 "Temperatur Ansaugluft Modell ungefiltert [RAM name from V530, interpolated]" SWORD M_FORMULA_0023 0 0 -3550 3003.5 ECU_ADDRESS 0x3FD812 /end MEASUREMENT
/begin MEASUREMENT tan_modell_ml_ratio_b1 "Faktor Luftmasse f???r TAN-Modell [RAM name from V530, interpolated]" UWORD M_FORMULA_0199 0 0 0 3.999938965 ECU_ADDRESS 0x3FD81C /end MEASUREMENT
/begin MEASUREMENT tan_modell_ml_ratio_b2 "Faktor Luftmasse f???r TAN-Modell [RAM name from V530, interpolated]" UWORD M_FORMULA_0199 0 0 0 3.999938965 ECU_ADDRESS 0x3FD81E /end MEASUREMENT
/begin MEASUREMENT tan_modell_ml_tau_b1 "Temperatur tau TAN-Modell [RAM name from V530, interpolated]" UWORD M_FORMULA_0681 0 0 -1e+12 1e+12 ECU_ADDRESS 0x3FD818 /end MEASUREMENT
/begin MEASUREMENT tan_modell_ml_tau_b2 "Temperatur tau TAN-Modell [RAM name from V530, interpolated]" UWORD M_FORMULA_0681 0 0 -1e+12 1e+12 ECU_ADDRESS 0x3FD81A /end MEASUREMENT
/begin MEASUREMENT tan_obd_ersatz "Zuteilung Ersatzwert Ansauglufttemperatur [RAM name from V530, interpolated]" UBYTE NO_COMPU_METHOD 0 0 0 255 ECU_ADDRESS 0x3FD821 FORMAT "%.4g" /end MEASUREMENT
/begin MEASUREMENT tan_modell_mr_kal "Motorraumtempabweichung durch TUMG [RAM name from V530, interpolated]" SWORD M_FORMULA_0074 0 0 -3276.8 3276.7 ECU_ADDRESS 0x3FD838 /end MEASUREMENT
/begin MEASUREMENT tan_modell_tmot "Motorraumtemperatur Zielwert [RAM name from V530, interpolated]" SWORD M_FORMULA_0023 0 0 -3550 3003.5 ECU_ADDRESS 0x3FD83A /end MEASUREMENT
/begin MEASUREMENT tan_n_dyn_delta "Drehzahl zwischen gefiltert und ungefiltert [RAM name from V530, interpolated]" SWORD M_FORMULA_0105 0 0 -32768 32767 ECU_ADDRESS 0x3FD836 /end MEASUREMENT
/begin MEASUREMENT time_rel_motor_start "Relativzeit bei Motorstart [RAM name from V530, interpolated]" ULONG M_FORMULA_0145 0 0 0 71582788.25 ECU_ADDRESS 0x3FD84C /end MEASUREMENT
/begin MEASUREMENT tka_ad "Eingelesener Spannungswert fuer Kuehlwasseraustrittstemperatur [RAM name from V530, interpolated]" SWORD M_FORMULA_0114 0 0 -32768 32767 ECU_ADDRESS 0x3FD850 /end MEASUREMENT
/begin MEASUREMENT tka_filter "Gefilterter Messwert der Kuehlwasseraustrittstemperatur [RAM name from V530, interpolated]" SWORD M_FORMULA_0975 0 0 -1092.35 546.025 ECU_ADDRESS 0x3FD854 /end MEASUREMENT
/begin MEASUREMENT tka_obd_st "tka_obd_st [RAM name from V530, interpolated]" UWORD NO_COMPU_METHOD 0 0 0 65535 ECU_ADDRESS 0x3FD858 FORMAT "%.4g" /end MEASUREMENT
/begin MEASUREMENT tka_obd_tmot_t "tka_obd_tmot_t [RAM name from V530, interpolated]" UWORD M_FORMULA_0071 0 0 0 6553.5 ECU_ADDRESS 0x3FD856 /end MEASUREMENT
/begin MEASUREMENT tka_roh "Ungefilterter Messwert der Kuehlwasseraustrittstemperatur [RAM name from V530, interpolated]" SWORD M_FORMULA_0975 0 0 -1092.35 546.025 ECU_ADDRESS 0x3FD852 /end MEASUREMENT
/begin MEASUREMENT tmot_modell_tumg_roh "Ungefilterter Umgebungsenergieabtrag [RAM name from V530, interpolated]" SWORD M_FORMULA_0074 0 0 -3276.8 3276.7 ECU_ADDRESS 0x3FD86A /end MEASUREMENT
/begin MEASUREMENT tmot_modell_lam_ist_mw "Begrenztes IST-Lambda [RAM name from V530, interpolated]" UWORD M_FORMULA_0025 0 0 0 3.999938965 ECU_ADDRESS 0x3FD876 /end MEASUREMENT
/begin MEASUREMENT tmot_obd_ml_ges_int "Integral der Luftmasse [RAM name from V530, interpolated]" ULONG M_FORMULA_1001 0 0 0 42949672.95 ECU_ADDRESS 0x3FD87C /end MEASUREMENT
/begin MEASUREMENT tmot_obd_ml_ges_mw "Lastmittelwert seit Start [RAM name from V530, interpolated]" SWORD M_FORMULA_0103 0 0 -3276.8 3276.7 ECU_ADDRESS 0x3FD884 /end MEASUREMENT
/begin MEASUREMENT tmot_obd_ml_ges_time "Zeitdauer der Integration [RAM name from V530, interpolated]" ULONG M_FORMULA_0452 0 0 0 429496729.5 ECU_ADDRESS 0x3FD880 /end MEASUREMENT
/begin MEASUREMENT tmot_obd_modell_abw "Differenz Messwert-Modell [RAM name from V530, interpolated]" SLONG M_FORMULA_1002 0 0 -209715.2 209715.1999 ECU_ADDRESS 0x3FD888 /end MEASUREMENT
/begin MEASUREMENT tmot_obd_max "Max. OBD-Kuehlwassertemperatur [RAM name from V530, interpolated]" SWORD M_FORMULA_0023 0 0 -3550 3003.5 ECU_ADDRESS 0x3FD8A2 /end MEASUREMENT
/begin MEASUREMENT tmot_obd_min "Max. OBD-Kuehlwassertemperatur [RAM name from V530, interpolated]" SWORD M_FORMULA_0023 0 0 -3550 3003.5 ECU_ADDRESS 0x3FD8A0 /end MEASUREMENT
/begin MEASUREMENT tsgrw_roh_b2 "Ungefilterte Saugrohrwandtemperatur [RAM name from V530, interpolated]" SWORD M_FORMULA_0975 0 0 -1092.35 546.025 ECU_ADDRESS 0x3FD92C /end MEASUREMENT
/begin MEASUREMENT tz_zyl2 "Zuendwinkel [RAM name from V530, interpolated]" SWORD M_FORMULA_0102 0 0 -3276.8 3276.7 ECU_ADDRESS 0x3FD9CE /end MEASUREMENT
/begin MEASUREMENT tz_zyl3 "Zuendwinkel [RAM name from V530, interpolated]" SWORD M_FORMULA_0102 0 0 -3276.8 3276.7 ECU_ADDRESS 0x3FD9D0 /end MEASUREMENT
/begin MEASUREMENT tz_zyl4 "Zuendwinkel [RAM name from V530, interpolated]" SWORD M_FORMULA_0102 0 0 -3276.8 3276.7 ECU_ADDRESS 0x3FD9D2 /end MEASUREMENT
/begin MEASUREMENT tz_zyl10 "Zuendwinkel [RAM name from V530, interpolated]" SWORD M_FORMULA_0102 0 0 -3276.8 3276.7 ECU_ADDRESS 0x3FD9DE /end MEASUREMENT
/begin MEASUREMENT tz_zyl6 "Zuendwinkel [RAM name from V530, interpolated]" SWORD M_FORMULA_0102 0 0 -3276.8 3276.7 ECU_ADDRESS 0x3FD9D6 /end MEASUREMENT
/begin MEASUREMENT tz_zyl7 "Zuendwinkel [RAM name from V530, interpolated]" SWORD M_FORMULA_0102 0 0 -3276.8 3276.7 ECU_ADDRESS 0x3FD9D8 /end MEASUREMENT
/begin MEASUREMENT tz_zyl8 "Zuendwinkel [RAM name from V530, interpolated]" SWORD M_FORMULA_0102 0 0 -3276.8 3276.7 ECU_ADDRESS 0x3FD9DA /end MEASUREMENT
/begin MEASUREMENT tz_zyl9 "Zuendwinkel [RAM name from V530, interpolated]" SWORD M_FORMULA_0102 0 0 -3276.8 3276.7 ECU_ADDRESS 0x3FD9DC /end MEASUREMENT
/begin MEASUREMENT uext_roh_pin_124_512 "Roh-Wert d. Versorgungsspannungen [RAM name from V530, interpolated]" UWORD M_FORMULA_0247 0 0 0 6.666564941 ECU_ADDRESS 0x3FDA2A /end MEASUREMENT
/begin MEASUREMENT md_ind_min_e2 "Indiziertes Minmoment [RAM name from V530, interpolated]" SWORD M_FORMULA_0009 0 0 -3276.8 3276.7 ECU_ADDRESS 0x3FDBA4 /end MEASUREMENT
/begin MEASUREMENT md_kupp_min_diff "Differenz zum Minmoment [RAM name from V530, interpolated]" SWORD M_FORMULA_0009 0 0 -3276.8 3276.7 ECU_ADDRESS 0x3FDBA8 /end MEASUREMENT
/begin MEASUREMENT md_ind_reib_e2 "Reibverluste [RAM name from V530, interpolated]" SWORD M_FORMULA_0009 0 0 -3276.8 3276.7 ECU_ADDRESS 0x3FDBAC /end MEASUREMENT
/begin MEASUREMENT md_kupp_off_e2 "zulaessige Abweichung Ebene 2 [RAM name from V530, interpolated]" SWORD M_FORMULA_0009 0 0 -3276.8 3276.7 ECU_ADDRESS 0x3FDBC0 /end MEASUREMENT
/begin MEASUREMENT md_kupp_ist_soll_e2 "IstSollabweichung Ebene 2 [RAM name from V530, interpolated]" SWORD M_FORMULA_0009 0 0 -3276.8 3276.7 ECU_ADDRESS 0x3FDBC4 /end MEASUREMENT
/begin MEASUREMENT md_fw_fgr_e2 "rel. Wunschmoment vom FGR Ebene 2 [RAM name from V530, interpolated]" SWORD M_FORMULA_0001 0 0 -3276.8 3276.7 ECU_ADDRESS 0x3FDBCA /end MEASUREMENT
/begin MEASUREMENT smg_e2_fehler "Fehlerstatus Ebene 2 [RAM name from V530, interpolated]" UBYTE NO_COMPU_METHOD 0 0 0 255 ECU_ADDRESS 0x3FDC32 FORMAT "%.4g" /end MEASUREMENT
/begin MEASUREMENT toel_e2_err "Anzahl der Vergleichs-Fehler [RAM name from V530, interpolated]" UBYTE M_FORMULA_0003 0 0 0 255 ECU_ADDRESS 0x3FDC4E /end MEASUREMENT
/begin MEASUREMENT sk_egas_off_ni "SK-Egasstufe - no Init [RAM name from V530, interpolated]" UBYTE NO_COMPU_METHOD 0 0 0 255 ECU_ADDRESS 0x3FF02A FORMAT "%.4g" /end MEASUREMENT
/begin MEASUREMENT sk_md_begr_ni "SK-Begrenzungsstufe - no Init [RAM name from V530, interpolated]" UBYTE NO_COMPU_METHOD 0 0 0 255 ECU_ADDRESS 0x3FF029 FORMAT "%.4g" /end MEASUREMENT
/begin COMPU_METHOD M_FORMULA_0000 "V530 FORMULA_0000" RAT_FUNC "%.4g" "-" COEFFS 0 1 0 0 0 1 /end COMPU_METHOD
/begin COMPU_METHOD M_FORMULA_0001 "V530 FORMULA_0001" RAT_FUNC "%.4g" "%" COEFFS 0 10 0 0 0 1 /end COMPU_METHOD
/begin COMPU_METHOD M_FORMULA_0003 "V530 FORMULA_0003" RAT_FUNC "%.4g" "-" COEFFS 0 1 0 0 0 1 /end COMPU_METHOD
/begin COMPU_METHOD M_FORMULA_0006 "V530 FORMULA_0006" RAT_FUNC "%.4g" "Upm" COEFFS 0 1 0 0 0 1 /end COMPU_METHOD
/begin COMPU_METHOD M_FORMULA_0007 "V530 FORMULA_0007" RAT_FUNC "%.4g" "-" COEFFS 0 10000 0 0 0 1 /end COMPU_METHOD
/begin COMPU_METHOD M_FORMULA_0009 "V530 FORMULA_0009" RAT_FUNC "%.4g" "Nm" COEFFS 0 10 0 0 0 1 /end COMPU_METHOD
/begin COMPU_METHOD M_FORMULA_0010 "V530 FORMULA_0010" RAT_FUNC "%.4g" "-" COEFFS 0 1 0 0 0 1 /end COMPU_METHOD
/begin COMPU_METHOD M_FORMULA_0021 "V530 FORMULA_0021" RAT_FUNC "%.4g" "s" COEFFS 0 100 0 0 0 1 /end COMPU_METHOD
/begin COMPU_METHOD M_FORMULA_0023 "V530 FORMULA_0023" RAT_FUNC "%.4g" "???C" COEFFS 0 10 2732 0 0 1 /end COMPU_METHOD
/begin COMPU_METHOD M_FORMULA_0024 "V530 FORMULA_0024" RAT_FUNC "%.4g" "-" COEFFS 0 32768 0 0 0 1 /end COMPU_METHOD
/begin COMPU_METHOD M_FORMULA_0025 "V530 FORMULA_0025" RAT_FUNC "%.4g" "-" COEFFS 0 16384 0 0 0 1 /end COMPU_METHOD
/begin COMPU_METHOD M_FORMULA_0037 "V530 FORMULA_0037" RAT_FUNC "%.4g" "-" COEFFS 0 1 0 0 0 1 /end COMPU_METHOD
/begin COMPU_METHOD M_FORMULA_0044 "V530 FORMULA_0044" RAT_FUNC "%.4g" "-" COEFFS 0 1 0 0 0 1 /end COMPU_METHOD
/begin COMPU_METHOD M_FORMULA_0071 "V530 FORMULA_0071" RAT_FUNC "%.4g" "s" COEFFS 0 10 0 0 0 1 /end COMPU_METHOD
/begin COMPU_METHOD M_FORMULA_0072 "V530 FORMULA_0072" RAT_FUNC "%.4g" "us" COEFFS 0 1 0 0 0 1 /end COMPU_METHOD
/begin COMPU_METHOD M_FORMULA_0073 "V530 FORMULA_0073" RAT_FUNC "%.4g" "-" COEFFS 0 1024 0 0 0 1 /end COMPU_METHOD
/begin COMPU_METHOD M_FORMULA_0074 "V530 FORMULA_0074" RAT_FUNC "%.4g" "Kelvin" COEFFS 0 10 0 0 0 1 /end COMPU_METHOD
/begin COMPU_METHOD M_FORMULA_0080 "V530 FORMULA_0080" RAT_FUNC "%.4g" "-" COEFFS 0 1 0 0 0 1 /end COMPU_METHOD
/begin COMPU_METHOD M_FORMULA_0102 "V530 FORMULA_0102" RAT_FUNC "%.4g" "???KW" COEFFS 0 10 0 0 0 1 /end COMPU_METHOD
/begin COMPU_METHOD M_FORMULA_0103 "V530 FORMULA_0103" RAT_FUNC "%.4g" "kg/h" COEFFS 0 10 0 0 0 1 /end COMPU_METHOD
/begin COMPU_METHOD M_FORMULA_0104 "V530 FORMULA_0104" RAT_FUNC "%.4g" "mg/asp" COEFFS 0 10 0 0 0 1 /end COMPU_METHOD
/begin COMPU_METHOD M_FORMULA_0105 "V530 FORMULA_0105" RAT_FUNC "%.4g" "Upm/s" COEFFS 0 1 0 0 0 1 /end COMPU_METHOD
/begin COMPU_METHOD M_FORMULA_0109 "V530 FORMULA_0109" RAT_FUNC "%.4g" "s" COEFFS 0 200 0 0 0 1 /end COMPU_METHOD
/begin COMPU_METHOD M_FORMULA_0114 "V530 FORMULA_0114" RAT_FUNC "%.4g" "digit" COEFFS 0 1 0 0 0 1 /end COMPU_METHOD
/begin COMPU_METHOD M_FORMULA_0143 "V530 FORMULA_0143" RAT_FUNC "%.4g" "qmm" COEFFS 0 10 0 0 0 1 /end COMPU_METHOD
/begin COMPU_METHOD M_FORMULA_0145 "V530 FORMULA_0145" RAT_FUNC "%.4g" "min" COEFFS 0 60 0 0 0 1 /end COMPU_METHOD
/begin COMPU_METHOD M_FORMULA_0199 "V530 FORMULA_0199" RAT_FUNC "%.4g" "-" COEFFS 0 16384 0 0 0 1 /end COMPU_METHOD
/begin COMPU_METHOD M_FORMULA_0227 "V530 FORMULA_0227" RAT_FUNC "%.4g" "nSs" COEFFS 0 51.22410237 0 0 0 1 /end COMPU_METHOD
/begin COMPU_METHOD M_FORMULA_0247 "V530 FORMULA_0247" RAT_FUNC "%.4g" "V" COEFFS 0 9830.4 0 0 0 1 /end COMPU_METHOD
/begin COMPU_METHOD M_FORMULA_0250 "V530 FORMULA_0250" RAT_FUNC "%.4g" "V" COEFFS 0 204.8 0 0 0 1 /end COMPU_METHOD
/begin COMPU_METHOD M_FORMULA_0272 "V530 FORMULA_0272" RAT_FUNC "%.4g" "Nm" COEFFS 0 10 0 0 0 1 /end COMPU_METHOD
/begin COMPU_METHOD M_FORMULA_0306 "V530 FORMULA_0306" RAT_FUNC "%.4g" "s" COEFFS 0 100 0 0 0 1 /end COMPU_METHOD
/begin COMPU_METHOD M_FORMULA_0354 "V530 FORMULA_0354" RAT_FUNC "%.4g" "ms" COEFFS 0 625 0 0 0 1 /end COMPU_METHOD
/begin COMPU_METHOD M_FORMULA_0437 "V530 FORMULA_0437" RAT_FUNC "%.4g" "%" COEFFS 0 327.68 0 0 0 1 /end COMPU_METHOD
/begin COMPU_METHOD M_FORMULA_0446 "V530 FORMULA_0446" RAT_FUNC "%.4g" "ms" COEFFS 0 250 0 0 0 1 /end COMPU_METHOD
/begin COMPU_METHOD M_FORMULA_0448 "V530 FORMULA_0448" RAT_FUNC "%.4g" "%" COEFFS 0 640 0 0 0 1 /end COMPU_METHOD
/begin COMPU_METHOD M_FORMULA_0452 "V530 FORMULA_0452" RAT_FUNC "%.4g" "s" COEFFS 0 10 0 0 0 1 /end COMPU_METHOD
/begin COMPU_METHOD M_FORMULA_0493 "V530 FORMULA_0493" RAT_FUNC "%.4g" "-" COEFFS 0 255 0 0 0 1 /end COMPU_METHOD
/begin COMPU_METHOD M_FORMULA_0562 "V530 FORMULA_0562" RAT_FUNC "%.4g" "Nm/s" COEFFS 0 0.05 0 0 0 1 /end COMPU_METHOD
/begin COMPU_METHOD M_FORMULA_0563 "V530 FORMULA_0563" RAT_FUNC "%.4g" "-" COEFFS 0 255 0 0 0 1 /end COMPU_METHOD
/begin COMPU_METHOD M_FORMULA_0583 "V530 FORMULA_0583" RAT_FUNC "%.4g" "V" COEFFS 0 204.8 0 0 0 1 /end COMPU_METHOD
/begin COMPU_METHOD M_FORMULA_0584 "V530 FORMULA_0584" RAT_FUNC "%.4g" "ms" COEFFS 0 0.2 0 0 0 1 /end COMPU_METHOD
/begin COMPU_METHOD M_FORMULA_0590 "V530 FORMULA_0590" RAT_FUNC "%.4g" "sec" COEFFS 0 200 0 0 0 1 /end COMPU_METHOD
/begin COMPU_METHOD M_FORMULA_0623 "V530 FORMULA_0623" RAT_FUNC "%.4g" "s" COEFFS 0 200 0 0 0 1 /end COMPU_METHOD
/begin COMPU_METHOD M_FORMULA_0624 "V530 FORMULA_0624" RAT_FUNC "%.4g" "%" COEFFS 0 1.28 0 0 0 1 /end COMPU_METHOD
/begin COMPU_METHOD M_FORMULA_0625 "V530 FORMULA_0625" RAT_FUNC "%.4g" "%" COEFFS 0 10 0 0 0 1 /end COMPU_METHOD
/begin COMPU_METHOD M_FORMULA_0670 "V530 FORMULA_0670" RAT_FUNC "%.4g" "-" COEFFS 0 32767 0 0 0 1 /end COMPU_METHOD
/begin COMPU_METHOD M_FORMULA_0671 "V530 FORMULA_0671" RAT_FUNC "%.4g" "1/s" COEFFS 0 327.68 0 0 0 1 /end COMPU_METHOD
/begin COMPU_METHOD M_FORMULA_0672 "V530 FORMULA_0672" RAT_FUNC "%.4g" "1/s" COEFFS 0 32767 0 0 0 1 /end COMPU_METHOD
/begin COMPU_METHOD M_FORMULA_0681 "V530 FORMULA_0681" RAT_FUNC "%.4g" "s" COEFFS 0 0 6553.5 0 1 0 /end COMPU_METHOD
/begin COMPU_METHOD M_FORMULA_0757 "V530 FORMULA_0757" RAT_FUNC "%.4g" "-" COEFFS 0 128 0 0 0 1 /end COMPU_METHOD
/begin COMPU_METHOD M_FORMULA_0759 "V530 FORMULA_0759" RAT_FUNC "%.4g" "Nm/s" COEFFS 0 10 0 0 0 1 /end COMPU_METHOD
/begin COMPU_METHOD M_FORMULA_0786 "V530 FORMULA_0786" RAT_FUNC "%.4g" "Nm/s" COEFFS 0 1 0 0 0 1 /end COMPU_METHOD
/begin COMPU_METHOD M_FORMULA_0975 "V530 FORMULA_0975" RAT_FUNC "%.4g" "???C" COEFFS 0 40 10926 0 0 1 /end COMPU_METHOD
/begin COMPU_METHOD M_FORMULA_1001 "V530 FORMULA_1001" RAT_FUNC "%.4g" "kgs/h" COEFFS 0 100 0 0 0 1 /end COMPU_METHOD
/begin COMPU_METHOD M_FORMULA_1002 "V530 FORMULA_1002" RAT_FUNC "%.4g" "Kelvin" COEFFS 0 10240 0 0 0 1 /end COMPU_METHOD
/begin COMPU_METHOD CM_0399 "X*0.08-200" RAT_FUNC "%.4g" "-200.0p" COEFFS 0 1 200 0 0 0.08 /end COMPU_METHOD
/begin COMPU_METHOD CM_0400 "X*5.12" RAT_FUNC "%.4g" "" COEFFS 0 1 0 0 0 5.12 /end COMPU_METHOD
/begin COMPU_METHOD CM_0401 "X*10" RAT_FUNC "%.4g" "-" COEFFS 0 1 0 0 0 10 /end COMPU_METHOD
/begin COMPU_METHOD CM_0402 "X*0.03333333333" RAT_FUNC "%.4g" "l" COEFFS 0 1 0 0 0 0.03333333333 /end COMPU_METHOD
/begin COMPU_METHOD CM_0403 "X*0.00390625" RAT_FUNC "%.4g" "V" COEFFS 0 1 0 0 0 0.00390625 /end COMPU_METHOD
/begin COMPU_METHOD CM_0404 "X*0.0009765625" RAT_FUNC "%.4g" "%/???C" COEFFS 0 1 0 0 0 0.0009765625 /end COMPU_METHOD
/begin COMPU_METHOD CM_0405 "X*0.1" RAT_FUNC "%.4g" "V/s" COEFFS 0 1 0 0 0 0.1 /end COMPU_METHOD
/begin COMPU_METHOD CM_0406 "X*0.1" RAT_FUNC "%.4g" "J/K*mol" COEFFS 0 1 0 0 0 0.1 /end COMPU_METHOD
/begin COMPU_METHOD CM_0407 "X" RAT_FUNC "%.4g" "Nkw-Schwelle" COEFFS 0 1 0 0 0 1 /end COMPU_METHOD
/begin COMPU_METHOD CM_0408 "X" RAT_FUNC "%.4g" "ber?cksichti-" COEFFS 0 1 0 0 0 1 /end COMPU_METHOD
/begin COMPU_METHOD CM_0409 "X*0.001525878906" RAT_FUNC "%.4g" "%" COEFFS 0 1 0 0 0 0.001525878906 /end COMPU_METHOD
/begin COMPU_METHOD CM_0410 "X*0.01820020222" RAT_FUNC "%.4g" "Ah" COEFFS 0 1 0 0 0 0.01820020222 /end COMPU_METHOD
/begin COMPU_METHOD CM_0411 "X*0.001" RAT_FUNC "%.4g" "dm**3" COEFFS 0 1 0 0 0 0.001 /end COMPU_METHOD
/begin COMPU_METHOD CM_0412 "X*0.001" RAT_FUNC "%.4g" "Kg/m**3" COEFFS 0 1 0 0 0 0.001 /end COMPU_METHOD
/begin COMPU_METHOD CM_0413 "X*0.5" RAT_FUNC "%.4g" "Segmente" COEFFS 0 1 0 0 0 0.5 /end COMPU_METHOD
/begin COMPU_METHOD CM_0414 "X*6.103515625e-05" RAT_FUNC "%.4g" "-*s" COEFFS 0 1 0 0 0 6.103515625e-05 /end COMPU_METHOD
/begin COMPU_METHOD CM_0415 "X*0.008" RAT_FUNC "%.4g" "kg/h" COEFFS 0 1 0 0 0 0.008 /end COMPU_METHOD
/begin COMPU_METHOD CM_0416 "X*0.1" RAT_FUNC "%.4g" "kg/h/0.01s" COEFFS 0 1 0 0 0 0.1 /end COMPU_METHOD
/begin COMPU_METHOD CM_0417 "X" RAT_FUNC "%.4g" "[]" COEFFS 0 1 0 0 0 1 /end COMPU_METHOD
/begin COMPU_METHOD CM_0418 "X*" RAT_FUNC "%.4g" "0.0p" COEFFS 0 1 0 0 0 1 /end COMPU_METHOD
/begin COMPU_METHOD CM_0419 "X*0.9333333333" RAT_FUNC "%.4g" "min" COEFFS 0 1 0 0 0 0.9333333333 /end COMPU_METHOD
/begin COMPU_METHOD CM_0420 "X*0.015" RAT_FUNC "%.4g" "V" COEFFS 0 1 0 0 0 0.015 /end COMPU_METHOD
/begin COMPU_METHOD CM_0421 "X*0.00025+6" RAT_FUNC "%.4g" "" COEFFS 0 1 -6 0 0 0.00025 /end COMPU_METHOD
/begin COMPU_METHOD CM_0422 "X*" RAT_FUNC "%.4g" "0p" COEFFS 0 1 0 0 0 1 /end COMPU_METHOD
/begin COMPU_METHOD CM_0423 "X/4" RAT_FUNC "%.4g" "m/s*s" COEFFS 0 4 0 0 0 1 /end COMPU_METHOD
/begin COMPU_METHOD CM_0428 "X/218.453" RAT_FUNC "%.4g" "1/min" COEFFS 0 1 0 0 0 0.004577643704 /end COMPU_METHOD
/begin COMPU_METHOD CM_0432 "X*75/512" RAT_FUNC "%.4g" "mm" COEFFS 0 512 0 0 0 75 /end COMPU_METHOD
/begin COMPU_METHOD CM_0433 "164/X" RAT_FUNC "%.4g" "s" COEFFS 0 0 -164 0 -1 0 /end COMPU_METHOD
/begin COMPU_METHOD CM_0434 "X" RAT_FUNC "%.4g" "[A_E]" COEFFS 0 1 0 0 0 1 /end COMPU_METHOD
/begin COMPU_METHOD CM_0435 "X/10" RAT_FUNC "%.4g" "[A_E]" COEFFS 0 10 0 0 0 1 /end COMPU_METHOD
/begin COMPU_METHOD CM_0436 "X/10" RAT_FUNC "%.4g" "[A_E][j]" COEFFS 0 10 0 0 0 1 /end COMPU_METHOD
/begin COMPU_METHOD CM_0437 "X/25600" RAT_FUNC "%.4g" "[A_E]" COEFFS 0 25600 0 0 0 1 /end COMPU_METHOD
/begin COMPU_METHOD CM_0454 "X" RAT_FUNC "%.4g" "NEAR" COEFFS 0 1 0 0 0 1 /end COMPU_METHOD
/begin COMPU_METHOD CM_0455 "X/156" RAT_FUNC "%.4g" "-" COEFFS 0 156 0 0 0 1 /end COMPU_METHOD
/begin COMPU_METHOD CM_0456 "X/16384" RAT_FUNC "%.4g" "LAM_SOLL" COEFFS 0 16384 0 0 0 1 /end COMPU_METHOD
/begin COMPU_METHOD CM_0457 "X/16384" RAT_FUNC "%.4g" "_" COEFFS 0 16384 0 0 0 1 /end COMPU_METHOD
/begin COMPU_METHOD CM_0458 "X/0.2048" RAT_FUNC "%.4g" "LANK_FETT" COEFFS 0 1 0 0 0 4.8828125 /end COMPU_METHOD
/begin COMPU_METHOD CM_0464 "X*2/25-200" RAT_FUNC "%.4g" "3" COEFFS 0 25 5000 0 0 2 /end COMPU_METHOD
/begin COMPU_METHOD CM_0465 "X" RAT_FUNC "%.4g" "Gen_awnumm[6]" COEFFS 0 1 0 0 0 1 /end COMPU_METHOD
/begin COMPU_METHOD CM_0466 "X*2" RAT_FUNC "%.4g" "s" COEFFS 0 1 0 0 0 2 /end COMPU_METHOD
/begin COMPU_METHOD CM_0467 "X" RAT_FUNC "%.4g" "Nkw[6]" COEFFS 0 1 0 0 0 1 /end COMPU_METHOD
/begin COMPU_METHOD CM_0468 "X" RAT_FUNC "%.4g" "KL_F_GENTYP" COEFFS 0 1 0 0 0 1 /end COMPU_METHOD
/begin RECORD_LAYOUT RL_AXP_SB NO_AXIS_PTS_X 1 UBYTE RESERVED 2 BYTE AXIS_PTS_X 3 SBYTE INDEX_INCR DIRECT /end RECORD_LAYOUT
/begin RECORD_LAYOUT RL_BLK_UB FNC_VALUES 1 UBYTE ROW_DIR DIRECT /end RECORD_LAYOUT
/begin RECORD_LAYOUT RL_CUR_SB_SB FNC_VALUES 4 SBYTE COLUMN_DIR DIRECT AXIS_PTS_X 3 SBYTE INDEX_INCR DIRECT NO_AXIS_PTS_X 1 UBYTE RESERVED 2 BYTE /end RECORD_LAYOUT
/begin RECORD_LAYOUT RL_CUR_SB_SW FNC_VALUES 4 SWORD COLUMN_DIR DIRECT AXIS_PTS_X 3 SBYTE INDEX_INCR DIRECT NO_AXIS_PTS_X 1 UBYTE RESERVED 2 BYTE /end RECORD_LAYOUT
/begin RECORD_LAYOUT RL_CUR_SB_UW FNC_VALUES 4 UWORD COLUMN_DIR DIRECT AXIS_PTS_X 3 SBYTE INDEX_INCR DIRECT NO_AXIS_PTS_X 1 UBYTE RESERVED 2 BYTE /end RECORD_LAYOUT
/begin RECORD_LAYOUT RL_CUR_UW_SB FNC_VALUES 4 SBYTE COLUMN_DIR DIRECT AXIS_PTS_X 3 UWORD INDEX_INCR DIRECT NO_AXIS_PTS_X 1 UBYTE RESERVED 2 BYTE /end RECORD_LAYOUT
/begin RECORD_LAYOUT RL_CUR_UW_UB FNC_VALUES 4 UBYTE COLUMN_DIR DIRECT AXIS_PTS_X 3 UWORD INDEX_INCR DIRECT NO_AXIS_PTS_X 1 UBYTE RESERVED 2 BYTE /end RECORD_LAYOUT
/begin RECORD_LAYOUT RL_GRP_UW_C FNC_VALUES 1 UWORD COLUMN_DIR DIRECT /end RECORD_LAYOUT
/begin RECORD_LAYOUT RL_MAP_SW_UW_SW FNC_VALUES 5 SWORD COLUMN_DIR DIRECT AXIS_PTS_X 3 SWORD INDEX_INCR DIRECT AXIS_PTS_Y 4 UWORD INDEX_INCR DIRECT NO_AXIS_PTS_X 1 UBYTE NO_AXIS_PTS_Y 2 UBYTE /end RECORD_LAYOUT
/begin RECORD_LAYOUT RL_MAP_SW_UW_UB FNC_VALUES 5 UBYTE COLUMN_DIR DIRECT AXIS_PTS_X 3 SWORD INDEX_INCR DIRECT AXIS_PTS_Y 4 UWORD INDEX_INCR DIRECT NO_AXIS_PTS_X 1 UBYTE NO_AXIS_PTS_Y 2 UBYTE /end RECORD_LAYOUT
/begin RECORD_LAYOUT RL_MAP_UW_SB_SW FNC_VALUES 5 SWORD COLUMN_DIR DIRECT AXIS_PTS_X 3 UWORD INDEX_INCR DIRECT AXIS_PTS_Y 4 SBYTE INDEX_INCR DIRECT NO_AXIS_PTS_X 1 UBYTE NO_AXIS_PTS_Y 2 UBYTE /end RECORD_LAYOUT
/begin RECORD_LAYOUT RL_MAP_UW_UW_UB FNC_VALUES 5 UBYTE COLUMN_DIR DIRECT AXIS_PTS_X 3 UWORD INDEX_INCR DIRECT AXIS_PTS_Y 4 UWORD INDEX_INCR DIRECT NO_AXIS_PTS_X 1 UBYTE NO_AXIS_PTS_Y 2 UBYTE /end RECORD_LAYOUT
/begin RECORD_LAYOUT RL_MAP_UW_UW_UW FNC_VALUES 5 UWORD COLUMN_DIR DIRECT AXIS_PTS_X 3 UWORD INDEX_INCR DIRECT AXIS_PTS_Y 4 UWORD INDEX_INCR DIRECT NO_AXIS_PTS_X 1 UBYTE NO_AXIS_PTS_Y 2 UBYTE /end RECORD_LAYOUT
/end MODULE
/end PROJECT
