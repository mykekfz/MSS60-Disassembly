ASAP2_VERSION 1 60
/begin PROJECT MSS60_V762_IGN "MSS60 (S65) V762 IGN CPU - production calibration 7848136 (V762.01-B500.02)"
/begin HEADER "Calibration description. Measurements: V530 RAM names transferred to V762 addresses (confidence in each long identifier). Status tag in every long identifier: verified (checked against the code) / A2L-ref (placed from the V530 A2L) / EST (estimated) / unassigned (unidentified)." VERSION "V762-RE-04112026" /end HEADER
/begin MODULE IGN "MSS60 V762 IGN"
/begin MOD_COMMON "" BYTE_ORDER MSB_FIRST ALIGNMENT_BYTE 1 ALIGNMENT_WORD 2 ALIGNMENT_LONG 4 /end MOD_COMMON
/begin CHARACTERISTIC KL_AUSS_OBD_POS_MD_DYN_KH "Maximum permitted positive dynamics during catalyst heating [verified]" CURVE 0x74DFC RL_CUR_SW_SW 0 CM_0007 -655360 655340 /begin AXIS_DESCR STD_AXIS NO_INPUT_QUANTITY CM_0003 6 -3.2768 3.2767 /end AXIS_DESCR /end CHARACTERISTIC
/begin CHARACTERISTIC KL_AUSS_OBD_TZ_GRAD "Deactivation threshold for tz_grad (ignition gradient) [verified]" CURVE 0x70630 RL_CUR_SW_SW 0 CM_0008 -3276.8 3276.7 /begin AXIS_DESCR STD_AXIS NO_INPUT_QUANTITY CM_0002 4 -32768 32767 /end AXIS_DESCR /end CHARACTERISTIC
/begin CHARACTERISTIC KL_AUSS_OBD_WICHT_KAT "Weighting of catalyst temperature for catalyst damage [verified]" CURVE 0x7067A RL_CUR_SW_UB 0 CM_0009 0 0.999999993 /begin AXIS_DESCR STD_AXIS NO_INPUT_QUANTITY CM_0006 4 -3550 3003.5 /end AXIS_DESCR /end CHARACTERISTIC
/begin CHARACTERISTIC K_DIAG_TR_UB_MIN__IGN_ "Battery-voltage threshold above which driver diagnosis starts [verified]" VALUE 0x70A62 RL_VAL_SW 0 CM_0021 -3276.8 3276.7 /end CHARACTERISTIC
/begin CHARACTERISTIC K_ED_AFZ_HS.DEC_NACH_EINTRAG "Fault code AFZ_HS - debounce filter decrement after fault-memory entry [verified]" VALUE 0x71597 RL_VAL_UB 0 CM_0000 0 255 /end CHARACTERISTIC
/begin CHARACTERISTIC K_ED_AFZ_HS.DEC_VOR_EINTRAG "Fault code AFZ_HS - debounce filter decrement before fault-memory entry [verified]" VALUE 0x71595 RL_VAL_UB 0 CM_0000 0 255 /end CHARACTERISTIC
/begin CHARACTERISTIC K_ED_AFZ_HS.FEHLERSCHWELLE "Fault code AFZ_HS - debounce filter threshold for setting the fault [verified]" VALUE 0x71592 RL_VAL_UB 0 CM_0000 0 255 /end CHARACTERISTIC
/begin CHARACTERISTIC K_ED_AFZ_HS.INC_NACH_EINTRAG "Fault code AFZ_HS - debounce filter increment after fault-memory entry [verified]" VALUE 0x71596 RL_VAL_UB 0 CM_0000 0 255 /end CHARACTERISTIC
/begin CHARACTERISTIC K_ED_AFZ_HS.INC_VOR_EINTRAG "Fault code AFZ_HS - debounce filter increment before fault-memory entry [verified]" VALUE 0x71594 RL_VAL_UB 0 CM_0000 0 255 /end CHARACTERISTIC
/begin CHARACTERISTIC K_ED_AFZ_HS.KLASSENINDEX "Fault code AFZ_HS - fault class selection (lamp / warning behaviour) [verified]" VALUE 0x71598 RL_VAL_UB 0 CM_0000 0 255 /end CHARACTERISTIC
/begin CHARACTERISTIC K_ED_AFZ_HS.OK_SCHWELLE "Fault code AFZ_HS - debounce filter threshold for clearing (healing) the fault [verified]" VALUE 0x71593 RL_VAL_UB 0 CM_0000 0 255 /end CHARACTERISTIC
/begin CHARACTERISTIC K_ED_AFZ_HS.P_CODE_OPENLOAD "Fault code AFZ_HS - OBD P-code reported for open circuit [verified]" VALUE 0x7158E RL_VAL_UW 0 CM_0000 0 65535 /end CHARACTERISTIC
/begin CHARACTERISTIC K_ED_AFZ_HS.P_CODE_SH_TO_GND "Fault code AFZ_HS - OBD P-code reported for short to ground [verified]" VALUE 0x7158C RL_VAL_UW 0 CM_0000 0 65535 /end CHARACTERISTIC
/begin CHARACTERISTIC K_ED_AFZ_HS.P_CODE_SH_TO_UB "Fault code AFZ_HS - OBD P-code reported for short to battery voltage [verified]" VALUE 0x7158A RL_VAL_UW 0 CM_0000 0 65535 /end CHARACTERISTIC
/begin CHARACTERISTIC K_ED_AFZ_HS.P_CODE_UNPLAUSIBEL "Fault code AFZ_HS - OBD P-code reported for implausible signal [verified]" VALUE 0x71590 RL_VAL_UW 0 CM_0000 0 65535 /end CHARACTERISTIC
/begin CHARACTERISTIC K_ED_APPL_DATA_IGN.DEC_NACH_EINTRAG "Fault code APPL_DATA_IGN - debounce filter decrement after fault-memory entry [verified]" VALUE 0x70C25 RL_VAL_UB 0 CM_0000 0 255 /end CHARACTERISTIC
/begin CHARACTERISTIC K_ED_APPL_DATA_IGN.DEC_VOR_EINTRAG "Fault code APPL_DATA_IGN - debounce filter decrement before fault-memory entry [verified]" VALUE 0x70C23 RL_VAL_UB 0 CM_0000 0 255 /end CHARACTERISTIC
/begin CHARACTERISTIC K_ED_APPL_DATA_IGN.FEHLERSCHWELLE "Fault code APPL_DATA_IGN - debounce filter threshold for setting the fault [verified]" VALUE 0x70C20 RL_VAL_UB 0 CM_0000 0 255 /end CHARACTERISTIC
/begin CHARACTERISTIC K_ED_APPL_DATA_IGN.INC_NACH_EINTRAG "Fault code APPL_DATA_IGN - debounce filter increment after fault-memory entry [verified]" VALUE 0x70C24 RL_VAL_UB 0 CM_0000 0 255 /end CHARACTERISTIC
/begin CHARACTERISTIC K_ED_APPL_DATA_IGN.INC_VOR_EINTRAG "Fault code APPL_DATA_IGN - debounce filter increment before fault-memory entry [verified]" VALUE 0x70C22 RL_VAL_UB 0 CM_0000 0 255 /end CHARACTERISTIC
/begin CHARACTERISTIC K_ED_APPL_DATA_IGN.KLASSENINDEX "Fault code APPL_DATA_IGN - fault class selection (lamp / warning behaviour) [verified]" VALUE 0x70C26 RL_VAL_UB 0 CM_0000 0 255 /end CHARACTERISTIC
/begin CHARACTERISTIC K_ED_APPL_DATA_IGN.OK_SCHWELLE "Fault code APPL_DATA_IGN - debounce filter threshold for clearing (healing) the fault [verified]" VALUE 0x70C21 RL_VAL_UB 0 CM_0000 0 255 /end CHARACTERISTIC
/begin CHARACTERISTIC K_ED_APPL_DATA_IGN.P_CODE_OPENLOAD "Fault code APPL_DATA_IGN - OBD P-code reported for open circuit [verified]" VALUE 0x70C1C RL_VAL_UW 0 CM_0000 0 65535 /end CHARACTERISTIC
/begin CHARACTERISTIC K_ED_APPL_DATA_IGN.P_CODE_SH_TO_GND "Fault code APPL_DATA_IGN - OBD P-code reported for short to ground [verified]" VALUE 0x70C1A RL_VAL_UW 0 CM_0000 0 65535 /end CHARACTERISTIC
/begin CHARACTERISTIC K_ED_APPL_DATA_IGN.P_CODE_SH_TO_UB "Fault code APPL_DATA_IGN - OBD P-code reported for short to battery voltage [verified]" VALUE 0x70C18 RL_VAL_UW 0 CM_0000 0 65535 /end CHARACTERISTIC
/begin CHARACTERISTIC K_ED_APPL_DATA_IGN.P_CODE_UNPLAUSIBEL "Fault code APPL_DATA_IGN - OBD P-code reported for implausible signal [verified]" VALUE 0x70C1E RL_VAL_UW 0 CM_0000 0 65535 /end CHARACTERISTIC
/begin CHARACTERISTIC K_ED_AUSS_ABG_Z1.DEC_NACH_EINTRAG "Fault code AUSS_ABG_Z1 - debounce filter decrement after fault-memory entry [verified]" VALUE 0x7128B RL_VAL_UB 0 CM_0000 0 255 /end CHARACTERISTIC
/begin CHARACTERISTIC K_ED_AUSS_ABG_Z1.DEC_VOR_EINTRAG "Fault code AUSS_ABG_Z1 - debounce filter decrement before fault-memory entry [verified]" VALUE 0x71289 RL_VAL_UB 0 CM_0000 0 255 /end CHARACTERISTIC
/begin CHARACTERISTIC K_ED_AUSS_ABG_Z1.FEHLERSCHWELLE "Fault code AUSS_ABG_Z1 - debounce filter threshold for setting the fault [verified]" VALUE 0x71286 RL_VAL_UB 0 CM_0000 0 255 /end CHARACTERISTIC
/begin CHARACTERISTIC K_ED_AUSS_ABG_Z1.INC_NACH_EINTRAG "Fault code AUSS_ABG_Z1 - debounce filter increment after fault-memory entry [verified]" VALUE 0x7128A RL_VAL_UB 0 CM_0000 0 255 /end CHARACTERISTIC
/begin CHARACTERISTIC K_ED_AUSS_ABG_Z1.INC_VOR_EINTRAG "Fault code AUSS_ABG_Z1 - debounce filter increment before fault-memory entry [verified]" VALUE 0x71288 RL_VAL_UB 0 CM_0000 0 255 /end CHARACTERISTIC
/begin CHARACTERISTIC K_ED_AUSS_ABG_Z1.KLASSENINDEX "Fault code AUSS_ABG_Z1 - fault class selection (lamp / warning behaviour) [verified]" VALUE 0x7128C RL_VAL_UB 0 CM_0000 0 255 /end CHARACTERISTIC
/begin CHARACTERISTIC K_ED_AUSS_ABG_Z1.OK_SCHWELLE "Fault code AUSS_ABG_Z1 - debounce filter threshold for clearing (healing) the fault [verified]" VALUE 0x71287 RL_VAL_UB 0 CM_0000 0 255 /end CHARACTERISTIC
/begin CHARACTERISTIC K_ED_AUSS_ABG_Z1.P_CODE_OPENLOAD "Fault code AUSS_ABG_Z1 - OBD P-code reported for open circuit [verified]" VALUE 0x71282 RL_VAL_UW 0 CM_0000 0 65535 /end CHARACTERISTIC
/begin CHARACTERISTIC K_ED_AUSS_ABG_Z1.P_CODE_SH_TO_GND "Fault code AUSS_ABG_Z1 - OBD P-code reported for short to ground [verified]" VALUE 0x71280 RL_VAL_UW 0 CM_0000 0 65535 /end CHARACTERISTIC
/begin CHARACTERISTIC K_ED_AUSS_ABG_Z1.P_CODE_SH_TO_UB "Fault code AUSS_ABG_Z1 - OBD P-code reported for short to battery voltage [verified]" VALUE 0x7127E RL_VAL_UW 0 CM_0000 0 65535 /end CHARACTERISTIC
/begin CHARACTERISTIC K_ED_AUSS_ABG_Z1.P_CODE_UNPLAUSIBEL "Fault code AUSS_ABG_Z1 - OBD P-code reported for implausible signal [verified]" VALUE 0x71284 RL_VAL_UW 0 CM_0000 0 65535 /end CHARACTERISTIC
/begin CHARACTERISTIC K_ED_AUSS_ABG_Z2.DEC_NACH_EINTRAG "Fault code AUSS_ABG_Z2 - debounce filter decrement after fault-memory entry [verified]" VALUE 0x712A5 RL_VAL_UB 0 CM_0000 0 255 /end CHARACTERISTIC
/begin CHARACTERISTIC K_ED_AUSS_ABG_Z2.DEC_VOR_EINTRAG "Fault code AUSS_ABG_Z2 - debounce filter decrement before fault-memory entry [verified]" VALUE 0x712A3 RL_VAL_UB 0 CM_0000 0 255 /end CHARACTERISTIC
/begin CHARACTERISTIC K_ED_AUSS_ABG_Z2.FEHLERSCHWELLE "Fault code AUSS_ABG_Z2 - debounce filter threshold for setting the fault [verified]" VALUE 0x712A0 RL_VAL_UB 0 CM_0000 0 255 /end CHARACTERISTIC
/begin CHARACTERISTIC K_ED_AUSS_ABG_Z2.INC_NACH_EINTRAG "Fault code AUSS_ABG_Z2 - debounce filter increment after fault-memory entry [verified]" VALUE 0x712A4 RL_VAL_UB 0 CM_0000 0 255 /end CHARACTERISTIC
/begin CHARACTERISTIC K_ED_AUSS_ABG_Z2.INC_VOR_EINTRAG "Fault code AUSS_ABG_Z2 - debounce filter increment before fault-memory entry [verified]" VALUE 0x712A2 RL_VAL_UB 0 CM_0000 0 255 /end CHARACTERISTIC
/begin CHARACTERISTIC K_ED_AUSS_ABG_Z2.KLASSENINDEX "Fault code AUSS_ABG_Z2 - fault class selection (lamp / warning behaviour) [verified]" VALUE 0x712A6 RL_VAL_UB 0 CM_0000 0 255 /end CHARACTERISTIC
/begin CHARACTERISTIC K_ED_AUSS_ABG_Z2.OK_SCHWELLE "Fault code AUSS_ABG_Z2 - debounce filter threshold for clearing (healing) the fault [verified]" VALUE 0x712A1 RL_VAL_UB 0 CM_0000 0 255 /end CHARACTERISTIC
/begin CHARACTERISTIC K_ED_AUSS_ABG_Z2.P_CODE_OPENLOAD "Fault code AUSS_ABG_Z2 - OBD P-code reported for open circuit [verified]" VALUE 0x7129C RL_VAL_UW 0 CM_0000 0 65535 /end CHARACTERISTIC
/begin CHARACTERISTIC K_ED_AUSS_ABG_Z2.P_CODE_SH_TO_GND "Fault code AUSS_ABG_Z2 - OBD P-code reported for short to ground [verified]" VALUE 0x7129A RL_VAL_UW 0 CM_0000 0 65535 /end CHARACTERISTIC
/begin CHARACTERISTIC K_ED_AUSS_ABG_Z2.P_CODE_SH_TO_UB "Fault code AUSS_ABG_Z2 - OBD P-code reported for short to battery voltage [verified]" VALUE 0x71298 RL_VAL_UW 0 CM_0000 0 65535 /end CHARACTERISTIC
/begin CHARACTERISTIC K_ED_AUSS_ABG_Z2.P_CODE_UNPLAUSIBEL "Fault code AUSS_ABG_Z2 - OBD P-code reported for implausible signal [verified]" VALUE 0x7129E RL_VAL_UW 0 CM_0000 0 65535 /end CHARACTERISTIC
/begin CHARACTERISTIC K_ED_AUSS_ABG_Z3.DEC_NACH_EINTRAG "Fault code AUSS_ABG_Z3 - debounce filter decrement after fault-memory entry [verified]" VALUE 0x712BF RL_VAL_UB 0 CM_0000 0 255 /end CHARACTERISTIC
/begin CHARACTERISTIC K_ED_AUSS_ABG_Z3.DEC_VOR_EINTRAG "Fault code AUSS_ABG_Z3 - debounce filter decrement before fault-memory entry [verified]" VALUE 0x712BD RL_VAL_UB 0 CM_0000 0 255 /end CHARACTERISTIC
/begin CHARACTERISTIC K_ED_AUSS_ABG_Z3.FEHLERSCHWELLE "Fault code AUSS_ABG_Z3 - debounce filter threshold for setting the fault [verified]" VALUE 0x712BA RL_VAL_UB 0 CM_0000 0 255 /end CHARACTERISTIC
/begin CHARACTERISTIC K_ED_AUSS_ABG_Z3.INC_NACH_EINTRAG "Fault code AUSS_ABG_Z3 - debounce filter increment after fault-memory entry [verified]" VALUE 0x712BE RL_VAL_UB 0 CM_0000 0 255 /end CHARACTERISTIC
/begin CHARACTERISTIC K_ED_AUSS_ABG_Z3.INC_VOR_EINTRAG "Fault code AUSS_ABG_Z3 - debounce filter increment before fault-memory entry [verified]" VALUE 0x712BC RL_VAL_UB 0 CM_0000 0 255 /end CHARACTERISTIC
/begin CHARACTERISTIC K_ED_AUSS_ABG_Z3.KLASSENINDEX "Fault code AUSS_ABG_Z3 - fault class selection (lamp / warning behaviour) [verified]" VALUE 0x712C0 RL_VAL_UB 0 CM_0000 0 255 /end CHARACTERISTIC
/begin CHARACTERISTIC K_ED_AUSS_ABG_Z3.OK_SCHWELLE "Fault code AUSS_ABG_Z3 - debounce filter threshold for clearing (healing) the fault [verified]" VALUE 0x712BB RL_VAL_UB 0 CM_0000 0 255 /end CHARACTERISTIC
/begin CHARACTERISTIC K_ED_AUSS_ABG_Z3.P_CODE_OPENLOAD "Fault code AUSS_ABG_Z3 - OBD P-code reported for open circuit [verified]" VALUE 0x712B6 RL_VAL_UW 0 CM_0000 0 65535 /end CHARACTERISTIC
/begin CHARACTERISTIC K_ED_AUSS_ABG_Z3.P_CODE_SH_TO_GND "Fault code AUSS_ABG_Z3 - OBD P-code reported for short to ground [verified]" VALUE 0x712B4 RL_VAL_UW 0 CM_0000 0 65535 /end CHARACTERISTIC
/begin CHARACTERISTIC K_ED_AUSS_ABG_Z3.P_CODE_SH_TO_UB "Fault code AUSS_ABG_Z3 - OBD P-code reported for short to battery voltage [verified]" VALUE 0x712B2 RL_VAL_UW 0 CM_0000 0 65535 /end CHARACTERISTIC
/begin CHARACTERISTIC K_ED_AUSS_ABG_Z3.P_CODE_UNPLAUSIBEL "Fault code AUSS_ABG_Z3 - OBD P-code reported for implausible signal [verified]" VALUE 0x712B8 RL_VAL_UW 0 CM_0000 0 65535 /end CHARACTERISTIC
/begin CHARACTERISTIC K_ED_AUSS_ABG_Z4.DEC_NACH_EINTRAG "Fault code AUSS_ABG_Z4 - debounce filter decrement after fault-memory entry [verified]" VALUE 0x712D9 RL_VAL_UB 0 CM_0000 0 255 /end CHARACTERISTIC
/begin CHARACTERISTIC K_ED_AUSS_ABG_Z4.DEC_VOR_EINTRAG "Fault code AUSS_ABG_Z4 - debounce filter decrement before fault-memory entry [verified]" VALUE 0x712D7 RL_VAL_UB 0 CM_0000 0 255 /end CHARACTERISTIC
/begin CHARACTERISTIC K_ED_AUSS_ABG_Z4.FEHLERSCHWELLE "Fault code AUSS_ABG_Z4 - debounce filter threshold for setting the fault [verified]" VALUE 0x712D4 RL_VAL_UB 0 CM_0000 0 255 /end CHARACTERISTIC
/begin CHARACTERISTIC K_ED_AUSS_ABG_Z4.INC_NACH_EINTRAG "Fault code AUSS_ABG_Z4 - debounce filter increment after fault-memory entry [verified]" VALUE 0x712D8 RL_VAL_UB 0 CM_0000 0 255 /end CHARACTERISTIC
/begin CHARACTERISTIC K_ED_AUSS_ABG_Z4.INC_VOR_EINTRAG "Fault code AUSS_ABG_Z4 - debounce filter increment before fault-memory entry [verified]" VALUE 0x712D6 RL_VAL_UB 0 CM_0000 0 255 /end CHARACTERISTIC
/begin CHARACTERISTIC K_ED_AUSS_ABG_Z4.KLASSENINDEX "Fault code AUSS_ABG_Z4 - fault class selection (lamp / warning behaviour) [verified]" VALUE 0x712DA RL_VAL_UB 0 CM_0000 0 255 /end CHARACTERISTIC
/begin CHARACTERISTIC K_ED_AUSS_ABG_Z4.OK_SCHWELLE "Fault code AUSS_ABG_Z4 - debounce filter threshold for clearing (healing) the fault [verified]" VALUE 0x712D5 RL_VAL_UB 0 CM_0000 0 255 /end CHARACTERISTIC
/begin CHARACTERISTIC K_ED_AUSS_ABG_Z4.P_CODE_OPENLOAD "Fault code AUSS_ABG_Z4 - OBD P-code reported for open circuit [verified]" VALUE 0x712D0 RL_VAL_UW 0 CM_0000 0 65535 /end CHARACTERISTIC
/begin CHARACTERISTIC K_ED_AUSS_ABG_Z4.P_CODE_SH_TO_GND "Fault code AUSS_ABG_Z4 - OBD P-code reported for short to ground [verified]" VALUE 0x712CE RL_VAL_UW 0 CM_0000 0 65535 /end CHARACTERISTIC
/begin CHARACTERISTIC K_ED_AUSS_ABG_Z4.P_CODE_SH_TO_UB "Fault code AUSS_ABG_Z4 - OBD P-code reported for short to battery voltage [verified]" VALUE 0x712CC RL_VAL_UW 0 CM_0000 0 65535 /end CHARACTERISTIC
/begin CHARACTERISTIC K_ED_AUSS_ABG_Z4.P_CODE_UNPLAUSIBEL "Fault code AUSS_ABG_Z4 - OBD P-code reported for implausible signal [verified]" VALUE 0x712D2 RL_VAL_UW 0 CM_0000 0 65535 /end CHARACTERISTIC
/begin CHARACTERISTIC K_ED_AUSS_ABG_Z5.DEC_NACH_EINTRAG "Fault code AUSS_ABG_Z5 - debounce filter decrement after fault-memory entry [verified]" VALUE 0x712F3 RL_VAL_UB 0 CM_0000 0 255 /end CHARACTERISTIC
/begin CHARACTERISTIC K_ED_AUSS_ABG_Z5.DEC_VOR_EINTRAG "Fault code AUSS_ABG_Z5 - debounce filter decrement before fault-memory entry [verified]" VALUE 0x712F1 RL_VAL_UB 0 CM_0000 0 255 /end CHARACTERISTIC
/begin CHARACTERISTIC K_ED_AUSS_ABG_Z5.FEHLERSCHWELLE "Fault code AUSS_ABG_Z5 - debounce filter threshold for setting the fault [verified]" VALUE 0x712EE RL_VAL_UB 0 CM_0000 0 255 /end CHARACTERISTIC
/begin CHARACTERISTIC K_ED_AUSS_ABG_Z5.INC_NACH_EINTRAG "Fault code AUSS_ABG_Z5 - debounce filter increment after fault-memory entry [verified]" VALUE 0x712F2 RL_VAL_UB 0 CM_0000 0 255 /end CHARACTERISTIC
/begin CHARACTERISTIC K_ED_AUSS_ABG_Z5.INC_VOR_EINTRAG "Fault code AUSS_ABG_Z5 - debounce filter increment before fault-memory entry [verified]" VALUE 0x712F0 RL_VAL_UB 0 CM_0000 0 255 /end CHARACTERISTIC
/begin CHARACTERISTIC K_ED_AUSS_ABG_Z5.KLASSENINDEX "Fault code AUSS_ABG_Z5 - fault class selection (lamp / warning behaviour) [verified]" VALUE 0x712F4 RL_VAL_UB 0 CM_0000 0 255 /end CHARACTERISTIC
/begin CHARACTERISTIC K_ED_AUSS_ABG_Z5.OK_SCHWELLE "Fault code AUSS_ABG_Z5 - debounce filter threshold for clearing (healing) the fault [verified]" VALUE 0x712EF RL_VAL_UB 0 CM_0000 0 255 /end CHARACTERISTIC
/begin CHARACTERISTIC K_ED_AUSS_ABG_Z5.P_CODE_OPENLOAD "Fault code AUSS_ABG_Z5 - OBD P-code reported for open circuit [verified]" VALUE 0x712EA RL_VAL_UW 0 CM_0000 0 65535 /end CHARACTERISTIC
/begin CHARACTERISTIC K_ED_AUSS_ABG_Z5.P_CODE_SH_TO_GND "Fault code AUSS_ABG_Z5 - OBD P-code reported for short to ground [verified]" VALUE 0x712E8 RL_VAL_UW 0 CM_0000 0 65535 /end CHARACTERISTIC
/begin CHARACTERISTIC K_ED_AUSS_ABG_Z5.P_CODE_SH_TO_UB "Fault code AUSS_ABG_Z5 - OBD P-code reported for short to battery voltage [verified]" VALUE 0x712E6 RL_VAL_UW 0 CM_0000 0 65535 /end CHARACTERISTIC
/begin CHARACTERISTIC K_ED_AUSS_ABG_Z5.P_CODE_UNPLAUSIBEL "Fault code AUSS_ABG_Z5 - OBD P-code reported for implausible signal [verified]" VALUE 0x712EC RL_VAL_UW 0 CM_0000 0 65535 /end CHARACTERISTIC
/begin CHARACTERISTIC K_ED_AUSS_ABG_Z6.DEC_NACH_EINTRAG "Fault code AUSS_ABG_Z6 - debounce filter decrement after fault-memory entry [verified]" VALUE 0x7130D RL_VAL_UB 0 CM_0000 0 255 /end CHARACTERISTIC
/begin CHARACTERISTIC K_ED_AUSS_ABG_Z6.DEC_VOR_EINTRAG "Fault code AUSS_ABG_Z6 - debounce filter decrement before fault-memory entry [verified]" VALUE 0x7130B RL_VAL_UB 0 CM_0000 0 255 /end CHARACTERISTIC
/begin CHARACTERISTIC K_ED_AUSS_ABG_Z6.FEHLERSCHWELLE "Fault code AUSS_ABG_Z6 - debounce filter threshold for setting the fault [verified]" VALUE 0x71308 RL_VAL_UB 0 CM_0000 0 255 /end CHARACTERISTIC
/begin CHARACTERISTIC K_ED_AUSS_ABG_Z6.INC_NACH_EINTRAG "Fault code AUSS_ABG_Z6 - debounce filter increment after fault-memory entry [verified]" VALUE 0x7130C RL_VAL_UB 0 CM_0000 0 255 /end CHARACTERISTIC
/begin CHARACTERISTIC K_ED_AUSS_ABG_Z6.INC_VOR_EINTRAG "Fault code AUSS_ABG_Z6 - debounce filter increment before fault-memory entry [verified]" VALUE 0x7130A RL_VAL_UB 0 CM_0000 0 255 /end CHARACTERISTIC
/begin CHARACTERISTIC K_ED_AUSS_ABG_Z6.KLASSENINDEX "Fault code AUSS_ABG_Z6 - fault class selection (lamp / warning behaviour) [verified]" VALUE 0x7130E RL_VAL_UB 0 CM_0000 0 255 /end CHARACTERISTIC
/begin CHARACTERISTIC K_ED_AUSS_ABG_Z6.OK_SCHWELLE "Fault code AUSS_ABG_Z6 - debounce filter threshold for clearing (healing) the fault [verified]" VALUE 0x71309 RL_VAL_UB 0 CM_0000 0 255 /end CHARACTERISTIC
/begin CHARACTERISTIC K_ED_AUSS_ABG_Z6.P_CODE_OPENLOAD "Fault code AUSS_ABG_Z6 - OBD P-code reported for open circuit [verified]" VALUE 0x71304 RL_VAL_UW 0 CM_0000 0 65535 /end CHARACTERISTIC
/begin CHARACTERISTIC K_ED_AUSS_ABG_Z6.P_CODE_SH_TO_GND "Fault code AUSS_ABG_Z6 - OBD P-code reported for short to ground [verified]" VALUE 0x71302 RL_VAL_UW 0 CM_0000 0 65535 /end CHARACTERISTIC
/begin CHARACTERISTIC K_ED_AUSS_ABG_Z6.P_CODE_SH_TO_UB "Fault code AUSS_ABG_Z6 - OBD P-code reported for short to battery voltage [verified]" VALUE 0x71300 RL_VAL_UW 0 CM_0000 0 65535 /end CHARACTERISTIC
/begin CHARACTERISTIC K_ED_AUSS_ABG_Z6.P_CODE_UNPLAUSIBEL "Fault code AUSS_ABG_Z6 - OBD P-code reported for implausible signal [verified]" VALUE 0x71306 RL_VAL_UW 0 CM_0000 0 65535 /end CHARACTERISTIC
/begin CHARACTERISTIC K_ED_AUSS_ABG_Z7.DEC_NACH_EINTRAG "Fault code AUSS_ABG_Z7 - debounce filter decrement after fault-memory entry [verified]" VALUE 0x71327 RL_VAL_UB 0 CM_0000 0 255 /end CHARACTERISTIC
/begin CHARACTERISTIC K_ED_AUSS_ABG_Z7.DEC_VOR_EINTRAG "Fault code AUSS_ABG_Z7 - debounce filter decrement before fault-memory entry [verified]" VALUE 0x71325 RL_VAL_UB 0 CM_0000 0 255 /end CHARACTERISTIC
/begin CHARACTERISTIC K_ED_AUSS_ABG_Z7.FEHLERSCHWELLE "Fault code AUSS_ABG_Z7 - debounce filter threshold for setting the fault [verified]" VALUE 0x71322 RL_VAL_UB 0 CM_0000 0 255 /end CHARACTERISTIC
/begin CHARACTERISTIC K_ED_AUSS_ABG_Z7.INC_NACH_EINTRAG "Fault code AUSS_ABG_Z7 - debounce filter increment after fault-memory entry [verified]" VALUE 0x71326 RL_VAL_UB 0 CM_0000 0 255 /end CHARACTERISTIC
/begin CHARACTERISTIC K_ED_AUSS_ABG_Z7.INC_VOR_EINTRAG "Fault code AUSS_ABG_Z7 - debounce filter increment before fault-memory entry [verified]" VALUE 0x71324 RL_VAL_UB 0 CM_0000 0 255 /end CHARACTERISTIC
/begin CHARACTERISTIC K_ED_AUSS_ABG_Z7.KLASSENINDEX "Fault code AUSS_ABG_Z7 - fault class selection (lamp / warning behaviour) [verified]" VALUE 0x71328 RL_VAL_UB 0 CM_0000 0 255 /end CHARACTERISTIC
/begin CHARACTERISTIC K_ED_AUSS_ABG_Z7.OK_SCHWELLE "Fault code AUSS_ABG_Z7 - debounce filter threshold for clearing (healing) the fault [verified]" VALUE 0x71323 RL_VAL_UB 0 CM_0000 0 255 /end CHARACTERISTIC
/begin CHARACTERISTIC K_ED_AUSS_ABG_Z7.P_CODE_OPENLOAD "Fault code AUSS_ABG_Z7 - OBD P-code reported for open circuit [verified]" VALUE 0x7131E RL_VAL_UW 0 CM_0000 0 65535 /end CHARACTERISTIC
/begin CHARACTERISTIC K_ED_AUSS_ABG_Z7.P_CODE_SH_TO_GND "Fault code AUSS_ABG_Z7 - OBD P-code reported for short to ground [verified]" VALUE 0x7131C RL_VAL_UW 0 CM_0000 0 65535 /end CHARACTERISTIC
/begin CHARACTERISTIC K_ED_AUSS_ABG_Z7.P_CODE_SH_TO_UB "Fault code AUSS_ABG_Z7 - OBD P-code reported for short to battery voltage [verified]" VALUE 0x7131A RL_VAL_UW 0 CM_0000 0 65535 /end CHARACTERISTIC
/begin CHARACTERISTIC K_ED_AUSS_ABG_Z7.P_CODE_UNPLAUSIBEL "Fault code AUSS_ABG_Z7 - OBD P-code reported for implausible signal [verified]" VALUE 0x71320 RL_VAL_UW 0 CM_0000 0 65535 /end CHARACTERISTIC
/begin CHARACTERISTIC K_ED_AUSS_ABG_Z8.DEC_NACH_EINTRAG "Fault code AUSS_ABG_Z8 - debounce filter decrement after fault-memory entry [verified]" VALUE 0x71341 RL_VAL_UB 0 CM_0000 0 255 /end CHARACTERISTIC
/begin CHARACTERISTIC K_ED_AUSS_ABG_Z8.DEC_VOR_EINTRAG "Fault code AUSS_ABG_Z8 - debounce filter decrement before fault-memory entry [verified]" VALUE 0x7133F RL_VAL_UB 0 CM_0000 0 255 /end CHARACTERISTIC
/begin CHARACTERISTIC K_ED_AUSS_ABG_Z8.FEHLERSCHWELLE "Fault code AUSS_ABG_Z8 - debounce filter threshold for setting the fault [verified]" VALUE 0x7133C RL_VAL_UB 0 CM_0000 0 255 /end CHARACTERISTIC
/begin CHARACTERISTIC K_ED_AUSS_ABG_Z8.INC_NACH_EINTRAG "Fault code AUSS_ABG_Z8 - debounce filter increment after fault-memory entry [verified]" VALUE 0x71340 RL_VAL_UB 0 CM_0000 0 255 /end CHARACTERISTIC
/begin CHARACTERISTIC K_ED_AUSS_ABG_Z8.INC_VOR_EINTRAG "Fault code AUSS_ABG_Z8 - debounce filter increment before fault-memory entry [verified]" VALUE 0x7133E RL_VAL_UB 0 CM_0000 0 255 /end CHARACTERISTIC
/begin CHARACTERISTIC K_ED_AUSS_ABG_Z8.KLASSENINDEX "Fault code AUSS_ABG_Z8 - fault class selection (lamp / warning behaviour) [verified]" VALUE 0x71342 RL_VAL_UB 0 CM_0000 0 255 /end CHARACTERISTIC
/begin CHARACTERISTIC K_ED_AUSS_ABG_Z8.OK_SCHWELLE "Fault code AUSS_ABG_Z8 - debounce filter threshold for clearing (healing) the fault [verified]" VALUE 0x7133D RL_VAL_UB 0 CM_0000 0 255 /end CHARACTERISTIC
/begin CHARACTERISTIC K_ED_AUSS_ABG_Z8.P_CODE_OPENLOAD "Fault code AUSS_ABG_Z8 - OBD P-code reported for open circuit [verified]" VALUE 0x71338 RL_VAL_UW 0 CM_0000 0 65535 /end CHARACTERISTIC
/begin CHARACTERISTIC K_ED_AUSS_ABG_Z8.P_CODE_SH_TO_GND "Fault code AUSS_ABG_Z8 - OBD P-code reported for short to ground [verified]" VALUE 0x71336 RL_VAL_UW 0 CM_0000 0 65535 /end CHARACTERISTIC
/begin CHARACTERISTIC K_ED_AUSS_ABG_Z8.P_CODE_SH_TO_UB "Fault code AUSS_ABG_Z8 - OBD P-code reported for short to battery voltage [verified]" VALUE 0x71334 RL_VAL_UW 0 CM_0000 0 65535 /end CHARACTERISTIC
/begin CHARACTERISTIC K_ED_AUSS_ABG_Z8.P_CODE_UNPLAUSIBEL "Fault code AUSS_ABG_Z8 - OBD P-code reported for implausible signal [verified]" VALUE 0x7133A RL_VAL_UW 0 CM_0000 0 65535 /end CHARACTERISTIC
/begin CHARACTERISTIC K_ED_AUSS_KAT_MULT.DEC_NACH_EINTRAG "Fault code AUSS_KAT_MULT - debounce filter decrement after fault-memory entry [verified]" VALUE 0x71271 RL_VAL_UB 0 CM_0000 0 255 /end CHARACTERISTIC
/begin CHARACTERISTIC K_ED_AUSS_KAT_MULT.DEC_VOR_EINTRAG "Fault code AUSS_KAT_MULT - debounce filter decrement before fault-memory entry [verified]" VALUE 0x7126F RL_VAL_UB 0 CM_0000 0 255 /end CHARACTERISTIC
/begin CHARACTERISTIC K_ED_AUSS_KAT_MULT.FEHLERSCHWELLE "Fault code AUSS_KAT_MULT - debounce filter threshold for setting the fault [verified]" VALUE 0x7126C RL_VAL_UB 0 CM_0000 0 255 /end CHARACTERISTIC
/begin CHARACTERISTIC K_ED_AUSS_KAT_MULT.INC_NACH_EINTRAG "Fault code AUSS_KAT_MULT - debounce filter increment after fault-memory entry [verified]" VALUE 0x71270 RL_VAL_UB 0 CM_0000 0 255 /end CHARACTERISTIC
/begin CHARACTERISTIC K_ED_AUSS_KAT_MULT.INC_VOR_EINTRAG "Fault code AUSS_KAT_MULT - debounce filter increment before fault-memory entry [verified]" VALUE 0x7126E RL_VAL_UB 0 CM_0000 0 255 /end CHARACTERISTIC
/begin CHARACTERISTIC K_ED_AUSS_KAT_MULT.KLASSENINDEX "Fault code AUSS_KAT_MULT - fault class selection (lamp / warning behaviour) [verified]" VALUE 0x71272 RL_VAL_UB 0 CM_0000 0 255 /end CHARACTERISTIC
/begin CHARACTERISTIC K_ED_AUSS_KAT_MULT.OK_SCHWELLE "Fault code AUSS_KAT_MULT - debounce filter threshold for clearing (healing) the fault [verified]" VALUE 0x7126D RL_VAL_UB 0 CM_0000 0 255 /end CHARACTERISTIC
/begin CHARACTERISTIC K_ED_AUSS_KAT_MULT.P_CODE_OPENLOAD "Fault code AUSS_KAT_MULT - OBD P-code reported for open circuit [verified]" VALUE 0x71268 RL_VAL_UW 0 CM_0000 0 65535 /end CHARACTERISTIC
/begin CHARACTERISTIC K_ED_AUSS_KAT_MULT.P_CODE_SH_TO_GND "Fault code AUSS_KAT_MULT - OBD P-code reported for short to ground [verified]" VALUE 0x71266 RL_VAL_UW 0 CM_0000 0 65535 /end CHARACTERISTIC
/begin CHARACTERISTIC K_ED_AUSS_KAT_MULT.P_CODE_SH_TO_UB "Fault code AUSS_KAT_MULT - OBD P-code reported for short to battery voltage [verified]" VALUE 0x71264 RL_VAL_UW 0 CM_0000 0 65535 /end CHARACTERISTIC
/begin CHARACTERISTIC K_ED_AUSS_KAT_MULT.P_CODE_UNPLAUSIBEL "Fault code AUSS_KAT_MULT - OBD P-code reported for implausible signal [verified]" VALUE 0x7126A RL_VAL_UW 0 CM_0000 0 65535 /end CHARACTERISTIC
/begin CHARACTERISTIC K_ED_AUSS_KAT_Z1.DEC_NACH_EINTRAG "Fault code AUSS_KAT_Z1 - debounce filter decrement after fault-memory entry [verified]" VALUE 0x71139 RL_VAL_UB 0 CM_0000 0 255 /end CHARACTERISTIC
/begin CHARACTERISTIC K_ED_AUSS_KAT_Z1.DEC_VOR_EINTRAG "Fault code AUSS_KAT_Z1 - debounce filter decrement before fault-memory entry [verified]" VALUE 0x71137 RL_VAL_UB 0 CM_0000 0 255 /end CHARACTERISTIC
/begin CHARACTERISTIC K_ED_AUSS_KAT_Z1.FEHLERSCHWELLE "Fault code AUSS_KAT_Z1 - debounce filter threshold for setting the fault [verified]" VALUE 0x71134 RL_VAL_UB 0 CM_0000 0 255 /end CHARACTERISTIC
/begin CHARACTERISTIC K_ED_AUSS_KAT_Z1.INC_NACH_EINTRAG "Fault code AUSS_KAT_Z1 - debounce filter increment after fault-memory entry [verified]" VALUE 0x71138 RL_VAL_UB 0 CM_0000 0 255 /end CHARACTERISTIC
/begin CHARACTERISTIC K_ED_AUSS_KAT_Z1.INC_VOR_EINTRAG "Fault code AUSS_KAT_Z1 - debounce filter increment before fault-memory entry [verified]" VALUE 0x71136 RL_VAL_UB 0 CM_0000 0 255 /end CHARACTERISTIC
/begin CHARACTERISTIC K_ED_AUSS_KAT_Z1.KLASSENINDEX "Fault code AUSS_KAT_Z1 - fault class selection (lamp / warning behaviour) [verified]" VALUE 0x7113A RL_VAL_UB 0 CM_0000 0 255 /end CHARACTERISTIC
/begin CHARACTERISTIC K_ED_AUSS_KAT_Z1.OK_SCHWELLE "Fault code AUSS_KAT_Z1 - debounce filter threshold for clearing (healing) the fault [verified]" VALUE 0x71135 RL_VAL_UB 0 CM_0000 0 255 /end CHARACTERISTIC
/begin CHARACTERISTIC K_ED_AUSS_KAT_Z1.P_CODE_OPENLOAD "Fault code AUSS_KAT_Z1 - OBD P-code reported for open circuit [verified]" VALUE 0x71130 RL_VAL_UW 0 CM_0000 0 65535 /end CHARACTERISTIC
/begin CHARACTERISTIC K_ED_AUSS_KAT_Z1.P_CODE_SH_TO_GND "Fault code AUSS_KAT_Z1 - OBD P-code reported for short to ground [verified]" VALUE 0x7112E RL_VAL_UW 0 CM_0000 0 65535 /end CHARACTERISTIC
/begin CHARACTERISTIC K_ED_AUSS_KAT_Z1.P_CODE_SH_TO_UB "Fault code AUSS_KAT_Z1 - OBD P-code reported for short to battery voltage [verified]" VALUE 0x7112C RL_VAL_UW 0 CM_0000 0 65535 /end CHARACTERISTIC
/begin CHARACTERISTIC K_ED_AUSS_KAT_Z1.P_CODE_UNPLAUSIBEL "Fault code AUSS_KAT_Z1 - OBD P-code reported for implausible signal [verified]" VALUE 0x71132 RL_VAL_UW 0 CM_0000 0 65535 /end CHARACTERISTIC
/begin CHARACTERISTIC K_ED_AUSS_KAT_Z10.DEC_NACH_EINTRAG "Fault code AUSS_KAT_Z10 - debounce filter decrement after fault-memory entry [verified]" VALUE 0x71223 RL_VAL_UB 0 CM_0000 0 255 /end CHARACTERISTIC
/begin CHARACTERISTIC K_ED_AUSS_KAT_Z10.DEC_VOR_EINTRAG "Fault code AUSS_KAT_Z10 - debounce filter decrement before fault-memory entry [verified]" VALUE 0x71221 RL_VAL_UB 0 CM_0000 0 255 /end CHARACTERISTIC
/begin CHARACTERISTIC K_ED_AUSS_KAT_Z10.FEHLERSCHWELLE "Fault code AUSS_KAT_Z10 - debounce filter threshold for setting the fault [verified]" VALUE 0x7121E RL_VAL_UB 0 CM_0000 0 255 /end CHARACTERISTIC
/begin CHARACTERISTIC K_ED_AUSS_KAT_Z10.INC_NACH_EINTRAG "Fault code AUSS_KAT_Z10 - debounce filter increment after fault-memory entry [verified]" VALUE 0x71222 RL_VAL_UB 0 CM_0000 0 255 /end CHARACTERISTIC
/begin CHARACTERISTIC K_ED_AUSS_KAT_Z10.INC_VOR_EINTRAG "Fault code AUSS_KAT_Z10 - debounce filter increment before fault-memory entry [verified]" VALUE 0x71220 RL_VAL_UB 0 CM_0000 0 255 /end CHARACTERISTIC
/begin CHARACTERISTIC K_ED_AUSS_KAT_Z10.KLASSENINDEX "Fault code AUSS_KAT_Z10 - fault class selection (lamp / warning behaviour) [verified]" VALUE 0x71224 RL_VAL_UB 0 CM_0000 0 255 /end CHARACTERISTIC
/begin CHARACTERISTIC K_ED_AUSS_KAT_Z10.OK_SCHWELLE "Fault code AUSS_KAT_Z10 - debounce filter threshold for clearing (healing) the fault [verified]" VALUE 0x7121F RL_VAL_UB 0 CM_0000 0 255 /end CHARACTERISTIC
/begin CHARACTERISTIC K_ED_AUSS_KAT_Z10.P_CODE_OPENLOAD "Fault code AUSS_KAT_Z10 - OBD P-code reported for open circuit [verified]" VALUE 0x7121A RL_VAL_UW 0 CM_0000 0 65535 /end CHARACTERISTIC
/begin CHARACTERISTIC K_ED_AUSS_KAT_Z10.P_CODE_SH_TO_GND "Fault code AUSS_KAT_Z10 - OBD P-code reported for short to ground [verified]" VALUE 0x71218 RL_VAL_UW 0 CM_0000 0 65535 /end CHARACTERISTIC
/begin CHARACTERISTIC K_ED_AUSS_KAT_Z10.P_CODE_SH_TO_UB "Fault code AUSS_KAT_Z10 - OBD P-code reported for short to battery voltage [verified]" VALUE 0x71216 RL_VAL_UW 0 CM_0000 0 65535 /end CHARACTERISTIC
/begin CHARACTERISTIC K_ED_AUSS_KAT_Z10.P_CODE_UNPLAUSIBEL "Fault code AUSS_KAT_Z10 - OBD P-code reported for implausible signal [verified]" VALUE 0x7121C RL_VAL_UW 0 CM_0000 0 65535 /end CHARACTERISTIC
/begin CHARACTERISTIC K_ED_AUSS_KAT_Z2.DEC_NACH_EINTRAG "Fault code AUSS_KAT_Z2 - debounce filter decrement after fault-memory entry [verified]" VALUE 0x71153 RL_VAL_UB 0 CM_0000 0 255 /end CHARACTERISTIC
/begin CHARACTERISTIC K_ED_AUSS_KAT_Z2.DEC_VOR_EINTRAG "Fault code AUSS_KAT_Z2 - debounce filter decrement before fault-memory entry [verified]" VALUE 0x71151 RL_VAL_UB 0 CM_0000 0 255 /end CHARACTERISTIC
/begin CHARACTERISTIC K_ED_AUSS_KAT_Z2.FEHLERSCHWELLE "Fault code AUSS_KAT_Z2 - debounce filter threshold for setting the fault [verified]" VALUE 0x7114E RL_VAL_UB 0 CM_0000 0 255 /end CHARACTERISTIC
/begin CHARACTERISTIC K_ED_AUSS_KAT_Z2.INC_NACH_EINTRAG "Fault code AUSS_KAT_Z2 - debounce filter increment after fault-memory entry [verified]" VALUE 0x71152 RL_VAL_UB 0 CM_0000 0 255 /end CHARACTERISTIC
/begin CHARACTERISTIC K_ED_AUSS_KAT_Z2.INC_VOR_EINTRAG "Fault code AUSS_KAT_Z2 - debounce filter increment before fault-memory entry [verified]" VALUE 0x71150 RL_VAL_UB 0 CM_0000 0 255 /end CHARACTERISTIC
/begin CHARACTERISTIC K_ED_AUSS_KAT_Z2.KLASSENINDEX "Fault code AUSS_KAT_Z2 - fault class selection (lamp / warning behaviour) [verified]" VALUE 0x71154 RL_VAL_UB 0 CM_0000 0 255 /end CHARACTERISTIC
/begin CHARACTERISTIC K_ED_AUSS_KAT_Z2.OK_SCHWELLE "Fault code AUSS_KAT_Z2 - debounce filter threshold for clearing (healing) the fault [verified]" VALUE 0x7114F RL_VAL_UB 0 CM_0000 0 255 /end CHARACTERISTIC
/begin CHARACTERISTIC K_ED_AUSS_KAT_Z2.P_CODE_OPENLOAD "Fault code AUSS_KAT_Z2 - OBD P-code reported for open circuit [verified]" VALUE 0x7114A RL_VAL_UW 0 CM_0000 0 65535 /end CHARACTERISTIC
/begin CHARACTERISTIC K_ED_AUSS_KAT_Z2.P_CODE_SH_TO_GND "Fault code AUSS_KAT_Z2 - OBD P-code reported for short to ground [verified]" VALUE 0x71148 RL_VAL_UW 0 CM_0000 0 65535 /end CHARACTERISTIC
/begin CHARACTERISTIC K_ED_AUSS_KAT_Z2.P_CODE_SH_TO_UB "Fault code AUSS_KAT_Z2 - OBD P-code reported for short to battery voltage [verified]" VALUE 0x71146 RL_VAL_UW 0 CM_0000 0 65535 /end CHARACTERISTIC
/begin CHARACTERISTIC K_ED_AUSS_KAT_Z2.P_CODE_UNPLAUSIBEL "Fault code AUSS_KAT_Z2 - OBD P-code reported for implausible signal [verified]" VALUE 0x7114C RL_VAL_UW 0 CM_0000 0 65535 /end CHARACTERISTIC
/begin CHARACTERISTIC K_ED_AUSS_KAT_Z3.DEC_NACH_EINTRAG "Fault code AUSS_KAT_Z3 - debounce filter decrement after fault-memory entry [verified]" VALUE 0x7116D RL_VAL_UB 0 CM_0000 0 255 /end CHARACTERISTIC
/begin CHARACTERISTIC K_ED_AUSS_KAT_Z3.DEC_VOR_EINTRAG "Fault code AUSS_KAT_Z3 - debounce filter decrement before fault-memory entry [verified]" VALUE 0x7116B RL_VAL_UB 0 CM_0000 0 255 /end CHARACTERISTIC
/begin CHARACTERISTIC K_ED_AUSS_KAT_Z3.FEHLERSCHWELLE "Fault code AUSS_KAT_Z3 - debounce filter threshold for setting the fault [verified]" VALUE 0x71168 RL_VAL_UB 0 CM_0000 0 255 /end CHARACTERISTIC
/begin CHARACTERISTIC K_ED_AUSS_KAT_Z3.INC_NACH_EINTRAG "Fault code AUSS_KAT_Z3 - debounce filter increment after fault-memory entry [verified]" VALUE 0x7116C RL_VAL_UB 0 CM_0000 0 255 /end CHARACTERISTIC
/begin CHARACTERISTIC K_ED_AUSS_KAT_Z3.INC_VOR_EINTRAG "Fault code AUSS_KAT_Z3 - debounce filter increment before fault-memory entry [verified]" VALUE 0x7116A RL_VAL_UB 0 CM_0000 0 255 /end CHARACTERISTIC
/begin CHARACTERISTIC K_ED_AUSS_KAT_Z3.KLASSENINDEX "Fault code AUSS_KAT_Z3 - fault class selection (lamp / warning behaviour) [verified]" VALUE 0x7116E RL_VAL_UB 0 CM_0000 0 255 /end CHARACTERISTIC
/begin CHARACTERISTIC K_ED_AUSS_KAT_Z3.OK_SCHWELLE "Fault code AUSS_KAT_Z3 - debounce filter threshold for clearing (healing) the fault [verified]" VALUE 0x71169 RL_VAL_UB 0 CM_0000 0 255 /end CHARACTERISTIC
/begin CHARACTERISTIC K_ED_AUSS_KAT_Z3.P_CODE_OPENLOAD "Fault code AUSS_KAT_Z3 - OBD P-code reported for open circuit [verified]" VALUE 0x71164 RL_VAL_UW 0 CM_0000 0 65535 /end CHARACTERISTIC
/begin CHARACTERISTIC K_ED_AUSS_KAT_Z3.P_CODE_SH_TO_GND "Fault code AUSS_KAT_Z3 - OBD P-code reported for short to ground [verified]" VALUE 0x71162 RL_VAL_UW 0 CM_0000 0 65535 /end CHARACTERISTIC
/begin CHARACTERISTIC K_ED_AUSS_KAT_Z3.P_CODE_SH_TO_UB "Fault code AUSS_KAT_Z3 - OBD P-code reported for short to battery voltage [verified]" VALUE 0x71160 RL_VAL_UW 0 CM_0000 0 65535 /end CHARACTERISTIC
/begin CHARACTERISTIC K_ED_AUSS_KAT_Z3.P_CODE_UNPLAUSIBEL "Fault code AUSS_KAT_Z3 - OBD P-code reported for implausible signal [verified]" VALUE 0x71166 RL_VAL_UW 0 CM_0000 0 65535 /end CHARACTERISTIC
/begin CHARACTERISTIC K_ED_AUSS_KAT_Z4.DEC_NACH_EINTRAG "Fault code AUSS_KAT_Z4 - debounce filter decrement after fault-memory entry [verified]" VALUE 0x71187 RL_VAL_UB 0 CM_0000 0 255 /end CHARACTERISTIC
/begin CHARACTERISTIC K_ED_AUSS_KAT_Z4.DEC_VOR_EINTRAG "Fault code AUSS_KAT_Z4 - debounce filter decrement before fault-memory entry [verified]" VALUE 0x71185 RL_VAL_UB 0 CM_0000 0 255 /end CHARACTERISTIC
/begin CHARACTERISTIC K_ED_AUSS_KAT_Z4.FEHLERSCHWELLE "Fault code AUSS_KAT_Z4 - debounce filter threshold for setting the fault [verified]" VALUE 0x71182 RL_VAL_UB 0 CM_0000 0 255 /end CHARACTERISTIC
/begin CHARACTERISTIC K_ED_AUSS_KAT_Z4.INC_NACH_EINTRAG "Fault code AUSS_KAT_Z4 - debounce filter increment after fault-memory entry [verified]" VALUE 0x71186 RL_VAL_UB 0 CM_0000 0 255 /end CHARACTERISTIC
/begin CHARACTERISTIC K_ED_AUSS_KAT_Z4.INC_VOR_EINTRAG "Fault code AUSS_KAT_Z4 - debounce filter increment before fault-memory entry [verified]" VALUE 0x71184 RL_VAL_UB 0 CM_0000 0 255 /end CHARACTERISTIC
/begin CHARACTERISTIC K_ED_AUSS_KAT_Z4.KLASSENINDEX "Fault code AUSS_KAT_Z4 - fault class selection (lamp / warning behaviour) [verified]" VALUE 0x71188 RL_VAL_UB 0 CM_0000 0 255 /end CHARACTERISTIC
/begin CHARACTERISTIC K_ED_AUSS_KAT_Z4.OK_SCHWELLE "Fault code AUSS_KAT_Z4 - debounce filter threshold for clearing (healing) the fault [verified]" VALUE 0x71183 RL_VAL_UB 0 CM_0000 0 255 /end CHARACTERISTIC
/begin CHARACTERISTIC K_ED_AUSS_KAT_Z4.P_CODE_OPENLOAD "Fault code AUSS_KAT_Z4 - OBD P-code reported for open circuit [verified]" VALUE 0x7117E RL_VAL_UW 0 CM_0000 0 65535 /end CHARACTERISTIC
/begin CHARACTERISTIC K_ED_AUSS_KAT_Z4.P_CODE_SH_TO_GND "Fault code AUSS_KAT_Z4 - OBD P-code reported for short to ground [verified]" VALUE 0x7117C RL_VAL_UW 0 CM_0000 0 65535 /end CHARACTERISTIC
/begin CHARACTERISTIC K_ED_AUSS_KAT_Z4.P_CODE_SH_TO_UB "Fault code AUSS_KAT_Z4 - OBD P-code reported for short to battery voltage [verified]" VALUE 0x7117A RL_VAL_UW 0 CM_0000 0 65535 /end CHARACTERISTIC
/begin CHARACTERISTIC K_ED_AUSS_KAT_Z4.P_CODE_UNPLAUSIBEL "Fault code AUSS_KAT_Z4 - OBD P-code reported for implausible signal [verified]" VALUE 0x71180 RL_VAL_UW 0 CM_0000 0 65535 /end CHARACTERISTIC
/begin CHARACTERISTIC K_ED_AUSS_KAT_Z5.DEC_NACH_EINTRAG "Fault code AUSS_KAT_Z5 - debounce filter decrement after fault-memory entry [verified]" VALUE 0x711A1 RL_VAL_UB 0 CM_0000 0 255 /end CHARACTERISTIC
/begin CHARACTERISTIC K_ED_AUSS_KAT_Z5.DEC_VOR_EINTRAG "Fault code AUSS_KAT_Z5 - debounce filter decrement before fault-memory entry [verified]" VALUE 0x7119F RL_VAL_UB 0 CM_0000 0 255 /end CHARACTERISTIC
/begin CHARACTERISTIC K_ED_AUSS_KAT_Z5.FEHLERSCHWELLE "Fault code AUSS_KAT_Z5 - debounce filter threshold for setting the fault [verified]" VALUE 0x7119C RL_VAL_UB 0 CM_0000 0 255 /end CHARACTERISTIC
/begin CHARACTERISTIC K_ED_AUSS_KAT_Z5.INC_NACH_EINTRAG "Fault code AUSS_KAT_Z5 - debounce filter increment after fault-memory entry [verified]" VALUE 0x711A0 RL_VAL_UB 0 CM_0000 0 255 /end CHARACTERISTIC
/begin CHARACTERISTIC K_ED_AUSS_KAT_Z5.INC_VOR_EINTRAG "Fault code AUSS_KAT_Z5 - debounce filter increment before fault-memory entry [verified]" VALUE 0x7119E RL_VAL_UB 0 CM_0000 0 255 /end CHARACTERISTIC
/begin CHARACTERISTIC K_ED_AUSS_KAT_Z5.KLASSENINDEX "Fault code AUSS_KAT_Z5 - fault class selection (lamp / warning behaviour) [verified]" VALUE 0x711A2 RL_VAL_UB 0 CM_0000 0 255 /end CHARACTERISTIC
/begin CHARACTERISTIC K_ED_AUSS_KAT_Z5.OK_SCHWELLE "Fault code AUSS_KAT_Z5 - debounce filter threshold for clearing (healing) the fault [verified]" VALUE 0x7119D RL_VAL_UB 0 CM_0000 0 255 /end CHARACTERISTIC
/begin CHARACTERISTIC K_ED_AUSS_KAT_Z5.P_CODE_OPENLOAD "Fault code AUSS_KAT_Z5 - OBD P-code reported for open circuit [verified]" VALUE 0x71198 RL_VAL_UW 0 CM_0000 0 65535 /end CHARACTERISTIC
/begin CHARACTERISTIC K_ED_AUSS_KAT_Z5.P_CODE_SH_TO_GND "Fault code AUSS_KAT_Z5 - OBD P-code reported for short to ground [verified]" VALUE 0x71196 RL_VAL_UW 0 CM_0000 0 65535 /end CHARACTERISTIC
/begin CHARACTERISTIC K_ED_AUSS_KAT_Z5.P_CODE_SH_TO_UB "Fault code AUSS_KAT_Z5 - OBD P-code reported for short to battery voltage [verified]" VALUE 0x71194 RL_VAL_UW 0 CM_0000 0 65535 /end CHARACTERISTIC
/begin CHARACTERISTIC K_ED_AUSS_KAT_Z5.P_CODE_UNPLAUSIBEL "Fault code AUSS_KAT_Z5 - OBD P-code reported for implausible signal [verified]" VALUE 0x7119A RL_VAL_UW 0 CM_0000 0 65535 /end CHARACTERISTIC
/begin CHARACTERISTIC K_ED_AUSS_KAT_Z6.DEC_NACH_EINTRAG "Fault code AUSS_KAT_Z6 - debounce filter decrement after fault-memory entry [verified]" VALUE 0x711BB RL_VAL_UB 0 CM_0000 0 255 /end CHARACTERISTIC
/begin CHARACTERISTIC K_ED_AUSS_KAT_Z6.DEC_VOR_EINTRAG "Fault code AUSS_KAT_Z6 - debounce filter decrement before fault-memory entry [verified]" VALUE 0x711B9 RL_VAL_UB 0 CM_0000 0 255 /end CHARACTERISTIC
/begin CHARACTERISTIC K_ED_AUSS_KAT_Z6.FEHLERSCHWELLE "Fault code AUSS_KAT_Z6 - debounce filter threshold for setting the fault [verified]" VALUE 0x711B6 RL_VAL_UB 0 CM_0000 0 255 /end CHARACTERISTIC
/begin CHARACTERISTIC K_ED_AUSS_KAT_Z6.INC_NACH_EINTRAG "Fault code AUSS_KAT_Z6 - debounce filter increment after fault-memory entry [verified]" VALUE 0x711BA RL_VAL_UB 0 CM_0000 0 255 /end CHARACTERISTIC
/begin CHARACTERISTIC K_ED_AUSS_KAT_Z6.INC_VOR_EINTRAG "Fault code AUSS_KAT_Z6 - debounce filter increment before fault-memory entry [verified]" VALUE 0x711B8 RL_VAL_UB 0 CM_0000 0 255 /end CHARACTERISTIC
/begin CHARACTERISTIC K_ED_AUSS_KAT_Z6.KLASSENINDEX "Fault code AUSS_KAT_Z6 - fault class selection (lamp / warning behaviour) [verified]" VALUE 0x711BC RL_VAL_UB 0 CM_0000 0 255 /end CHARACTERISTIC
/begin CHARACTERISTIC K_ED_AUSS_KAT_Z6.OK_SCHWELLE "Fault code AUSS_KAT_Z6 - debounce filter threshold for clearing (healing) the fault [verified]" VALUE 0x711B7 RL_VAL_UB 0 CM_0000 0 255 /end CHARACTERISTIC
/begin CHARACTERISTIC K_ED_AUSS_KAT_Z6.P_CODE_OPENLOAD "Fault code AUSS_KAT_Z6 - OBD P-code reported for open circuit [verified]" VALUE 0x711B2 RL_VAL_UW 0 CM_0000 0 65535 /end CHARACTERISTIC
/begin CHARACTERISTIC K_ED_AUSS_KAT_Z6.P_CODE_SH_TO_GND "Fault code AUSS_KAT_Z6 - OBD P-code reported for short to ground [verified]" VALUE 0x711B0 RL_VAL_UW 0 CM_0000 0 65535 /end CHARACTERISTIC
/begin CHARACTERISTIC K_ED_AUSS_KAT_Z6.P_CODE_SH_TO_UB "Fault code AUSS_KAT_Z6 - OBD P-code reported for short to battery voltage [verified]" VALUE 0x711AE RL_VAL_UW 0 CM_0000 0 65535 /end CHARACTERISTIC
/begin CHARACTERISTIC K_ED_AUSS_KAT_Z6.P_CODE_UNPLAUSIBEL "Fault code AUSS_KAT_Z6 - OBD P-code reported for implausible signal [verified]" VALUE 0x711B4 RL_VAL_UW 0 CM_0000 0 65535 /end CHARACTERISTIC
/begin CHARACTERISTIC K_ED_AUSS_KAT_Z7.DEC_NACH_EINTRAG "Fault code AUSS_KAT_Z7 - debounce filter decrement after fault-memory entry [verified]" VALUE 0x711D5 RL_VAL_UB 0 CM_0000 0 255 /end CHARACTERISTIC
/begin CHARACTERISTIC K_ED_AUSS_KAT_Z7.DEC_VOR_EINTRAG "Fault code AUSS_KAT_Z7 - debounce filter decrement before fault-memory entry [verified]" VALUE 0x711D3 RL_VAL_UB 0 CM_0000 0 255 /end CHARACTERISTIC
/begin CHARACTERISTIC K_ED_AUSS_KAT_Z7.FEHLERSCHWELLE "Fault code AUSS_KAT_Z7 - debounce filter threshold for setting the fault [verified]" VALUE 0x711D0 RL_VAL_UB 0 CM_0000 0 255 /end CHARACTERISTIC
/begin CHARACTERISTIC K_ED_AUSS_KAT_Z7.INC_NACH_EINTRAG "Fault code AUSS_KAT_Z7 - debounce filter increment after fault-memory entry [verified]" VALUE 0x711D4 RL_VAL_UB 0 CM_0000 0 255 /end CHARACTERISTIC
/begin CHARACTERISTIC K_ED_AUSS_KAT_Z7.INC_VOR_EINTRAG "Fault code AUSS_KAT_Z7 - debounce filter increment before fault-memory entry [verified]" VALUE 0x711D2 RL_VAL_UB 0 CM_0000 0 255 /end CHARACTERISTIC
/begin CHARACTERISTIC K_ED_AUSS_KAT_Z7.KLASSENINDEX "Fault code AUSS_KAT_Z7 - fault class selection (lamp / warning behaviour) [verified]" VALUE 0x711D6 RL_VAL_UB 0 CM_0000 0 255 /end CHARACTERISTIC
/begin CHARACTERISTIC K_ED_AUSS_KAT_Z7.OK_SCHWELLE "Fault code AUSS_KAT_Z7 - debounce filter threshold for clearing (healing) the fault [verified]" VALUE 0x711D1 RL_VAL_UB 0 CM_0000 0 255 /end CHARACTERISTIC
/begin CHARACTERISTIC K_ED_AUSS_KAT_Z7.P_CODE_OPENLOAD "Fault code AUSS_KAT_Z7 - OBD P-code reported for open circuit [verified]" VALUE 0x711CC RL_VAL_UW 0 CM_0000 0 65535 /end CHARACTERISTIC
/begin CHARACTERISTIC K_ED_AUSS_KAT_Z7.P_CODE_SH_TO_GND "Fault code AUSS_KAT_Z7 - OBD P-code reported for short to ground [verified]" VALUE 0x711CA RL_VAL_UW 0 CM_0000 0 65535 /end CHARACTERISTIC
/begin CHARACTERISTIC K_ED_AUSS_KAT_Z7.P_CODE_SH_TO_UB "Fault code AUSS_KAT_Z7 - OBD P-code reported for short to battery voltage [verified]" VALUE 0x711C8 RL_VAL_UW 0 CM_0000 0 65535 /end CHARACTERISTIC
/begin CHARACTERISTIC K_ED_AUSS_KAT_Z7.P_CODE_UNPLAUSIBEL "Fault code AUSS_KAT_Z7 - OBD P-code reported for implausible signal [verified]" VALUE 0x711CE RL_VAL_UW 0 CM_0000 0 65535 /end CHARACTERISTIC
/begin CHARACTERISTIC K_ED_AUSS_KAT_Z8.DEC_NACH_EINTRAG "Fault code AUSS_KAT_Z8 - debounce filter decrement after fault-memory entry [verified]" VALUE 0x711EF RL_VAL_UB 0 CM_0000 0 255 /end CHARACTERISTIC
/begin CHARACTERISTIC K_ED_AUSS_KAT_Z8.DEC_VOR_EINTRAG "Fault code AUSS_KAT_Z8 - debounce filter decrement before fault-memory entry [verified]" VALUE 0x711ED RL_VAL_UB 0 CM_0000 0 255 /end CHARACTERISTIC
/begin CHARACTERISTIC K_ED_AUSS_KAT_Z8.FEHLERSCHWELLE "Fault code AUSS_KAT_Z8 - debounce filter threshold for setting the fault [verified]" VALUE 0x711EA RL_VAL_UB 0 CM_0000 0 255 /end CHARACTERISTIC
/begin CHARACTERISTIC K_ED_AUSS_KAT_Z8.INC_NACH_EINTRAG "Fault code AUSS_KAT_Z8 - debounce filter increment after fault-memory entry [verified]" VALUE 0x711EE RL_VAL_UB 0 CM_0000 0 255 /end CHARACTERISTIC
/begin CHARACTERISTIC K_ED_AUSS_KAT_Z8.INC_VOR_EINTRAG "Fault code AUSS_KAT_Z8 - debounce filter increment before fault-memory entry [verified]" VALUE 0x711EC RL_VAL_UB 0 CM_0000 0 255 /end CHARACTERISTIC
/begin CHARACTERISTIC K_ED_AUSS_KAT_Z8.KLASSENINDEX "Fault code AUSS_KAT_Z8 - fault class selection (lamp / warning behaviour) [verified]" VALUE 0x711F0 RL_VAL_UB 0 CM_0000 0 255 /end CHARACTERISTIC
/begin CHARACTERISTIC K_ED_AUSS_KAT_Z8.OK_SCHWELLE "Fault code AUSS_KAT_Z8 - debounce filter threshold for clearing (healing) the fault [verified]" VALUE 0x711EB RL_VAL_UB 0 CM_0000 0 255 /end CHARACTERISTIC
/begin CHARACTERISTIC K_ED_AUSS_KAT_Z8.P_CODE_OPENLOAD "Fault code AUSS_KAT_Z8 - OBD P-code reported for open circuit [verified]" VALUE 0x711E6 RL_VAL_UW 0 CM_0000 0 65535 /end CHARACTERISTIC
/begin CHARACTERISTIC K_ED_AUSS_KAT_Z8.P_CODE_SH_TO_GND "Fault code AUSS_KAT_Z8 - OBD P-code reported for short to ground [verified]" VALUE 0x711E4 RL_VAL_UW 0 CM_0000 0 65535 /end CHARACTERISTIC
/begin CHARACTERISTIC K_ED_AUSS_KAT_Z8.P_CODE_SH_TO_UB "Fault code AUSS_KAT_Z8 - OBD P-code reported for short to battery voltage [verified]" VALUE 0x711E2 RL_VAL_UW 0 CM_0000 0 65535 /end CHARACTERISTIC
/begin CHARACTERISTIC K_ED_AUSS_KAT_Z8.P_CODE_UNPLAUSIBEL "Fault code AUSS_KAT_Z8 - OBD P-code reported for implausible signal [verified]" VALUE 0x711E8 RL_VAL_UW 0 CM_0000 0 65535 /end CHARACTERISTIC
/begin CHARACTERISTIC K_ED_AUSS_KAT_Z9.DEC_NACH_EINTRAG "Fault code AUSS_KAT_Z9 - debounce filter decrement after fault-memory entry [verified]" VALUE 0x71209 RL_VAL_UB 0 CM_0000 0 255 /end CHARACTERISTIC
/begin CHARACTERISTIC K_ED_AUSS_KAT_Z9.DEC_VOR_EINTRAG "Fault code AUSS_KAT_Z9 - debounce filter decrement before fault-memory entry [verified]" VALUE 0x71207 RL_VAL_UB 0 CM_0000 0 255 /end CHARACTERISTIC
/begin CHARACTERISTIC K_ED_AUSS_KAT_Z9.FEHLERSCHWELLE "Fault code AUSS_KAT_Z9 - debounce filter threshold for setting the fault [verified]" VALUE 0x71204 RL_VAL_UB 0 CM_0000 0 255 /end CHARACTERISTIC
/begin CHARACTERISTIC K_ED_AUSS_KAT_Z9.INC_NACH_EINTRAG "Fault code AUSS_KAT_Z9 - debounce filter increment after fault-memory entry [verified]" VALUE 0x71208 RL_VAL_UB 0 CM_0000 0 255 /end CHARACTERISTIC
/begin CHARACTERISTIC K_ED_AUSS_KAT_Z9.INC_VOR_EINTRAG "Fault code AUSS_KAT_Z9 - debounce filter increment before fault-memory entry [verified]" VALUE 0x71206 RL_VAL_UB 0 CM_0000 0 255 /end CHARACTERISTIC
/begin CHARACTERISTIC K_ED_AUSS_KAT_Z9.KLASSENINDEX "Fault code AUSS_KAT_Z9 - fault class selection (lamp / warning behaviour) [verified]" VALUE 0x7120A RL_VAL_UB 0 CM_0000 0 255 /end CHARACTERISTIC
/begin CHARACTERISTIC K_ED_AUSS_KAT_Z9.OK_SCHWELLE "Fault code AUSS_KAT_Z9 - debounce filter threshold for clearing (healing) the fault [verified]" VALUE 0x71205 RL_VAL_UB 0 CM_0000 0 255 /end CHARACTERISTIC
/begin CHARACTERISTIC K_ED_AUSS_KAT_Z9.P_CODE_OPENLOAD "Fault code AUSS_KAT_Z9 - OBD P-code reported for open circuit [verified]" VALUE 0x71200 RL_VAL_UW 0 CM_0000 0 65535 /end CHARACTERISTIC
/begin CHARACTERISTIC K_ED_AUSS_KAT_Z9.P_CODE_SH_TO_GND "Fault code AUSS_KAT_Z9 - OBD P-code reported for short to ground [verified]" VALUE 0x711FE RL_VAL_UW 0 CM_0000 0 65535 /end CHARACTERISTIC
/begin CHARACTERISTIC K_ED_AUSS_KAT_Z9.P_CODE_SH_TO_UB "Fault code AUSS_KAT_Z9 - OBD P-code reported for short to battery voltage [verified]" VALUE 0x711FC RL_VAL_UW 0 CM_0000 0 65535 /end CHARACTERISTIC
/begin CHARACTERISTIC K_ED_AUSS_KAT_Z9.P_CODE_UNPLAUSIBEL "Fault code AUSS_KAT_Z9 - OBD P-code reported for implausible signal [verified]" VALUE 0x71202 RL_VAL_UW 0 CM_0000 0 65535 /end CHARACTERISTIC
/begin CHARACTERISTIC K_ED_BLS_PLAU.DEC_NACH_EINTRAG "Fault code BLS_PLAU - debounce filter decrement after fault-memory entry [verified]" VALUE 0x71493 RL_VAL_UB 0 CM_0000 0 255 /end CHARACTERISTIC
/begin CHARACTERISTIC K_ED_BLS_PLAU.DEC_VOR_EINTRAG "Fault code BLS_PLAU - debounce filter decrement before fault-memory entry [verified]" VALUE 0x71491 RL_VAL_UB 0 CM_0000 0 255 /end CHARACTERISTIC
/begin CHARACTERISTIC K_ED_BLS_PLAU.FEHLERSCHWELLE "Fault code BLS_PLAU - debounce filter threshold for setting the fault [verified]" VALUE 0x7148E RL_VAL_UB 0 CM_0000 0 255 /end CHARACTERISTIC
/begin CHARACTERISTIC K_ED_BLS_PLAU.INC_NACH_EINTRAG "Fault code BLS_PLAU - debounce filter increment after fault-memory entry [verified]" VALUE 0x71492 RL_VAL_UB 0 CM_0000 0 255 /end CHARACTERISTIC
/begin CHARACTERISTIC K_ED_BLS_PLAU.INC_VOR_EINTRAG "Fault code BLS_PLAU - debounce filter increment before fault-memory entry [verified]" VALUE 0x71490 RL_VAL_UB 0 CM_0000 0 255 /end CHARACTERISTIC
/begin CHARACTERISTIC K_ED_BLS_PLAU.KLASSENINDEX "Fault code BLS_PLAU - fault class selection (lamp / warning behaviour) [verified]" VALUE 0x71494 RL_VAL_UB 0 CM_0000 0 255 /end CHARACTERISTIC
/begin CHARACTERISTIC K_ED_BLS_PLAU.OK_SCHWELLE "Fault code BLS_PLAU - debounce filter threshold for clearing (healing) the fault [verified]" VALUE 0x7148F RL_VAL_UB 0 CM_0000 0 255 /end CHARACTERISTIC
/begin CHARACTERISTIC K_ED_BLS_PLAU.P_CODE_OPENLOAD "Fault code BLS_PLAU - OBD P-code reported for open circuit [verified]" VALUE 0x7148A RL_VAL_UW 0 CM_0000 0 65535 /end CHARACTERISTIC
/begin CHARACTERISTIC K_ED_BLS_PLAU.P_CODE_SH_TO_GND "Fault code BLS_PLAU - OBD P-code reported for short to ground [verified]" VALUE 0x71488 RL_VAL_UW 0 CM_0000 0 65535 /end CHARACTERISTIC
/begin CHARACTERISTIC K_ED_BLS_PLAU.P_CODE_SH_TO_UB "Fault code BLS_PLAU - OBD P-code reported for short to battery voltage [verified]" VALUE 0x71486 RL_VAL_UW 0 CM_0000 0 65535 /end CHARACTERISTIC
/begin CHARACTERISTIC K_ED_BLS_PLAU.P_CODE_UNPLAUSIBEL "Fault code BLS_PLAU - OBD P-code reported for implausible signal [verified]" VALUE 0x7148C RL_VAL_UW 0 CM_0000 0 65535 /end CHARACTERISTIC
/begin CHARACTERISTIC K_ED_DK1_ADAPT.DEC_NACH_EINTRAG "Fault code DK1_ADAPT - debounce filter decrement after fault-memory entry [verified]" VALUE 0x70E2D RL_VAL_UB 0 CM_0000 0 255 /end CHARACTERISTIC
/begin CHARACTERISTIC K_ED_DK1_ADAPT.DEC_VOR_EINTRAG "Fault code DK1_ADAPT - debounce filter decrement before fault-memory entry [verified]" VALUE 0x70E2B RL_VAL_UB 0 CM_0000 0 255 /end CHARACTERISTIC
/begin CHARACTERISTIC K_ED_DK1_ADAPT.FEHLERSCHWELLE "Fault code DK1_ADAPT - debounce filter threshold for setting the fault [verified]" VALUE 0x70E28 RL_VAL_UB 0 CM_0000 0 255 /end CHARACTERISTIC
/begin CHARACTERISTIC K_ED_DK1_ADAPT.INC_NACH_EINTRAG "Fault code DK1_ADAPT - debounce filter increment after fault-memory entry [verified]" VALUE 0x70E2C RL_VAL_UB 0 CM_0000 0 255 /end CHARACTERISTIC
/begin CHARACTERISTIC K_ED_DK1_ADAPT.INC_VOR_EINTRAG "Fault code DK1_ADAPT - debounce filter increment before fault-memory entry [verified]" VALUE 0x70E2A RL_VAL_UB 0 CM_0000 0 255 /end CHARACTERISTIC
/begin CHARACTERISTIC K_ED_DK1_ADAPT.KLASSENINDEX "Fault code DK1_ADAPT - fault class selection (lamp / warning behaviour) [verified]" VALUE 0x70E2E RL_VAL_UB 0 CM_0000 0 255 /end CHARACTERISTIC
/begin CHARACTERISTIC K_ED_DK1_ADAPT.OK_SCHWELLE "Fault code DK1_ADAPT - debounce filter threshold for clearing (healing) the fault [verified]" VALUE 0x70E29 RL_VAL_UB 0 CM_0000 0 255 /end CHARACTERISTIC
/begin CHARACTERISTIC K_ED_DK1_ADAPT.P_CODE_OPENLOAD "Fault code DK1_ADAPT - OBD P-code reported for open circuit [verified]" VALUE 0x70E24 RL_VAL_UW 0 CM_0000 0 65535 /end CHARACTERISTIC
/begin CHARACTERISTIC K_ED_DK1_ADAPT.P_CODE_SH_TO_GND "Fault code DK1_ADAPT - OBD P-code reported for short to ground [verified]" VALUE 0x70E22 RL_VAL_UW 0 CM_0000 0 65535 /end CHARACTERISTIC
/begin CHARACTERISTIC K_ED_DK1_ADAPT.P_CODE_SH_TO_UB "Fault code DK1_ADAPT - OBD P-code reported for short to battery voltage [verified]" VALUE 0x70E20 RL_VAL_UW 0 CM_0000 0 65535 /end CHARACTERISTIC
/begin CHARACTERISTIC K_ED_DK1_ADAPT.P_CODE_UNPLAUSIBEL "Fault code DK1_ADAPT - OBD P-code reported for implausible signal [verified]" VALUE 0x70E26 RL_VAL_UW 0 CM_0000 0 65535 /end CHARACTERISTIC
/begin CHARACTERISTIC K_ED_DK1_CAN.DEC_NACH_EINTRAG "Fault code DK1_CAN - debounce filter decrement after fault-memory entry [verified]" VALUE 0x70CF5 RL_VAL_UB 0 CM_0000 0 255 /end CHARACTERISTIC
/begin CHARACTERISTIC K_ED_DK1_CAN.DEC_VOR_EINTRAG "Fault code DK1_CAN - debounce filter decrement before fault-memory entry [verified]" VALUE 0x70CF3 RL_VAL_UB 0 CM_0000 0 255 /end CHARACTERISTIC
/begin CHARACTERISTIC K_ED_DK1_CAN.FEHLERSCHWELLE "Fault code DK1_CAN - debounce filter threshold for setting the fault [verified]" VALUE 0x70CF0 RL_VAL_UB 0 CM_0000 0 255 /end CHARACTERISTIC
/begin CHARACTERISTIC K_ED_DK1_CAN.INC_NACH_EINTRAG "Fault code DK1_CAN - debounce filter increment after fault-memory entry [verified]" VALUE 0x70CF4 RL_VAL_UB 0 CM_0000 0 255 /end CHARACTERISTIC
/begin CHARACTERISTIC K_ED_DK1_CAN.INC_VOR_EINTRAG "Fault code DK1_CAN - debounce filter increment before fault-memory entry [verified]" VALUE 0x70CF2 RL_VAL_UB 0 CM_0000 0 255 /end CHARACTERISTIC
/begin CHARACTERISTIC K_ED_DK1_CAN.KLASSENINDEX "Fault code DK1_CAN - fault class selection (lamp / warning behaviour) [verified]" VALUE 0x70CF6 RL_VAL_UB 0 CM_0000 0 255 /end CHARACTERISTIC
/begin CHARACTERISTIC K_ED_DK1_CAN.OK_SCHWELLE "Fault code DK1_CAN - debounce filter threshold for clearing (healing) the fault [verified]" VALUE 0x70CF1 RL_VAL_UB 0 CM_0000 0 255 /end CHARACTERISTIC
/begin CHARACTERISTIC K_ED_DK1_CAN.P_CODE_OPENLOAD "Fault code DK1_CAN - OBD P-code reported for open circuit [verified]" VALUE 0x70CEC RL_VAL_UW 0 CM_0000 0 65535 /end CHARACTERISTIC
/begin CHARACTERISTIC K_ED_DK1_CAN.P_CODE_SH_TO_GND "Fault code DK1_CAN - OBD P-code reported for short to ground [verified]" VALUE 0x70CEA RL_VAL_UW 0 CM_0000 0 65535 /end CHARACTERISTIC
/begin CHARACTERISTIC K_ED_DK1_CAN.P_CODE_SH_TO_UB "Fault code DK1_CAN - OBD P-code reported for short to battery voltage [verified]" VALUE 0x70CE8 RL_VAL_UW 0 CM_0000 0 65535 /end CHARACTERISTIC
/begin CHARACTERISTIC K_ED_DK1_CAN.P_CODE_UNPLAUSIBEL "Fault code DK1_CAN - OBD P-code reported for implausible signal [verified]" VALUE 0x70CEE RL_VAL_UW 0 CM_0000 0 65535 /end CHARACTERISTIC
/begin CHARACTERISTIC K_ED_DK1_CMD.DEC_NACH_EINTRAG "Fault code DK1_CMD - debounce filter decrement after fault-memory entry [verified]" VALUE 0x7104F RL_VAL_UB 0 CM_0000 0 255 /end CHARACTERISTIC
/begin CHARACTERISTIC K_ED_DK1_CMD.DEC_VOR_EINTRAG "Fault code DK1_CMD - debounce filter decrement before fault-memory entry [verified]" VALUE 0x7104D RL_VAL_UB 0 CM_0000 0 255 /end CHARACTERISTIC
/begin CHARACTERISTIC K_ED_DK1_CMD.FEHLERSCHWELLE "Fault code DK1_CMD - debounce filter threshold for setting the fault [verified]" VALUE 0x7104A RL_VAL_UB 0 CM_0000 0 255 /end CHARACTERISTIC
/begin CHARACTERISTIC K_ED_DK1_CMD.INC_NACH_EINTRAG "Fault code DK1_CMD - debounce filter increment after fault-memory entry [verified]" VALUE 0x7104E RL_VAL_UB 0 CM_0000 0 255 /end CHARACTERISTIC
/begin CHARACTERISTIC K_ED_DK1_CMD.INC_VOR_EINTRAG "Fault code DK1_CMD - debounce filter increment before fault-memory entry [verified]" VALUE 0x7104C RL_VAL_UB 0 CM_0000 0 255 /end CHARACTERISTIC
/begin CHARACTERISTIC K_ED_DK1_CMD.KLASSENINDEX "Fault code DK1_CMD - fault class selection (lamp / warning behaviour) [verified]" VALUE 0x71050 RL_VAL_UB 0 CM_0000 0 255 /end CHARACTERISTIC
/begin CHARACTERISTIC K_ED_DK1_CMD.OK_SCHWELLE "Fault code DK1_CMD - debounce filter threshold for clearing (healing) the fault [verified]" VALUE 0x7104B RL_VAL_UB 0 CM_0000 0 255 /end CHARACTERISTIC
/begin CHARACTERISTIC K_ED_DK1_CMD.P_CODE_OPENLOAD "Fault code DK1_CMD - OBD P-code reported for open circuit [verified]" VALUE 0x71046 RL_VAL_UW 0 CM_0000 0 65535 /end CHARACTERISTIC
/begin CHARACTERISTIC K_ED_DK1_CMD.P_CODE_SH_TO_GND "Fault code DK1_CMD - OBD P-code reported for short to ground [verified]" VALUE 0x71044 RL_VAL_UW 0 CM_0000 0 65535 /end CHARACTERISTIC
/begin CHARACTERISTIC K_ED_DK1_CMD.P_CODE_SH_TO_UB "Fault code DK1_CMD - OBD P-code reported for short to battery voltage [verified]" VALUE 0x71042 RL_VAL_UW 0 CM_0000 0 65535 /end CHARACTERISTIC
/begin CHARACTERISTIC K_ED_DK1_CMD.P_CODE_UNPLAUSIBEL "Fault code DK1_CMD - OBD P-code reported for implausible signal [verified]" VALUE 0x71048 RL_VAL_UW 0 CM_0000 0 65535 /end CHARACTERISTIC
/begin CHARACTERISTIC K_ED_DK1_FEDERN.DEC_NACH_EINTRAG "Fault code DK1_FEDERN - debounce filter decrement after fault-memory entry [verified]" VALUE 0x70FCD RL_VAL_UB 0 CM_0000 0 255 /end CHARACTERISTIC
/begin CHARACTERISTIC K_ED_DK1_FEDERN.DEC_VOR_EINTRAG "Fault code DK1_FEDERN - debounce filter decrement before fault-memory entry [verified]" VALUE 0x70FCB RL_VAL_UB 0 CM_0000 0 255 /end CHARACTERISTIC
/begin CHARACTERISTIC K_ED_DK1_FEDERN.FEHLERSCHWELLE "Fault code DK1_FEDERN - debounce filter threshold for setting the fault [verified]" VALUE 0x70FC8 RL_VAL_UB 0 CM_0000 0 255 /end CHARACTERISTIC
/begin CHARACTERISTIC K_ED_DK1_FEDERN.INC_NACH_EINTRAG "Fault code DK1_FEDERN - debounce filter increment after fault-memory entry [verified]" VALUE 0x70FCC RL_VAL_UB 0 CM_0000 0 255 /end CHARACTERISTIC
/begin CHARACTERISTIC K_ED_DK1_FEDERN.INC_VOR_EINTRAG "Fault code DK1_FEDERN - debounce filter increment before fault-memory entry [verified]" VALUE 0x70FCA RL_VAL_UB 0 CM_0000 0 255 /end CHARACTERISTIC
/begin CHARACTERISTIC K_ED_DK1_FEDERN.KLASSENINDEX "Fault code DK1_FEDERN - fault class selection (lamp / warning behaviour) [verified]" VALUE 0x70FCE RL_VAL_UB 0 CM_0000 0 255 /end CHARACTERISTIC
/begin CHARACTERISTIC K_ED_DK1_FEDERN.OK_SCHWELLE "Fault code DK1_FEDERN - debounce filter threshold for clearing (healing) the fault [verified]" VALUE 0x70FC9 RL_VAL_UB 0 CM_0000 0 255 /end CHARACTERISTIC
/begin CHARACTERISTIC K_ED_DK1_FEDERN.P_CODE_OPENLOAD "Fault code DK1_FEDERN - OBD P-code reported for open circuit [verified]" VALUE 0x70FC4 RL_VAL_UW 0 CM_0000 0 65535 /end CHARACTERISTIC
/begin CHARACTERISTIC K_ED_DK1_FEDERN.P_CODE_SH_TO_GND "Fault code DK1_FEDERN - OBD P-code reported for short to ground [verified]" VALUE 0x70FC2 RL_VAL_UW 0 CM_0000 0 65535 /end CHARACTERISTIC
/begin CHARACTERISTIC K_ED_DK1_FEDERN.P_CODE_SH_TO_UB "Fault code DK1_FEDERN - OBD P-code reported for short to battery voltage [verified]" VALUE 0x70FC0 RL_VAL_UW 0 CM_0000 0 65535 /end CHARACTERISTIC
/begin CHARACTERISTIC K_ED_DK1_FEDERN.P_CODE_UNPLAUSIBEL "Fault code DK1_FEDERN - OBD P-code reported for implausible signal [verified]" VALUE 0x70FC6 RL_VAL_UW 0 CM_0000 0 65535 /end CHARACTERISTIC
/begin CHARACTERISTIC K_ED_DK1_PDR.DEC_NACH_EINTRAG "Fault code DK1_PDR - debounce filter decrement after fault-memory entry [verified]" VALUE 0x70F31 RL_VAL_UB 0 CM_0000 0 255 /end CHARACTERISTIC
/begin CHARACTERISTIC K_ED_DK1_PDR.DEC_VOR_EINTRAG "Fault code DK1_PDR - debounce filter decrement before fault-memory entry [verified]" VALUE 0x70F2F RL_VAL_UB 0 CM_0000 0 255 /end CHARACTERISTIC
/begin CHARACTERISTIC K_ED_DK1_PDR.FEHLERSCHWELLE "Fault code DK1_PDR - debounce filter threshold for setting the fault [verified]" VALUE 0x70F2C RL_VAL_UB 0 CM_0000 0 255 /end CHARACTERISTIC
/begin CHARACTERISTIC K_ED_DK1_PDR.INC_NACH_EINTRAG "Fault code DK1_PDR - debounce filter increment after fault-memory entry [verified]" VALUE 0x70F30 RL_VAL_UB 0 CM_0000 0 255 /end CHARACTERISTIC
/begin CHARACTERISTIC K_ED_DK1_PDR.INC_VOR_EINTRAG "Fault code DK1_PDR - debounce filter increment before fault-memory entry [verified]" VALUE 0x70F2E RL_VAL_UB 0 CM_0000 0 255 /end CHARACTERISTIC
/begin CHARACTERISTIC K_ED_DK1_PDR.KLASSENINDEX "Fault code DK1_PDR - fault class selection (lamp / warning behaviour) [verified]" VALUE 0x70F32 RL_VAL_UB 0 CM_0000 0 255 /end CHARACTERISTIC
/begin CHARACTERISTIC K_ED_DK1_PDR.OK_SCHWELLE "Fault code DK1_PDR - debounce filter threshold for clearing (healing) the fault [verified]" VALUE 0x70F2D RL_VAL_UB 0 CM_0000 0 255 /end CHARACTERISTIC
/begin CHARACTERISTIC K_ED_DK1_PDR.P_CODE_OPENLOAD "Fault code DK1_PDR - OBD P-code reported for open circuit [verified]" VALUE 0x70F28 RL_VAL_UW 0 CM_0000 0 65535 /end CHARACTERISTIC
/begin CHARACTERISTIC K_ED_DK1_PDR.P_CODE_SH_TO_GND "Fault code DK1_PDR - OBD P-code reported for short to ground [verified]" VALUE 0x70F26 RL_VAL_UW 0 CM_0000 0 65535 /end CHARACTERISTIC
/begin CHARACTERISTIC K_ED_DK1_PDR.P_CODE_SH_TO_UB "Fault code DK1_PDR - OBD P-code reported for short to battery voltage [verified]" VALUE 0x70F24 RL_VAL_UW 0 CM_0000 0 65535 /end CHARACTERISTIC
/begin CHARACTERISTIC K_ED_DK1_PDR.P_CODE_UNPLAUSIBEL "Fault code DK1_PDR - OBD P-code reported for implausible signal [verified]" VALUE 0x70F2A RL_VAL_UW 0 CM_0000 0 65535 /end CHARACTERISTIC
/begin CHARACTERISTIC K_ED_DK1_REGLER.DEC_NACH_EINTRAG "Fault code DK1_REGLER - debounce filter decrement after fault-memory entry [verified]" VALUE 0x70DF9 RL_VAL_UB 0 CM_0000 0 255 /end CHARACTERISTIC
/begin CHARACTERISTIC K_ED_DK1_REGLER.DEC_VOR_EINTRAG "Fault code DK1_REGLER - debounce filter decrement before fault-memory entry [verified]" VALUE 0x70DF7 RL_VAL_UB 0 CM_0000 0 255 /end CHARACTERISTIC
/begin CHARACTERISTIC K_ED_DK1_REGLER.FEHLERSCHWELLE "Fault code DK1_REGLER - debounce filter threshold for setting the fault [verified]" VALUE 0x70DF4 RL_VAL_UB 0 CM_0000 0 255 /end CHARACTERISTIC
/begin CHARACTERISTIC K_ED_DK1_REGLER.INC_NACH_EINTRAG "Fault code DK1_REGLER - debounce filter increment after fault-memory entry [verified]" VALUE 0x70DF8 RL_VAL_UB 0 CM_0000 0 255 /end CHARACTERISTIC
/begin CHARACTERISTIC K_ED_DK1_REGLER.INC_VOR_EINTRAG "Fault code DK1_REGLER - debounce filter increment before fault-memory entry [verified]" VALUE 0x70DF6 RL_VAL_UB 0 CM_0000 0 255 /end CHARACTERISTIC
/begin CHARACTERISTIC K_ED_DK1_REGLER.KLASSENINDEX "Fault code DK1_REGLER - fault class selection (lamp / warning behaviour) [verified]" VALUE 0x70DFA RL_VAL_UB 0 CM_0000 0 255 /end CHARACTERISTIC
/begin CHARACTERISTIC K_ED_DK1_REGLER.OK_SCHWELLE "Fault code DK1_REGLER - debounce filter threshold for clearing (healing) the fault [verified]" VALUE 0x70DF5 RL_VAL_UB 0 CM_0000 0 255 /end CHARACTERISTIC
/begin CHARACTERISTIC K_ED_DK1_REGLER.P_CODE_OPENLOAD "Fault code DK1_REGLER - OBD P-code reported for open circuit [verified]" VALUE 0x70DF0 RL_VAL_UW 0 CM_0000 0 65535 /end CHARACTERISTIC
/begin CHARACTERISTIC K_ED_DK1_REGLER.P_CODE_SH_TO_GND "Fault code DK1_REGLER - OBD P-code reported for short to ground [verified]" VALUE 0x70DEE RL_VAL_UW 0 CM_0000 0 65535 /end CHARACTERISTIC
/begin CHARACTERISTIC K_ED_DK1_REGLER.P_CODE_SH_TO_UB "Fault code DK1_REGLER - OBD P-code reported for short to battery voltage [verified]" VALUE 0x70DEC RL_VAL_UW 0 CM_0000 0 65535 /end CHARACTERISTIC
/begin CHARACTERISTIC K_ED_DK1_REGLER.P_CODE_UNPLAUSIBEL "Fault code DK1_REGLER - OBD P-code reported for implausible signal [verified]" VALUE 0x70DF2 RL_VAL_UW 0 CM_0000 0 65535 /end CHARACTERISTIC
/begin CHARACTERISTIC K_ED_DK1_SK_ERR.DEC_NACH_EINTRAG "Fault code DK1_SK_ERR - debounce filter decrement after fault-memory entry [verified]" VALUE 0x70F99 RL_VAL_UB 0 CM_0000 0 255 /end CHARACTERISTIC
/begin CHARACTERISTIC K_ED_DK1_SK_ERR.DEC_VOR_EINTRAG "Fault code DK1_SK_ERR - debounce filter decrement before fault-memory entry [verified]" VALUE 0x70F97 RL_VAL_UB 0 CM_0000 0 255 /end CHARACTERISTIC
/begin CHARACTERISTIC K_ED_DK1_SK_ERR.FEHLERSCHWELLE "Fault code DK1_SK_ERR - debounce filter threshold for setting the fault [verified]" VALUE 0x70F94 RL_VAL_UB 0 CM_0000 0 255 /end CHARACTERISTIC
/begin CHARACTERISTIC K_ED_DK1_SK_ERR.INC_NACH_EINTRAG "Fault code DK1_SK_ERR - debounce filter increment after fault-memory entry [verified]" VALUE 0x70F98 RL_VAL_UB 0 CM_0000 0 255 /end CHARACTERISTIC
/begin CHARACTERISTIC K_ED_DK1_SK_ERR.INC_VOR_EINTRAG "Fault code DK1_SK_ERR - debounce filter increment before fault-memory entry [verified]" VALUE 0x70F96 RL_VAL_UB 0 CM_0000 0 255 /end CHARACTERISTIC
/begin CHARACTERISTIC K_ED_DK1_SK_ERR.KLASSENINDEX "Fault code DK1_SK_ERR - fault class selection (lamp / warning behaviour) [verified]" VALUE 0x70F9A RL_VAL_UB 0 CM_0000 0 255 /end CHARACTERISTIC
/begin CHARACTERISTIC K_ED_DK1_SK_ERR.OK_SCHWELLE "Fault code DK1_SK_ERR - debounce filter threshold for clearing (healing) the fault [verified]" VALUE 0x70F95 RL_VAL_UB 0 CM_0000 0 255 /end CHARACTERISTIC
/begin CHARACTERISTIC K_ED_DK1_SK_ERR.P_CODE_OPENLOAD "Fault code DK1_SK_ERR - OBD P-code reported for open circuit [verified]" VALUE 0x70F90 RL_VAL_UW 0 CM_0000 0 65535 /end CHARACTERISTIC
/begin CHARACTERISTIC K_ED_DK1_SK_ERR.P_CODE_SH_TO_GND "Fault code DK1_SK_ERR - OBD P-code reported for short to ground [verified]" VALUE 0x70F8E RL_VAL_UW 0 CM_0000 0 65535 /end CHARACTERISTIC
/begin CHARACTERISTIC K_ED_DK1_SK_ERR.P_CODE_SH_TO_UB "Fault code DK1_SK_ERR - OBD P-code reported for short to battery voltage [verified]" VALUE 0x70F8C RL_VAL_UW 0 CM_0000 0 65535 /end CHARACTERISTIC
/begin CHARACTERISTIC K_ED_DK1_SK_ERR.P_CODE_UNPLAUSIBEL "Fault code DK1_SK_ERR - OBD P-code reported for implausible signal [verified]" VALUE 0x70F92 RL_VAL_UW 0 CM_0000 0 65535 /end CHARACTERISTIC
/begin CHARACTERISTIC K_ED_DK1_WDK.DEC_NACH_EINTRAG "Fault code DK1_WDK - debounce filter decrement after fault-memory entry [verified]" VALUE 0x70EFD RL_VAL_UB 0 CM_0000 0 255 /end CHARACTERISTIC
/begin CHARACTERISTIC K_ED_DK1_WDK.DEC_VOR_EINTRAG "Fault code DK1_WDK - debounce filter decrement before fault-memory entry [verified]" VALUE 0x70EFB RL_VAL_UB 0 CM_0000 0 255 /end CHARACTERISTIC
/begin CHARACTERISTIC KL_EGAS_EXD_VORST_DK_AUF "Throttle pre-control value, opening [verified]" CURVE 0x724A2 RL_CUR_SW_UB 0 CM_0026 0 199.21875 /begin AXIS_DESCR STD_AXIS NO_INPUT_QUANTITY CM_0013 4 -3276.8 3276.7 /end AXIS_DESCR /end CHARACTERISTIC
/begin CHARACTERISTIC KL_EGAS_EXD_VORST_DK_ZU "Throttle pre-control value, closing [verified]" CURVE 0x724B0 RL_CUR_SW_UB 0 CM_0026 0 199.21875 /begin AXIS_DESCR STD_AXIS NO_INPUT_QUANTITY CM_0013 4 -3276.8 3276.7 /end AXIS_DESCR /end CHARACTERISTIC
/begin CHARACTERISTIC KL_EGAS_SK_DK_DIFF_MAX "Maximum setpoint/actual difference [verified]" CURVE 0x723EE RL_CUR_SW_SW 0 CM_0013 -3276.8 3276.7 /begin AXIS_DESCR STD_AXIS NO_INPUT_QUANTITY CM_0013 4 -3276.8 3276.7 /end AXIS_DESCR /end CHARACTERISTIC
/begin CHARACTERISTIC KL_EGAS_SK_LLS_FS_OFFS "Offset for idle-valve plausibility [verified]" CURVE 0x7242C RL_CUR_SW_SW 0 CM_0003 -3.2768 3.2767 /begin AXIS_DESCR STD_AXIS NO_INPUT_QUANTITY CM_0028 6 -3276.8 3276.7 /end AXIS_DESCR /end CHARACTERISTIC
/begin CHARACTERISTIC KL_EGAS_SK_WDK_DIFF "Maximum analogue vs CAN deviation [verified]" CURVE 0x72400 RL_CUR_SW_SW 0 CM_0013 -3276.8 3276.7 /begin AXIS_DESCR STD_AXIS NO_INPUT_QUANTITY CM_0013 4 -3276.8 3276.7 /end AXIS_DESCR /end CHARACTERISTIC
/begin CHARACTERISTIC K_EGAS_CAN_ALIVE_ERR_MAX "Maximum time for CAN alive signal [verified]" VALUE 0x71877 RL_VAL_UB 0 CM_0000 0 255 /end CHARACTERISTIC
/begin CHARACTERISTIC K_EGAS_DK_R_DIAG_CLR "Fault mask for ClrDiag [verified]" VALUE 0x71880 RL_VAL_UW 0 CM_0000 0 65535 /end CHARACTERISTIC
/begin CHARACTERISTIC K_EGAS_DK_R_DIAG_CLR_MAX "Maximum count for ClrDiag, throttle [verified]" VALUE 0x71885 RL_VAL_UB 0 CM_0000 0 255 /end CHARACTERISTIC
/begin CHARACTERISTIC K_EGAS_DK_R_DIAG_FAIL "Fault mask for failsafe [verified]" VALUE 0x71882 RL_VAL_UW 0 CM_0000 0 65535 /end CHARACTERISTIC
/begin CHARACTERISTIC K_EGAS_EXD_GS_SOLL "Setpoint for large step (throttle test) [%] [verified]" VALUE 0x7247E RL_VAL_SW 0 CM_0013 -3276.8 3276.7 /end CHARACTERISTIC
/begin CHARACTERISTIC K_EGAS_EXD_GS_T_MAX "Maximum time for large step [s] [verified]" VALUE 0x72479 RL_VAL_UB 0 CM_0020 0 1.275 /end CHARACTERISTIC
/begin CHARACTERISTIC K_EGAS_EXD_KS_SOLL "Setpoint for small step (throttle test) [%] [verified]" VALUE 0x7247C RL_VAL_SW 0 CM_0013 -3276.8 3276.7 /end CHARACTERISTIC
/begin CHARACTERISTIC K_EGAS_EXD_KS_T_MAX "Maximum time for small step [s] [verified]" VALUE 0x72478 RL_VAL_UB 0 CM_0020 0 1.275 /end CHARACTERISTIC
/begin CHARACTERISTIC K_EGAS_EXD_R1_SOLL "End value ramp 1 - opening 1 [%] [verified]" VALUE 0x72482 RL_VAL_SW 0 CM_0013 -3276.8 3276.7 /end CHARACTERISTIC
/begin CHARACTERISTIC K_EGAS_EXD_R1_SOLL_TV "Minimum setpoint for duty cycle - opening 1 [%] [verified]" VALUE 0x72480 RL_VAL_SW 0 CM_0013 -3276.8 3276.7 /end CHARACTERISTIC
/begin CHARACTERISTIC K_EGAS_EXD_R1_TIME "Time ramp 1 - opening 1 [s] [verified]" VALUE 0x72486 RL_VAL_UW 0 CM_0020 0 327.675 /end CHARACTERISTIC
/begin CHARACTERISTIC K_EGAS_EXD_R2_SOLL "End value ramp 2 - opening 2 [%] [verified]" VALUE 0x72484 RL_VAL_SW 0 CM_0013 -3276.8 3276.7 /end CHARACTERISTIC
/begin CHARACTERISTIC K_EGAS_EXD_R2_TIME "Time ramp 2 - opening 2 [s] [verified]" VALUE 0x72488 RL_VAL_UW 0 CM_0020 0 327.675 /end CHARACTERISTIC
/begin CHARACTERISTIC K_EGAS_EXD_R3_TIME "Time ramp 3 - closing [s] [verified]" VALUE 0x7248A RL_VAL_UW 0 CM_0020 0 327.675 /end CHARACTERISTIC
/begin CHARACTERISTIC K_EGAS_EXD_SW_SOLL "Start value for steps [%] [verified]" VALUE 0x7247A RL_VAL_SW 0 CM_0013 -3276.8 3276.7 /end CHARACTERISTIC
/begin CHARACTERISTIC K_EGAS_EXD_UB_MAX "Maximum battery voltage for throttle diagnosis [V] [verified]" VALUE 0x72476 RL_VAL_SW 0 CM_0021 -3276.8 3276.7 /end CHARACTERISTIC
/begin CHARACTERISTIC K_EGAS_EXD_UB_MIN "Minimum battery voltage for throttle diagnosis [V] [verified]" VALUE 0x72474 RL_VAL_SW 0 CM_0021 -3276.8 3276.7 /end CHARACTERISTIC
/begin CHARACTERISTIC K_EGAS_LLS_R_DIAG_CLR "Fault mask for ClrDiag [verified]" VALUE 0x7187C RL_VAL_UW 0 CM_0000 0 65535 /end CHARACTERISTIC
/begin CHARACTERISTIC K_EGAS_LLS_R_DIAG_CLR_MAX "Maximum count for ClrDiag, idle air valve [verified]" VALUE 0x71884 RL_VAL_UB 0 CM_0000 0 255 /end CHARACTERISTIC
/begin CHARACTERISTIC K_EGAS_LLS_R_DIAG_FAIL "Fault mask for failsafe [verified]" VALUE 0x7187E RL_VAL_UW 0 CM_0000 0 65535 /end CHARACTERISTIC
/begin CHARACTERISTIC K_EGAS_SK_CONTROL "Safety-concept switch [verified]" VALUE 0x723C2 RL_VAL_UB 0 CM_0000 0 255 /end CHARACTERISTIC
/begin CHARACTERISTIC K_EGAS_SK_DK_OFFEN_1 "Threshold for gap open [%] [verified]" VALUE 0x723DC RL_VAL_SW 0 CM_0013 -3276.8 3276.7 /end CHARACTERISTIC
/begin CHARACTERISTIC K_EGAS_SK_DK_OFFEN_2 "Threshold for clamping open [%] [verified]" VALUE 0x723DE RL_VAL_SW 0 CM_0013 -3276.8 3276.7 /end CHARACTERISTIC
/begin CHARACTERISTIC K_EGAS_SK_IST_DIFF_LLS "Maximum difference, actual-value deviation [%] [verified]" VALUE 0x723CA RL_VAL_SW 0 CM_0013 -3276.8 3276.7 /end CHARACTERISTIC
/begin CHARACTERISTIC K_EGAS_SK_NEUINIT_MAX "Maximum number of re-initialisations [verified]" VALUE 0x723E0 RL_VAL_UB 0 CM_0000 0 255 /end CHARACTERISTIC
/begin CHARACTERISTIC K_EGAS_SK_SOLL_DIFF "Maximum difference, setpoint deviation [%] [verified]" VALUE 0x723C6 RL_VAL_SW 0 CM_0013 -3276.8 3276.7 /end CHARACTERISTIC
/begin CHARACTERISTIC K_EGAS_SK_SOLL_DIFF_LLS "Maximum difference, setpoint deviation [%] [verified]" VALUE 0x723C8 RL_VAL_SW 0 CM_0013 -3276.8 3276.7 /end CHARACTERISTIC
/begin CHARACTERISTIC K_EGAS_SK_TAU_DK "Filter, throttle monitoring [s] [verified]" VALUE 0x723C5 RL_VAL_UB 0 CM_0027 0 255 /end CHARACTERISTIC
/begin CHARACTERISTIC K_EGAS_SK_TAU_LLS "Filter, idle air valve monitoring [s] [verified]" VALUE 0x723C4 RL_VAL_UB 0 CM_0027 0 255 /end CHARACTERISTIC
/begin CHARACTERISTIC K_EGAS_SK_T_IST "Maximum time for setpoint/actual deviation [s] [verified]" VALUE 0x723D0 RL_VAL_UW 0 CM_0025 0 655.35 /end CHARACTERISTIC
/begin CHARACTERISTIC K_EGAS_SK_T_IST_LLS "Maximum time for actual-value deviation [s] [verified]" VALUE 0x723D4 RL_VAL_UW 0 CM_0025 0 655.35 /end CHARACTERISTIC
/begin CHARACTERISTIC K_EGAS_SK_T_MODE "Maximum time for mode deviation [s] [verified]" VALUE 0x723D6 RL_VAL_UW 0 CM_0025 0 655.35 /end CHARACTERISTIC
/begin CHARACTERISTIC K_EGAS_SK_T_MODE_INIT "Maximum time for mode deviation during idle-valve init [s] [verified]" VALUE 0x723D8 RL_VAL_UW 0 CM_0025 0 655.35 /end CHARACTERISTIC
/begin CHARACTERISTIC K_EGAS_SK_T_NP_MAX "Maximum duration for zero-point adaptation [sec] [verified]" VALUE 0x723DA RL_VAL_UW 0 CM_0029 0 327.675 /end CHARACTERISTIC
/begin CHARACTERISTIC K_EGAS_SK_T_OFFEN "Maximum time for actual-value deviation [s] [verified]" VALUE 0x723C3 RL_VAL_UB 0 CM_0025 0 2.55 /end CHARACTERISTIC
/begin CHARACTERISTIC K_EGAS_SK_T_SOLL "Maximum time for setpoint deviation [s] [verified]" VALUE 0x723CC RL_VAL_UW 0 CM_0025 0 655.35 /end CHARACTERISTIC
/begin CHARACTERISTIC K_EGAS_SK_T_SOLL_LLS "Maximum time for setpoint deviation [s] [verified]" VALUE 0x723D2 RL_VAL_UW 0 CM_0025 0 655.35 /end CHARACTERISTIC
/begin CHARACTERISTIC K_EGAS_SK_T_WDK "Maximum time for analogue vs CAN deviation [s] [verified]" VALUE 0x723CE RL_VAL_UW 0 CM_0025 0 655.35 /end CHARACTERISTIC
/begin CHARACTERISTIC K_EGAS_STM_DK_SK_TST "Safety-concept test time [sec] [verified]" VALUE 0x72456 RL_VAL_UW 0 CM_0029 0 327.675 /end CHARACTERISTIC
/begin CHARACTERISTIC K_EGAS_STM_DK_SK_ZU "Threshold for safety-concept / linkage test [%] [verified]" VALUE 0x72454 RL_VAL_SW 0 CM_0013 -3276.8 3276.7 /end CHARACTERISTIC
/begin CHARACTERISTIC KL_FGR_VAHA_DIAG "Speed difference front/rear axle [verified]" CURVE 0x726AA RL_CUR_SW_SW 0 CM_0010 -2048 2047.9375 /begin AXIS_DESCR STD_AXIS NO_INPUT_QUANTITY CM_0010 4 -2048 2047.9375 /end AXIS_DESCR /end CHARACTERISTIC
/begin CHARACTERISTIC K_FGR_VAHA_DIAG_T "Wait time for front/rear speed difference fault [s] [verified]" VALUE 0x72559 RL_VAL_UB 0 CM_0025 0 2.55 /end CHARACTERISTIC
/begin CHARACTERISTIC K_FGR_V_DIAG "Maximum deviation V_RAD_HR vs V_DIREKT [km/h] [verified]" VALUE 0x72556 RL_VAL_SW 0 CM_0010 -2048 2047.9375 /end CHARACTERISTIC
/begin CHARACTERISTIC K_FGR_V_DIAG_T "Wait time for V_RAD_HR/V_DIREKT difference fault [s] [verified]" VALUE 0x72558 RL_VAL_UB 0 CM_0025 0 2.55 /end CHARACTERISTIC
/begin CHARACTERISTIC K_FGR_V_FEHLER_T "Hold time for signal fault before switch-off [s] [verified]" VALUE 0x72540 RL_VAL_UB 0 CM_0025 0 2.55 /end CHARACTERISTIC
/begin CHARACTERISTIC K_VR_DIAG_MAX_OFFSET "Maximum permitted diagnosis offset of the measuring coil [verified]" VALUE 0x7E4EC RL_VAL_SW 0 CM_0054 -26.39986688 26.39906122 /end CHARACTERISTIC
/begin CHARACTERISTIC K_VR_TEST_DIAG "Test diagnosis of measuring coil [verified]" VALUE 0x7E4E7 RL_VAL_UB 0 CM_0000 0 255 /end CHARACTERISTIC
/begin CHARACTERISTIC K_VR_TEST_SEND_ENABLE "Test function enable [verified]" VALUE 0x7E4E4 RL_VAL_UB 0 CM_0000 0 255 /end CHARACTERISTIC
/begin CHARACTERISTIC K_VR_TEST_U_MESS "Test voltage selection [verified]" VALUE 0x7E4E5 RL_VAL_UB 0 CM_0057 0 255 /end CHARACTERISTIC
/begin CHARACTERISTIC K_VR_TEST_V_MESS "Test gain stage [verified]" VALUE 0x7E4E6 RL_VAL_UB 0 CM_0000 0 255 /end CHARACTERISTIC
/begin CHARACTERISTIC KL_LLR_DIAG_N_INT_TMOT "Lock time for idle-controller toggle diagnosis [verified]" CURVE 0x76448 RL_CUR_SW_UW 0 CM_0025 0 655.35 /begin AXIS_DESCR STD_AXIS NO_INPUT_QUANTITY CM_0006 4 -3550 3003.5 /end AXIS_DESCR /end CHARACTERISTIC
/begin CHARACTERISTIC KL_LLR_N_SOLL_TMOT_E2 "Idle speed, level 2 (monitoring) [verified]" CURVE 0x7E748 RL_CUR_SW_SW 0 CM_0002 -32768 32767 /begin AXIS_DESCR STD_AXIS NO_INPUT_QUANTITY CM_0006 4 -3550 3003.5 /end AXIS_DESCR /end CHARACTERISTIC
/begin CHARACTERISTIC K_LLR_MD_MAX_E2 "Maximum integral share, level 2 [Nm] [verified]" VALUE 0x7E740 RL_VAL_SW 0 CM_0017 -3276.8 3276.7 /end CHARACTERISTIC
/begin CHARACTERISTIC K_LLR_N_DIFF_MAX_E2 "Threshold for maximum ramp, level 2 [Upm] [verified]" VALUE 0x7E742 RL_VAL_SW 0 CM_0002 -32768 32767 /end CHARACTERISTIC
/begin CHARACTERISTIC K_LLR_N_SOLL_NF_FAKTOR_E2 "Factor for tracking target speed, level 2 [verified]" VALUE 0x7E744 RL_VAL_UW 0 CM_0016 0 63.99902344 /end CHARACTERISTIC
/begin CHARACTERISTIC K_LLR_N_SOLL_NF_MAX_E2 "Maximum tracking target speed, level 2 [Upm] [verified]" VALUE 0x7E746 RL_VAL_SW 0 CM_0002 -32768 32767 /end CHARACTERISTIC
/begin CHARACTERISTIC KF_MD_SK_DIFF_MAX "Deviation of actual torque [verified]" MAP 0x79106 RL_MAP_SW_SW_SW 0 CM_0017 -3276.8 3276.7 /begin AXIS_DESCR STD_AXIS NO_INPUT_QUANTITY CM_0002 6 -32768 32767 /end AXIS_DESCR /begin AXIS_DESCR STD_AXIS NO_INPUT_QUANTITY CM_0017 6 -3276.8 3276.7 /end AXIS_DESCR /end CHARACTERISTIC
/begin CHARACTERISTIC KL_MD_SK_GRAD_MAX "Torque limit from safety-concept stage [verified]" CURVE 0x790F2 RL_CUR_UB_SW 0 CM_0007 -655360 655340 /begin AXIS_DESCR STD_AXIS NO_INPUT_QUANTITY CM_0000 6 0 255 /end AXIS_DESCR /end CHARACTERISTIC
/begin CHARACTERISTIC KL_MD_SK_MD_BEGR "Torque limit from safety-concept stage [verified]" CURVE 0x790DE RL_CUR_UB_SW 0 CM_0017 -3276.8 3276.7 /begin AXIS_DESCR STD_AXIS NO_INPUT_QUANTITY CM_0000 6 0 255 /end AXIS_DESCR /end CHARACTERISTIC
/begin CHARACTERISTIC KL_MD_SK_WDK "With idle air valve [verified]" CURVE 0x790B0 RL_CUR_SW_SW 0 CM_0013 -3276.8 3276.7 /begin AXIS_DESCR STD_AXIS NO_INPUT_QUANTITY CM_0002 3 -32768 32767 /end AXIS_DESCR /end CHARACTERISTIC
/begin CHARACTERISTIC KL_MD_SK_WDK_TI_OFFS "Maximum throttle position at pedal=0 and injection off [verified]" CURVE 0x790BE RL_CUR_UB_SW 0 CM_0013 -3276.8 3276.7 /begin AXIS_DESCR STD_AXIS NO_INPUT_QUANTITY CM_0000 10 0 255 /end AXIS_DESCR /end CHARACTERISTIC
/begin CHARACTERISTIC K_MD_ETA_SK_MIN "Minimum efficiency during safety-concept suppression [%] [verified]" VALUE 0x76A82 RL_VAL_UW 0 CM_0050 0 199.9969474 /end CHARACTERISTIC
/begin CHARACTERISTIC K_MD_SK_BEGR_RAMPE "Ramp limiter for torque limitation, safety concept [Nm/s] [verified]" VALUE 0x79090 RL_VAL_SW 0 CM_0073 -3276.8 3276.7 /end CHARACTERISTIC
/begin CHARACTERISTIC K_MD_SK_CFG "SK-Cfg [verified]" VALUE 0x79072 RL_VAL_UB 0 CM_0000 0 255 /end CHARACTERISTIC
/begin CHARACTERISTIC K_MD_SK_ETA_MIN "Minimum efficiency to secure torque calculation [%] [verified]" VALUE 0x79086 RL_VAL_UW 0 CM_0050 0 199.9969474 /end CHARACTERISTIC
/begin CHARACTERISTIC K_MD_SK_FWMAX "Maximum torque at pedal=0 [Nm] [verified]" VALUE 0x7907A RL_VAL_SW 0 CM_0017 -3276.8 3276.7 /end CHARACTERISTIC
/begin CHARACTERISTIC K_MD_SK_IND_MAX "Maximum indicated ignition/throttle torque [Nm] [verified]" VALUE 0x79088 RL_VAL_SW 0 CM_0017 -3276.8 3276.7 /end CHARACTERISTIC
/begin CHARACTERISTIC K_MD_SK_LLR_MAX "Maximum idle controller share [Nm] [verified]" VALUE 0x7908A RL_VAL_SW 0 CM_0017 -3276.8 3276.7 /end CHARACTERISTIC
/begin CHARACTERISTIC K_MD_SK_MAX_MDMIN "Maximum permitted MDmin [Nm] [verified]" VALUE 0x79082 RL_VAL_SW 0 CM_0017 -3276.8 3276.7 /end CHARACTERISTIC
/begin CHARACTERISTIC K_MD_SK_NHYS "Idle speed offset at pedal=0 [Upm] [verified]" VALUE 0x79078 RL_VAL_SW 0 CM_0002 -32768 32767 /end CHARACTERISTIC
/begin CHARACTERISTIC K_MD_SK_N_MDMIN "Engine-speed threshold for torque monitoring MDmin [Upm] [verified]" VALUE 0x79080 RL_VAL_SW 0 CM_0002 -32768 32767 /end CHARACTERISTIC
/begin CHARACTERISTIC K_MD_SK_N_MIN "Engine-speed threshold for torque monitoring [Upm] [verified]" VALUE 0x79076 RL_VAL_SW 0 CM_0002 -32768 32767 /end CHARACTERISTIC
/begin CHARACTERISTIC K_MD_SK_PWGMIN "Pedal threshold for pedal=0 [%] [verified]" VALUE 0x79075 RL_VAL_UB 0 CM_0013 0 25.5 /end CHARACTERISTIC
/begin CHARACTERISTIC K_MD_SK_RF_MAX "Maximum relative charge to secure torque calculation [verified]" VALUE 0x79084 RL_VAL_SW 0 CM_0003 -3.2768 3.2767 /end CHARACTERISTIC
/begin CHARACTERISTIC K_MD_SK_TAU_PWG "Filter, pedal=0 monitoring [s] [verified]" VALUE 0x79073 RL_VAL_UB 0 CM_0027 0 255 /end CHARACTERISTIC
/begin CHARACTERISTIC K_MD_SK_TAU_VERGL "Filter, comparison torque [s] [verified]" VALUE 0x79074 RL_VAL_UB 0 CM_0027 0 255 /end CHARACTERISTIC
/begin CHARACTERISTIC K_MD_SK_TIMER_0 "Maximum timer for pedal=0 [s] [verified]" VALUE 0x7907C RL_VAL_UW 0 CM_0025 0 655.35 /end CHARACTERISTIC
/begin CHARACTERISTIC K_MD_SK_TIMER_1 "Maximum timer for pedal>0 [s] [verified]" VALUE 0x7907E RL_VAL_UW 0 CM_0025 0 655.35 /end CHARACTERISTIC
/begin CHARACTERISTIC K_MD_SK_TIRED_HYS "Hysteresis for re-enabling a cylinder [verified]" VALUE 0x7908E RL_VAL_UW 0 CM_0016 0 63.99902344 /end CHARACTERISTIC
/begin CHARACTERISTIC K_MD_SK_TIRED_MIN "Minimum value for injection suppressions [verified]" VALUE 0x7908C RL_VAL_UB 0 CM_0000 0 255 /end CHARACTERISTIC
/begin CHARACTERISTIC K_MD_SK_WDK_KH_OFFS "Offset on KL_MD_SK_WDK during catalyst heating [%] [verified]" VALUE 0x790A8 RL_VAL_SW 0 CM_0013 -3276.8 3276.7 /end CHARACTERISTIC
/begin CHARACTERISTIC K_PWG_BLS_T_BRP_FEHLER "Limitation delay - brake pressure [ms] [verified]" VALUE 0x7AC69 RL_VAL_UB 0 CM_0032 0 1275 /end CHARACTERISTIC
/begin CHARACTERISTIC K_PWG_BLS_T_V_FEHLER "Limitation delay - brake pressure [ms] [verified]" VALUE 0x7AC6A RL_VAL_UB 0 CM_0032 0 1275 /end CHARACTERISTIC
/begin CHARACTERISTIC K_PWG_SK_NULLAGE "Diagnosis threshold [%] [verified]" VALUE 0x7AC92 RL_VAL_SW 0 CM_0013 -3276.8 3276.7 /end CHARACTERISTIC
/begin CHARACTERISTIC KL_SK_LLR_N_SOLL "Target engine speed from safety-concept stage [verified]" CURVE 0x7C2D0 RL_CUR_UB_SW 0 CM_0002 -32768 32767 /begin AXIS_DESCR STD_AXIS NO_INPUT_QUANTITY CM_0000 6 0 255 /end AXIS_DESCR /end CHARACTERISTIC
/begin CHARACTERISTIC K_SK_CFG__IGN_ "SK-Cfg [verified]" VALUE 0x7C114 RL_VAL_UB 0 CM_0000 0 255 /end CHARACTERISTIC
/begin CHARACTERISTIC K_SK_CRC32__IGN_ "CRC32-Aktivierung [verified]" VALUE 0x7C122 RL_VAL_UB 0 CM_0000 0 255 /end CHARACTERISTIC
/begin CHARACTERISTIC K_SK_EGAS_OFF_TIME__IGN_ "Time until throttle (E-gas) shut-off [s] [verified]" VALUE 0x7C12E RL_VAL_UW 0 CM_0025 0 655.35 /end CHARACTERISTIC
/begin CHARACTERISTIC K_SK_FGR_SPERRE__IGN_ "Cruise control lock [verified]" VALUE 0x7C127 RL_VAL_UB 0 CM_0000 0 255 /end CHARACTERISTIC
/begin CHARACTERISTIC K_SK_FM_EGAS_TEST__IGN_ "Safety-concept E-gas test mask [verified]" VALUE 0x7C117 RL_VAL_UB 0 CM_0000 0 255 /end CHARACTERISTIC
/begin CHARACTERISTIC K_SK_FM_FAIL_ZYL_TEST__IGN_ "Safety-concept injection test mask (1=off) [verified]" VALUE 0x7C11A RL_VAL_UW 0 CM_0000 0 65535 /end CHARACTERISTIC
/begin CHARACTERISTIC K_SK_FM_GEMISCH_TEST__IGN_ "Safety-concept mixture test mask [verified]" VALUE 0x7C116 RL_VAL_UB 0 CM_0000 0 255 /end CHARACTERISTIC
/begin CHARACTERISTIC K_SK_FM_LAM_TEST__IGN_ "Safety-concept lambda test mask [verified]" VALUE 0x7C11E RL_VAL_UB 0 CM_0000 0 255 /end CHARACTERISTIC
/begin CHARACTERISTIC K_SK_FM_MD_TEST__IGN_ "Safety-concept torque test mask [verified]" VALUE 0x7C11D RL_VAL_UB 0 CM_0000 0 255 /end CHARACTERISTIC
/begin CHARACTERISTIC K_SK_FM_MVAC_TEST__IGN_ "SK MVAC-Testmaske [verified]" VALUE 0x7C11F RL_VAL_UB 0 CM_0000 0 255 /end CHARACTERISTIC
/begin CHARACTERISTIC K_SK_FM_SMG_TEST__IGN_ "Safety-concept SMG test mask [verified]" VALUE 0x7C11C RL_VAL_UB 0 CM_0000 0 255 /end CHARACTERISTIC
/begin CHARACTERISTIC K_SK_FRA_SPERRE__IGN_ "Charge-adaptation lock [verified]" VALUE 0x7C125 RL_VAL_UB 0 CM_0000 0 255 /end CHARACTERISTIC
/begin CHARACTERISTIC K_SK_KH_SPERRE__IGN_ "Catalyst-heating lock [verified]" VALUE 0x7C126 RL_VAL_UB 0 CM_0000 0 255 /end CHARACTERISTIC
/begin CHARACTERISTIC K_SK_LAM_EINGR_TI__IGN_ "LA-Eingriff bei Teilfeuerung [verified]" VALUE 0x7C12B RL_VAL_UB 0 CM_0000 0 255 /end CHARACTERISTIC
/begin CHARACTERISTIC K_SK_LLRA_SPERRE__IGN_ "Idle-controller adaptation lock [verified]" VALUE 0x7C124 RL_VAL_UB 0 CM_0000 0 255 /end CHARACTERISTIC
/begin CHARACTERISTIC K_SK_MAX_OS_ERR__IGN_ "Permitted operating-system faults before reset [verified]" VALUE 0x7C120 RL_VAL_UB 0 CM_0000 0 255 /end CHARACTERISTIC
/begin CHARACTERISTIC K_SK_MAX_RESETS__IGN_ "Maximum number of resets per ECU run [verified]" VALUE 0x7C115 RL_VAL_UB 0 CM_0000 0 255 /end CHARACTERISTIC
/begin CHARACTERISTIC K_SK_MD_BEGR_DK_OFFEN__IGN_ "Limitation with open flaps [verified]" VALUE 0x7C12A RL_VAL_UB 0 CM_0000 0 255 /end CHARACTERISTIC
/begin CHARACTERISTIC K_SK_MD_BEGR_MVAC_SYS__IGN_ "Limitation with brake-booster vacuum system fault [verified]" VALUE 0x7C132 RL_VAL_UB 0 CM_0000 0 255 /end CHARACTERISTIC
/begin CHARACTERISTIC K_SK_MD_BEGR_RESET__IGN_ "Limitation from the 1st reset [verified]" VALUE 0x7C133 RL_VAL_UB 0 CM_0000 0 255 /end CHARACTERISTIC
/begin CHARACTERISTIC K_SK_MD_TI_EINGR__IGN_ "Enable partial firing (cylinder cut-out) [verified]" VALUE 0x7C128 RL_VAL_UB 0 CM_0000 0 255 /end CHARACTERISTIC
/begin CHARACTERISTIC K_SK_MD_VL_SPERRE__IGN_ "Full-load lock [verified]" VALUE 0x7C129 RL_VAL_UB 0 CM_0000 0 255 /end CHARACTERISTIC
/begin CHARACTERISTIC K_SK_PKS_NOTLAUF__IGN_ "Fuel-pressure-control activation [verified]" VALUE 0x7C123 RL_VAL_UB 0 CM_0000 0 255 /end CHARACTERISTIC
/begin CHARACTERISTIC K_SK_PROZ_ERR__IGN_ "Process monitoring mask [verified]" VALUE 0x7C130 RL_VAL_UW 0 CM_0000 0 65535 /end CHARACTERISTIC
/begin CHARACTERISTIC K_SK_TASK_ERR__IGN_ "Task monitoring mask [verified]" VALUE 0x7C121 RL_VAL_UB 0 CM_0000 0 255 /end CHARACTERISTIC
/begin CHARACTERISTIC K_SK_T_RESET_DELAY_OS__IGN_ "Reset delay for operating-system fault [s] [verified]" VALUE 0x7C12C RL_VAL_UB 0 CM_0025 0 2.55 /end CHARACTERISTIC
/begin CHARACTERISTIC K_SK_ZYL_OFF_MAX__IGN_ "Number of cylinders cut per bank [verified]" VALUE 0x7C118 RL_VAL_UB 0 CM_0000 0 255 /end CHARACTERISTIC
/begin CHARACTERISTIC K_SK_E2_KOMP_ERR_MAX__IGN_ "Maximum faults for complement comparison [verified]" VALUE 0x7C242 RL_VAL_UB 0 CM_0000 0 255 /end CHARACTERISTIC
/begin CHARACTERISTIC K_SK_MAX_RESETS_E2__IGN_ "Maximum number of resets per ECU run, level 2 [verified]" VALUE 0x7C243 RL_VAL_UB 0 CM_0000 0 255 /end CHARACTERISTIC
/begin CHARACTERISTIC KL_SMG_SK_PROG_MAX "Maximum programs with safety-concept limit [verified]" CURVE 0x7C436 RL_CUR_UB_UB 0 CM_0000 0 255 /begin AXIS_DESCR STD_AXIS NO_INPUT_QUANTITY CM_0000 6 0 255 /end AXIS_DESCR /end CHARACTERISTIC
/begin CHARACTERISTIC K_SMG_ALIVE_ERR_MAX "Maximum time for CAN alive signal [verified]" VALUE 0x7CD0A RL_VAL_UB 0 CM_0000 0 255 /end CHARACTERISTIC
/begin CHARACTERISTIC K_SMG_CAN_TESTMODE "Test mode setting [verified]" VALUE 0x7CD0D RL_VAL_UB 0 CM_0000 0 255 /end CHARACTERISTIC
/begin CHARACTERISTIC K_SMG_CHKSUM_ERR_MAX "Maximum time for CAN checksum [verified]" VALUE 0x7CD0B RL_VAL_UB 0 CM_0000 0 255 /end CHARACTERISTIC
/begin CHARACTERISTIC K_SMG_SK_CONTROL "Safety-concept configuration [verified]" VALUE 0x7C3EF RL_VAL_UB 0 CM_0000 0 255 /end CHARACTERISTIC
/begin CHARACTERISTIC K_SMG_SK_MD_SCHW "Torque diagnosis threshold [verified]" VALUE 0x7C410 RL_VAL_SW 0 CM_0017 -3276.8 3276.7 /end CHARACTERISTIC
/begin CHARACTERISTIC K_SMG_SK_M_KUPP_MIN "Maximum clutch torque at AK [verified]" VALUE 0x7C408 RL_VAL_SW 0 CM_0017 -3276.8 3276.7 /end CHARACTERISTIC
/begin CHARACTERISTIC K_SMG_SK_NBERCH_MAX "Engine-speed threshold nBerech (calculated speed) [verified]" VALUE 0x7C3FC RL_VAL_SW 0 CM_0002 -32768 32767 /end CHARACTERISTIC
/begin CHARACTERISTIC K_SMG_SK_NBERCH_T "Time threshold nBerech [verified]" VALUE 0x7C3FA RL_VAL_UB 0 CM_0025 0 2.55 /end CHARACTERISTIC
/begin CHARACTERISTIC K_SMG_SK_NGETR_MAX "Engine-speed threshold, gearbox speed [verified]" VALUE 0x7C404 RL_VAL_SW 0 CM_0002 -32768 32767 /end CHARACTERISTIC
/begin CHARACTERISTIC K_SMG_SK_NGETR_T "Time threshold, gearbox speed [verified]" VALUE 0x7C402 RL_VAL_UB 0 CM_0025 0 2.55 /end CHARACTERISTIC
/begin CHARACTERISTIC K_SMG_SK_NMAX_FSP "Nmax threshold during shift [verified]" VALUE 0x7C40C RL_VAL_SW 0 CM_0002 -32768 32767 /end CHARACTERISTIC
/begin CHARACTERISTIC K_SMG_SK_NMAX_FSP_INAKTIV "Nmax threshold outside shift [verified]" VALUE 0x7C40A RL_VAL_SW 0 CM_0002 -32768 32767 /end CHARACTERISTIC
/begin CHARACTERISTIC K_SMG_SK_NZIEL_MAX "Engine-speed threshold, target speed [verified]" VALUE 0x7C400 RL_VAL_SW 0 CM_0002 -32768 32767 /end CHARACTERISTIC
/begin CHARACTERISTIC K_SMG_SK_NZIEL_T "Time threshold, target speed [verified]" VALUE 0x7C3FE RL_VAL_UB 0 CM_0025 0 2.55 /end CHARACTERISTIC
/begin CHARACTERISTIC K_SMG_SK_T_DME_ST_MAX "Time threshold, status check [verified]" VALUE 0x7C3F9 RL_VAL_UB 0 CM_0025 0 2.55 /end CHARACTERISTIC
/begin CHARACTERISTIC K_SMG_SK_T_MAX "Time threshold, CAN fault detection [verified]" VALUE 0x7C3F8 RL_VAL_UB 0 CM_0025 0 2.55 /end CHARACTERISTIC
/begin CHARACTERISTIC K_SMG_SK_T_NGETR_MAX "Time threshold, maximum gearbox speed [verified]" VALUE 0x7C406 RL_VAL_UB 0 CM_0025 0 2.55 /end CHARACTERISTIC
/begin CHARACTERISTIC K_SMG_SK_T_NZIEL_MAX "Time threshold, maximum target speed [verified]" VALUE 0x7C407 RL_VAL_UB 0 CM_0025 0 2.55 /end CHARACTERISTIC
/begin CHARACTERISTIC K_SMG_SK_T_PHASE_MAX_AB "Maximum time [verified]" VALUE 0x7C3F0 RL_VAL_UW 0 CM_0025 0 655.35 /end CHARACTERISTIC
/begin CHARACTERISTIC K_SMG_SK_T_PHASE_MAX_AUF "Maximum time [verified]" VALUE 0x7C3F4 RL_VAL_UW 0 CM_0025 0 655.35 /end CHARACTERISTIC
/begin CHARACTERISTIC K_SMG_SK_T_PHASE_MAX_SCHA "Maximum time [verified]" VALUE 0x7C3F2 RL_VAL_UW 0 CM_0025 0 655.35 /end CHARACTERISTIC
/begin CHARACTERISTIC K_SMG_SK_T_PHASE_N_MAX "Maximum time for Nmax exceedance [verified]" VALUE 0x7C3F6 RL_VAL_UW 0 CM_0025 0 655.35 /end CHARACTERISTIC
/begin CHARACTERISTIC K_SMG_SK_V_SCHW "Vehicle-speed diagnosis threshold [verified]" VALUE 0x7C40E RL_VAL_SW 0 CM_0010 -2048 2047.9375 /end CHARACTERISTIC
/begin CHARACTERISTIC K_SMG_TESTMODE "Test functions [verified]" VALUE 0x7C31D RL_VAL_UB 0 CM_0000 0 255 /end CHARACTERISTIC
/begin CHARACTERISTIC KL_TABG_DIAG_PLAUSI_ML_FAK "Weighting factor during diagnosis [verified]" CURVE 0x79442 RL_CUR_SW_UW 0 CM_0016 0 63.99902344 /begin AXIS_DESCR STD_AXIS NO_INPUT_QUANTITY CM_0102 4 -3276.8 3276.7 /end AXIS_DESCR /end CHARACTERISTIC
/begin CHARACTERISTIC K_TAN_OBD_N_DYN_MAX "Maximum engine-speed dynamics [Upm/s] [verified]" VALUE 0x7D34C RL_VAL_SW 0 CM_0067 -32768 32767 /end CHARACTERISTIC
/begin CHARACTERISTIC K_TAN_OBD_N_MAX "Minimum engine speed [Upm] [verified]" VALUE 0x7D34A RL_VAL_SW 0 CM_0002 -32768 32767 /end CHARACTERISTIC
/begin CHARACTERISTIC K_TAN_OBD_N_MIN "Minimum engine speed [Upm] [verified]" VALUE 0x7D348 RL_VAL_SW 0 CM_0002 -32768 32767 /end CHARACTERISTIC
/begin CHARACTERISTIC K_TAN_OBD_RF_DYN_MAX "Maximum dynamics of relative charge [verified]" VALUE 0x7D354 RL_VAL_SW 0 CM_0003 -3.2768 3.2767 /end CHARACTERISTIC
/begin CHARACTERISTIC K_TAN_OBD_RF_MAX "Upper limit, relative charge [verified]" VALUE 0x7D352 RL_VAL_SW 0 CM_0003 -3.2768 3.2767 /end CHARACTERISTIC
/begin CHARACTERISTIC K_TAN_OBD_RF_MIN "Lower limit, relative charge [verified]" VALUE 0x7D350 RL_VAL_SW 0 CM_0003 -3.2768 3.2767 /end CHARACTERISTIC
/begin CHARACTERISTIC K_TAN_OBD_TMOT_MIN "Lower limit, engine temperature [?C] [verified]" VALUE 0x7D34E RL_VAL_SW 0 CM_0006 -3550 3003.5 /end CHARACTERISTIC
/begin CHARACTERISTIC K_TDME_DIAG_MAX "Upper limit, ECU temperature [verified]" VALUE 0x7D4A8 RL_VAL_SW 0 CM_0107 -1092.35 546.025 /end CHARACTERISTIC
/begin CHARACTERISTIC K_TDME_DIAG_MIN "Lower limit, ECU temperature [verified]" VALUE 0x7D4A6 RL_VAL_SW 0 CM_0107 -1092.35 546.025 /end CHARACTERISTIC
/begin CHARACTERISTIC KF_TIME_REL_OBD_MAX_STANDZEIT "Maximum engine-off (soak) time [verified]" MAP 0x7D54C RL_MAP_SW_SW_UW 0 CM_0108 0 65535 /begin AXIS_DESCR STD_AXIS NO_INPUT_QUANTITY CM_0006 4 -3550 3003.5 /end AXIS_DESCR /begin AXIS_DESCR STD_AXIS NO_INPUT_QUANTITY CM_0006 4 -3550 3003.5 /end AXIS_DESCR /end CHARACTERISTIC
/begin CHARACTERISTIC KF_TIME_REL_OBD_MIN_STANDZEIT "Minimum engine-off (soak) time [verified]" MAP 0x7D4EA RL_MAP_SW_SW_UW 0 CM_0060 0 1092.250002 /begin AXIS_DESCR STD_AXIS NO_INPUT_QUANTITY CM_0006 6 -3550 3003.5 /end AXIS_DESCR /begin AXIS_DESCR STD_AXIS NO_INPUT_QUANTITY CM_0006 6 -3550 3003.5 /end AXIS_DESCR /end CHARACTERISTIC
/begin CHARACTERISTIC KF_TMOT_OBD_ML_GES_MW "Mean-value threshold of air mass [verified]" MAP 0x7D6E0 RL_MAP_SW_SW_SW 0 CM_0102 -3276.8 3276.7 /begin AXIS_DESCR STD_AXIS NO_INPUT_QUANTITY CM_0006 8 -3550 3003.5 /end AXIS_DESCR /begin AXIS_DESCR STD_AXIS NO_INPUT_QUANTITY CM_0006 8 -3550 3003.5 /end AXIS_DESCR /end CHARACTERISTIC
/begin CHARACTERISTIC KL_TMOT_OBD_DELTA "Fluctuation of engine temperature [verified]" CURVE 0x7D620 RL_CUR_SW_SW 0 CM_0024 -3276.8 3276.7 /begin AXIS_DESCR STD_AXIS NO_INPUT_QUANTITY CM_0006 8 -3550 3003.5 /end AXIS_DESCR /end CHARACTERISTIC
/begin CHARACTERISTIC KL_TMOT_OBD_MODELL_DELTA "Fluctuation of model temperature [verified]" CURVE 0x7D5FE RL_CUR_SW_SW 0 CM_0024 -3276.8 3276.7 /begin AXIS_DESCR STD_AXIS NO_INPUT_QUANTITY CM_0006 8 -3550 3003.5 /end AXIS_DESCR /end CHARACTERISTIC
/begin CHARACTERISTIC K_TMOT_ELU_ERR_CC_HIGH_TMOT_1 "Yellow check-control message over coolant temp and electric-fan fault [verified]" VALUE 0x7D5C2 RL_VAL_SW 0 CM_0006 -3550 3003.5 /end CHARACTERISTIC
/begin CHARACTERISTIC K_TOEL_DELTA_E2 "Deviation from engine temperature [?C] [verified]" VALUE 0x7EE5C RL_VAL_SW 0 CM_0006 -3550 3003.5 /end CHARACTERISTIC
/begin CHARACTERISTIC K_TOEL_MAX_E2 "Maximum oil temperature [?C] [verified]" VALUE 0x7EE5A RL_VAL_SW 0 CM_0006 -3550 3003.5 /end CHARACTERISTIC
/begin CHARACTERISTIC K_TOEL_MAX_NEG_GRAD_E2 "Gradient threshold, level 2 [verified]" VALUE 0x7EE5E RL_VAL_SW 0 CM_0111 -32768 32767 /end CHARACTERISTIC
/begin CHARACTERISTIC K_TOEL_MAX_POS_GRAD_E2 "Gradient threshold, level 2 [verified]" VALUE 0x7EE60 RL_VAL_SW 0 CM_0111 -32768 32767 /end CHARACTERISTIC
/begin CHARACTERISTIC K_TOEL_MIN_E2 "Minimum oil temperature [?C] [verified]" VALUE 0x7EE58 RL_VAL_SW 0 CM_0006 -3550 3003.5 /end CHARACTERISTIC
/begin CHARACTERISTIC KL_TUMG_OBD_V "Time constant for tumg_obd_model_offset2 [verified]" CURVE 0x727A8 RL_CUR_SW_UW 0 CM_0027 0 65535 /begin AXIS_DESCR STD_AXIS NO_INPUT_QUANTITY CM_0010 8 -2048 2047.9375 /end AXIS_DESCR /end CHARACTERISTIC
/begin CHARACTERISTIC K_VDIAG_DN_OHNE_V "Engine-speed delta threshold for speed diagnosis [verified]" VALUE 0x7E4E0 RL_VAL_SW 0 CM_0067 -32768 32767 /end CHARACTERISTIC
/begin CHARACTERISTIC K_VDIAG_GRAD_MAX "Maximum speed jump in 10 ms [verified]" VALUE 0x7E4DC RL_VAL_SW 0 CM_0115 -2048 2047.9375 /end CHARACTERISTIC
/begin CHARACTERISTIC K_VDIAG_OFFSET "Diagnosis threshold [verified]" VALUE 0x7E4D8 RL_VAL_SW 0 CM_0010 -2048 2047.9375 /end CHARACTERISTIC
/begin CHARACTERISTIC K_VDIAG_SA_OHNE_V "Timer for speed diagnosis [verified]" VALUE 0x7E4DE RL_VAL_UW 0 CM_0025 0 655.35 /end CHARACTERISTIC
/begin CHARACTERISTIC K_VDIAG_VMAX "Maximum diagnosis threshold [verified]" VALUE 0x7E4DA RL_VAL_SW 0 CM_0010 -2048 2047.9375 /end CHARACTERISTIC
/begin CHARACTERISTIC K_V_MAX_E2 "Maximum speed - level 2 [km/h] [verified]" VALUE 0x7EE68 RL_VAL_SW 0 CM_0010 -2048 2047.9375 /end CHARACTERISTIC
/begin CHARACTERISTIC K_V_MAX_NEG_GRAD_E2 "Minimum rate limit - level 2 [km/h*10ms] [verified]" VALUE 0x7EE62 RL_VAL_SW 0 CM_0115 -2048 2047.9375 /end CHARACTERISTIC
/begin CHARACTERISTIC K_V_MAX_POS_GRAD_E2 "Maximum rate limit - level 2 [km/h*10ms] [verified]" VALUE 0x7EE64 RL_VAL_SW 0 CM_0115 -2048 2047.9375 /end CHARACTERISTIC
/begin CHARACTERISTIC K_V_MIN_E2 "Minimum speed - level 2 [km/h] [verified]" VALUE 0x7EE66 RL_VAL_SW 0 CM_0010 -2048 2047.9375 /end CHARACTERISTIC
/begin CHARACTERISTIC KF_MD_IND_LW_VERLUSTE_E2 "Gas-exchange losses, level 2 [verified]" MAP 0x7E8BE RL_MAP_SW_SW_SW 0 CM_0017 -3276.8 3276.7 /begin AXIS_DESCR STD_AXIS NO_INPUT_QUANTITY CM_0002 4 -32768 32767 /end AXIS_DESCR /begin AXIS_DESCR STD_AXIS NO_INPUT_QUANTITY CM_0003 4 -3.2768 3.2767 /end AXIS_DESCR /end CHARACTERISTIC
/begin CHARACTERISTIC KF_MD_IND_OPT_E2 "Optimum torque at lambda 1, level 2 [verified]" MAP 0x7E7CC RL_MAP_SW_SW_SW 0 CM_0017 -3276.8 3276.7 /begin AXIS_DESCR STD_AXIS NO_INPUT_QUANTITY CM_0002 10 -32768 32767 /end AXIS_DESCR /begin AXIS_DESCR STD_AXIS NO_INPUT_QUANTITY CM_0003 10 -3.2768 3.2767 /end AXIS_DESCR /end CHARACTERISTIC
/begin CHARACTERISTIC KF_MD_IND_MIN_SCHUB_E2 "Friction torque, level 2 [verified]" MAP 0x7E910 RL_MAP_SW_SW_SW 0 CM_0017 -3276.8 3276.7 /begin AXIS_DESCR STD_AXIS NO_INPUT_QUANTITY CM_0002 4 -32768 32767 /end AXIS_DESCR /begin AXIS_DESCR STD_AXIS NO_INPUT_QUANTITY CM_0006 4 -3550 3003.5 /end AXIS_DESCR /end CHARACTERISTIC
/begin CHARACTERISTIC KF_MD_KUPP_OFF_E2 "Deviation of actual torque, level 2 [verified]" MAP 0x7EA2E RL_MAP_SW_SW_SW 0 CM_0017 -3276.8 3276.7 /begin AXIS_DESCR STD_AXIS NO_INPUT_QUANTITY CM_0002 6 -32768 32767 /end AXIS_DESCR /begin AXIS_DESCR STD_AXIS NO_INPUT_QUANTITY CM_0017 6 -3276.8 3276.7 /end AXIS_DESCR /end CHARACTERISTIC
/begin CHARACTERISTIC KF_MD_SMG_BEGR_OFF_E2 "Maximum offset on driver demand, level 2 [verified]" MAP 0x7EA90 RL_MAP_SW_SW_SW 0 CM_0017 -3276.8 3276.7 /begin AXIS_DESCR STD_AXIS NO_INPUT_QUANTITY CM_0017 3 -3276.8 3276.7 /end AXIS_DESCR /begin AXIS_DESCR STD_AXIS NO_INPUT_QUANTITY CM_0002 3 -32768 32767 /end AXIS_DESCR /end CHARACTERISTIC
/begin CHARACTERISTIC KL_MD_IND_REIB_OFFSET_E2 "Offset for friction torque after start - level 2 [verified]" CURVE 0x7E7B0 RL_CUR_SW_SW 0 CM_0074 -327.68 327.67 /begin AXIS_DESCR STD_AXIS NO_INPUT_QUANTITY CM_0006 2 -3550 3003.5 /end AXIS_DESCR /end CHARACTERISTIC
/begin CHARACTERISTIC KL_MD_RF_MAX_E2 "Maximum relative charge [verified]" CURVE 0x7E786 RL_CUR_SW_SW 0 CM_0003 -3.2768 3.2767 /begin AXIS_DESCR STD_AXIS NO_INPUT_QUANTITY CM_0002 10 -32768 32767 /end AXIS_DESCR /end CHARACTERISTIC
/begin CHARACTERISTIC K_UB_DIAG_GRAD_INT_MAX "Integral diagnosis threshold [verified]" VALUE 0x7E4B2 RL_VAL_SW 0 CM_0116 -51.08269056 51.08113164 /end CHARACTERISTIC
/begin CHARACTERISTIC K_UB_DIAG_KL87_MAX_SPERRE "Maximum diagnosis lock time after terminal 87 off [verified]" VALUE 0x7E4B7 RL_VAL_UB 0 CM_0032 0 1275 /end CHARACTERISTIC
/begin CHARACTERISTIC K_UB_DIAG_MAX "Upper limit, battery voltage [verified]" VALUE 0x7E4AA RL_VAL_SW 0 CM_0116 -51.08269056 51.08113164 /end CHARACTERISTIC
/begin CHARACTERISTIC K_UB_DIAG_MIN "Lower limit, battery voltage [verified]" VALUE 0x7E4A8 RL_VAL_SW 0 CM_0116 -51.08269056 51.08113164 /end CHARACTERISTIC
/begin CHARACTERISTIC K_UEXT_DIAG_MAX "Upper limit, supply voltage [verified]" VALUE 0x7E4BC RL_VAL_UW 0 CM_0118 0 426.6601584 /end CHARACTERISTIC
/begin CHARACTERISTIC K_UEXT_DIAG_MIN "Lower limit, supply voltage [verified]" VALUE 0x7E4BA RL_VAL_UW 0 CM_0118 0 426.6601584 /end CHARACTERISTIC
/begin CHARACTERISTIC K_UINTERN_FEHLER_ZAEHLER "Maximum value of fault filter [verified]" VALUE 0x7E4CC RL_VAL_UW 0 CM_0000 0 65535 /end CHARACTERISTIC
/begin CHARACTERISTIC KF_MD_FAHRER_KOMFORT_E2 "Driver demand - Komfort, level 2 (monitoring copy) [rel. torque %] [verified]" MAP 0x7EAB0 RL_MAP_SW_SW_SW 0 CM_0013 -3276.8 3276.7 /begin AXIS_DESCR STD_AXIS NO_INPUT_QUANTITY CM_0235 6 -32768 32767 /end AXIS_DESCR /begin AXIS_DESCR STD_AXIS NO_INPUT_QUANTITY CM_0013 6 -3276.8 3276.7 /end AXIS_DESCR /end CHARACTERISTIC
/begin CHARACTERISTIC KF_MD_FAHRER_NORMAL_E2 "Driver demand - Normal, level 2 (monitoring copy) [rel. torque %] [verified]" MAP 0x7EB12 RL_MAP_SW_SW_SW 0 CM_0013 -3276.8 3276.7 /begin AXIS_DESCR STD_AXIS NO_INPUT_QUANTITY CM_0235 6 -32768 32767 /end AXIS_DESCR /begin AXIS_DESCR STD_AXIS NO_INPUT_QUANTITY CM_0013 6 -3276.8 3276.7 /end AXIS_DESCR /end CHARACTERISTIC
/begin CHARACTERISTIC KF_MD_FAHRER_SPORT_E2 "Driver demand - Sport, level 2 (monitoring copy) [rel. torque %] [verified]" MAP 0x7EB74 RL_MAP_SW_SW_SW 0 CM_0013 -3276.8 3276.7 /begin AXIS_DESCR STD_AXIS NO_INPUT_QUANTITY CM_0235 6 -32768 32767 /end AXIS_DESCR /begin AXIS_DESCR STD_AXIS NO_INPUT_QUANTITY CM_0013 6 -3276.8 3276.7 /end AXIS_DESCR /end CHARACTERISTIC
/begin CHARACTERISTIC KF_MD_FAHRER_MUEDE_E2 "Driver demand - Muede, level 2 (monitoring copy) [rel. torque %] [verified]" MAP 0x7EBD6 RL_MAP_SW_SW_SW 0 CM_0013 -3276.8 3276.7 /begin AXIS_DESCR STD_AXIS NO_INPUT_QUANTITY CM_0235 6 -32768 32767 /end AXIS_DESCR /begin AXIS_DESCR STD_AXIS NO_INPUT_QUANTITY CM_0013 6 -3276.8 3276.7 /end AXIS_DESCR /end CHARACTERISTIC
/begin CHARACTERISTIC KF_MD_FAHRER_MUNTER_E2 "Driver demand - Munter, level 2 (monitoring copy) [rel. torque %] [verified]" MAP 0x7EC38 RL_MAP_SW_SW_SW 0 CM_0013 -3276.8 3276.7 /begin AXIS_DESCR STD_AXIS NO_INPUT_QUANTITY CM_0235 6 -32768 32767 /end AXIS_DESCR /begin AXIS_DESCR STD_AXIS NO_INPUT_QUANTITY CM_0013 6 -3276.8 3276.7 /end AXIS_DESCR /end CHARACTERISTIC
/begin CHARACTERISTIC KF_MD_ZW_OPT_E2 "Optimum ignition angle, level 2 [degKW x/10] [verified]" MAP 0x7E974 RL_MAP_SW_SW_SW 0 CM_0013 -3276.8 3276.7 /begin AXIS_DESCR STD_AXIS NO_INPUT_QUANTITY CM_0235 10 -32768 32767 /end AXIS_DESCR /begin AXIS_DESCR STD_AXIS NO_INPUT_QUANTITY CM_0003 6 -3.2768 3.2767 /end AXIS_DESCR /end CHARACTERISTIC
/begin CHARACTERISTIC KF_MD_ZW_OPT_OFFS_KH_E2 "Cat-heating offset on KF_MD_ZW_OPT_E2 [verified]" MAP 0x7EA0E RL_MAP_SW_SW_SW 0 CM_0013 -3276.8 3276.7 /begin AXIS_DESCR STD_AXIS NO_INPUT_QUANTITY CM_0235 3 -32768 32767 /end AXIS_DESCR /begin AXIS_DESCR STD_AXIS NO_INPUT_QUANTITY CM_0003 3 -3.2768 3.2767 /end AXIS_DESCR /end CHARACTERISTIC
/begin CHARACTERISTIC KF_MD_IND_LW_OFFS_KH_E2 "Charge-exchange loss offset in cat heating, level 2 [verified]" MAP 0x7E8F0 RL_MAP_SW_SW_SW 0 CM_0017 -3276.8 3276.7 /begin AXIS_DESCR STD_AXIS NO_INPUT_QUANTITY CM_0235 3 -32768 32767 /end AXIS_DESCR /begin AXIS_DESCR STD_AXIS NO_INPUT_QUANTITY CM_0003 3 -3.2768 3.2767 /end AXIS_DESCR /end CHARACTERISTIC
/begin CHARACTERISTIC KL_EGAS_EXD_VORST_LLS_AUF "Idle-air actuator feed-forward duty, opening [verified]" CURVE 0x724BE RL_CUR_SW_UB 0 CM_0026 0 199.21875 /begin AXIS_DESCR STD_AXIS NO_INPUT_QUANTITY CM_0013 4 -3276.8 3276.7 /end AXIS_DESCR /end CHARACTERISTIC
/begin CHARACTERISTIC KL_EGAS_EXD_VORST_LLS_ZU "Idle-air actuator feed-forward duty, closing [verified]" CURVE 0x724CC RL_CUR_SW_UB 0 CM_0026 0 199.21875 /begin AXIS_DESCR STD_AXIS NO_INPUT_QUANTITY CM_0013 4 -3276.8 3276.7 /end AXIS_DESCR /end CHARACTERISTIC
/begin CHARACTERISTIC KL_EGAS_SK_LLS_FS "Error threshold, idle-air plausibility (rf difference vs rf) [verified]" CURVE 0x72412 RL_CUR_SW_SW 0 CM_0003 -3.2768 3.2767 /begin AXIS_DESCR STD_AXIS NO_INPUT_QUANTITY CM_0003 6 -3.2768 3.2767 /end AXIS_DESCR /end CHARACTERISTIC
/begin CHARACTERISTIC K_EGAS_SK_LLS_N_SCHW "n-Schwelle fuer LLS-Plausi [verified]" VALUE 0x723EC RL_VAL_SW 0 CM_0235 -32768 32767 /end CHARACTERISTIC
/begin CHARACTERISTIC K_EGAS_SK_LLS_DIAG_T "max. Zeit LLS-Plausi [verified]" VALUE 0x723E3 RL_VAL_UB 0 CM_0025 0 2.55 /end CHARACTERISTIC
/begin CHARACTERISTIC K_EGAS_SK_LLS_CRTK "Wichtungsfaktor Summe [verified]" VALUE 0x723E6 RL_VAL_UW 0 CM_0245 0 63.99902344 /end CHARACTERISTIC
/begin CHARACTERISTIC K_EGAS_SK_LLS_DIAG "Wichtungsfaktor Differenz [verified]" VALUE 0x723E4 RL_VAL_UW 0 CM_0245 0 63.99902344 /end CHARACTERISTIC
/begin CHARACTERISTIC K_EGAS_SK_LLS_DK_SCHW "DK-Schwelle fuer LLS-Plausi [verified]" VALUE 0x723E8 RL_VAL_SW 0 CM_0013 -3276.8 3276.7 /end CHARACTERISTIC
/begin CHARACTERISTIC K_EGAS_SK_LLS_AQ_MVAC "AQ_BRE-Schwelle fuer LLS -Plausi [verified]" VALUE 0x723EA RL_VAL_UW 0 CM_0012 0 6553.5 /end CHARACTERISTIC
/begin CHARACTERISTIC K_LLR_DIAG_TMOT "Tmot-Schwelle [verified]" VALUE 0x7624E RL_VAL_SW 0 CM_0256 -3550 3003.5 /end CHARACTERISTIC
/begin CHARACTERISTIC K_LLR_DIAG_TOEL "Toel-Schwelle [verified]" VALUE 0x76250 RL_VAL_SW 0 CM_0256 -3550 3003.5 /end CHARACTERISTIC
/begin CHARACTERISTIC K_LLR_DIAG_TUMG "Tumg-Schwelle [verified]" VALUE 0x76252 RL_VAL_SW 0 CM_0256 -3550 3003.5 /end CHARACTERISTIC
/begin CHARACTERISTIC K_LLR_DIAG_N_ZU_GROSS "Schwelle fuer n zu gross [verified]" VALUE 0x76258 RL_VAL_SW 0 CM_0002 -32768 32767 /end CHARACTERISTIC
/begin CHARACTERISTIC K_LLR_DIAG_N_ZU_KLEIN "Schwelle fuer n zu klein [verified]" VALUE 0x7625A RL_VAL_SW 0 CM_0002 -32768 32767 /end CHARACTERISTIC
/begin CHARACTERISTIC K_LLR_DIAG_TOGGLE_MAX "Maxwert f?r Toggleerkennung [verified]" VALUE 0x7628D RL_VAL_UB 0 CM_0000 0 255 /end CHARACTERISTIC
/begin CHARACTERISTIC K_LLR_DIAG_N_INT_MAX "Maxwert f?r Integral [verified]" VALUE 0x7628E RL_VAL_UW 0 CM_0278 0 6553.5 /end CHARACTERISTIC
/begin CHARACTERISTIC K_LLR_DIAG_CSS_TMOT "Tmot-Schwelle [verified]" VALUE 0x7625E RL_VAL_SW 0 CM_0256 -3550 3003.5 /end CHARACTERISTIC
/begin CHARACTERISTIC K_LLR_DIAG_CSS_TOEL "Toel-Schwelle [verified]" VALUE 0x76262 RL_VAL_SW 0 CM_0256 -3550 3003.5 /end CHARACTERISTIC
/begin CHARACTERISTIC K_LLR_DIAG_CSS_TUMG "Tumg-Schwelle [verified]" VALUE 0x76260 RL_VAL_SW 0 CM_0256 -3550 3003.5 /end CHARACTERISTIC
/begin CHARACTERISTIC K_LLR_DIAG_CSS_N_ZU_GROSS "Schwelle fuer n zu gross [verified]" VALUE 0x76264 RL_VAL_SW 0 CM_0002 -32768 32767 /end CHARACTERISTIC
/begin CHARACTERISTIC K_LLR_DIAG_CSS_N_ZU_KLEIN "Schwelle fuer n zu klein [verified]" VALUE 0x76266 RL_VAL_SW 0 CM_0002 -32768 32767 /end CHARACTERISTIC
/begin CHARACTERISTIC K_LLR_DIAG_CSS_TOGGLE_MAX "Maxwert f?r Toggleerkennung [verified]" VALUE 0x7628C RL_VAL_UB 0 CM_0000 0 255 /end CHARACTERISTIC
/begin CHARACTERISTIC K_LLR_DIAG_CSS_N_INT_MAX "Maxwert f?r Integral [verified]" VALUE 0x76290 RL_VAL_UL 0 CM_0278 0 429496729.5 /end CHARACTERISTIC
/begin CHARACTERISTIC K_FGR_N_DIF_DIAG_T "Max Zeitdauer eines DSC Bremseneingriff [EST]" VALUE 0x72528 RL_VAL_UW 0 CM_0247 0 655.35 /end CHARACTERISTIC
/begin CHARACTERISTIC K_TMOT_DIAG_MIN "Unter Grenze Motortemperatur [verified]" VALUE 0x7D580 RL_VAL_SW 0 CM_0303 -1092.35 546.025 /end CHARACTERISTIC
/begin CHARACTERISTIC K_TMOT_DIAG_MAX "Obere Grenze Motortemperatur [verified]" VALUE 0x7D582 RL_VAL_SW 0 CM_0303 -1092.35 546.025 /end CHARACTERISTIC
/begin CHARACTERISTIC K_TMOT_DIAG_GRAD_MAX "Max. Gradient ?ber 100ms [EST]" VALUE 0x7D588 RL_VAL_SW 0 CM_0304 -819.2 819.175 /end CHARACTERISTIC
/begin CHARACTERISTIC K_TMOT_DIAG_TIME "Ansprechzeit der Plausibilitaet geg e-nueber Masse [verified]" VALUE 0x7D590 RL_VAL_UW 0 CM_0247 0 655.35 /end CHARACTERISTIC
/begin CHARACTERISTIC K_TMOT_DIAG_GRAD_TAU "Filterkonstante f? r die Gradientenberechnung [verified]" VALUE 0x7D595 RL_VAL_UB 0 CM_0306 0.1003921569 25.6 /end CHARACTERISTIC
/begin CHARACTERISTIC K_EGAS_SK_FAIL_MAX "max. Anzahl fuer Fail-Status [verified]" VALUE 0x723E1 RL_VAL_UB 0 CM_0000 0 255 /end CHARACTERISTIC
/begin CHARACTERISTIC K_EGAS_SK_T_RGPOS "max. Zeit CAN-Fehlerkennung [verified]" VALUE 0x723E2 RL_VAL_UB 0 CM_0247 0 2.55 /end CHARACTERISTIC
/begin CHARACTERISTIC K_TOEL_OBD_CFG "0 OFF 1 ON 2 ON be- dingt Datenschalter fuer OBD [verified]" VALUE 0x7D956 RL_VAL_UB 0 CM_0000 0 255 /end CHARACTERISTIC
/begin CHARACTERISTIC K_TOEL_OBD_TIME_ML_SINCE_START "Initialisierungszeit fuer toel_obd nach Start [EST]" VALUE 0x7D958 RL_VAL_UW 0 CM_0247 0 655.35 /end CHARACTERISTIC
/begin CHARACTERISTIC K_TOEL_OBD_TDELTA_MAX_TIME "zeitliches Bewertu ngsintervall toel_obd_tdelta_max_time ?ltemperatursensor (QLT)/ Plausibilit?t Sei [EST]" VALUE 0x7D95A RL_VAL_UW 0 CM_0301 0 6553.5 /end CHARACTERISTIC
/begin CHARACTERISTIC K_TOEL_OBD_TDELTA_MAX "zul. maximale Abweichung von toel_qlt_roh zu toel_modell [EST]" VALUE 0x7D95C RL_VAL_SW 0 CM_0323 -3276.8 3276.7 /end CHARACTERISTIC
/begin CHARACTERISTIC K_TOEL_OBD_ML_MW_SCHWELLE "Schwelle f?r OBD -Sperre durch tmot_obd_ml_ges_mw [verified]" VALUE 0x7D95E RL_VAL_SW 0 CM_0255 -3276.8 3276.7 /end CHARACTERISTIC
/begin CHARACTERISTIC K_TOEL_OBD_LOCK_TIMER "Timerlimit f?r OBD -Sperre durch tmot_obd_ml_ges_mw [EST]" VALUE 0x7D960 RL_VAL_UW 0 CM_0301 0 6553.5 /end CHARACTERISTIC
/begin CHARACTERISTIC K_TOEL_OBD_TMOT_START "Mindest zust_tmot_start_dc f?r toel_obd_freigabe [verified]" VALUE 0x7D962 RL_VAL_SW 0 CM_0006 -3550 3003.5 /end CHARACTERISTIC
/begin CHARACTERISTIC K_TOEL_OBD_TIME_MS_MIN "Mindest time_ms f?r toel_obd_freigabe [verified]" VALUE 0x7D964 RL_VAL_UW 0 CM_0233 0 1092.25 /end CHARACTERISTIC
/begin CHARACTERISTIC KL_TOEL_OBD_MODELL_DELTA "Allowed deviation vs modelled oil temperature [verified]" CURVE 0x7D9AC RL_CUR_SW_SW 0 CM_0000 -32768 32767 /begin AXIS_DESCR STD_AXIS NO_INPUT_QUANTITY CM_0006 8 -3550 3003.5 /end AXIS_DESCR /end CHARACTERISTIC
/begin CHARACTERISTIC KL_TOEL_OBD_QLT_DELTA "Allowed deviation vs measured oil temperature (QLT sensor) [verified]" CURVE 0x7D9CE RL_CUR_SW_SW 0 CM_0000 -32768 32767 /begin AXIS_DESCR STD_AXIS NO_INPUT_QUANTITY CM_0006 8 -3550 3003.5 /end AXIS_DESCR /end CHARACTERISTIC
/begin CHARACTERISTIC KL_TOEL_OBD_TIME_DC "OBD driving-cycle time vs measured oil temperature [verified]" CURVE 0x7D9F0 RL_CUR_SW_UW 0 CM_0000 0 65535 /begin AXIS_DESCR STD_AXIS NO_INPUT_QUANTITY CM_0006 6 -3550 3003.5 /end AXIS_DESCR /end CHARACTERISTIC
/begin CHARACTERISTIC K_MD_ZYL_ANZ_E2 "Zylinderanzahl Ebene2 [verified]" VALUE 0x7E774 RL_VAL_UB 0 CM_0000 0 255 /end CHARACTERISTIC
/begin CHARACTERISTIC K_MD_E2_FW_REL_SCHW "Max. Abweichung rel- Fahrerwunsch [verified]" VALUE 0x7E75C RL_VAL_SW 0 CM_0276 -3276.8 3276.7 /end CHARACTERISTIC
/begin CHARACTERISTIC K_MD_E2_IST_SCHW "Max. Abweichung Istmoment [verified]" VALUE 0x7E762 RL_VAL_SW 0 CM_0322 -3276.8 3276.7 /end CHARACTERISTIC
/begin CHARACTERISTIC K_MD_E2_MAX_SCHW "Max. Abweichung Maxmoment [verified]" VALUE 0x7E764 RL_VAL_SW 0 CM_0322 -3276.8 3276.7 /end CHARACTERISTIC
/begin CHARACTERISTIC K_MD_E2_MIN_SCHW "Max. Abweichung Minmoment [verified]" VALUE 0x7E766 RL_VAL_SW 0 CM_0322 -3276.8 3276.7 /end CHARACTERISTIC
/begin CHARACTERISTIC K_MD_E2_SCHLEPP_SCHW "Max. Abweichung Schleppmoment [verified]" VALUE 0x7E768 RL_VAL_SW 0 CM_0322 -3276.8 3276.7 /end CHARACTERISTIC
/begin CHARACTERISTIC K_MD_E2_ERR_MAX "Max. Zeit f?r Vergleichsfehler [verified]" VALUE 0x7E75A RL_VAL_UB 0 CM_0301 0 25.5 /end CHARACTERISTIC
/begin CHARACTERISTIC K_MD_POLYNOM_A_E2 "Polynom A Ebene2 [verified]" VALUE 0x7E77C RL_VAL_SW 0 CM_0326 -327.68 327.67 /end CHARACTERISTIC
/begin CHARACTERISTIC K_MD_POLYNOM_B_E2 "Polynom B Ebene2 [verified]" VALUE 0x7E77E RL_VAL_SW 0 CM_0326 -327.68 327.67 /end CHARACTERISTIC
/begin CHARACTERISTIC K_MD_ETA_ZW_MIN_E2 "minimales ETA Ebene2 [verified]" VALUE 0x7E77A RL_VAL_UW 0 CM_0271 0 199.9969482 /end CHARACTERISTIC
/begin CHARACTERISTIC K_MD_ETA_LA_E2 "LA-Faktor [verified]" VALUE 0x7E772 RL_VAL_UW 0 CM_0245 0 63.99902344 /end CHARACTERISTIC
/begin CHARACTERISTIC K_KR_DIAG_T "Maximalzeit der Bereichsueberwachungdiagnose. [verified]" VALUE 0x74D9A RL_VAL_UW 0 CM_0301 0 6553.5 /end CHARACTERISTIC
/begin CHARACTERISTIC K_LLR_ERR_MAX_E2 "max. Fehler LLR Ebene 2 [verified]" VALUE 0x7E73C RL_VAL_UB 0 CM_0000 0 255 /end CHARACTERISTIC
/begin CHARACTERISTIC K_LLR_DMD_MAX_E2 "Rampe max. I-Anteil Ebene 2 [verified]" VALUE 0x7E73D RL_VAL_UB 0 CM_0068 0 255 /end CHARACTERISTIC
/begin CHARACTERISTIC K_LLR_MD_MIN_E2 "min. I-Anteil Ebene 2 [verified]" VALUE 0x7E73E RL_VAL_SW 0 CM_0322 -3276.8 3276.7 /end CHARACTERISTIC
/begin CHARACTERISTIC K_FR_MIN_E2 "Min.-Grenze Korrekturfaktor fr_reg_out Ebene2 [verified]" VALUE 0x7ECB0 RL_VAL_UW 0 CM_0307 0 1.999969482 /end CHARACTERISTIC
/begin CHARACTERISTIC K_FR_MAX_E2 "Max.-Grenze Korrekturfaktor fr_reg_out Ebene2 [verified]" VALUE 0x7ECB2 RL_VAL_UW 0 CM_0307 0 1.999969482 /end CHARACTERISTIC
/begin CHARACTERISTIC K_FR_GRAD_NEG_E2 "Max. neg. Gradient Korrektu r-faktor fr_reg_out Ebene2 [verified]" VALUE 0x7ECB4 RL_VAL_UW 0 CM_0334 0 199.9969482 /end CHARACTERISTIC
/begin CHARACTERISTIC K_FR_GRAD_POS_E2 "Max. pos. Gradient Korrektu r-faktor fr_reg_out Ebene2 [verified]" VALUE 0x7ECB6 RL_VAL_UW 0 CM_0334 0 199.9969482 /end CHARACTERISTIC
/begin CHARACTERISTIC K_FRA_LOLI_OUT_MIN_E2 "Min. Grenze Korrekturfaktor fra _out Ebene2 [verified]" VALUE 0x7ECB8 RL_VAL_UW 0 CM_0307 0 1.999969482 /end CHARACTERISTIC
/begin CHARACTERISTIC K_FRA_LOLI_OUT_MAX_E2 "Max. Grenze Korrektu rfaktor fra _out Ebene2 [verified]" VALUE 0x7ECBA RL_VAL_UW 0 CM_0307 0 1.999969482 /end CHARACTERISTIC
/begin CHARACTERISTIC K_FRA_GRAD_NEG_E2 "Max. neg. Gradi ent Korrektu r-faktor fra _out Ebene2 [verified]" VALUE 0x7ECBC RL_VAL_UW 0 CM_0334 0 199.9969482 /end CHARACTERISTIC
/begin CHARACTERISTIC K_FRA_GRAD_POS_E2 "Max. pos. Gradient Korrektu r-faktor fra_out Ebene2 [verified]" VALUE 0x7ECBE RL_VAL_UW 0 CM_0334 0 199.9969482 /end CHARACTERISTIC
/begin CHARACTERISTIC K_SERVO_STROM_DIAG_KS_UB "Min. Servo-Ventilstrom Kurzschluss nach UB [verified]" VALUE 0x7BC2C RL_VAL_UW 0 CM_0343 0 58326.15 /end CHARACTERISTIC
/begin CHARACTERISTIC K_SERVO_STROM_DIAG_OL "Max. Servo-Ventilstrom Openload [verified]" VALUE 0x7BC2E RL_VAL_UW 0 CM_0343 0 58326.15 /end CHARACTERISTIC
/begin CHARACTERISTIC K_SERVO_STROM_DIAG_MIN_TAST "Min. Steigung Kennlinie i=f(Tast*Ub) [verified]" VALUE 0x7BC30 RL_VAL_UB 0 CM_0344 0 255 /end CHARACTERISTIC
/begin CHARACTERISTIC K_SERVO_STROM_DIAG_MIN_OFFSET "Neg. Kennlinienoffset f. min. Steigung [verified]" VALUE 0x7BC32 RL_VAL_UW 0 CM_0343 0 58326.15 /end CHARACTERISTIC
/begin CHARACTERISTIC K_SERVO_STROM_DIAG_MAX_TAST "Max. Steigung Kennlinie i=f(Tast*Ub) [verified]" VALUE 0x7BC34 RL_VAL_UB 0 CM_0344 0 255 /end CHARACTERISTIC
/begin CHARACTERISTIC K_SERVO_STROM_DIAG_MAX_OFFSET "Neg. Kennlinie noffset f. max. Steigung [verified]" VALUE 0x7BC36 RL_VAL_UW 0 CM_0343 0 58326.15 /end CHARACTERISTIC
/begin CHARACTERISTIC KL_MD_FAHRER_FAK_E2 "v-Progression - Ebene 2 [verified]" CURVE 0x7E7BA RL_CUR_SW_SW 0 CM_0245 -32 31.99902344 /begin AXIS_DESCR STD_AXIS NO_INPUT_QUANTITY CM_0260 4 -2048 2047.9375 /end AXIS_DESCR /end CHARACTERISTIC
/begin CHARACTERISTIC K_AUSS_OBD_ABG_1 "Schwelle Aussetzer Abgas 1.Intervall. [A2L-ref]" VALUE 0x705A7 RL_VAL_UB 0 CM_0000 0 255 /end CHARACTERISTIC
/begin CHARACTERISTIC K_AUSS_OBD_ABG_4 "Schwelle Aussetzer je 1000er Intervall. [A2L-ref]" VALUE 0x705A8 RL_VAL_UB 0 CM_0000 0 255 /end CHARACTERISTIC
/begin CHARACTERISTIC K_AUSS_OBD_ABG_WORST_CYL "Schwelle schlechtester Zylinder. [A2L-ref]" VALUE 0x705D0 RL_VAL_SW 0 CM_0377 -200 199.9938965 /end CHARACTERISTIC
/begin CHARACTERISTIC K_AUSS_OBD_CFG "Schalter Freigabe Aussetzererkennung: 0 = Aus; 1 = Aktiv [A2L-ref]" VALUE 0x705A4 RL_VAL_UB 0 CM_0000 0 255 /end CHARACTERISTIC
/begin CHARACTERISTIC K_AUSS_OBD_N_MAX "Obere Aktivierungsdrehzahlschwelle. [A2L-ref]" VALUE 0x705C4 RL_VAL_SW 0 CM_0002 -32768 32767 /end CHARACTERISTIC
/begin CHARACTERISTIC K_AUSS_OBD_N_MIN "Untere Aktivierungsdrehzahlschwelle. [A2L-ref]" VALUE 0x705C6 RL_VAL_SW 0 CM_0002 -32768 32767 /end CHARACTERISTIC
/begin CHARACTERISTIC K_AUSS_OBD_RATE_ABG_ZYL "Rate Aussetzer je Zylinder Abgas. [A2L-ref]" VALUE 0x705A6 RL_VAL_UB 0 CM_0000 0 255 /end CHARACTERISTIC
/begin CHARACTERISTIC K_AUSS_OBD_SA_CNT "Anzahl der SA-Bereiche fuer Wiedereinsetzen. [A2L-ref]" VALUE 0x705A9 RL_VAL_UB 0 CM_0000 0 255 /end CHARACTERISTIC
/begin CHARACTERISTIC K_AUSS_OBD_SA_T_MIN "Min. Dauer fuer SA-Bereiche fuer Wiedereinsetzen. [A2L-ref]" VALUE 0x705AA RL_VAL_UB 0 CM_0023 0 25.5 /end CHARACTERISTIC
/begin CHARACTERISTIC K_AUSS_OBD_SUM_KAT "Schwelle Katschaedigen. [A2L-ref]" VALUE 0x705CC RL_VAL_UW 0 CM_0378 0 257 /end CHARACTERISTIC
/begin CHARACTERISTIC K_AUSS_OBD_T_IDLE "Zeit seit Deaktivierungsbedingung. [A2L-ref]" VALUE 0x705C8 RL_VAL_UW 0 CM_0025 0 655.35 /end CHARACTERISTIC
/begin CHARACTERISTIC K_AUSS_OBD_T_MIN_LAM "Maximale Abschaltzeit wegen Lamda-Unterschreitung. [A2L-ref]" VALUE 0x705CA RL_VAL_UW 0 CM_0025 0 655.35 /end CHARACTERISTIC
/begin CHARACTERISTIC K_AUSS_OBD_WICHT_NS "Gewichtungsfaktors fuer Nebenschluss. [A2L-ref]" VALUE 0x705C0 RL_VAL_UW 0 CM_0164 0 255.9960938 /end CHARACTERISTIC
/begin CHARACTERISTIC K_AUSS_OBD_WICHT_SPARK "Gewichtungsfaktors fuer Zuendauss. [A2L-ref]" VALUE 0x705BE RL_VAL_UW 0 CM_0164 0 255.9960938 /end CHARACTERISTIC
/begin CHARACTERISTIC K_DIAGNOSE_INDEX_HI "Diagnoseindex [A2L-ref]" VALUE 0x7024B RL_VAL_UB 0 CM_0000 0 255 /end CHARACTERISTIC
/begin CHARACTERISTIC K_DIAGNOSE_INDEX_LO "Diagnoseindex [A2L-ref]" VALUE 0x7024C RL_VAL_UB 0 CM_0000 0 255 /end CHARACTERISTIC
/begin CHARACTERISTIC K_FGR_T_FEHLER_E2 "Wartezeit f?r Ebene 2 Fehlermeldung [A2L-ref]" VALUE 0x7E73A RL_VAL_UB 0 CM_0023 0 25.5 /end CHARACTERISTIC
/begin CHARACTERISTIC K_FGR_V_SOLL_MIN_KMH_E2 "E2 Min. Ziel-/Sollgeschwindigkeit in km/h [A2L-ref]" VALUE 0x7E736 RL_VAL_SW 0 CM_0010 -2048 2047.9375 /end CHARACTERISTIC
/begin CHARACTERISTIC K_FGR_V_SOLL_MIN_MPH_E2 "E2 Min. Ziel-/Sollgeschwindigkeit in mph [A2L-ref]" VALUE 0x7E738 RL_VAL_SW 0 CM_0045 -2048 2047.9375 /end CHARACTERISTIC
/begin CHARACTERISTIC K_MD_E2_N_MIN "Min. Drehzahlschwelle [verified]" VALUE 0x7E780 RL_VAL_SW 0 CM_0002 -32768 32767 /end CHARACTERISTIC
/begin CHARACTERISTIC K_MD_E2_TAU_SOLL "s 0.1p 25.6*x Filter Sollmoment Ebene2 [verified]" VALUE 0x7E75B RL_VAL_UB 0 CM_0027 0 255 /end CHARACTERISTIC
/begin CHARACTERISTIC K_MD_HYP_DN_E2 "Offset auf Leerlaufdrehzahl [verified]" VALUE 0x7E76A RL_VAL_SW 0 CM_0002 -32768 32767 /end CHARACTERISTIC
/begin CHARACTERISTIC K_MD_HYP_VERH_E2 "Hyperbelfaktor [verified]" VALUE 0x7E76C RL_VAL_UB 0 CM_0037 0 1.9921875 /end CHARACTERISTIC
/begin CHARACTERISTIC K_MD_IND_REIB_ABREG_E2 "Abregelrampre f?r Reibmoment nach Start- Ebene2 [verified]" VALUE 0x7E782 RL_VAL_SW 0 CM_0073 -3276.8 3276.7 /end CHARACTERISTIC
/begin CHARACTERISTIC K_MD_LLR_AD_MAX_E2 "Max. Leerlaufadaption [verified]" VALUE 0x7E760 RL_VAL_SW 0 CM_0017 -3276.8 3276.7 /end CHARACTERISTIC
/begin CHARACTERISTIC K_MD_MSR_MAX_E2 "max. MSR-Moment Ebene2 [verified]" VALUE 0x7E770 RL_VAL_SW 0 CM_0017 -3276.8 3276.7 /end CHARACTERISTIC
/begin CHARACTERISTIC K_MD_SK_TIRED_ZYL_10of11_ "Ausblendmasken [A2L-ref]" VALUE 0x790A4 RL_VAL_UW 0 CM_0000 0 65535 /end CHARACTERISTIC
/begin CHARACTERISTIC K_MD_SK_TIRED_ZYL_11of11_ "Ausblendmasken [A2L-ref]" VALUE 0x790A6 RL_VAL_UW 0 CM_0000 0 65535 /end CHARACTERISTIC
/begin CHARACTERISTIC K_MD_SK_TIRED_ZYL_1of11_ "Ausblendmasken [A2L-ref]" VALUE 0x79092 RL_VAL_UW 0 CM_0000 0 65535 /end CHARACTERISTIC
/begin CHARACTERISTIC K_MD_SK_TIRED_ZYL_2of11_ "Ausblendmasken [A2L-ref]" VALUE 0x79094 RL_VAL_UW 0 CM_0000 0 65535 /end CHARACTERISTIC
/begin CHARACTERISTIC K_MD_SK_TIRED_ZYL_3of11_ "Ausblendmasken [A2L-ref]" VALUE 0x79096 RL_VAL_UW 0 CM_0000 0 65535 /end CHARACTERISTIC
/begin CHARACTERISTIC K_MD_SK_TIRED_ZYL_4of11_ "Ausblendmasken [A2L-ref]" VALUE 0x79098 RL_VAL_UW 0 CM_0000 0 65535 /end CHARACTERISTIC
/begin CHARACTERISTIC K_MD_SK_TIRED_ZYL_5of11_ "Ausblendmasken [A2L-ref]" VALUE 0x7909A RL_VAL_UW 0 CM_0000 0 65535 /end CHARACTERISTIC
/begin CHARACTERISTIC K_MD_SK_TIRED_ZYL_6of11_ "Ausblendmasken [A2L-ref]" VALUE 0x7909C RL_VAL_UW 0 CM_0000 0 65535 /end CHARACTERISTIC
/begin CHARACTERISTIC K_MD_SK_TIRED_ZYL_7of11_ "Ausblendmasken [A2L-ref]" VALUE 0x7909E RL_VAL_UW 0 CM_0000 0 65535 /end CHARACTERISTIC
/begin CHARACTERISTIC K_MD_SK_TIRED_ZYL_8of11_ "Ausblendmasken [A2L-ref]" VALUE 0x790A0 RL_VAL_UW 0 CM_0000 0 65535 /end CHARACTERISTIC
/begin CHARACTERISTIC K_MD_SK_TIRED_ZYL_9of11_ "Ausblendmasken [A2L-ref]" VALUE 0x790A2 RL_VAL_UW 0 CM_0000 0 65535 /end CHARACTERISTIC
/begin CHARACTERISTIC K_MD_SK_WDK_LLSFAIL_OFFS "Offset auf KL_MD_SK_WDK bei LLS-Off [A2L-ref]" VALUE 0x790AA RL_VAL_SW 0 CM_0013 -3276.8 3276.7 /end CHARACTERISTIC
/begin CHARACTERISTIC K_MD_START_OFF_E2 "Startoffset [verified]" VALUE 0x7E76E RL_VAL_SW 0 CM_0017 -3276.8 3276.7 /end CHARACTERISTIC
/begin CHARACTERISTIC K_MD_TAU_START_OFF_E2 "Filter Startoffset [verified]" VALUE 0x7E76D RL_VAL_UB 0 CM_0306 0.1003921569 25.6 /end CHARACTERISTIC
/begin CHARACTERISTIC K_MD_VERBR_MAX_E2 "max. Verbrauchermoment Ebene2 [verified]" VALUE 0x7E75E RL_VAL_SW 0 CM_0017 -3276.8 3276.7 /end CHARACTERISTIC
/begin CHARACTERISTIC K_N_E2_DELTA "Max zulaessige Drehzahl fuer Ebene 2 [A2L-ref]" VALUE 0x7EC9A RL_VAL_SW 0 CM_0002 -32768 32767 /end CHARACTERISTIC
/begin CHARACTERISTIC K_N_E2_T_MAX "Maximale Fehlerzeit der Drehzahl fuer Ebene 2 [A2L-ref]" VALUE 0x7EC9C RL_VAL_UW 0 CM_0025 0 655.35 /end CHARACTERISTIC
/begin CHARACTERISTIC K_N_GETR_HS_DIAG_N "Leergasse: Bandgrenze Getr.eing.drehz. - Motordrehzahl [A2L-ref]" VALUE 0x7AAD6 RL_VAL_SW 0 CM_0002 -32768 32767 /end CHARACTERISTIC
/begin CHARACTERISTIC K_N_GETR_HS_DIAG_N_KS "Kraftschluss: Bandgrenze Getr.eing.drehz. - Motordrehzahl [A2L-ref]" VALUE 0x7AAD8 RL_VAL_SW 0 CM_0002 -32768 32767 /end CHARACTERISTIC
/begin CHARACTERISTIC K_N_GETR_HS_DIAG_T "Timergrenze, um Diagnose zu beenden [A2L-ref]" VALUE 0x7AADA RL_VAL_UW 0 CM_0020 0 327.675 /end CHARACTERISTIC
/begin CHARACTERISTIC K_PKS_CAN_ALIVE_ERR_MAX "max. Alivefehler [A2L-ref]" VALUE 0x7AC58 RL_VAL_UB 0 CM_0000 0 255 /end CHARACTERISTIC
/begin CHARACTERISTIC K_PWG1_DIAG_MAX "Obere Diagnoseschwelle-Pedalwertgeber 1 [verified]" VALUE 0x7AC7C RL_VAL_SW 0 CM_0031 -160 159.9951172 /end CHARACTERISTIC
/begin CHARACTERISTIC K_PWG1_DIAG_MIN "Unter Diagnoseschwelle -Pedalwertgeber 1 [verified]" VALUE 0x7AC7A RL_VAL_SW 0 CM_0031 -160 159.9951172 /end CHARACTERISTIC
/begin CHARACTERISTIC K_PWG_DELTA_E2 "Zulaessige Differenz zur Ebene 2 [verified]" VALUE 0x7ECA4 RL_VAL_SW 0 CM_0013 -3276.8 3276.7 /end CHARACTERISTIC
/begin CHARACTERISTIC K_PWG_ERR_MAX_E2 "max. Fehler fuer Vergleich [verified]" VALUE 0x7ECA6 RL_VAL_UB 0 CM_0000 0 255 /end CHARACTERISTIC
/begin CHARACTERISTIC K_PWG_NORM_E2 "Normierung Potentiometerspannung Ebene 2 [verified]" VALUE 0x7ECA0 RL_VAL_SW 0 CM_0385 -327.68 327.67 /end CHARACTERISTIC
/begin CHARACTERISTIC K_PWG_NORM_HS_E2 "Normierung Potentiometerspannung f?r Handschalter Ebene 2 [verified]" VALUE 0x7ECA2 RL_VAL_SW 0 CM_0385 -327.68 327.67 /end CHARACTERISTIC
/begin CHARACTERISTIC K_PWG_SMG_ANFAHREN_FAK_E2 "max. Faktor fuer 2. Gan ganfahrt Ebene 2 [verified]" VALUE 0x7ECA8 RL_VAL_UW 0 CM_0016 0 63.99902344 /end CHARACTERISTIC
/begin CHARACTERISTIC K_PWG_TAU_FEHLER "Filterkonstante fuer den absol u-ten Spannungswert im Fehlerfall [verified]" VALUE 0x7AC83 RL_VAL_UB 0 CM_0065 0.005019607843 1.28 /end CHARACTERISTIC
/begin CHARACTERISTIC K_SCHALTER_BLS_ENTPRELLUNG_E2 "Fehlerentprellschwelle fuer BLS E2 [A2L-ref]" VALUE 0x7EE42 RL_VAL_UB 0 CM_0000 0 255 /end CHARACTERISTIC
/begin CHARACTERISTIC K_SK_EGAS_OFF_14of16_ "DK2 DK1 LLS2 LLS1 [A2L-ref]" VALUE 0x7C141 RL_VAL_UB 0 CM_0000 0 255 /end CHARACTERISTIC
/begin CHARACTERISTIC K_SK_EGAS_OFF_15of16_ "DK2 DK1 LLS2 LLS1 [A2L-ref]" VALUE 0x7C142 RL_VAL_UB 0 CM_0000 0 255 /end CHARACTERISTIC
/begin CHARACTERISTIC K_SK_EGAS_OFF_16of16_ "DK2 DK1 LLS2 LLS1 [A2L-ref]" VALUE 0x7C143 RL_VAL_UB 0 CM_0000 0 255 /end CHARACTERISTIC
/begin CHARACTERISTIC K_SK_EGAS_OFF_1of16_ "DK2 DK1 LLS2 LLS1 [A2L-ref]" VALUE 0x7C134 RL_VAL_UB 0 CM_0000 0 255 /end CHARACTERISTIC
/begin CHARACTERISTIC K_SK_EGAS_OFF_2of16_ "DK2 DK1 LLS2 LLS1 [A2L-ref]" VALUE 0x7C135 RL_VAL_UB 0 CM_0000 0 255 /end CHARACTERISTIC
/begin CHARACTERISTIC K_SK_EGAS_OFF_3of16_ "DK2 DK1 LLS2 LLS1 [A2L-ref]" VALUE 0x7C136 RL_VAL_UB 0 CM_0000 0 255 /end CHARACTERISTIC
/begin CHARACTERISTIC K_SK_EGAS_OFF_4of16_ "DK2 DK1 LLS2 LLS1 [A2L-ref]" VALUE 0x7C137 RL_VAL_UB 0 CM_0000 0 255 /end CHARACTERISTIC
/begin CHARACTERISTIC K_SK_EGAS_OFF_5of16_ "DK2 DK1 LLS2 LLS1 [A2L-ref]" VALUE 0x7C138 RL_VAL_UB 0 CM_0000 0 255 /end CHARACTERISTIC
/begin CHARACTERISTIC K_SK_EGAS_OFF_7of16_ "DK2 DK1 LLS2 LLS1 [EST]" VALUE 0x7AD3C RL_VAL_UB 0 CM_0000 0 255 /end CHARACTERISTIC
/begin CHARACTERISTIC K_SK_LAM_EINGR_10of32_ "Gemisch Boff Zoff DK LLS [A2L-ref]" VALUE 0x7C21D RL_VAL_UB 0 CM_0000 0 255 /end CHARACTERISTIC
/begin CHARACTERISTIC K_SK_LAM_EINGR_11of32_ "Gemisch Boff Zoff DK LLS [A2L-ref]" VALUE 0x7C21E RL_VAL_UB 0 CM_0000 0 255 /end CHARACTERISTIC
/begin CHARACTERISTIC K_SK_LAM_EINGR_12of32_ "Gemisch Boff Zoff DK LLS [A2L-ref]" VALUE 0x7C21F RL_VAL_UB 0 CM_0000 0 255 /end CHARACTERISTIC
/begin CHARACTERISTIC K_SK_LAM_EINGR_13of32_ "Gemisch Boff Zoff DK LLS [A2L-ref]" VALUE 0x7C220 RL_VAL_UB 0 CM_0000 0 255 /end CHARACTERISTIC
/begin CHARACTERISTIC K_SK_LAM_EINGR_14of32_ "Gemisch Boff Zoff DK LLS [A2L-ref]" VALUE 0x7C221 RL_VAL_UB 0 CM_0000 0 255 /end CHARACTERISTIC
/begin CHARACTERISTIC K_SK_LAM_EINGR_15of32_ "Gemisch Boff Zoff DK LLS [A2L-ref]" VALUE 0x7C222 RL_VAL_UB 0 CM_0000 0 255 /end CHARACTERISTIC
/begin CHARACTERISTIC K_SK_LAM_EINGR_16of32_ "Gemisch Boff Zoff DK LLS [A2L-ref]" VALUE 0x7C223 RL_VAL_UB 0 CM_0000 0 255 /end CHARACTERISTIC
/begin CHARACTERISTIC K_SK_LAM_EINGR_17of32_ "Gemisch Boff Zoff DK LLS [A2L-ref]" VALUE 0x7C224 RL_VAL_UB 0 CM_0000 0 255 /end CHARACTERISTIC
/begin CHARACTERISTIC K_SK_LAM_EINGR_18of32_ "Gemisch Boff Zoff DK LLS [A2L-ref]" VALUE 0x7C225 RL_VAL_UB 0 CM_0000 0 255 /end CHARACTERISTIC
/begin CHARACTERISTIC K_SK_LAM_EINGR_19of32_ "Gemisch Boff Zoff DK LLS [A2L-ref]" VALUE 0x7C226 RL_VAL_UB 0 CM_0000 0 255 /end CHARACTERISTIC
/begin CHARACTERISTIC K_SK_LAM_EINGR_1of32_ "Gemisch Boff Zoff DK LLS [A2L-ref]" VALUE 0x7C214 RL_VAL_UB 0 CM_0000 0 255 /end CHARACTERISTIC
/begin CHARACTERISTIC K_SK_LAM_EINGR_20of32_ "Gemisch Boff Zoff DK LLS [A2L-ref]" VALUE 0x7C227 RL_VAL_UB 0 CM_0000 0 255 /end CHARACTERISTIC
/begin CHARACTERISTIC K_SK_LAM_EINGR_21of32_ "Gemisch Boff Zoff DK LLS [A2L-ref]" VALUE 0x7C228 RL_VAL_UB 0 CM_0000 0 255 /end CHARACTERISTIC
/begin CHARACTERISTIC K_SK_LAM_EINGR_22of32_ "Gemisch Boff Zoff DK LLS [A2L-ref]" VALUE 0x7C229 RL_VAL_UB 0 CM_0000 0 255 /end CHARACTERISTIC
/begin CHARACTERISTIC K_SK_LAM_EINGR_23of32_ "Gemisch Boff Zoff DK LLS [A2L-ref]" VALUE 0x7C22A RL_VAL_UB 0 CM_0000 0 255 /end CHARACTERISTIC
/begin CHARACTERISTIC K_SK_LAM_EINGR_24of32_ "Gemisch Boff Zoff DK LLS [A2L-ref]" VALUE 0x7C22B RL_VAL_UB 0 CM_0000 0 255 /end CHARACTERISTIC
/begin CHARACTERISTIC K_SK_LAM_EINGR_25of32_ "Gemisch Boff Zoff DK LLS [A2L-ref]" VALUE 0x7C22C RL_VAL_UB 0 CM_0000 0 255 /end CHARACTERISTIC
/begin CHARACTERISTIC K_SK_LAM_EINGR_26of32_ "Gemisch Boff Zoff DK LLS [A2L-ref]" VALUE 0x7C22D RL_VAL_UB 0 CM_0000 0 255 /end CHARACTERISTIC
/begin CHARACTERISTIC K_SK_LAM_EINGR_27of32_ "Gemisch Boff Zoff DK LLS [A2L-ref]" VALUE 0x7C22E RL_VAL_UB 0 CM_0000 0 255 /end CHARACTERISTIC
/begin CHARACTERISTIC K_SK_LAM_EINGR_28of32_ "Gemisch Boff Zoff DK LLS [A2L-ref]" VALUE 0x7C22F RL_VAL_UB 0 CM_0000 0 255 /end CHARACTERISTIC
/begin CHARACTERISTIC K_SK_LAM_EINGR_29of32_ "Gemisch Boff Zoff DK LLS [A2L-ref]" VALUE 0x7C230 RL_VAL_UB 0 CM_0000 0 255 /end CHARACTERISTIC
/begin CHARACTERISTIC K_SK_LAM_EINGR_2of32_ "Gemisch Boff Zoff DK LLS [A2L-ref]" VALUE 0x7C215 RL_VAL_UB 0 CM_0000 0 255 /end CHARACTERISTIC
/begin CHARACTERISTIC K_SK_LAM_EINGR_30of32_ "Gemisch Boff Zoff DK LLS [A2L-ref]" VALUE 0x7C231 RL_VAL_UB 0 CM_0000 0 255 /end CHARACTERISTIC
/begin CHARACTERISTIC K_SK_LAM_EINGR_31of32_ "Gemisch Boff Zoff DK LLS [A2L-ref]" VALUE 0x7C232 RL_VAL_UB 0 CM_0000 0 255 /end CHARACTERISTIC
/begin CHARACTERISTIC K_SK_LAM_EINGR_32of32_ "Gemisch Boff Zoff DK LLS [A2L-ref]" VALUE 0x7C233 RL_VAL_UB 0 CM_0000 0 255 /end CHARACTERISTIC
/begin CHARACTERISTIC K_SK_LAM_EINGR_3of32_ "Gemisch Boff Zoff DK LLS [A2L-ref]" VALUE 0x7C216 RL_VAL_UB 0 CM_0000 0 255 /end CHARACTERISTIC
/begin CHARACTERISTIC K_SK_LAM_EINGR_4of32_ "Gemisch Boff Zoff DK LLS [A2L-ref]" VALUE 0x7C217 RL_VAL_UB 0 CM_0000 0 255 /end CHARACTERISTIC
/begin CHARACTERISTIC K_SK_LAM_EINGR_5of32_ "Gemisch Boff Zoff DK LLS [A2L-ref]" VALUE 0x7C218 RL_VAL_UB 0 CM_0000 0 255 /end CHARACTERISTIC
/begin CHARACTERISTIC K_SK_LAM_EINGR_6of32_ "Gemisch Boff Zoff DK LLS [A2L-ref]" VALUE 0x7C219 RL_VAL_UB 0 CM_0000 0 255 /end CHARACTERISTIC
/begin CHARACTERISTIC K_SK_LAM_EINGR_7of32_ "Gemisch Boff Zoff DK LLS [A2L-ref]" VALUE 0x7C21A RL_VAL_UB 0 CM_0000 0 255 /end CHARACTERISTIC
/begin CHARACTERISTIC K_SK_LAM_EINGR_8of32_ "Gemisch Boff Zoff DK LLS [A2L-ref]" VALUE 0x7C21B RL_VAL_UB 0 CM_0000 0 255 /end CHARACTERISTIC
/begin CHARACTERISTIC K_SK_LAM_EINGR_9of32_ "Gemisch Boff Zoff DK LLS [A2L-ref]" VALUE 0x7C21C RL_VAL_UB 0 CM_0000 0 255 /end CHARACTERISTIC
/begin CHARACTERISTIC K_SK_MD_BEGR_EGAS_10of64_ "WDK2 WDK1 DK2 DK1 LLS2 LLS1 [A2L-ref]" VALUE 0x7C14D RL_VAL_UB 0 CM_0000 0 255 /end CHARACTERISTIC
/begin CHARACTERISTIC K_SK_MD_BEGR_EGAS_11of64_ "WDK2 WDK1 DK2 DK1 LLS2 LLS1 [A2L-ref]" VALUE 0x7C14E RL_VAL_UB 0 CM_0000 0 255 /end CHARACTERISTIC
/begin CHARACTERISTIC K_SK_MD_BEGR_EGAS_12of64_ "WDK2 WDK1 DK2 DK1 LLS2 LLS1 [A2L-ref]" VALUE 0x7C14F RL_VAL_UB 0 CM_0000 0 255 /end CHARACTERISTIC
/begin CHARACTERISTIC K_SK_MD_BEGR_EGAS_13of64_ "WDK2 WDK1 DK2 DK1 LLS2 LLS1 [A2L-ref]" VALUE 0x7C150 RL_VAL_UB 0 CM_0000 0 255 /end CHARACTERISTIC
/begin CHARACTERISTIC K_SK_MD_BEGR_EGAS_14of64_ "WDK2 WDK1 DK2 DK1 LLS2 LLS1 [A2L-ref]" VALUE 0x7C151 RL_VAL_UB 0 CM_0000 0 255 /end CHARACTERISTIC
/begin CHARACTERISTIC K_SK_MD_BEGR_EGAS_15of64_ "WDK2 WDK1 DK2 DK1 LLS2 LLS1 [A2L-ref]" VALUE 0x7C152 RL_VAL_UB 0 CM_0000 0 255 /end CHARACTERISTIC
/begin CHARACTERISTIC K_SK_MD_BEGR_EGAS_16of64_ "WDK2 WDK1 DK2 DK1 LLS2 LLS1 [A2L-ref]" VALUE 0x7C153 RL_VAL_UB 0 CM_0000 0 255 /end CHARACTERISTIC
/begin CHARACTERISTIC K_SK_MD_BEGR_EGAS_1of64_ "WDK2 WDK1 DK2 DK1 LLS2 LLS1 [A2L-ref]" VALUE 0x7C144 RL_VAL_UB 0 CM_0000 0 255 /end CHARACTERISTIC
/begin CHARACTERISTIC K_SK_MD_BEGR_EGAS_25of64_ "WDK2 WDK1 DK2 DK1 LLS2 LLS1 [A2L-ref]" VALUE 0x7C157 RL_VAL_UB 0 CM_0000 0 255 /end CHARACTERISTIC
/begin CHARACTERISTIC K_SK_MD_BEGR_EGAS_26of64_ "WDK2 WDK1 DK2 DK1 LLS2 LLS1 [A2L-ref]" VALUE 0x7C158 RL_VAL_UB 0 CM_0000 0 255 /end CHARACTERISTIC
/begin CHARACTERISTIC K_SK_MD_BEGR_EGAS_27of64_ "WDK2 WDK1 DK2 DK1 LLS2 LLS1 [A2L-ref]" VALUE 0x7C159 RL_VAL_UB 0 CM_0000 0 255 /end CHARACTERISTIC
/begin CHARACTERISTIC K_SK_MD_BEGR_EGAS_28of64_ "WDK2 WDK1 DK2 DK1 LLS2 LLS1 [A2L-ref]" VALUE 0x7C15A RL_VAL_UB 0 CM_0000 0 255 /end CHARACTERISTIC
/begin CHARACTERISTIC K_SK_MD_BEGR_EGAS_2of64_ "WDK2 WDK1 DK2 DK1 LLS2 LLS1 [A2L-ref]" VALUE 0x7C145 RL_VAL_UB 0 CM_0000 0 255 /end CHARACTERISTIC
/begin CHARACTERISTIC K_SK_MD_BEGR_EGAS_3of64_ "WDK2 WDK1 DK2 DK1 LLS2 LLS1 [A2L-ref]" VALUE 0x7C146 RL_VAL_UB 0 CM_0000 0 255 /end CHARACTERISTIC
/begin CHARACTERISTIC K_SK_MD_BEGR_EGAS_41of64_ "WDK2 WDK1 DK2 DK1 LLS2 LLS1 [A2L-ref]" VALUE 0x7C167 RL_VAL_UB 0 CM_0000 0 255 /end CHARACTERISTIC
/begin CHARACTERISTIC K_SK_MD_BEGR_EGAS_42of64_ "WDK2 WDK1 DK2 DK1 LLS2 LLS1 [A2L-ref]" VALUE 0x7C168 RL_VAL_UB 0 CM_0000 0 255 /end CHARACTERISTIC
/begin CHARACTERISTIC K_SK_MD_BEGR_EGAS_43of64_ "WDK2 WDK1 DK2 DK1 LLS2 LLS1 [A2L-ref]" VALUE 0x7C169 RL_VAL_UB 0 CM_0000 0 255 /end CHARACTERISTIC
/begin CHARACTERISTIC K_SK_MD_BEGR_EGAS_44of64_ "WDK2 WDK1 DK2 DK1 LLS2 LLS1 [A2L-ref]" VALUE 0x7C16A RL_VAL_UB 0 CM_0000 0 255 /end CHARACTERISTIC
/begin CHARACTERISTIC K_SK_MD_BEGR_EGAS_4of64_ "WDK2 WDK1 DK2 DK1 LLS2 LLS1 [A2L-ref]" VALUE 0x7C147 RL_VAL_UB 0 CM_0000 0 255 /end CHARACTERISTIC
/begin CHARACTERISTIC K_SK_MD_BEGR_EGAS_5of64_ "WDK2 WDK1 DK2 DK1 LLS2 LLS1 [A2L-ref]" VALUE 0x7C148 RL_VAL_UB 0 CM_0000 0 255 /end CHARACTERISTIC
/begin CHARACTERISTIC K_SK_MD_BEGR_EGAS_64of64_ "WDK2 WDK1 DK2 DK1 LLS2 LLS1 [A2L-ref]" VALUE 0x7C183 RL_VAL_UB 0 CM_0000 0 255 /end CHARACTERISTIC
/begin CHARACTERISTIC K_SK_MD_BEGR_EGAS_6of64_ "WDK2 WDK1 DK2 DK1 LLS2 LLS1 [A2L-ref]" VALUE 0x7C149 RL_VAL_UB 0 CM_0000 0 255 /end CHARACTERISTIC
/begin CHARACTERISTIC K_SK_MD_BEGR_EGAS_7of64_ "WDK2 WDK1 DK2 DK1 LLS2 LLS1 [A2L-ref]" VALUE 0x7C14A RL_VAL_UB 0 CM_0000 0 255 /end CHARACTERISTIC
/begin CHARACTERISTIC K_SK_MD_BEGR_EGAS_8of64_ "WDK2 WDK1 DK2 DK1 LLS2 LLS1 [A2L-ref]" VALUE 0x7C14B RL_VAL_UB 0 CM_0000 0 255 /end CHARACTERISTIC
/begin CHARACTERISTIC K_SK_MD_BEGR_EGAS_9of64_ "WDK2 WDK1 DK2 DK1 LLS2 LLS1 [A2L-ref]" VALUE 0x7C14C RL_VAL_UB 0 CM_0000 0 255 /end CHARACTERISTIC
/begin CHARACTERISTIC K_SK_MD_BEGR_GEMISCH_17of32_ "VAN KATS FPLAU LAVK PKS [A2L-ref]" VALUE 0x7C204 RL_VAL_UB 0 CM_0000 0 255 /end CHARACTERISTIC
/begin CHARACTERISTIC K_SK_MD_BEGR_GEMISCH_18of32_ "VAN KATS FPLAU LAVK PKS [A2L-ref]" VALUE 0x7C205 RL_VAL_UB 0 CM_0000 0 255 /end CHARACTERISTIC
/begin CHARACTERISTIC K_SK_MD_BEGR_GEMISCH_19of32_ "VAN KATS FPLAU LAVK PKS [A2L-ref]" VALUE 0x7C206 RL_VAL_UB 0 CM_0000 0 255 /end CHARACTERISTIC
/begin CHARACTERISTIC K_SK_MD_BEGR_GEMISCH_1of32_ "VAN KATS FPLAU LAVK PKS [A2L-ref]" VALUE 0x7C1F4 RL_VAL_UB 0 CM_0000 0 255 /end CHARACTERISTIC
/begin CHARACTERISTIC K_SK_MD_BEGR_GEMISCH_20of32_ "VAN KATS FPLAU LAVK PKS [A2L-ref]" VALUE 0x7C207 RL_VAL_UB 0 CM_0000 0 255 /end CHARACTERISTIC
/begin CHARACTERISTIC K_SK_MD_BEGR_GEMISCH_21of32_ "VAN KATS FPLAU LAVK PKS [A2L-ref]" VALUE 0x7C208 RL_VAL_UB 0 CM_0000 0 255 /end CHARACTERISTIC
/begin CHARACTERISTIC K_SK_MD_BEGR_GEMISCH_22of32_ "VAN KATS FPLAU LAVK PKS [A2L-ref]" VALUE 0x7C209 RL_VAL_UB 0 CM_0000 0 255 /end CHARACTERISTIC
/begin CHARACTERISTIC K_SK_MD_BEGR_GEMISCH_23of32_ "VAN KATS FPLAU LAVK PKS [A2L-ref]" VALUE 0x7C20A RL_VAL_UB 0 CM_0000 0 255 /end CHARACTERISTIC
/begin CHARACTERISTIC K_SK_MD_BEGR_GEMISCH_24of32_ "VAN KATS FPLAU LAVK PKS [A2L-ref]" VALUE 0x7C20B RL_VAL_UB 0 CM_0000 0 255 /end CHARACTERISTIC
/begin CHARACTERISTIC K_SK_MD_BEGR_GEMISCH_25of32_ "VAN KATS FPLAU LAVK PKS [A2L-ref]" VALUE 0x7C20C RL_VAL_UB 0 CM_0000 0 255 /end CHARACTERISTIC
/begin CHARACTERISTIC K_SK_MD_BEGR_GEMISCH_26of32_ "VAN KATS FPLAU LAVK PKS [A2L-ref]" VALUE 0x7C20D RL_VAL_UB 0 CM_0000 0 255 /end CHARACTERISTIC
/begin CHARACTERISTIC K_SK_MD_BEGR_GEMISCH_27of32_ "VAN KATS FPLAU LAVK PKS [A2L-ref]" VALUE 0x7C20E RL_VAL_UB 0 CM_0000 0 255 /end CHARACTERISTIC
/begin CHARACTERISTIC K_SK_MD_BEGR_GEMISCH_28of32_ "VAN KATS FPLAU LAVK PKS [A2L-ref]" VALUE 0x7C20F RL_VAL_UB 0 CM_0000 0 255 /end CHARACTERISTIC
/begin CHARACTERISTIC K_SK_MD_BEGR_GEMISCH_29of32_ "VAN KATS FPLAU LAVK PKS [A2L-ref]" VALUE 0x7C210 RL_VAL_UB 0 CM_0000 0 255 /end CHARACTERISTIC
/begin CHARACTERISTIC K_SK_MD_BEGR_GEMISCH_2of32_ "VAN KATS FPLAU LAVK PKS [A2L-ref]" VALUE 0x7C1F5 RL_VAL_UB 0 CM_0000 0 255 /end CHARACTERISTIC
/begin CHARACTERISTIC K_SK_MD_BEGR_GEMISCH_30of32_ "VAN KATS FPLAU LAVK PKS [A2L-ref]" VALUE 0x7C211 RL_VAL_UB 0 CM_0000 0 255 /end CHARACTERISTIC
/begin CHARACTERISTIC K_SK_MD_BEGR_GEMISCH_31of32_ "VAN KATS FPLAU LAVK PKS [A2L-ref]" VALUE 0x7C212 RL_VAL_UB 0 CM_0000 0 255 /end CHARACTERISTIC
/begin CHARACTERISTIC K_SK_MD_BEGR_GEMISCH_32of32_ "VAN KATS FPLAU LAVK PKS [A2L-ref]" VALUE 0x7C213 RL_VAL_UB 0 CM_0000 0 255 /end CHARACTERISTIC
/begin CHARACTERISTIC K_SK_MD_BEGR_GEMISCH_3of32_ "VAN KATS FPLAU LAVK PKS [A2L-ref]" VALUE 0x7C1F6 RL_VAL_UB 0 CM_0000 0 255 /end CHARACTERISTIC
/begin CHARACTERISTIC K_SK_MD_BEGR_GEMISCH_4of32_ "VAN KATS FPLAU LAVK PKS [A2L-ref]" VALUE 0x7C1F7 RL_VAL_UB 0 CM_0000 0 255 /end CHARACTERISTIC
/begin CHARACTERISTIC K_SK_MD_BEGR_MD_10of16_ "SollIst Mdmin EtaRf LLR [A2L-ref]" VALUE 0x7C1ED RL_VAL_UB 0 CM_0000 0 255 /end CHARACTERISTIC
/begin CHARACTERISTIC K_SK_MD_BEGR_MD_11of16_ "SollIst Mdmin EtaRf LLR [A2L-ref]" VALUE 0x7C1EE RL_VAL_UB 0 CM_0000 0 255 /end CHARACTERISTIC
/begin CHARACTERISTIC K_SK_MD_BEGR_MD_12of16_ "SollIst Mdmin EtaRf LLR [A2L-ref]" VALUE 0x7C1EF RL_VAL_UB 0 CM_0000 0 255 /end CHARACTERISTIC
/begin CHARACTERISTIC K_SK_MD_BEGR_MD_13of16_ "SollIst Mdmin EtaRf LLR [A2L-ref]" VALUE 0x7C1F0 RL_VAL_UB 0 CM_0000 0 255 /end CHARACTERISTIC
/begin CHARACTERISTIC K_SK_MD_BEGR_MD_14of16_ "SollIst Mdmin EtaRf LLR [A2L-ref]" VALUE 0x7C1F1 RL_VAL_UB 0 CM_0000 0 255 /end CHARACTERISTIC
/begin CHARACTERISTIC K_SK_MD_BEGR_MD_15of16_ "SollIst Mdmin EtaRf LLR [A2L-ref]" VALUE 0x7C1F2 RL_VAL_UB 0 CM_0000 0 255 /end CHARACTERISTIC
/begin CHARACTERISTIC K_SK_MD_BEGR_MD_16of16_ "SollIst Mdmin EtaRf LLR [A2L-ref]" VALUE 0x7C1F3 RL_VAL_UB 0 CM_0000 0 255 /end CHARACTERISTIC
/begin CHARACTERISTIC K_SK_MD_BEGR_MD_1of16_ "SollIst Mdmin EtaRf LLR [A2L-ref]" VALUE 0x7C1E4 RL_VAL_UB 0 CM_0000 0 255 /end CHARACTERISTIC
/begin CHARACTERISTIC K_SK_MD_BEGR_MD_4of16_ "SollIst Mdmin EtaRf LLR [A2L-ref]" VALUE 0x7C1E7 RL_VAL_UB 0 CM_0000 0 255 /end CHARACTERISTIC
/begin CHARACTERISTIC K_SK_MD_BEGR_MD_5of16_ "SollIst Mdmin EtaRf LLR [A2L-ref]" VALUE 0x7C1E8 RL_VAL_UB 0 CM_0000 0 255 /end CHARACTERISTIC
/begin CHARACTERISTIC K_SK_MD_BEGR_MD_6of16_ "SollIst Mdmin EtaRf LLR [A2L-ref]" VALUE 0x7C1E9 RL_VAL_UB 0 CM_0000 0 255 /end CHARACTERISTIC
/begin CHARACTERISTIC K_SK_MD_BEGR_MD_7of16_ "SollIst Mdmin EtaRf LLR [A2L-ref]" VALUE 0x7C1EA RL_VAL_UB 0 CM_0000 0 255 /end CHARACTERISTIC
/begin CHARACTERISTIC K_SK_MD_BEGR_MD_8of16_ "SollIst Mdmin EtaRf LLR [A2L-ref]" VALUE 0x7C1EB RL_VAL_UB 0 CM_0000 0 255 /end CHARACTERISTIC
/begin CHARACTERISTIC K_SK_MD_BEGR_MD_9of16_ "SollIst Mdmin EtaRf LLR [A2L-ref]" VALUE 0x7C1EC RL_VAL_UB 0 CM_0000 0 255 /end CHARACTERISTIC
/begin CHARACTERISTIC K_SK_MD_BEGR_MVAC_1of4_ "ELUP MVAC [A2L-ref]" VALUE 0x7C23A RL_VAL_UB 0 CM_0000 0 255 /end CHARACTERISTIC
/begin CHARACTERISTIC K_SK_MD_BEGR_MVAC_2of4_ "ELUP MVAC [A2L-ref]" VALUE 0x7C23B RL_VAL_UB 0 CM_0000 0 255 /end CHARACTERISTIC
/begin CHARACTERISTIC K_SK_MD_BEGR_MVAC_3of4_ "ELUP MVAC [A2L-ref]" VALUE 0x7C23C RL_VAL_UB 0 CM_0000 0 255 /end CHARACTERISTIC
/begin CHARACTERISTIC K_SK_MD_BEGR_MVAC_4of4_ "ELUP MVAC [A2L-ref]" VALUE 0x7C23D RL_VAL_UB 0 CM_0000 0 255 /end CHARACTERISTIC
/begin CHARACTERISTIC K_SK_MD_BEGR_PWG_1of6_ "pwg_mode [A2L-ref]" VALUE 0x7C234 RL_VAL_UB 0 CM_0000 0 255 /end CHARACTERISTIC
/begin CHARACTERISTIC K_SK_MD_BEGR_PWG_2of6_ "pwg_mode [A2L-ref]" VALUE 0x7C235 RL_VAL_UB 0 CM_0000 0 255 /end CHARACTERISTIC
/begin CHARACTERISTIC K_SK_MD_BEGR_PWG_3of6_ "pwg_mode [A2L-ref]" VALUE 0x7C236 RL_VAL_UB 0 CM_0000 0 255 /end CHARACTERISTIC
/begin CHARACTERISTIC K_SK_MD_BEGR_PWG_4of6_ "pwg_mode [A2L-ref]" VALUE 0x7C237 RL_VAL_UB 0 CM_0000 0 255 /end CHARACTERISTIC
/begin CHARACTERISTIC K_SK_MD_BEGR_PWG_5of6_ "pwg_mode [A2L-ref]" VALUE 0x7C238 RL_VAL_UB 0 CM_0000 0 255 /end CHARACTERISTIC
/begin CHARACTERISTIC K_SK_MD_BEGR_PWG_6of6_ "pwg_mode [A2L-ref]" VALUE 0x7C239 RL_VAL_UB 0 CM_0000 0 255 /end CHARACTERISTIC
/begin CHARACTERISTIC K_SK_MD_BEGR_SMG_10of16_ "CANErr CANSk STAT SABR [A2L-ref]" VALUE 0x7C1DD RL_VAL_UB 0 CM_0000 0 255 /end CHARACTERISTIC
/begin CHARACTERISTIC K_SK_MD_BEGR_SMG_11of16_ "CANErr CANSk STAT SABR [A2L-ref]" VALUE 0x7C1DE RL_VAL_UB 0 CM_0000 0 255 /end CHARACTERISTIC
/begin CHARACTERISTIC K_SK_MD_BEGR_SMG_12of16_ "CANErr CANSk STAT SABR [A2L-ref]" VALUE 0x7C1DF RL_VAL_UB 0 CM_0000 0 255 /end CHARACTERISTIC
/begin CHARACTERISTIC K_SK_MD_BEGR_SMG_13of16_ "CANErr CANSk STAT SABR [A2L-ref]" VALUE 0x7C1E0 RL_VAL_UB 0 CM_0000 0 255 /end CHARACTERISTIC
/begin CHARACTERISTIC K_SK_MD_BEGR_SMG_14of16_ "CANErr CANSk STAT SABR [A2L-ref]" VALUE 0x7C1E1 RL_VAL_UB 0 CM_0000 0 255 /end CHARACTERISTIC
/begin CHARACTERISTIC K_SK_MD_BEGR_SMG_15of16_ "CANErr CANSk STAT SABR [A2L-ref]" VALUE 0x7C1E2 RL_VAL_UB 0 CM_0000 0 255 /end CHARACTERISTIC
/begin CHARACTERISTIC K_SK_MD_BEGR_SMG_16of16_ "CANErr CANSk STAT SABR [A2L-ref]" VALUE 0x7C1E3 RL_VAL_UB 0 CM_0000 0 255 /end CHARACTERISTIC
/begin CHARACTERISTIC K_SK_MD_BEGR_SMG_1of16_ "CANErr CANSk STAT SABR [A2L-ref]" VALUE 0x7C1D4 RL_VAL_UB 0 CM_0000 0 255 /end CHARACTERISTIC
/begin CHARACTERISTIC K_SK_MD_BEGR_SMG_2of16_ "CANErr CANSk STAT SABR [A2L-ref]" VALUE 0x7C1D5 RL_VAL_UB 0 CM_0000 0 255 /end CHARACTERISTIC
/begin CHARACTERISTIC K_SK_MD_BEGR_SMG_3of16_ "CANErr CANSk STAT SABR [A2L-ref]" VALUE 0x7C1D6 RL_VAL_UB 0 CM_0000 0 255 /end CHARACTERISTIC
/begin CHARACTERISTIC K_SK_MD_BEGR_SMG_4of16_ "CANErr CANSk STAT SABR [A2L-ref]" VALUE 0x7C1D7 RL_VAL_UB 0 CM_0000 0 255 /end CHARACTERISTIC
/begin CHARACTERISTIC K_SK_MD_BEGR_SMG_5of16_ "CANErr CANSk STAT SABR [A2L-ref]" VALUE 0x7C1D8 RL_VAL_UB 0 CM_0000 0 255 /end CHARACTERISTIC
/begin CHARACTERISTIC K_SK_MD_BEGR_SMG_6of16_ "CANErr CANSk STAT SABR [A2L-ref]" VALUE 0x7C1D9 RL_VAL_UB 0 CM_0000 0 255 /end CHARACTERISTIC
/begin CHARACTERISTIC K_SK_MD_BEGR_SMG_7of16_ "CANErr CANSk STAT SABR [A2L-ref]" VALUE 0x7C1DA RL_VAL_UB 0 CM_0000 0 255 /end CHARACTERISTIC
/begin CHARACTERISTIC K_SK_MD_BEGR_SMG_8of16_ "CANErr CANSk STAT SABR [A2L-ref]" VALUE 0x7C1DB RL_VAL_UB 0 CM_0000 0 255 /end CHARACTERISTIC
/begin CHARACTERISTIC K_SK_MD_BEGR_SMG_9of16_ "CANErr CANSk STAT SABR [A2L-ref]" VALUE 0x7C1DC RL_VAL_UB 0 CM_0000 0 255 /end CHARACTERISTIC
/begin CHARACTERISTIC K_SK_MD_BEGR_TI_10of16_ "B2 B1 Z2 Z1 [A2L-ref]" VALUE 0x7C18D RL_VAL_UB 0 CM_0000 0 255 /end CHARACTERISTIC
/begin CHARACTERISTIC K_SK_MD_BEGR_TI_11of16_ "B2 B1 Z2 Z1 [A2L-ref]" VALUE 0x7C18E RL_VAL_UB 0 CM_0000 0 255 /end CHARACTERISTIC
/begin CHARACTERISTIC K_SK_MD_BEGR_TI_12of16_ "B2 B1 Z2 Z1 [A2L-ref]" VALUE 0x7C18F RL_VAL_UB 0 CM_0000 0 255 /end CHARACTERISTIC
/begin CHARACTERISTIC K_SK_MD_BEGR_TI_13of16_ "B2 B1 Z2 Z1 [A2L-ref]" VALUE 0x7C190 RL_VAL_UB 0 CM_0000 0 255 /end CHARACTERISTIC
/begin CHARACTERISTIC K_SK_MD_BEGR_TI_14of16_ "B2 B1 Z2 Z1 [A2L-ref]" VALUE 0x7C191 RL_VAL_UB 0 CM_0000 0 255 /end CHARACTERISTIC
/begin CHARACTERISTIC K_SK_MD_BEGR_TI_15of16_ "B2 B1 Z2 Z1 [A2L-ref]" VALUE 0x7C192 RL_VAL_UB 0 CM_0000 0 255 /end CHARACTERISTIC
/begin CHARACTERISTIC K_SK_MD_BEGR_TI_16of16_ "B2 B1 Z2 Z1 [A2L-ref]" VALUE 0x7C193 RL_VAL_UB 0 CM_0000 0 255 /end CHARACTERISTIC
/begin CHARACTERISTIC K_SK_MD_BEGR_TI_2of16_ "B2 B1 Z2 Z1 [A2L-ref]" VALUE 0x7C185 RL_VAL_UB 0 CM_0000 0 255 /end CHARACTERISTIC
/begin CHARACTERISTIC K_SK_MD_BEGR_TI_3of16_ "B2 B1 Z2 Z1 [A2L-ref]" VALUE 0x7C186 RL_VAL_UB 0 CM_0000 0 255 /end CHARACTERISTIC
/begin CHARACTERISTIC K_SK_MD_BEGR_TI_4of16_ "B2 B1 Z2 Z1 [A2L-ref]" VALUE 0x7C187 RL_VAL_UB 0 CM_0000 0 255 /end CHARACTERISTIC
/begin CHARACTERISTIC K_SK_MD_BEGR_TI_5of16_ "B2 B1 Z2 Z1 [A2L-ref]" VALUE 0x7C188 RL_VAL_UB 0 CM_0000 0 255 /end CHARACTERISTIC
/begin CHARACTERISTIC K_SK_MD_BEGR_TI_6of16_ "B2 B1 Z2 Z1 [A2L-ref]" VALUE 0x7C189 RL_VAL_UB 0 CM_0000 0 255 /end CHARACTERISTIC
/begin CHARACTERISTIC K_SK_MD_BEGR_TI_7of16_ "B2 B1 Z2 Z1 [A2L-ref]" VALUE 0x7C18A RL_VAL_UB 0 CM_0000 0 255 /end CHARACTERISTIC
/begin CHARACTERISTIC K_SK_MD_BEGR_TI_8of16_ "B2 B1 Z2 Z1 [A2L-ref]" VALUE 0x7C18B RL_VAL_UB 0 CM_0000 0 255 /end CHARACTERISTIC
/begin CHARACTERISTIC K_SK_MD_BEGR_TI_9of16_ "B2 B1 Z2 Z1 [A2L-ref]" VALUE 0x7C18C RL_VAL_UB 0 CM_0000 0 255 /end CHARACTERISTIC
/begin CHARACTERISTIC K_SK_MVAC_KH_1of4_ "ELUP MVAC [A2L-ref]" VALUE 0x7C23E RL_VAL_UB 0 CM_0000 0 255 /end CHARACTERISTIC
/begin CHARACTERISTIC K_SK_MVAC_KH_2of4_ "ELUP MVAC [A2L-ref]" VALUE 0x7C23F RL_VAL_UB 0 CM_0000 0 255 /end CHARACTERISTIC
/begin CHARACTERISTIC K_SK_MVAC_KH_3of4_ "ELUP MVAC [A2L-ref]" VALUE 0x7C240 RL_VAL_UB 0 CM_0000 0 255 /end CHARACTERISTIC
/begin CHARACTERISTIC K_SK_MVAC_KH_4of4_ "ELUP MVAC [A2L-ref]" VALUE 0x7C241 RL_VAL_UB 0 CM_0000 0 255 /end CHARACTERISTIC
/begin CHARACTERISTIC K_SK_TI_OFF_EGAS_10of64_ "TI2 TI1 DK2 DK1 LLS2 LLS1 [A2L-ref]" VALUE 0x7C19D RL_VAL_UB 0 CM_0000 0 255 /end CHARACTERISTIC
/begin CHARACTERISTIC K_SK_TI_OFF_EGAS_11of64_ "TI2 TI1 DK2 DK1 LLS2 LLS1 [A2L-ref]" VALUE 0x7C19E RL_VAL_UB 0 CM_0000 0 255 /end CHARACTERISTIC
/begin CHARACTERISTIC K_SK_TI_OFF_EGAS_12of64_ "TI2 TI1 DK2 DK1 LLS2 LLS1 [A2L-ref]" VALUE 0x7C19F RL_VAL_UB 0 CM_0000 0 255 /end CHARACTERISTIC
/begin CHARACTERISTIC K_SK_TI_OFF_EGAS_13of64_ "TI2 TI1 DK2 DK1 LLS2 LLS1 [A2L-ref]" VALUE 0x7C1A0 RL_VAL_UB 0 CM_0000 0 255 /end CHARACTERISTIC
/begin CHARACTERISTIC K_SK_TI_OFF_EGAS_14of64_ "TI2 TI1 DK2 DK1 LLS2 LLS1 [A2L-ref]" VALUE 0x7C1A1 RL_VAL_UB 0 CM_0000 0 255 /end CHARACTERISTIC
/begin CHARACTERISTIC K_SK_TI_OFF_EGAS_15of64_ "TI2 TI1 DK2 DK1 LLS2 LLS1 [A2L-ref]" VALUE 0x7C1A2 RL_VAL_UB 0 CM_0000 0 255 /end CHARACTERISTIC
/begin CHARACTERISTIC K_SK_TI_OFF_EGAS_16of64_ "TI2 TI1 DK2 DK1 LLS2 LLS1 [A2L-ref]" VALUE 0x7C1A3 RL_VAL_UB 0 CM_0000 0 255 /end CHARACTERISTIC
/begin CHARACTERISTIC K_SK_TI_OFF_EGAS_17of64_ "TI2 TI1 DK2 DK1 LLS2 LLS1 [A2L-ref]" VALUE 0x7C1A4 RL_VAL_UB 0 CM_0000 0 255 /end CHARACTERISTIC
/begin CHARACTERISTIC K_SK_TI_OFF_EGAS_18of64_ "TI2 TI1 DK2 DK1 LLS2 LLS1 [A2L-ref]" VALUE 0x7C1A5 RL_VAL_UB 0 CM_0000 0 255 /end CHARACTERISTIC
/begin CHARACTERISTIC K_SK_TI_OFF_EGAS_19of64_ "TI2 TI1 DK2 DK1 LLS2 LLS1 [A2L-ref]" VALUE 0x7C1A6 RL_VAL_UB 0 CM_0000 0 255 /end CHARACTERISTIC
/begin CHARACTERISTIC K_SK_TI_OFF_EGAS_1of64_ "TI2 TI1 DK2 DK1 LLS2 LLS1 [A2L-ref]" VALUE 0x7C194 RL_VAL_UB 0 CM_0000 0 255 /end CHARACTERISTIC
/begin CHARACTERISTIC K_SK_TI_OFF_EGAS_20of64_ "TI2 TI1 DK2 DK1 LLS2 LLS1 [A2L-ref]" VALUE 0x7C1A7 RL_VAL_UB 0 CM_0000 0 255 /end CHARACTERISTIC
/begin CHARACTERISTIC K_SK_TI_OFF_EGAS_21of64_ "TI2 TI1 DK2 DK1 LLS2 LLS1 [A2L-ref]" VALUE 0x7C1A8 RL_VAL_UB 0 CM_0000 0 255 /end CHARACTERISTIC
/begin CHARACTERISTIC K_SK_TI_OFF_EGAS_22of64_ "TI2 TI1 DK2 DK1 LLS2 LLS1 [A2L-ref]" VALUE 0x7C1A9 RL_VAL_UB 0 CM_0000 0 255 /end CHARACTERISTIC
/begin CHARACTERISTIC K_SK_TI_OFF_EGAS_23of64_ "TI2 TI1 DK2 DK1 LLS2 LLS1 [A2L-ref]" VALUE 0x7C1AA RL_VAL_UB 0 CM_0000 0 255 /end CHARACTERISTIC
/begin CHARACTERISTIC K_SK_TI_OFF_EGAS_24of64_ "TI2 TI1 DK2 DK1 LLS2 LLS1 [A2L-ref]" VALUE 0x7C1AB RL_VAL_UB 0 CM_0000 0 255 /end CHARACTERISTIC
/begin CHARACTERISTIC K_SK_TI_OFF_EGAS_25of64_ "TI2 TI1 DK2 DK1 LLS2 LLS1 [A2L-ref]" VALUE 0x7C1AC RL_VAL_UB 0 CM_0000 0 255 /end CHARACTERISTIC
/begin CHARACTERISTIC K_SK_TI_OFF_EGAS_26of64_ "TI2 TI1 DK2 DK1 LLS2 LLS1 [A2L-ref]" VALUE 0x7C1AD RL_VAL_UB 0 CM_0000 0 255 /end CHARACTERISTIC
/begin CHARACTERISTIC K_SK_TI_OFF_EGAS_27of64_ "TI2 TI1 DK2 DK1 LLS2 LLS1 [A2L-ref]" VALUE 0x7C1AE RL_VAL_UB 0 CM_0000 0 255 /end CHARACTERISTIC
/begin CHARACTERISTIC K_SK_TI_OFF_EGAS_28of64_ "TI2 TI1 DK2 DK1 LLS2 LLS1 [A2L-ref]" VALUE 0x7C1AF RL_VAL_UB 0 CM_0000 0 255 /end CHARACTERISTIC
/begin CHARACTERISTIC K_SK_TI_OFF_EGAS_29of64_ "TI2 TI1 DK2 DK1 LLS2 LLS1 [A2L-ref]" VALUE 0x7C1B0 RL_VAL_UB 0 CM_0000 0 255 /end CHARACTERISTIC
/begin CHARACTERISTIC K_SK_TI_OFF_EGAS_2of64_ "TI2 TI1 DK2 DK1 LLS2 LLS1 [A2L-ref]" VALUE 0x7C195 RL_VAL_UB 0 CM_0000 0 255 /end CHARACTERISTIC
/begin CHARACTERISTIC K_SK_TI_OFF_EGAS_30of64_ "TI2 TI1 DK2 DK1 LLS2 LLS1 [A2L-ref]" VALUE 0x7C1B1 RL_VAL_UB 0 CM_0000 0 255 /end CHARACTERISTIC
/begin CHARACTERISTIC K_SK_TI_OFF_EGAS_31of64_ "TI2 TI1 DK2 DK1 LLS2 LLS1 [A2L-ref]" VALUE 0x7C1B2 RL_VAL_UB 0 CM_0000 0 255 /end CHARACTERISTIC
/begin CHARACTERISTIC K_SK_TI_OFF_EGAS_32of64_ "TI2 TI1 DK2 DK1 LLS2 LLS1 [A2L-ref]" VALUE 0x7C1B3 RL_VAL_UB 0 CM_0000 0 255 /end CHARACTERISTIC
/begin CHARACTERISTIC K_SK_TI_OFF_EGAS_33of64_ "TI2 TI1 DK2 DK1 LLS2 LLS1 [A2L-ref]" VALUE 0x7C1B4 RL_VAL_UB 0 CM_0000 0 255 /end CHARACTERISTIC
/begin CHARACTERISTIC K_SK_TI_OFF_EGAS_34of64_ "TI2 TI1 DK2 DK1 LLS2 LLS1 [A2L-ref]" VALUE 0x7C1B5 RL_VAL_UB 0 CM_0000 0 255 /end CHARACTERISTIC
/begin CHARACTERISTIC K_SK_TI_OFF_EGAS_35of64_ "TI2 TI1 DK2 DK1 LLS2 LLS1 [A2L-ref]" VALUE 0x7C1B6 RL_VAL_UB 0 CM_0000 0 255 /end CHARACTERISTIC
/begin CHARACTERISTIC K_SK_TI_OFF_EGAS_36of64_ "TI2 TI1 DK2 DK1 LLS2 LLS1 [A2L-ref]" VALUE 0x7C1B7 RL_VAL_UB 0 CM_0000 0 255 /end CHARACTERISTIC
/begin CHARACTERISTIC K_SK_TI_OFF_EGAS_37of64_ "TI2 TI1 DK2 DK1 LLS2 LLS1 [A2L-ref]" VALUE 0x7C1B8 RL_VAL_UB 0 CM_0000 0 255 /end CHARACTERISTIC
/begin CHARACTERISTIC K_SK_TI_OFF_EGAS_38of64_ "TI2 TI1 DK2 DK1 LLS2 LLS1 [A2L-ref]" VALUE 0x7C1B9 RL_VAL_UB 0 CM_0000 0 255 /end CHARACTERISTIC
/begin CHARACTERISTIC K_SK_TI_OFF_EGAS_39of64_ "TI2 TI1 DK2 DK1 LLS2 LLS1 [A2L-ref]" VALUE 0x7C1BA RL_VAL_UB 0 CM_0000 0 255 /end CHARACTERISTIC
/begin CHARACTERISTIC K_SK_TI_OFF_EGAS_3of64_ "TI2 TI1 DK2 DK1 LLS2 LLS1 [A2L-ref]" VALUE 0x7C196 RL_VAL_UB 0 CM_0000 0 255 /end CHARACTERISTIC
/begin CHARACTERISTIC K_SK_TI_OFF_EGAS_40of64_ "TI2 TI1 DK2 DK1 LLS2 LLS1 [A2L-ref]" VALUE 0x7C1BB RL_VAL_UB 0 CM_0000 0 255 /end CHARACTERISTIC
/begin CHARACTERISTIC K_SK_TI_OFF_EGAS_41of64_ "TI2 TI1 DK2 DK1 LLS2 LLS1 [A2L-ref]" VALUE 0x7C1BC RL_VAL_UB 0 CM_0000 0 255 /end CHARACTERISTIC
/begin CHARACTERISTIC K_SK_TI_OFF_EGAS_42of64_ "TI2 TI1 DK2 DK1 LLS2 LLS1 [A2L-ref]" VALUE 0x7C1BD RL_VAL_UB 0 CM_0000 0 255 /end CHARACTERISTIC
/begin CHARACTERISTIC K_SK_TI_OFF_EGAS_43of64_ "TI2 TI1 DK2 DK1 LLS2 LLS1 [A2L-ref]" VALUE 0x7C1BE RL_VAL_UB 0 CM_0000 0 255 /end CHARACTERISTIC
/begin CHARACTERISTIC K_SK_TI_OFF_EGAS_44of64_ "TI2 TI1 DK2 DK1 LLS2 LLS1 [A2L-ref]" VALUE 0x7C1BF RL_VAL_UB 0 CM_0000 0 255 /end CHARACTERISTIC
/begin CHARACTERISTIC K_SK_TI_OFF_EGAS_45of64_ "TI2 TI1 DK2 DK1 LLS2 LLS1 [A2L-ref]" VALUE 0x7C1C0 RL_VAL_UB 0 CM_0000 0 255 /end CHARACTERISTIC
/begin CHARACTERISTIC K_SK_TI_OFF_EGAS_46of64_ "TI2 TI1 DK2 DK1 LLS2 LLS1 [A2L-ref]" VALUE 0x7C1C1 RL_VAL_UB 0 CM_0000 0 255 /end CHARACTERISTIC
/begin CHARACTERISTIC K_SK_TI_OFF_EGAS_47of64_ "TI2 TI1 DK2 DK1 LLS2 LLS1 [A2L-ref]" VALUE 0x7C1C2 RL_VAL_UB 0 CM_0000 0 255 /end CHARACTERISTIC
/begin CHARACTERISTIC K_SK_TI_OFF_EGAS_48of64_ "TI2 TI1 DK2 DK1 LLS2 LLS1 [A2L-ref]" VALUE 0x7C1C3 RL_VAL_UB 0 CM_0000 0 255 /end CHARACTERISTIC
/begin CHARACTERISTIC K_SK_TI_OFF_EGAS_49of64_ "TI2 TI1 DK2 DK1 LLS2 LLS1 [A2L-ref]" VALUE 0x7C1C4 RL_VAL_UB 0 CM_0000 0 255 /end CHARACTERISTIC
/begin CHARACTERISTIC K_SK_TI_OFF_EGAS_4of64_ "TI2 TI1 DK2 DK1 LLS2 LLS1 [A2L-ref]" VALUE 0x7C197 RL_VAL_UB 0 CM_0000 0 255 /end CHARACTERISTIC
/begin CHARACTERISTIC K_SK_TI_OFF_EGAS_50of64_ "TI2 TI1 DK2 DK1 LLS2 LLS1 [A2L-ref]" VALUE 0x7C1C5 RL_VAL_UB 0 CM_0000 0 255 /end CHARACTERISTIC
/begin CHARACTERISTIC K_SK_TI_OFF_EGAS_51of64_ "TI2 TI1 DK2 DK1 LLS2 LLS1 [A2L-ref]" VALUE 0x7C1C6 RL_VAL_UB 0 CM_0000 0 255 /end CHARACTERISTIC
/begin CHARACTERISTIC K_SK_TI_OFF_EGAS_52of64_ "TI2 TI1 DK2 DK1 LLS2 LLS1 [A2L-ref]" VALUE 0x7C1C7 RL_VAL_UB 0 CM_0000 0 255 /end CHARACTERISTIC
/begin CHARACTERISTIC K_SK_TI_OFF_EGAS_53of64_ "TI2 TI1 DK2 DK1 LLS2 LLS1 [A2L-ref]" VALUE 0x7C1C8 RL_VAL_UB 0 CM_0000 0 255 /end CHARACTERISTIC
/begin CHARACTERISTIC K_SK_TI_OFF_EGAS_54of64_ "TI2 TI1 DK2 DK1 LLS2 LLS1 [A2L-ref]" VALUE 0x7C1C9 RL_VAL_UB 0 CM_0000 0 255 /end CHARACTERISTIC
/begin CHARACTERISTIC K_SK_TI_OFF_EGAS_55of64_ "TI2 TI1 DK2 DK1 LLS2 LLS1 [A2L-ref]" VALUE 0x7C1CA RL_VAL_UB 0 CM_0000 0 255 /end CHARACTERISTIC
/begin CHARACTERISTIC K_SK_TI_OFF_EGAS_56of64_ "TI2 TI1 DK2 DK1 LLS2 LLS1 [A2L-ref]" VALUE 0x7C1CB RL_VAL_UB 0 CM_0000 0 255 /end CHARACTERISTIC
/begin CHARACTERISTIC K_SK_TI_OFF_EGAS_57of64_ "TI2 TI1 DK2 DK1 LLS2 LLS1 [A2L-ref]" VALUE 0x7C1CC RL_VAL_UB 0 CM_0000 0 255 /end CHARACTERISTIC
/begin CHARACTERISTIC K_SK_TI_OFF_EGAS_58of64_ "TI2 TI1 DK2 DK1 LLS2 LLS1 [A2L-ref]" VALUE 0x7C1CD RL_VAL_UB 0 CM_0000 0 255 /end CHARACTERISTIC
/begin CHARACTERISTIC K_SK_TI_OFF_EGAS_59of64_ "TI2 TI1 DK2 DK1 LLS2 LLS1 [A2L-ref]" VALUE 0x7C1CE RL_VAL_UB 0 CM_0000 0 255 /end CHARACTERISTIC
/begin CHARACTERISTIC K_SK_TI_OFF_EGAS_5of64_ "TI2 TI1 DK2 DK1 LLS2 LLS1 [A2L-ref]" VALUE 0x7C198 RL_VAL_UB 0 CM_0000 0 255 /end CHARACTERISTIC
/begin CHARACTERISTIC K_SK_TI_OFF_EGAS_60of64_ "TI2 TI1 DK2 DK1 LLS2 LLS1 [A2L-ref]" VALUE 0x7C1CF RL_VAL_UB 0 CM_0000 0 255 /end CHARACTERISTIC
/begin CHARACTERISTIC K_SK_TI_OFF_EGAS_61of64_ "TI2 TI1 DK2 DK1 LLS2 LLS1 [A2L-ref]" VALUE 0x7C1D0 RL_VAL_UB 0 CM_0000 0 255 /end CHARACTERISTIC
/begin CHARACTERISTIC K_SK_TI_OFF_EGAS_62of64_ "TI2 TI1 DK2 DK1 LLS2 LLS1 [A2L-ref]" VALUE 0x7C1D1 RL_VAL_UB 0 CM_0000 0 255 /end CHARACTERISTIC
/begin CHARACTERISTIC K_SK_TI_OFF_EGAS_63of64_ "TI2 TI1 DK2 DK1 LLS2 LLS1 [A2L-ref]" VALUE 0x7C1D2 RL_VAL_UB 0 CM_0000 0 255 /end CHARACTERISTIC
/begin CHARACTERISTIC K_SK_TI_OFF_EGAS_64of64_ "TI2 TI1 DK2 DK1 LLS2 LLS1 [A2L-ref]" VALUE 0x7C1D3 RL_VAL_UB 0 CM_0000 0 255 /end CHARACTERISTIC
/begin CHARACTERISTIC K_SK_TI_OFF_EGAS_6of64_ "TI2 TI1 DK2 DK1 LLS2 LLS1 [A2L-ref]" VALUE 0x7C199 RL_VAL_UB 0 CM_0000 0 255 /end CHARACTERISTIC
/begin CHARACTERISTIC K_SK_TI_OFF_EGAS_7of64_ "TI2 TI1 DK2 DK1 LLS2 LLS1 [A2L-ref]" VALUE 0x7C19A RL_VAL_UB 0 CM_0000 0 255 /end CHARACTERISTIC
/begin CHARACTERISTIC K_SK_TI_OFF_EGAS_8of64_ "TI2 TI1 DK2 DK1 LLS2 LLS1 [A2L-ref]" VALUE 0x7C19B RL_VAL_UB 0 CM_0000 0 255 /end CHARACTERISTIC
/begin CHARACTERISTIC K_SK_TI_OFF_EGAS_9of64_ "TI2 TI1 DK2 DK1 LLS2 LLS1 [A2L-ref]" VALUE 0x7C19C RL_VAL_UB 0 CM_0000 0 255 /end CHARACTERISTIC
/begin CHARACTERISTIC K_SMG_E2_ST_ERR_MAX "max. Fehler fuer Statusvergleich [A2L-ref]" VALUE 0x7EE44 RL_VAL_UB 0 CM_0000 0 255 /end CHARACTERISTIC
/begin CHARACTERISTIC K_TAN_OBD_CFG "Plausibilisierung Ansauglufttemperatur [A2L-ref]" VALUE 0x7D33A RL_VAL_UB 0 CM_0000 0 255 /end CHARACTERISTIC
/begin CHARACTERISTIC K_TAN_OBD_DELTA_MAX "Maximale Temperaturdifferenz der beiden HFM [A2L-ref]" VALUE 0x7D33C RL_VAL_SW 0 CM_0024 -3276.8 3276.7 /end CHARACTERISTIC
/begin CHARACTERISTIC K_TAN_OBD_N_DYN_TAU "Filterkonstante f???r Drehzahldynamik [A2L-ref]" VALUE 0x7D335 RL_VAL_UB 0 CM_0027 0 255 /end CHARACTERISTIC
/begin CHARACTERISTIC K_TAN_OBD_T_DELTA "Zeitfenster f???r Temperaturabweichung [A2L-ref]" VALUE 0x7D33E RL_VAL_UW 0 CM_0023 0 6553.5 /end CHARACTERISTIC
/begin CHARACTERISTIC K_TAN_OBD_V_T_MIN "Zeitfenster f???r Mindestgeschwindigkeit [EST]" VALUE 0x7D340 RL_VAL_UW 0 CM_0023 0 6553.5 /end CHARACTERISTIC
/begin CHARACTERISTIC K_TIME_REL_OBD_CFG "0 Diag. aus 1 Diag. aktiv ELSE undef Konfiguration Relativzeitdiagn o- se [A2L-ref]" VALUE 0x7D4D0 RL_VAL_UB 0 CM_0000 0 255 /end CHARACTERISTIC
/begin CHARACTERISTIC K_TIME_REL_OBD_MAX_FEHLER "Fehlerschwelle [A2L-ref]" VALUE 0x7D4D1 RL_VAL_UB 0 CM_0000 0 255 /end CHARACTERISTIC
/begin CHARACTERISTIC K_TIME_REL_OBD_TMOT_ABSTELL "Minimale Abstelltemp. d. Motors fuer Diagnose [A2L-ref]" VALUE 0x7D4DC RL_VAL_SW 0 CM_0006 -3550 3003.5 /end CHARACTERISTIC
/begin CHARACTERISTIC K_TIME_REL_OBD_TMOT_DELTA_MIN "tmot-Mindestabkuehlung bei MS [A2L-ref]" VALUE 0x7D4E6 RL_VAL_SW 0 CM_0024 -3276.8 3276.7 /end CHARACTERISTIC
/begin CHARACTERISTIC K_TIME_REL_OBD_TMOT_START_FAST "minimales tmot fuer Standzeitd i-agnose FAST [A2L-ref]" VALUE 0x7D4E0 RL_VAL_SW 0 CM_0006 -3550 3003.5 /end CHARACTERISTIC
/begin CHARACTERISTIC K_TIME_REL_OBD_TMOT_START_SLOW "minimales tmot fuer Standzeitd i-agnose SLOW [A2L-ref]" VALUE 0x7D4DE RL_VAL_SW 0 CM_0006 -3550 3003.5 /end CHARACTERISTIC
/begin CHARACTERISTIC K_TIME_REL_OBD_T_MAX "Maximaler Fortschritt time_rel im lfd. Betrieb [A2L-ref]" VALUE 0x7D4D2 RL_VAL_UW 0 CM_0027 0 65535 /end CHARACTERISTIC
/begin CHARACTERISTIC K_TIME_REL_OBD_T_MIN "Minimaler Fortschritt time_rel im lfd. Betrieb [A2L-ref]" VALUE 0x7D4D4 RL_VAL_UW 0 CM_0027 0 65535 /end CHARACTERISTIC
/begin CHARACTERISTIC K_TIME_REL_OBD_T_ML "Min. Laufzeit Motor fuer Diagn o-se [A2L-ref]" VALUE 0x7D4D8 RL_VAL_UL 0 CM_0025 0 42949672.95 /end CHARACTERISTIC
/begin CHARACTERISTIC K_TIME_REL_OBD_UB_MIN "Schwelle U-Batt. Diagnose [A2L-ref]" VALUE 0x7D4E2 RL_VAL_SW 0 CM_0021 -3276.8 3276.7 /end CHARACTERISTIC
/begin CHARACTERISTIC K_TIME_REL_OBD_ZERO_CNT_MAX "time_rel-Reset-Zaehler Maxwert [A2L-ref]" VALUE 0x7D4E4 RL_VAL_UB 0 CM_0000 0 255 /end CHARACTERISTIC
/begin CHARACTERISTIC K_TMOT_DIAG_TAN "TAN-Schwelle zur Plausibilitaetsu e-berpruefung [A2L-ref]" VALUE 0x7D584 RL_VAL_SW 0 CM_0006 -3550 3003.5 /end CHARACTERISTIC
/begin CHARACTERISTIC K_TMOT_DIAG_TKA "TKA-Schwelle zur Plausibilitaetsueberpruefung [A2L-ref]" VALUE 0x7D586 RL_VAL_SW 0 CM_0006 -3550 3003.5 /end CHARACTERISTIC
/begin CHARACTERISTIC K_TMOT_ERR_MAX_E2 "max. Fehler fuer Vergleich [A2L-ref]" VALUE 0x7EE4C RL_VAL_UB 0 CM_0000 0 255 /end CHARACTERISTIC
/begin CHARACTERISTIC K_TMOT_MAX_E2 "max. Kuehlmitteltemperatur [A2L-ref]" VALUE 0x7EE50 RL_VAL_SW 0 CM_0006 -3550 3003.5 /end CHARACTERISTIC
/begin CHARACTERISTIC K_TMOT_MAX_NEG_GRAD_E2 "Neg. Gradientenschwelle Ebene2 [A2L-ref]" VALUE 0x7EE52 RL_VAL_SW 0 CM_0111 -32768 32767 /end CHARACTERISTIC
/begin CHARACTERISTIC K_TMOT_MAX_POS_GRAD_E2 "Pos. Gradientenschwelle Ebene2 [A2L-ref]" VALUE 0x7EE54 RL_VAL_SW 0 CM_0111 -32768 32767 /end CHARACTERISTIC
/begin CHARACTERISTIC K_TMOT_MIN_E2 "min. Kuehlmitteltemperatur [A2L-ref]" VALUE 0x7EE4E RL_VAL_SW 0 CM_0006 -3550 3003.5 /end CHARACTERISTIC
/begin CHARACTERISTIC K_TMOT_OBD_BLOCKHEATER_DIFF "Erkennung eines Blockheaters [A2L-ref]" VALUE 0x7D5AE RL_VAL_SW 0 CM_0024 -3276.8 3276.7 /end CHARACTERISTIC
/begin CHARACTERISTIC K_TMOT_OBD_CFG "Einschalten der Diagnose [A2L-ref]" VALUE 0x7D5B4 RL_VAL_UB 0 CM_0000 0 255 /end CHARACTERISTIC
/begin CHARACTERISTIC K_TMOT_OBD_DIFF_MAX "Maximale zulaessige Differenz Messwert-Modell [A2L-ref]" VALUE 0x7D5B0 RL_VAL_SW 0 CM_0024 -3276.8 3276.7 /end CHARACTERISTIC
/begin CHARACTERISTIC K_TMOT_OBD_HIGH_TIME "Standzeit fuer high-Diagnose [A2L-ref]" VALUE 0x7D5CE RL_VAL_UW 0 CM_0380 0 1092.25 /end CHARACTERISTIC
/begin CHARACTERISTIC K_TOEL_ERR_MAX_E2 "Max.Fehler f?r Vergleich [A2L-ref]" VALUE 0x7EE56 RL_VAL_UB 0 CM_0000 0 255 /end CHARACTERISTIC
/begin CHARACTERISTIC K_TUMG_OBD_T_POWER_ON "Wartezeit nach Power On [A2L-ref]" VALUE 0x7DBBC RL_VAL_UW 0 CM_0025 0 655.35 /end CHARACTERISTIC
/begin CHARACTERISTIC K_ZOELP_DIAG_KABELBRUCH "Pumpenstromschwelle fuer Kabelbruch (Openload) [A2L-ref]" VALUE 0x7E718 RL_VAL_UB 0 CM_0253 0 25.5 /end CHARACTERISTIC
/begin CHARACTERISTIC K_ZOELP_DIAG_KLEMMEN "Pumpenstromschwelle fuer Klemmen [A2L-ref]" VALUE 0x7E717 RL_VAL_UB 0 CM_0253 0 25.5 /end CHARACTERISTIC
/begin CHARACTERISTIC K_ZOELP_DIAG_KURZSCHLUSS "Pumpenstromschwelle fuer Kurzschluss [A2L-ref]" VALUE 0x7E716 RL_VAL_UB 0 CM_0253 0 25.5 /end CHARACTERISTIC
/begin CHARACTERISTIC K_PWG_A0_MIN_E2 "Unter Adaptionschwelle Ebene 2 [verified]" VALUE 0x7EC9E RL_VAL_SW 0 CM_0031 -160 159.9951172 /end CHARACTERISTIC
/begin CHARACTERISTIC K_SMG_MOT_NL_T_MAX_E2 "max. TZ-Nachlaufzeit Ebene 2 [EST]" VALUE 0x7EE46 RL_VAL_UW 0 CM_0020 0 327.675 /end CHARACTERISTIC
/begin CHARACTERISTIC K_SMG_NGETR_MAX_E2 "max. Getriebedrehzahl Ebene 2 [EST]" VALUE 0x7EE48 RL_VAL_SW 0 CM_0002 -32768 32767 /end CHARACTERISTIC
/begin CHARACTERISTIC K_TAN_DIAG_MAX "Obere Grenze Ansauglufttemperatur [verified]" VALUE 0x7D32A RL_VAL_SW 0 CM_0107 -1092.35 546.025 /end CHARACTERISTIC
/begin CHARACTERISTIC K_TAN_DIAG_MIN "Unter Grenze Ansauglufttemperatur [verified]" VALUE 0x7D328 RL_VAL_SW 0 CM_0107 -1092.35 546.025 /end CHARACTERISTIC
/begin CHARACTERISTIC K_TMOT_OBD_T_SA_MAX "Maximale Zeit im Schub [EST]" VALUE 0x7D5B6 RL_VAL_UW 0 CM_0025 0 655.35 /end CHARACTERISTIC
/begin CHARACTERISTIC K_TUMG_OBD_TIME_MS_MIN "min. Motorstandzeit fuer Kaltstarte r-kennung [EST]" VALUE 0x7DBC0 RL_VAL_UW 0 CM_0380 0 1092.25 /end CHARACTERISTIC
/begin CHARACTERISTIC K_ZOELP_DIAG_TIME_WAIT "Wartezeit der Diagnose nach Pumpe an [EST]" VALUE 0x7E710 RL_VAL_UB 0 CM_0023 0 25.5 /end CHARACTERISTIC
/begin CHARACTERISTIC K_DKG_NREG_DIAG_DN_OFFS "n-Schwelle fuer Dynamisierung [verified]" VALUE 0x70A8C RL_VAL_SW 0 CM_0067 -32768 32767 /end CHARACTERISTIC
/begin CHARACTERISTIC K_DKG_NREG_DIAG_T "n-Schwelle fuer Dynamisierung [verified]" VALUE 0x70A8E RL_VAL_UB 0 CM_0270 0 1.275 /end CHARACTERISTIC
/begin CHARACTERISTIC K_SPA_TEST "0 Normalbetrieb 1 Testbetrieb SPA Testschalter [verified]" VALUE 0x7CD16 RL_VAL_UB 0 CM_0000 0 255 /end CHARACTERISTIC
/begin CHARACTERISTIC K_SPA_SK_GANG_AUS "SK Ganganzeige bei ausgeschalteter Schaltpunktanzeige [EST]" VALUE 0x7CD72 RL_VAL_UB 0 CM_0000 0 255 /end CHARACTERISTIC
/begin CHARACTERISTIC K_SPA_SK_ART_HOCH "SK Ausgabegroesse fuer Hochschaltung [EST]" VALUE 0x7CD73 RL_VAL_UB 0 CM_0000 0 255 /end CHARACTERISTIC
/begin CHARACTERISTIC K_SPA_SK_GANG_MAX "SK Ganganzeige groesstmoeglicher Wert [verified]" VALUE 0x7CD74 RL_VAL_UB 0 CM_0000 0 255 /end CHARACTERISTIC
/begin CHARACTERISTIC K_SPA_SK_ART_MAX "SK Ausgabegroesse groesstmoeglicher Wert [verified]" VALUE 0x7CD75 RL_VAL_UB 0 CM_0000 0 255 /end CHARACTERISTIC
/begin CHARACTERISTIC K_SPA_SK_ERROR_CNT_INC "SK Fehlerincrement, um Anzeige auszuschalten [EST]" VALUE 0x7CD76 RL_VAL_SB 0 CM_0000 -128 127 /end CHARACTERISTIC
/begin CHARACTERISTIC K_SPA_SK_ERROR_CNT_DEC "SK Fehlerincrement, um Anzeige auszuschalten [EST]" VALUE 0x7CD77 RL_VAL_SB 0 CM_0000 -128 127 /end CHARACTERISTIC
/begin CHARACTERISTIC K_SPA_SK_ERROR_CNT_MAX "SK Fehlerschwelle, um Anzeige auszuschalten [verified]" VALUE 0x7CD78 RL_VAL_SB 0 CM_0000 -128 127 /end CHARACTERISTIC
/begin CHARACTERISTIC K_SMG_NGETR_DIFF_E2 "Unidentified constant read directly by IGN 0x11b18c (chapter unknown) [A2L-ref]" VALUE 0x7EE4A RL_VAL_SW 0 CM_0000 -32768 32767 /end CHARACTERISTIC
/begin CHARACTERISTIC K_MD_SK_N_DIFF_MAX "Aktivierungsschwelle [verified]" VALUE 0x790AC RL_VAL_SW 0 CM_0002 -32768 32767 /end CHARACTERISTIC
/begin CHARACTERISTIC K_LLR_N_SOLL_ABSE_KAT_OBD_WERT_MIN "KatObdWert-Schwelle fuer Absenkung [verified]" VALUE 0x76286 RL_VAL_UW 0 CM_0259 0 3.999938965 /end CHARACTERISTIC
/begin CHARACTERISTIC K_LLR_DIAG_MD_ERR_ABR "Absteuerrampe Fehlerfall [verified]" VALUE 0x76254 RL_VAL_UW 0 CM_0440 0 13107 /end CHARACTERISTIC
/begin CHARACTERISTIC K_KA_DIAG_T "Maximalzeit der Diagnose Bereichsueberwachung. [verified]" VALUE 0x738D8 RL_VAL_UW 0 CM_0301 0 6553.5 /end CHARACTERISTIC
/begin CHARACTERISTIC K_TUMG_OBD_TIME_ML_MIN "min. Motorlaufzeit fuer stabile B e-dingungen [verified]" VALUE 0x7DBBE RL_VAL_UW 0 CM_0027 0 65535 /end CHARACTERISTIC
/begin CHARACTERISTIC K_TUMG_OBD_TMOT_START_MAX "max. Motortemperatur bei Start der Kaltstarterkennung [verified]" VALUE 0x7DBC2 RL_VAL_SW 0 CM_0256 -3550 3003.5 /end CHARACTERISTIC
/begin CHARACTERISTIC K_TUMG_OBD_TMOT_TAN_DELTA_MAX "max. Differenz zwischen tmot und tan fuer Kaltstart [verified]" VALUE 0x7DBC4 RL_VAL_SW 0 CM_0323 -3276.8 3276.7 /end CHARACTERISTIC
/begin CHARACTERISTIC K_TUMG_OBD_T_BEGR_MAX "Hoechsttemperatur fuer Kaltstarte r-kennung [verified]" VALUE 0x7DBC8 RL_VAL_SW 0 CM_0256 -3550 3003.5 /end CHARACTERISTIC
/begin CHARACTERISTIC K_TUMG_OBD_T_BEGR_MIN "Mindesttemperatur fuer Kaltstarte r-kennung [verified]" VALUE 0x7DBCA RL_VAL_SW 0 CM_0256 -3550 3003.5 /end CHARACTERISTIC
/begin CHARACTERISTIC K_TUMG_OBD_TMOT_KALT_MAX "max. Motortemperatur fuer Kaltsta r-terkennung [verified]" VALUE 0x7DBCC RL_VAL_SW 0 CM_0256 -3550 3003.5 /end CHARACTERISTIC
/begin CHARACTERISTIC K_TUMG_OBD_MODEL_DELTA_MIN "min. Toleranz zwischen tumg und Modelltemperatur [verified]" VALUE 0x7DBCE RL_VAL_SW 0 CM_0323 -3276.8 3276.7 /end CHARACTERISTIC
/begin CHARACTERISTIC K_TUMG_OBD_MODEL_DELTA_MAX "max. Toleranz zwischen tumg und Modelltemperatur [verified]" VALUE 0x7DBD0 RL_VAL_SW 0 CM_0323 -3276.8 3276.7 /end CHARACTERISTIC
/begin CHARACTERISTIC K_TUMG_OBD_KS_ML_MIN "Mindest-ml-Durchsatz fuer KS -Erkennung [verified]" VALUE 0x7DBD2 RL_VAL_SW 0 CM_0255 -3276.8 3276.7 /end CHARACTERISTIC
/begin CHARACTERISTIC K_TUMG_OBD_KS_MW_MIN "Mindestkaltstartluftmassendurchsatz fuer KS-Erkennung [verified]" VALUE 0x7DBD4 RL_VAL_SW 0 CM_0255 -3276.8 3276.7 /end CHARACTERISTIC
/begin CHARACTERISTIC K_TUMG_OBD_CFG "0x00 OBD aus 0x01 OBD kont i- nuierlich 0x02 OBD ei n- malig Schalter Diagnose-Art [verified]" VALUE 0x7DBD6 RL_VAL_UB 0 CM_0000 0 255 /end CHARACTERISTIC
/begin CHARACTERISTIC K_TUMG_OBD_TOEL_WICHT "toel_roh_obd-Wichtung fuer B e-rechnung tumg_obd_start_mw [verified]" VALUE 0x7DBD7 RL_VAL_UB 0 CM_0447 0 31.875 /end CHARACTERISTIC
/begin CHARACTERISTIC K_TUMG_OBD_TMOT_WICHT "tmot-Wichtung fuer Berechnung tumg_obd_start_mw [verified]" VALUE 0x7DBD8 RL_VAL_UB 0 CM_0447 0 31.875 /end CHARACTERISTIC
/begin CHARACTERISTIC K_TUMG_OBD_ERROR_T "Zaehler fuer ok-Entprellung Umgebungstemperatur- sensor/Plausibilit?t ?l- temperatursensor (QLT)/ Se [verified]" VALUE 0x7DBD9 RL_VAL_UB 0 CM_0000 0 255 /end CHARACTERISTIC
/begin CHARACTERISTIC K_TUMG_OBD_KS_ML_MW_TAU "Tau fuer pt1 -Filterung von tumg_obd_ks_ml_mw [verified]" VALUE 0x7DBDA RL_VAL_UW 0 CM_0324 0.1 6553.5 /end CHARACTERISTIC
/begin CHARACTERISTIC K_FGR_HOCHLAUF_DIAG "0x0 Aus 0x1 Ein FGR Abwurf wegen Hochlauf Fehler 0: Aus, 1: Ein [EST]" VALUE 0x724DD RL_VAL_UB 0 CM_0000 0 255 /end CHARACTERISTIC
/begin CHARACTERISTIC K_FGR_KUPPLUNGS_DIAG "0x0 Aus 0x1 Ein FGR Abwurf wegen Kupplungs Fehler 0: Aus, 1: Ein [EST]" VALUE 0x724DE RL_VAL_UB 0 CM_0000 0 255 /end CHARACTERISTIC
/begin CHARACTERISTIC K_TABG_KAT_OBD_GRAD_TAU "Filterkonstante fuer die Ka t-temperatur [verified]" VALUE 0x7D123 RL_VAL_UB 0 CM_0306 0.1003921569 25.6 /end CHARACTERISTIC
/begin CHARACTERISTIC K_TABG_KAT_OBD_GRAD_MAX "Max. Gradient ueber 100ms [verified]" VALUE 0x7D124 RL_VAL_SW 0 CM_0448 -1638.4 1638.35 /end CHARACTERISTIC
/begin CHARACTERISTIC K_EGAS_FT_ERR_SCHW "min. Schwelle fuer FT-Fehler [verified]" VALUE 0x71851 RL_VAL_UB 0 CM_0276 0 25.5 /end CHARACTERISTIC
/begin CHARACTERISTIC KL_SPA_SK_GANG_MIN_N "kleinstmoeglicher Gang wegen Drehzahlband [EST]" CURVE 0x7D008 RL_CUR_SW_SB 0 CM_0015 -128 127 /begin AXIS_DESCR STD_AXIS NO_INPUT_QUANTITY CM_0260 6 -2048 2047.9375 /end AXIS_DESCR /end CHARACTERISTIC
/begin CHARACTERISTIC KL_SPA_SK_GANG_MIN_NORM "kleinstmoeglicher Gang fuer Rueckschaltung [EST]" CURVE 0x7D01C RL_CUR_SW_SB 0 CM_0015 -128 127 /begin AXIS_DESCR STD_AXIS NO_INPUT_QUANTITY CM_0260 6 -2048 2047.9375 /end AXIS_DESCR /end CHARACTERISTIC
/begin CHARACTERISTIC K_LLR_DIAG_T "Diagnosezeit [verified]" VALUE 0x76256 RL_VAL_UW 0 CM_0301 0 6553.5 /end CHARACTERISTIC
/begin CHARACTERISTIC K_LLR_DIAG_N_INT_SCHW "Schwelle f?r Integralbildung [verified]" VALUE 0x7625C RL_VAL_SW 0 CM_0002 -32768 32767 /end CHARACTERISTIC
/begin CHARACTERISTIC K_LLR_DIAG_CSS_N_INT_SCHW "Schwelle f?r Integralbildung [verified]" VALUE 0x76268 RL_VAL_SW 0 CM_0002 -32768 32767 /end CHARACTERISTIC
/begin CHARACTERISTIC K_LLR_DIAG_CSS_T "Diagnosezeit [verified]" VALUE 0x7626A RL_VAL_UW 0 CM_0301 0 6553.5 /end CHARACTERISTIC
/begin CHARACTERISTIC KL_LLR_DIAG_RF_PSAU_SCHW "RfPsau-Diagnoseschwelle [verified]" CURVE 0x76424 RL_CUR_SW_SW 0 CM_0282 -3.2768 3.2767 /begin AXIS_DESCR STD_AXIS NO_INPUT_QUANTITY CM_0002 4 -32768 32767 /end AXIS_DESCR /end CHARACTERISTIC
/begin CHARACTERISTIC KL_LLR_DIAG_RF_PSAU_SCHW_CSS "RfPsau-Diagnoseschwelle Coldstart-Strategy [verified]" CURVE 0x76436 RL_CUR_SW_SW 0 CM_0282 -3.2768 3.2767 /begin AXIS_DESCR STD_AXIS NO_INPUT_QUANTITY CM_0002 4 -32768 32767 /end AXIS_DESCR /end CHARACTERISTIC
/begin CHARACTERISTIC KF_MD_IND_REIB_E2 "Reibmoment Ebene2 [verified]" MAP 0x7E942 RL_MAP_SW_SW_SW 0 CM_0322 -3276.8 3276.7 /begin AXIS_DESCR STD_AXIS NO_INPUT_QUANTITY CM_0006 4 -3550 3003.5 /end AXIS_DESCR /begin AXIS_DESCR STD_AXIS NO_INPUT_QUANTITY CM_0006 4 -3550 3003.5 /end AXIS_DESCR /end CHARACTERISTIC
/begin CHARACTERISTIC K_FRA_OUT_FPLAU_OBD_MAX "Anschlag fuer Fuellungsplausianschlag [verified]" VALUE 0x7320E RL_VAL_UW 0 CM_0307 0 1.999969482 /end CHARACTERISTIC
/begin CHARACTERISTIC K_FRA_OUT_FPLAU_OBD_MIN "Anschlag fuer Fuellungsplausianschlag [verified]" VALUE 0x73210 RL_VAL_UW 0 CM_0307 0 1.999969482 /end CHARACTERISTIC
/begin COMPU_METHOD CM_0000 "X" RAT_FUNC "%.4g" "-" COEFFS 0 1 0 0 0 1 /end COMPU_METHOD
/begin COMPU_METHOD CM_0002 "X" RAT_FUNC "%.4g" "Upm" COEFFS 0 1 0 0 0 1 /end COMPU_METHOD
/begin COMPU_METHOD CM_0003 "X*0.0001" RAT_FUNC "%.4g" "-" COEFFS 0 1 0 0 0 0.0001 /end COMPU_METHOD
/begin COMPU_METHOD CM_0006 "X*0.1-273.2" RAT_FUNC "%.4g" "?C" COEFFS 0 1 273.2 0 0 0.1 /end COMPU_METHOD
/begin COMPU_METHOD CM_0007 "X*20.0" RAT_FUNC "%.4g" "Nm/s" COEFFS 0 1 0 0 0 20 /end COMPU_METHOD
/begin COMPU_METHOD CM_0008 "X*0.1" RAT_FUNC "%.4g" "?KW/Segm" COEFFS 0 1 0 0 0 0.1 /end COMPU_METHOD
/begin COMPU_METHOD CM_0009 "X*0.0039215686" RAT_FUNC "%.4g" "-" COEFFS 0 1 0 0 0 0.0039215686 /end COMPU_METHOD
/begin COMPU_METHOD CM_0010 "X*0.0625" RAT_FUNC "%.4g" "km/h" COEFFS 0 1 0 0 0 0.0625 /end COMPU_METHOD
/begin COMPU_METHOD CM_0012 "X*0.1" RAT_FUNC "%.4g" "qmm" COEFFS 0 1 0 0 0 0.1 /end COMPU_METHOD
/begin COMPU_METHOD CM_0013 "X*0.1" RAT_FUNC "%.4g" "%" COEFFS 0 1 0 0 0 0.1 /end COMPU_METHOD
/begin COMPU_METHOD CM_0015 "X" RAT_FUNC "%.4g" ".Gang" COEFFS 0 1 0 0 0 1 /end COMPU_METHOD
/begin COMPU_METHOD CM_0016 "X*0.0009765625" RAT_FUNC "%.4g" "-" COEFFS 0 1 0 0 0 0.0009765625 /end COMPU_METHOD
/begin COMPU_METHOD CM_0017 "X*0.1" RAT_FUNC "%.4g" "Nm" COEFFS 0 1 0 0 0 0.1 /end COMPU_METHOD
/begin COMPU_METHOD CM_0020 "X*0.005" RAT_FUNC "%.4g" "s" COEFFS 0 1 0 0 0 0.005 /end COMPU_METHOD
/begin COMPU_METHOD CM_0021 "X*0.1" RAT_FUNC "%.4g" "V" COEFFS 0 1 0 0 0 0.1 /end COMPU_METHOD
/begin COMPU_METHOD CM_0023 "X*0.1" RAT_FUNC "%.4g" "s" COEFFS 0 1 0 0 0 0.1 /end COMPU_METHOD
/begin COMPU_METHOD CM_0024 "X*0.1" RAT_FUNC "%.4g" "Kelvin" COEFFS 0 1 0 0 0 0.1 /end COMPU_METHOD
/begin COMPU_METHOD CM_0025 "X*0.01" RAT_FUNC "%.4g" "s" COEFFS 0 1 0 0 0 0.01 /end COMPU_METHOD
/begin COMPU_METHOD CM_0026 "X*0.78125" RAT_FUNC "%.4g" "%" COEFFS 0 1 0 0 0 0.78125 /end COMPU_METHOD
/begin COMPU_METHOD CM_0027 "X" RAT_FUNC "%.4g" "s" COEFFS 0 1 0 0 0 1 /end COMPU_METHOD
/begin COMPU_METHOD CM_0028 "X*0.1" RAT_FUNC "%.4g" "?KW" COEFFS 0 1 0 0 0 0.1 /end COMPU_METHOD
/begin COMPU_METHOD CM_0029 "X*0.005" RAT_FUNC "%.4g" "sec" COEFFS 0 1 0 0 0 0.005 /end COMPU_METHOD
/begin COMPU_METHOD CM_0031 "X*0.0048828125" RAT_FUNC "%.4g" "V" COEFFS 0 1 0 0 0 0.0048828125 /end COMPU_METHOD
/begin COMPU_METHOD CM_0032 "X*5.0" RAT_FUNC "%.4g" "ms" COEFFS 0 1 0 0 0 5 /end COMPU_METHOD
/begin COMPU_METHOD CM_0037 "X*0.0078125" RAT_FUNC "%.4g" "-" COEFFS 0 1 0 0 0 0.0078125 /end COMPU_METHOD
/begin COMPU_METHOD CM_0045 "X*0.0625" RAT_FUNC "%.4g" "mph" COEFFS 0 1 0 0 0 0.0625 /end COMPU_METHOD
/begin COMPU_METHOD CM_0050 "X*0.0030517578" RAT_FUNC "%.4g" "%" COEFFS 0 1 0 0 0 0.0030517578 /end COMPU_METHOD
/begin COMPU_METHOD CM_0054 "X*0.00080566" RAT_FUNC "%.4g" "V" COEFFS 0 1 0 0 0 0.00080566 /end COMPU_METHOD
/begin COMPU_METHOD CM_0057 "X" RAT_FUNC "%.4g" "V" COEFFS 0 1 0 0 0 1 /end COMPU_METHOD
/begin COMPU_METHOD CM_0060 "X*0.0166666667" RAT_FUNC "%.4g" "min" COEFFS 0 1 0 0 0 0.0166666667 /end COMPU_METHOD
/begin COMPU_METHOD CM_0065 "1.28/X" RAT_FUNC "%.4g" "s" COEFFS 0 0 -1.28 0 -1 0 /end COMPU_METHOD
/begin COMPU_METHOD CM_0067 "X" RAT_FUNC "%.4g" "Upm/s" COEFFS 0 1 0 0 0 1 /end COMPU_METHOD
/begin COMPU_METHOD CM_0068 "X" RAT_FUNC "%.4g" "Nm/s" COEFFS 0 1 0 0 0 1 /end COMPU_METHOD
/begin COMPU_METHOD CM_0073 "X*0.1" RAT_FUNC "%.4g" "Nm/s" COEFFS 0 1 0 0 0 0.1 /end COMPU_METHOD
/begin COMPU_METHOD CM_0074 "X*0.01" RAT_FUNC "%.4g" "Nm" COEFFS 0 1 0 0 0 0.01 /end COMPU_METHOD
/begin COMPU_METHOD CM_0102 "X*0.1" RAT_FUNC "%.4g" "kg/h" COEFFS 0 1 0 0 0 0.1 /end COMPU_METHOD
/begin COMPU_METHOD CM_0107 "X*0.025-273.15" RAT_FUNC "%.4g" "?C" COEFFS 0 1 273.15 0 0 0.025 /end COMPU_METHOD
/begin COMPU_METHOD CM_0108 "X" RAT_FUNC "%.4g" "min" COEFFS 0 1 0 0 0 1 /end COMPU_METHOD
/begin COMPU_METHOD CM_0111 "X" RAT_FUNC "%.4g" "Kelvin/s" COEFFS 0 1 0 0 0 1 /end COMPU_METHOD
/begin COMPU_METHOD CM_0115 "X*0.0625" RAT_FUNC "%.4g" "km/h*10ms" COEFFS 0 1 0 0 0 0.0625 /end COMPU_METHOD
/begin COMPU_METHOD CM_0116 "X*0.00155892" RAT_FUNC "%.4g" "V" COEFFS 0 1 0 0 0 0.00155892 /end COMPU_METHOD
/begin COMPU_METHOD CM_0118 "X*0.0065104167" RAT_FUNC "%.4g" "V" COEFFS 0 1 0 0 0 0.0065104167 /end COMPU_METHOD
/begin COMPU_METHOD CM_0164 "X*0.00390625" RAT_FUNC "%.4g" "-" COEFFS 0 1 0 0 0 0.00390625 /end COMPU_METHOD
/begin COMPU_METHOD CM_0233 "X/60" RAT_FUNC "%.4g" "min" COEFFS 0 60 0 0 0 1 /end COMPU_METHOD
/begin COMPU_METHOD CM_0235 "X" RAT_FUNC "%.4g" "rpm" COEFFS 0 1 0 0 0 1 /end COMPU_METHOD
/begin COMPU_METHOD CM_0245 "X*32/32768" RAT_FUNC "%.4g" "-" COEFFS 0 1024 0 0 0 1 /end COMPU_METHOD
/begin COMPU_METHOD CM_0247 "X/100" RAT_FUNC "%.4g" "s" COEFFS 0 100 0 0 0 1 /end COMPU_METHOD
/begin COMPU_METHOD CM_0253 "X*0.1" RAT_FUNC "%.4g" "A" COEFFS 0 1 0 0 0 0.1 /end COMPU_METHOD
/begin COMPU_METHOD CM_0255 "X/10" RAT_FUNC "%.4g" "kg/h" COEFFS 0 10 0 0 0 1 /end COMPU_METHOD
/begin COMPU_METHOD CM_0256 "(X-2732)/10" RAT_FUNC "%.4g" "?C" COEFFS 0 10 2732 0 0 1 /end COMPU_METHOD
/begin COMPU_METHOD CM_0259 "X/16384" RAT_FUNC "%.4g" "-" COEFFS 0 16384 0 0 0 1 /end COMPU_METHOD
/begin COMPU_METHOD CM_0260 "X/16" RAT_FUNC "%.4g" "km/h" COEFFS 0 16 0 0 0 1 /end COMPU_METHOD
/begin COMPU_METHOD CM_0270 "X/200" RAT_FUNC "%.4g" "s" COEFFS 0 200 0 0 0 1 /end COMPU_METHOD
/begin COMPU_METHOD CM_0271 "X*100/32768" RAT_FUNC "%.4g" "%" COEFFS 0 8192 0 0 0 25 /end COMPU_METHOD
/begin COMPU_METHOD CM_0276 "X/10" RAT_FUNC "%.4g" "%" COEFFS 0 10 0 0 0 1 /end COMPU_METHOD
/begin COMPU_METHOD CM_0278 "X/10" RAT_FUNC "%.4g" "Upm*s" COEFFS 0 10 0 0 0 1 /end COMPU_METHOD
/begin COMPU_METHOD CM_0282 "X/10000" RAT_FUNC "%.4g" "-" COEFFS 0 10000 0 0 0 1 /end COMPU_METHOD
/begin COMPU_METHOD CM_0301 "X/10" RAT_FUNC "%.4g" "s" COEFFS 0 10 0 0 0 1 /end COMPU_METHOD
/begin COMPU_METHOD CM_0303 "X/40-273.15" RAT_FUNC "%.4g" "?C" COEFFS 0 40 10926 0 0 1 /end COMPU_METHOD
/begin COMPU_METHOD CM_0304 "X/40" RAT_FUNC "%.4g" "K/100ms" COEFFS 0 40 0 0 0 1 /end COMPU_METHOD
/begin COMPU_METHOD CM_0306 "25.6/X" RAT_FUNC "%.4g" "s" COEFFS 0 0 -25.6 0 -1 0 /end COMPU_METHOD
/begin COMPU_METHOD CM_0307 "X/32768" RAT_FUNC "%.4g" "-" COEFFS 0 32768 0 0 0 1 /end COMPU_METHOD
/begin COMPU_METHOD CM_0322 "X/10" RAT_FUNC "%.4g" "Nm" COEFFS 0 10 0 0 0 1 /end COMPU_METHOD
/begin COMPU_METHOD CM_0323 "X/10" RAT_FUNC "%.4g" "Kelvin" COEFFS 0 10 0 0 0 1 /end COMPU_METHOD
/begin COMPU_METHOD CM_0324 "6553.5/X" RAT_FUNC "%.4g" "s" COEFFS 0 0 -6553.5 0 -1 0 /end COMPU_METHOD
/begin COMPU_METHOD CM_0326 "X/100" RAT_FUNC "%.4g" "10E-4" COEFFS 0 100 0 0 0 1 /end COMPU_METHOD
/begin COMPU_METHOD CM_0334 "X/327.68" RAT_FUNC "%.4g" "1/s" COEFFS 0 1 0 0 0 0.003051757812 /end COMPU_METHOD
/begin COMPU_METHOD CM_0343 "X*0.89" RAT_FUNC "%.4g" "mA" COEFFS 0 1 0 0 0 0.89 /end COMPU_METHOD
/begin COMPU_METHOD CM_0344 "X" RAT_FUNC "%.4g" "mA/V*Tast" COEFFS 0 1 0 0 0 1 /end COMPU_METHOD
/begin COMPU_METHOD CM_0377 "X*0.006103515625" RAT_FUNC "%.4g" "%" COEFFS 0 1 0 0 0 0.006103515625 /end COMPU_METHOD
/begin COMPU_METHOD CM_0378 "X*0.003921568627" RAT_FUNC "%.4g" "-" COEFFS 0 1 0 0 0 0.003921568627 /end COMPU_METHOD
/begin COMPU_METHOD CM_0380 "X*0.01666666667" RAT_FUNC "%.4g" "min" COEFFS 0 1 0 0 0 0.01666666667 /end COMPU_METHOD
/begin COMPU_METHOD CM_0385 "X*0.01" RAT_FUNC "%.4g" "%/V" COEFFS 0 1 0 0 0 0.01 /end COMPU_METHOD
/begin COMPU_METHOD CM_0440 "X/5" RAT_FUNC "%.4g" "Nm/s" COEFFS 0 5 0 0 0 1 /end COMPU_METHOD
/begin COMPU_METHOD CM_0447 "X/8" RAT_FUNC "%.4g" "-" COEFFS 0 8 0 0 0 1 /end COMPU_METHOD
/begin COMPU_METHOD CM_0448 "X/20" RAT_FUNC "%.4g" "K/100ms" COEFFS 0 20 0 0 0 1 /end COMPU_METHOD
/begin RECORD_LAYOUT RL_CUR_SW_SB FNC_VALUES 4 SBYTE COLUMN_DIR DIRECT AXIS_PTS_X 3 SWORD INDEX_INCR DIRECT NO_AXIS_PTS_X 1 UBYTE RESERVED 2 BYTE /end RECORD_LAYOUT
/begin RECORD_LAYOUT RL_CUR_SW_SW FNC_VALUES 4 SWORD COLUMN_DIR DIRECT AXIS_PTS_X 3 SWORD INDEX_INCR DIRECT NO_AXIS_PTS_X 1 UBYTE RESERVED 2 BYTE /end RECORD_LAYOUT
/begin RECORD_LAYOUT RL_CUR_SW_UB FNC_VALUES 4 UBYTE COLUMN_DIR DIRECT AXIS_PTS_X 3 SWORD INDEX_INCR DIRECT NO_AXIS_PTS_X 1 UBYTE RESERVED 2 BYTE /end RECORD_LAYOUT
/begin RECORD_LAYOUT RL_CUR_SW_UW FNC_VALUES 4 UWORD COLUMN_DIR DIRECT AXIS_PTS_X 3 SWORD INDEX_INCR DIRECT NO_AXIS_PTS_X 1 UBYTE RESERVED 2 BYTE /end RECORD_LAYOUT
/begin RECORD_LAYOUT RL_CUR_UB_SW FNC_VALUES 4 SWORD COLUMN_DIR DIRECT AXIS_PTS_X 3 UBYTE INDEX_INCR DIRECT NO_AXIS_PTS_X 1 UBYTE RESERVED 2 BYTE /end RECORD_LAYOUT
/begin RECORD_LAYOUT RL_CUR_UB_UB FNC_VALUES 4 UBYTE COLUMN_DIR DIRECT AXIS_PTS_X 3 UBYTE INDEX_INCR DIRECT NO_AXIS_PTS_X 1 UBYTE RESERVED 2 BYTE /end RECORD_LAYOUT
/begin RECORD_LAYOUT RL_MAP_SW_SW_SW FNC_VALUES 5 SWORD COLUMN_DIR DIRECT AXIS_PTS_X 3 SWORD INDEX_INCR DIRECT AXIS_PTS_Y 4 SWORD INDEX_INCR DIRECT NO_AXIS_PTS_X 1 UBYTE NO_AXIS_PTS_Y 2 UBYTE /end RECORD_LAYOUT
/begin RECORD_LAYOUT RL_MAP_SW_SW_UW FNC_VALUES 5 UWORD COLUMN_DIR DIRECT AXIS_PTS_X 3 SWORD INDEX_INCR DIRECT AXIS_PTS_Y 4 SWORD INDEX_INCR DIRECT NO_AXIS_PTS_X 1 UBYTE NO_AXIS_PTS_Y 2 UBYTE /end RECORD_LAYOUT
/begin RECORD_LAYOUT RL_VAL_SB FNC_VALUES 1 SBYTE COLUMN_DIR DIRECT /end RECORD_LAYOUT
/begin RECORD_LAYOUT RL_VAL_SW FNC_VALUES 1 SWORD COLUMN_DIR DIRECT /end RECORD_LAYOUT
/begin RECORD_LAYOUT RL_VAL_UB FNC_VALUES 1 UBYTE COLUMN_DIR DIRECT /end RECORD_LAYOUT
/begin RECORD_LAYOUT RL_VAL_UL FNC_VALUES 1 ULONG COLUMN_DIR DIRECT /end RECORD_LAYOUT
/begin RECORD_LAYOUT RL_VAL_UW FNC_VALUES 1 UWORD COLUMN_DIR DIRECT /end RECORD_LAYOUT
/begin GROUP G_x_Diagnostics__OBD__level_2__safety_concept__tester_ "x Diagnostics (OBD, level 2, safety concept, tester)" ROOT
 /begin REF_CHARACTERISTIC KL_AUSS_OBD_POS_MD_DYN_KH KL_AUSS_OBD_TZ_GRAD KL_AUSS_OBD_WICHT_KAT K_DIAG_TR_UB_MIN__IGN_ KL_EGAS_EXD_VORST_DK_AUF KL_EGAS_EXD_VORST_DK_ZU KL_EGAS_SK_DK_DIFF_MAX KL_EGAS_SK_LLS_FS_OFFS KL_EGAS_SK_WDK_DIFF K_EGAS_CAN_ALIVE_ERR_MAX K_EGAS_DK_R_DIAG_CLR K_EGAS_DK_R_DIAG_CLR_MAX K_EGAS_DK_R_DIAG_FAIL K_EGAS_EXD_GS_SOLL K_EGAS_EXD_GS_T_MAX K_EGAS_EXD_KS_SOLL K_EGAS_EXD_KS_T_MAX K_EGAS_EXD_R1_SOLL K_EGAS_EXD_R1_SOLL_TV K_EGAS_EXD_R1_TIME K_EGAS_EXD_R2_SOLL K_EGAS_EXD_R2_TIME K_EGAS_EXD_R3_TIME K_EGAS_EXD_SW_SOLL K_EGAS_EXD_UB_MAX K_EGAS_EXD_UB_MIN K_EGAS_LLS_R_DIAG_CLR K_EGAS_LLS_R_DIAG_CLR_MAX K_EGAS_LLS_R_DIAG_FAIL K_EGAS_SK_CONTROL K_EGAS_SK_DK_OFFEN_1 K_EGAS_SK_DK_OFFEN_2 K_EGAS_SK_IST_DIFF_LLS K_EGAS_SK_NEUINIT_MAX K_EGAS_SK_SOLL_DIFF K_EGAS_SK_SOLL_DIFF_LLS K_EGAS_SK_TAU_DK K_EGAS_SK_TAU_LLS K_EGAS_SK_T_IST K_EGAS_SK_T_IST_LLS K_EGAS_SK_T_MODE K_EGAS_SK_T_MODE_INIT K_EGAS_SK_T_NP_MAX K_EGAS_SK_T_OFFEN K_EGAS_SK_T_SOLL K_EGAS_SK_T_SOLL_LLS K_EGAS_SK_T_WDK K_EGAS_STM_DK_SK_TST K_EGAS_STM_DK_SK_ZU KL_FGR_VAHA_DIAG K_FGR_VAHA_DIAG_T K_FGR_V_DIAG K_FGR_V_DIAG_T K_FGR_V_FEHLER_T K_VR_DIAG_MAX_OFFSET K_VR_TEST_DIAG K_VR_TEST_SEND_ENABLE K_VR_TEST_U_MESS K_VR_TEST_V_MESS KL_LLR_DIAG_N_INT_TMOT KL_LLR_N_SOLL_TMOT_E2 K_LLR_MD_MAX_E2 K_LLR_N_DIFF_MAX_E2 K_LLR_N_SOLL_NF_FAKTOR_E2 K_LLR_N_SOLL_NF_MAX_E2 KF_MD_SK_DIFF_MAX KL_MD_SK_GRAD_MAX KL_MD_SK_MD_BEGR KL_MD_SK_WDK KL_MD_SK_WDK_TI_OFFS K_MD_ETA_SK_MIN K_MD_SK_BEGR_RAMPE K_MD_SK_CFG K_MD_SK_ETA_MIN K_MD_SK_FWMAX K_MD_SK_IND_MAX K_MD_SK_LLR_MAX K_MD_SK_MAX_MDMIN K_MD_SK_NHYS K_MD_SK_N_MDMIN K_MD_SK_N_MIN K_MD_SK_PWGMIN K_MD_SK_RF_MAX K_MD_SK_TAU_PWG K_MD_SK_TAU_VERGL K_MD_SK_TIMER_0 K_MD_SK_TIMER_1 K_MD_SK_TIRED_HYS K_MD_SK_TIRED_MIN K_MD_SK_WDK_KH_OFFS K_PWG_BLS_T_BRP_FEHLER K_PWG_BLS_T_V_FEHLER K_PWG_SK_NULLAGE KL_SK_LLR_N_SOLL K_SK_CFG__IGN_ K_SK_CRC32__IGN_ K_SK_EGAS_OFF_TIME__IGN_ K_SK_FGR_SPERRE__IGN_ K_SK_FM_EGAS_TEST__IGN_ K_SK_FM_FAIL_ZYL_TEST__IGN_ K_SK_FM_GEMISCH_TEST__IGN_ K_SK_FM_LAM_TEST__IGN_ K_SK_FM_MD_TEST__IGN_ K_SK_FM_MVAC_TEST__IGN_ K_SK_FM_SMG_TEST__IGN_ K_SK_FRA_SPERRE__IGN_ K_SK_KH_SPERRE__IGN_ K_SK_LAM_EINGR_TI__IGN_ K_SK_LLRA_SPERRE__IGN_ K_SK_MAX_OS_ERR__IGN_ K_SK_MAX_RESETS__IGN_ K_SK_MD_BEGR_DK_OFFEN__IGN_ K_SK_MD_BEGR_MVAC_SYS__IGN_ K_SK_MD_BEGR_RESET__IGN_ K_SK_MD_TI_EINGR__IGN_ K_SK_MD_VL_SPERRE__IGN_ K_SK_PKS_NOTLAUF__IGN_ K_SK_PROZ_ERR__IGN_ K_SK_TASK_ERR__IGN_ K_SK_T_RESET_DELAY_OS__IGN_ K_SK_ZYL_OFF_MAX__IGN_ K_SK_E2_KOMP_ERR_MAX__IGN_ K_SK_MAX_RESETS_E2__IGN_ KL_SMG_SK_PROG_MAX K_SMG_ALIVE_ERR_MAX K_SMG_CAN_TESTMODE K_SMG_CHKSUM_ERR_MAX K_SMG_SK_CONTROL K_SMG_SK_MD_SCHW K_SMG_SK_M_KUPP_MIN K_SMG_SK_NBERCH_MAX K_SMG_SK_NBERCH_T K_SMG_SK_NGETR_MAX K_SMG_SK_NGETR_T K_SMG_SK_NMAX_FSP K_SMG_SK_NMAX_FSP_INAKTIV K_SMG_SK_NZIEL_MAX K_SMG_SK_NZIEL_T K_SMG_SK_T_DME_ST_MAX K_SMG_SK_T_MAX K_SMG_SK_T_NGETR_MAX K_SMG_SK_T_NZIEL_MAX K_SMG_SK_T_PHASE_MAX_AB K_SMG_SK_T_PHASE_MAX_AUF K_SMG_SK_T_PHASE_MAX_SCHA K_SMG_SK_T_PHASE_N_MAX K_SMG_SK_V_SCHW K_SMG_TESTMODE KL_TABG_DIAG_PLAUSI_ML_FAK K_TAN_OBD_N_DYN_MAX K_TAN_OBD_N_MAX K_TAN_OBD_N_MIN K_TAN_OBD_RF_DYN_MAX K_TAN_OBD_RF_MAX K_TAN_OBD_RF_MIN K_TAN_OBD_TMOT_MIN K_TDME_DIAG_MAX K_TDME_DIAG_MIN KF_TIME_REL_OBD_MAX_STANDZEIT KF_TIME_REL_OBD_MIN_STANDZEIT KF_TMOT_OBD_ML_GES_MW KL_TMOT_OBD_DELTA KL_TMOT_OBD_MODELL_DELTA K_TMOT_ELU_ERR_CC_HIGH_TMOT_1 K_TOEL_DELTA_E2 K_TOEL_MAX_E2 K_TOEL_MAX_NEG_GRAD_E2 K_TOEL_MAX_POS_GRAD_E2 K_TOEL_MIN_E2 KL_TUMG_OBD_V K_VDIAG_DN_OHNE_V K_VDIAG_GRAD_MAX K_VDIAG_OFFSET K_VDIAG_SA_OHNE_V K_VDIAG_VMAX K_V_MAX_E2 K_V_MAX_NEG_GRAD_E2 K_V_MAX_POS_GRAD_E2 K_V_MIN_E2 KF_MD_IND_LW_VERLUSTE_E2 KF_MD_IND_OPT_E2 KF_MD_IND_MIN_SCHUB_E2 KF_MD_KUPP_OFF_E2 KF_MD_SMG_BEGR_OFF_E2 KL_MD_IND_REIB_OFFSET_E2 KL_MD_RF_MAX_E2 K_UB_DIAG_GRAD_INT_MAX K_UB_DIAG_KL87_MAX_SPERRE K_UB_DIAG_MAX K_UB_DIAG_MIN K_UEXT_DIAG_MAX K_UEXT_DIAG_MIN K_UINTERN_FEHLER_ZAEHLER KF_MD_FAHRER_KOMFORT_E2 KF_MD_FAHRER_NORMAL_E2 KF_MD_FAHRER_SPORT_E2 KF_MD_FAHRER_MUEDE_E2 KF_MD_FAHRER_MUNTER_E2 KF_MD_ZW_OPT_E2 KF_MD_ZW_OPT_OFFS_KH_E2 KF_MD_IND_LW_OFFS_KH_E2 KL_EGAS_EXD_VORST_LLS_AUF KL_EGAS_EXD_VORST_LLS_ZU KL_EGAS_SK_LLS_FS K_EGAS_SK_LLS_N_SCHW K_EGAS_SK_LLS_DIAG_T K_EGAS_SK_LLS_CRTK K_EGAS_SK_LLS_DIAG K_EGAS_SK_LLS_DK_SCHW K_EGAS_SK_LLS_AQ_MVAC K_LLR_DIAG_TMOT K_LLR_DIAG_TOEL K_LLR_DIAG_TUMG K_LLR_DIAG_N_ZU_GROSS K_LLR_DIAG_N_ZU_KLEIN K_LLR_DIAG_TOGGLE_MAX K_LLR_DIAG_N_INT_MAX K_LLR_DIAG_CSS_TMOT K_LLR_DIAG_CSS_TOEL K_LLR_DIAG_CSS_TUMG K_LLR_DIAG_CSS_N_ZU_GROSS K_LLR_DIAG_CSS_N_ZU_KLEIN K_LLR_DIAG_CSS_TOGGLE_MAX K_LLR_DIAG_CSS_N_INT_MAX K_FGR_N_DIF_DIAG_T K_TMOT_DIAG_MIN K_TMOT_DIAG_MAX K_TMOT_DIAG_GRAD_MAX K_TMOT_DIAG_TIME K_TMOT_DIAG_GRAD_TAU K_EGAS_SK_FAIL_MAX K_EGAS_SK_T_RGPOS K_TOEL_OBD_CFG K_TOEL_OBD_TIME_ML_SINCE_START K_TOEL_OBD_TDELTA_MAX_TIME K_TOEL_OBD_TDELTA_MAX K_TOEL_OBD_ML_MW_SCHWELLE K_TOEL_OBD_LOCK_TIMER K_TOEL_OBD_TMOT_START K_TOEL_OBD_TIME_MS_MIN KL_TOEL_OBD_MODELL_DELTA KL_TOEL_OBD_QLT_DELTA KL_TOEL_OBD_TIME_DC K_MD_ZYL_ANZ_E2 K_MD_E2_FW_REL_SCHW K_MD_E2_IST_SCHW K_MD_E2_MAX_SCHW K_MD_E2_MIN_SCHW K_MD_E2_SCHLEPP_SCHW K_MD_E2_ERR_MAX K_MD_POLYNOM_A_E2 K_MD_POLYNOM_B_E2 K_MD_ETA_ZW_MIN_E2 K_MD_ETA_LA_E2 K_KR_DIAG_T K_LLR_ERR_MAX_E2 K_LLR_DMD_MAX_E2 K_LLR_MD_MIN_E2 K_FR_MIN_E2 K_FR_MAX_E2 K_FR_GRAD_NEG_E2 K_FR_GRAD_POS_E2 K_FRA_LOLI_OUT_MIN_E2 K_FRA_LOLI_OUT_MAX_E2 K_FRA_GRAD_NEG_E2 K_FRA_GRAD_POS_E2 K_SERVO_STROM_DIAG_KS_UB K_SERVO_STROM_DIAG_OL K_SERVO_STROM_DIAG_MIN_TAST K_SERVO_STROM_DIAG_MIN_OFFSET K_SERVO_STROM_DIAG_MAX_TAST K_SERVO_STROM_DIAG_MAX_OFFSET KL_MD_FAHRER_FAK_E2 K_AUSS_OBD_ABG_1 K_AUSS_OBD_ABG_4 K_AUSS_OBD_ABG_WORST_CYL K_AUSS_OBD_CFG K_AUSS_OBD_N_MAX K_AUSS_OBD_N_MIN K_AUSS_OBD_RATE_ABG_ZYL K_AUSS_OBD_SA_CNT K_AUSS_OBD_SA_T_MIN K_AUSS_OBD_SUM_KAT K_AUSS_OBD_T_IDLE K_AUSS_OBD_T_MIN_LAM K_AUSS_OBD_WICHT_NS K_AUSS_OBD_WICHT_SPARK K_DIAGNOSE_INDEX_HI K_DIAGNOSE_INDEX_LO K_FGR_T_FEHLER_E2 K_FGR_V_SOLL_MIN_KMH_E2 K_FGR_V_SOLL_MIN_MPH_E2 K_MD_E2_N_MIN K_MD_E2_TAU_SOLL K_MD_HYP_DN_E2 K_MD_HYP_VERH_E2 K_MD_IND_REIB_ABREG_E2 K_MD_LLR_AD_MAX_E2 K_MD_MSR_MAX_E2 K_MD_SK_TIRED_ZYL_10of11_ K_MD_SK_TIRED_ZYL_11of11_ K_MD_SK_TIRED_ZYL_1of11_ K_MD_SK_TIRED_ZYL_2of11_ K_MD_SK_TIRED_ZYL_3of11_ K_MD_SK_TIRED_ZYL_4of11_ K_MD_SK_TIRED_ZYL_5of11_ K_MD_SK_TIRED_ZYL_6of11_ K_MD_SK_TIRED_ZYL_7of11_ K_MD_SK_TIRED_ZYL_8of11_ K_MD_SK_TIRED_ZYL_9of11_ K_MD_SK_WDK_LLSFAIL_OFFS K_MD_START_OFF_E2 K_MD_TAU_START_OFF_E2 K_MD_VERBR_MAX_E2 K_N_E2_DELTA K_N_E2_T_MAX K_N_GETR_HS_DIAG_N K_N_GETR_HS_DIAG_N_KS K_N_GETR_HS_DIAG_T K_PKS_CAN_ALIVE_ERR_MAX K_PWG1_DIAG_MAX K_PWG1_DIAG_MIN K_PWG_DELTA_E2 K_PWG_ERR_MAX_E2 K_PWG_NORM_E2 K_PWG_NORM_HS_E2 K_PWG_SMG_ANFAHREN_FAK_E2 K_PWG_TAU_FEHLER K_SCHALTER_BLS_ENTPRELLUNG_E2 K_SK_EGAS_OFF_14of16_ K_SK_EGAS_OFF_15of16_ K_SK_EGAS_OFF_16of16_ K_SK_EGAS_OFF_1of16_ K_SK_EGAS_OFF_2of16_ K_SK_EGAS_OFF_3of16_ K_SK_EGAS_OFF_4of16_ K_SK_EGAS_OFF_5of16_ K_SK_EGAS_OFF_7of16_ K_SK_LAM_EINGR_10of32_ K_SK_LAM_EINGR_11of32_ K_SK_LAM_EINGR_12of32_ K_SK_LAM_EINGR_13of32_ K_SK_LAM_EINGR_14of32_ K_SK_LAM_EINGR_15of32_ K_SK_LAM_EINGR_16of32_ K_SK_LAM_EINGR_17of32_ K_SK_LAM_EINGR_18of32_ K_SK_LAM_EINGR_19of32_ K_SK_LAM_EINGR_1of32_ K_SK_LAM_EINGR_20of32_ K_SK_LAM_EINGR_21of32_ K_SK_LAM_EINGR_22of32_ K_SK_LAM_EINGR_23of32_ K_SK_LAM_EINGR_24of32_ K_SK_LAM_EINGR_25of32_ K_SK_LAM_EINGR_26of32_ K_SK_LAM_EINGR_27of32_ K_SK_LAM_EINGR_28of32_ K_SK_LAM_EINGR_29of32_ K_SK_LAM_EINGR_2of32_ K_SK_LAM_EINGR_30of32_ K_SK_LAM_EINGR_31of32_ K_SK_LAM_EINGR_32of32_ K_SK_LAM_EINGR_3of32_ K_SK_LAM_EINGR_4of32_ K_SK_LAM_EINGR_5of32_ K_SK_LAM_EINGR_6of32_ K_SK_LAM_EINGR_7of32_ K_SK_LAM_EINGR_8of32_ K_SK_LAM_EINGR_9of32_ K_SK_MD_BEGR_EGAS_10of64_ K_SK_MD_BEGR_EGAS_11of64_ K_SK_MD_BEGR_EGAS_12of64_ K_SK_MD_BEGR_EGAS_13of64_ K_SK_MD_BEGR_EGAS_14of64_ K_SK_MD_BEGR_EGAS_15of64_ K_SK_MD_BEGR_EGAS_16of64_ K_SK_MD_BEGR_EGAS_1of64_ K_SK_MD_BEGR_EGAS_25of64_ K_SK_MD_BEGR_EGAS_26of64_ K_SK_MD_BEGR_EGAS_27of64_ K_SK_MD_BEGR_EGAS_28of64_ K_SK_MD_BEGR_EGAS_2of64_ K_SK_MD_BEGR_EGAS_3of64_ K_SK_MD_BEGR_EGAS_41of64_ K_SK_MD_BEGR_EGAS_42of64_ K_SK_MD_BEGR_EGAS_43of64_ K_SK_MD_BEGR_EGAS_44of64_ K_SK_MD_BEGR_EGAS_4of64_ K_SK_MD_BEGR_EGAS_5of64_ K_SK_MD_BEGR_EGAS_64of64_ K_SK_MD_BEGR_EGAS_6of64_ K_SK_MD_BEGR_EGAS_7of64_ K_SK_MD_BEGR_EGAS_8of64_ K_SK_MD_BEGR_EGAS_9of64_ K_SK_MD_BEGR_GEMISCH_17of32_ K_SK_MD_BEGR_GEMISCH_18of32_ K_SK_MD_BEGR_GEMISCH_19of32_ K_SK_MD_BEGR_GEMISCH_1of32_ K_SK_MD_BEGR_GEMISCH_20of32_ K_SK_MD_BEGR_GEMISCH_21of32_ K_SK_MD_BEGR_GEMISCH_22of32_ K_SK_MD_BEGR_GEMISCH_23of32_ K_SK_MD_BEGR_GEMISCH_24of32_ K_SK_MD_BEGR_GEMISCH_25of32_ K_SK_MD_BEGR_GEMISCH_26of32_ K_SK_MD_BEGR_GEMISCH_27of32_ K_SK_MD_BEGR_GEMISCH_28of32_ K_SK_MD_BEGR_GEMISCH_29of32_ K_SK_MD_BEGR_GEMISCH_2of32_ K_SK_MD_BEGR_GEMISCH_30of32_ K_SK_MD_BEGR_GEMISCH_31of32_ K_SK_MD_BEGR_GEMISCH_32of32_ K_SK_MD_BEGR_GEMISCH_3of32_ K_SK_MD_BEGR_GEMISCH_4of32_ K_SK_MD_BEGR_MD_10of16_ K_SK_MD_BEGR_MD_11of16_ K_SK_MD_BEGR_MD_12of16_ K_SK_MD_BEGR_MD_13of16_ K_SK_MD_BEGR_MD_14of16_ K_SK_MD_BEGR_MD_15of16_ K_SK_MD_BEGR_MD_16of16_ K_SK_MD_BEGR_MD_1of16_ K_SK_MD_BEGR_MD_4of16_ K_SK_MD_BEGR_MD_5of16_ K_SK_MD_BEGR_MD_6of16_ K_SK_MD_BEGR_MD_7of16_ K_SK_MD_BEGR_MD_8of16_ K_SK_MD_BEGR_MD_9of16_ K_SK_MD_BEGR_MVAC_1of4_ K_SK_MD_BEGR_MVAC_2of4_ K_SK_MD_BEGR_MVAC_3of4_ K_SK_MD_BEGR_MVAC_4of4_ K_SK_MD_BEGR_PWG_1of6_ K_SK_MD_BEGR_PWG_2of6_ K_SK_MD_BEGR_PWG_3of6_ K_SK_MD_BEGR_PWG_4of6_ K_SK_MD_BEGR_PWG_5of6_ K_SK_MD_BEGR_PWG_6of6_ K_SK_MD_BEGR_SMG_10of16_ K_SK_MD_BEGR_SMG_11of16_ K_SK_MD_BEGR_SMG_12of16_ K_SK_MD_BEGR_SMG_13of16_ K_SK_MD_BEGR_SMG_14of16_ K_SK_MD_BEGR_SMG_15of16_ K_SK_MD_BEGR_SMG_16of16_ K_SK_MD_BEGR_SMG_1of16_ K_SK_MD_BEGR_SMG_2of16_ K_SK_MD_BEGR_SMG_3of16_ K_SK_MD_BEGR_SMG_4of16_ K_SK_MD_BEGR_SMG_5of16_ K_SK_MD_BEGR_SMG_6of16_ K_SK_MD_BEGR_SMG_7of16_ K_SK_MD_BEGR_SMG_8of16_ K_SK_MD_BEGR_SMG_9of16_ K_SK_MD_BEGR_TI_10of16_ K_SK_MD_BEGR_TI_11of16_ K_SK_MD_BEGR_TI_12of16_ K_SK_MD_BEGR_TI_13of16_ K_SK_MD_BEGR_TI_14of16_ K_SK_MD_BEGR_TI_15of16_ K_SK_MD_BEGR_TI_16of16_ K_SK_MD_BEGR_TI_2of16_ K_SK_MD_BEGR_TI_3of16_ K_SK_MD_BEGR_TI_4of16_ K_SK_MD_BEGR_TI_5of16_ K_SK_MD_BEGR_TI_6of16_ K_SK_MD_BEGR_TI_7of16_ K_SK_MD_BEGR_TI_8of16_ K_SK_MD_BEGR_TI_9of16_ K_SK_MVAC_KH_1of4_ K_SK_MVAC_KH_2of4_ K_SK_MVAC_KH_3of4_ K_SK_MVAC_KH_4of4_ K_SK_TI_OFF_EGAS_10of64_ K_SK_TI_OFF_EGAS_11of64_ K_SK_TI_OFF_EGAS_12of64_ K_SK_TI_OFF_EGAS_13of64_ K_SK_TI_OFF_EGAS_14of64_ K_SK_TI_OFF_EGAS_15of64_ K_SK_TI_OFF_EGAS_16of64_ K_SK_TI_OFF_EGAS_17of64_ K_SK_TI_OFF_EGAS_18of64_ K_SK_TI_OFF_EGAS_19of64_ K_SK_TI_OFF_EGAS_1of64_ K_SK_TI_OFF_EGAS_20of64_ K_SK_TI_OFF_EGAS_21of64_ K_SK_TI_OFF_EGAS_22of64_ K_SK_TI_OFF_EGAS_23of64_ K_SK_TI_OFF_EGAS_24of64_ K_SK_TI_OFF_EGAS_25of64_ K_SK_TI_OFF_EGAS_26of64_ K_SK_TI_OFF_EGAS_27of64_ K_SK_TI_OFF_EGAS_28of64_ K_SK_TI_OFF_EGAS_29of64_ K_SK_TI_OFF_EGAS_2of64_ K_SK_TI_OFF_EGAS_30of64_ K_SK_TI_OFF_EGAS_31of64_ K_SK_TI_OFF_EGAS_32of64_ K_SK_TI_OFF_EGAS_33of64_ K_SK_TI_OFF_EGAS_34of64_ K_SK_TI_OFF_EGAS_35of64_ K_SK_TI_OFF_EGAS_36of64_ K_SK_TI_OFF_EGAS_37of64_ K_SK_TI_OFF_EGAS_38of64_ K_SK_TI_OFF_EGAS_39of64_ K_SK_TI_OFF_EGAS_3of64_ K_SK_TI_OFF_EGAS_40of64_ K_SK_TI_OFF_EGAS_41of64_ K_SK_TI_OFF_EGAS_42of64_ K_SK_TI_OFF_EGAS_43of64_ K_SK_TI_OFF_EGAS_44of64_ K_SK_TI_OFF_EGAS_45of64_ K_SK_TI_OFF_EGAS_46of64_ K_SK_TI_OFF_EGAS_47of64_ K_SK_TI_OFF_EGAS_48of64_ K_SK_TI_OFF_EGAS_49of64_ K_SK_TI_OFF_EGAS_4of64_ K_SK_TI_OFF_EGAS_50of64_ K_SK_TI_OFF_EGAS_51of64_ K_SK_TI_OFF_EGAS_52of64_ K_SK_TI_OFF_EGAS_53of64_ K_SK_TI_OFF_EGAS_54of64_ K_SK_TI_OFF_EGAS_55of64_ K_SK_TI_OFF_EGAS_56of64_ K_SK_TI_OFF_EGAS_57of64_ K_SK_TI_OFF_EGAS_58of64_ K_SK_TI_OFF_EGAS_59of64_ K_SK_TI_OFF_EGAS_5of64_ K_SK_TI_OFF_EGAS_60of64_ K_SK_TI_OFF_EGAS_61of64_ K_SK_TI_OFF_EGAS_62of64_ K_SK_TI_OFF_EGAS_63of64_ K_SK_TI_OFF_EGAS_64of64_ K_SK_TI_OFF_EGAS_6of64_ K_SK_TI_OFF_EGAS_7of64_ K_SK_TI_OFF_EGAS_8of64_ K_SK_TI_OFF_EGAS_9of64_ K_SMG_E2_ST_ERR_MAX K_TAN_OBD_CFG K_TAN_OBD_DELTA_MAX K_TAN_OBD_N_DYN_TAU K_TAN_OBD_T_DELTA K_TAN_OBD_V_T_MIN K_TIME_REL_OBD_CFG K_TIME_REL_OBD_MAX_FEHLER K_TIME_REL_OBD_TMOT_ABSTELL K_TIME_REL_OBD_TMOT_DELTA_MIN K_TIME_REL_OBD_TMOT_START_FAST K_TIME_REL_OBD_TMOT_START_SLOW K_TIME_REL_OBD_T_MAX K_TIME_REL_OBD_T_MIN K_TIME_REL_OBD_T_ML K_TIME_REL_OBD_UB_MIN K_TIME_REL_OBD_ZERO_CNT_MAX K_TMOT_DIAG_TAN K_TMOT_DIAG_TKA K_TMOT_ERR_MAX_E2 K_TMOT_MAX_E2 K_TMOT_MAX_NEG_GRAD_E2 K_TMOT_MAX_POS_GRAD_E2 K_TMOT_MIN_E2 K_TMOT_OBD_BLOCKHEATER_DIFF K_TMOT_OBD_CFG K_TMOT_OBD_DIFF_MAX K_TMOT_OBD_HIGH_TIME K_TOEL_ERR_MAX_E2 K_TUMG_OBD_T_POWER_ON K_ZOELP_DIAG_KABELBRUCH K_ZOELP_DIAG_KLEMMEN K_ZOELP_DIAG_KURZSCHLUSS K_PWG_A0_MIN_E2 K_SMG_MOT_NL_T_MAX_E2 K_SMG_NGETR_MAX_E2 K_TAN_DIAG_MAX K_TAN_DIAG_MIN K_TMOT_OBD_T_SA_MAX K_TUMG_OBD_TIME_MS_MIN K_ZOELP_DIAG_TIME_WAIT K_DKG_NREG_DIAG_DN_OFFS K_DKG_NREG_DIAG_T K_SPA_TEST K_SPA_SK_GANG_AUS K_SPA_SK_ART_HOCH K_SPA_SK_GANG_MAX K_SPA_SK_ART_MAX K_SPA_SK_ERROR_CNT_INC K_SPA_SK_ERROR_CNT_DEC K_SPA_SK_ERROR_CNT_MAX K_SMG_NGETR_DIFF_E2 K_MD_SK_N_DIFF_MAX K_LLR_N_SOLL_ABSE_KAT_OBD_WERT_MIN K_LLR_DIAG_MD_ERR_ABR K_KA_DIAG_T K_TUMG_OBD_TIME_ML_MIN K_TUMG_OBD_TMOT_START_MAX K_TUMG_OBD_TMOT_TAN_DELTA_MAX K_TUMG_OBD_T_BEGR_MAX K_TUMG_OBD_T_BEGR_MIN K_TUMG_OBD_TMOT_KALT_MAX K_TUMG_OBD_MODEL_DELTA_MIN K_TUMG_OBD_MODEL_DELTA_MAX K_TUMG_OBD_KS_ML_MIN K_TUMG_OBD_KS_MW_MIN K_TUMG_OBD_CFG K_TUMG_OBD_TOEL_WICHT K_TUMG_OBD_TMOT_WICHT K_TUMG_OBD_ERROR_T K_TUMG_OBD_KS_ML_MW_TAU K_FGR_HOCHLAUF_DIAG K_FGR_KUPPLUNGS_DIAG K_TABG_KAT_OBD_GRAD_TAU K_TABG_KAT_OBD_GRAD_MAX K_EGAS_FT_ERR_SCHW KL_SPA_SK_GANG_MIN_N KL_SPA_SK_GANG_MIN_NORM K_LLR_DIAG_T K_LLR_DIAG_N_INT_SCHW K_LLR_DIAG_CSS_N_INT_SCHW K_LLR_DIAG_CSS_T KL_LLR_DIAG_RF_PSAU_SCHW KL_LLR_DIAG_RF_PSAU_SCHW_CSS KF_MD_IND_REIB_E2 K_FRA_OUT_FPLAU_OBD_MAX K_FRA_OUT_FPLAU_OBD_MIN /end REF_CHARACTERISTIC
/end GROUP
/begin GROUP G_y_Fault_paths__K_ED_ "y Fault paths (K_ED)" ROOT
 /begin REF_CHARACTERISTIC K_ED_AFZ_HS.DEC_NACH_EINTRAG K_ED_AFZ_HS.DEC_VOR_EINTRAG K_ED_AFZ_HS.FEHLERSCHWELLE K_ED_AFZ_HS.INC_NACH_EINTRAG K_ED_AFZ_HS.INC_VOR_EINTRAG K_ED_AFZ_HS.KLASSENINDEX K_ED_AFZ_HS.OK_SCHWELLE K_ED_AFZ_HS.P_CODE_OPENLOAD K_ED_AFZ_HS.P_CODE_SH_TO_GND K_ED_AFZ_HS.P_CODE_SH_TO_UB K_ED_AFZ_HS.P_CODE_UNPLAUSIBEL K_ED_APPL_DATA_IGN.DEC_NACH_EINTRAG K_ED_APPL_DATA_IGN.DEC_VOR_EINTRAG K_ED_APPL_DATA_IGN.FEHLERSCHWELLE K_ED_APPL_DATA_IGN.INC_NACH_EINTRAG K_ED_APPL_DATA_IGN.INC_VOR_EINTRAG K_ED_APPL_DATA_IGN.KLASSENINDEX K_ED_APPL_DATA_IGN.OK_SCHWELLE K_ED_APPL_DATA_IGN.P_CODE_OPENLOAD K_ED_APPL_DATA_IGN.P_CODE_SH_TO_GND K_ED_APPL_DATA_IGN.P_CODE_SH_TO_UB K_ED_APPL_DATA_IGN.P_CODE_UNPLAUSIBEL K_ED_AUSS_ABG_Z1.DEC_NACH_EINTRAG K_ED_AUSS_ABG_Z1.DEC_VOR_EINTRAG K_ED_AUSS_ABG_Z1.FEHLERSCHWELLE K_ED_AUSS_ABG_Z1.INC_NACH_EINTRAG K_ED_AUSS_ABG_Z1.INC_VOR_EINTRAG K_ED_AUSS_ABG_Z1.KLASSENINDEX K_ED_AUSS_ABG_Z1.OK_SCHWELLE K_ED_AUSS_ABG_Z1.P_CODE_OPENLOAD K_ED_AUSS_ABG_Z1.P_CODE_SH_TO_GND K_ED_AUSS_ABG_Z1.P_CODE_SH_TO_UB K_ED_AUSS_ABG_Z1.P_CODE_UNPLAUSIBEL K_ED_AUSS_ABG_Z2.DEC_NACH_EINTRAG K_ED_AUSS_ABG_Z2.DEC_VOR_EINTRAG K_ED_AUSS_ABG_Z2.FEHLERSCHWELLE K_ED_AUSS_ABG_Z2.INC_NACH_EINTRAG K_ED_AUSS_ABG_Z2.INC_VOR_EINTRAG K_ED_AUSS_ABG_Z2.KLASSENINDEX K_ED_AUSS_ABG_Z2.OK_SCHWELLE K_ED_AUSS_ABG_Z2.P_CODE_OPENLOAD K_ED_AUSS_ABG_Z2.P_CODE_SH_TO_GND K_ED_AUSS_ABG_Z2.P_CODE_SH_TO_UB K_ED_AUSS_ABG_Z2.P_CODE_UNPLAUSIBEL K_ED_AUSS_ABG_Z3.DEC_NACH_EINTRAG K_ED_AUSS_ABG_Z3.DEC_VOR_EINTRAG K_ED_AUSS_ABG_Z3.FEHLERSCHWELLE K_ED_AUSS_ABG_Z3.INC_NACH_EINTRAG K_ED_AUSS_ABG_Z3.INC_VOR_EINTRAG K_ED_AUSS_ABG_Z3.KLASSENINDEX K_ED_AUSS_ABG_Z3.OK_SCHWELLE K_ED_AUSS_ABG_Z3.P_CODE_OPENLOAD K_ED_AUSS_ABG_Z3.P_CODE_SH_TO_GND K_ED_AUSS_ABG_Z3.P_CODE_SH_TO_UB K_ED_AUSS_ABG_Z3.P_CODE_UNPLAUSIBEL K_ED_AUSS_ABG_Z4.DEC_NACH_EINTRAG K_ED_AUSS_ABG_Z4.DEC_VOR_EINTRAG K_ED_AUSS_ABG_Z4.FEHLERSCHWELLE K_ED_AUSS_ABG_Z4.INC_NACH_EINTRAG K_ED_AUSS_ABG_Z4.INC_VOR_EINTRAG K_ED_AUSS_ABG_Z4.KLASSENINDEX K_ED_AUSS_ABG_Z4.OK_SCHWELLE K_ED_AUSS_ABG_Z4.P_CODE_OPENLOAD K_ED_AUSS_ABG_Z4.P_CODE_SH_TO_GND K_ED_AUSS_ABG_Z4.P_CODE_SH_TO_UB K_ED_AUSS_ABG_Z4.P_CODE_UNPLAUSIBEL K_ED_AUSS_ABG_Z5.DEC_NACH_EINTRAG K_ED_AUSS_ABG_Z5.DEC_VOR_EINTRAG K_ED_AUSS_ABG_Z5.FEHLERSCHWELLE K_ED_AUSS_ABG_Z5.INC_NACH_EINTRAG K_ED_AUSS_ABG_Z5.INC_VOR_EINTRAG K_ED_AUSS_ABG_Z5.KLASSENINDEX K_ED_AUSS_ABG_Z5.OK_SCHWELLE K_ED_AUSS_ABG_Z5.P_CODE_OPENLOAD K_ED_AUSS_ABG_Z5.P_CODE_SH_TO_GND K_ED_AUSS_ABG_Z5.P_CODE_SH_TO_UB K_ED_AUSS_ABG_Z5.P_CODE_UNPLAUSIBEL K_ED_AUSS_ABG_Z6.DEC_NACH_EINTRAG K_ED_AUSS_ABG_Z6.DEC_VOR_EINTRAG K_ED_AUSS_ABG_Z6.FEHLERSCHWELLE K_ED_AUSS_ABG_Z6.INC_NACH_EINTRAG K_ED_AUSS_ABG_Z6.INC_VOR_EINTRAG K_ED_AUSS_ABG_Z6.KLASSENINDEX K_ED_AUSS_ABG_Z6.OK_SCHWELLE K_ED_AUSS_ABG_Z6.P_CODE_OPENLOAD K_ED_AUSS_ABG_Z6.P_CODE_SH_TO_GND K_ED_AUSS_ABG_Z6.P_CODE_SH_TO_UB K_ED_AUSS_ABG_Z6.P_CODE_UNPLAUSIBEL K_ED_AUSS_ABG_Z7.DEC_NACH_EINTRAG K_ED_AUSS_ABG_Z7.DEC_VOR_EINTRAG K_ED_AUSS_ABG_Z7.FEHLERSCHWELLE K_ED_AUSS_ABG_Z7.INC_NACH_EINTRAG K_ED_AUSS_ABG_Z7.INC_VOR_EINTRAG K_ED_AUSS_ABG_Z7.KLASSENINDEX K_ED_AUSS_ABG_Z7.OK_SCHWELLE K_ED_AUSS_ABG_Z7.P_CODE_OPENLOAD K_ED_AUSS_ABG_Z7.P_CODE_SH_TO_GND K_ED_AUSS_ABG_Z7.P_CODE_SH_TO_UB K_ED_AUSS_ABG_Z7.P_CODE_UNPLAUSIBEL K_ED_AUSS_ABG_Z8.DEC_NACH_EINTRAG K_ED_AUSS_ABG_Z8.DEC_VOR_EINTRAG K_ED_AUSS_ABG_Z8.FEHLERSCHWELLE K_ED_AUSS_ABG_Z8.INC_NACH_EINTRAG K_ED_AUSS_ABG_Z8.INC_VOR_EINTRAG K_ED_AUSS_ABG_Z8.KLASSENINDEX K_ED_AUSS_ABG_Z8.OK_SCHWELLE K_ED_AUSS_ABG_Z8.P_CODE_OPENLOAD K_ED_AUSS_ABG_Z8.P_CODE_SH_TO_GND K_ED_AUSS_ABG_Z8.P_CODE_SH_TO_UB K_ED_AUSS_ABG_Z8.P_CODE_UNPLAUSIBEL K_ED_AUSS_KAT_MULT.DEC_NACH_EINTRAG K_ED_AUSS_KAT_MULT.DEC_VOR_EINTRAG K_ED_AUSS_KAT_MULT.FEHLERSCHWELLE K_ED_AUSS_KAT_MULT.INC_NACH_EINTRAG K_ED_AUSS_KAT_MULT.INC_VOR_EINTRAG K_ED_AUSS_KAT_MULT.KLASSENINDEX K_ED_AUSS_KAT_MULT.OK_SCHWELLE K_ED_AUSS_KAT_MULT.P_CODE_OPENLOAD K_ED_AUSS_KAT_MULT.P_CODE_SH_TO_GND K_ED_AUSS_KAT_MULT.P_CODE_SH_TO_UB K_ED_AUSS_KAT_MULT.P_CODE_UNPLAUSIBEL K_ED_AUSS_KAT_Z1.DEC_NACH_EINTRAG K_ED_AUSS_KAT_Z1.DEC_VOR_EINTRAG K_ED_AUSS_KAT_Z1.FEHLERSCHWELLE K_ED_AUSS_KAT_Z1.INC_NACH_EINTRAG K_ED_AUSS_KAT_Z1.INC_VOR_EINTRAG K_ED_AUSS_KAT_Z1.KLASSENINDEX K_ED_AUSS_KAT_Z1.OK_SCHWELLE K_ED_AUSS_KAT_Z1.P_CODE_OPENLOAD K_ED_AUSS_KAT_Z1.P_CODE_SH_TO_GND K_ED_AUSS_KAT_Z1.P_CODE_SH_TO_UB K_ED_AUSS_KAT_Z1.P_CODE_UNPLAUSIBEL K_ED_AUSS_KAT_Z10.DEC_NACH_EINTRAG K_ED_AUSS_KAT_Z10.DEC_VOR_EINTRAG K_ED_AUSS_KAT_Z10.FEHLERSCHWELLE K_ED_AUSS_KAT_Z10.INC_NACH_EINTRAG K_ED_AUSS_KAT_Z10.INC_VOR_EINTRAG K_ED_AUSS_KAT_Z10.KLASSENINDEX K_ED_AUSS_KAT_Z10.OK_SCHWELLE K_ED_AUSS_KAT_Z10.P_CODE_OPENLOAD K_ED_AUSS_KAT_Z10.P_CODE_SH_TO_GND K_ED_AUSS_KAT_Z10.P_CODE_SH_TO_UB K_ED_AUSS_KAT_Z10.P_CODE_UNPLAUSIBEL K_ED_AUSS_KAT_Z2.DEC_NACH_EINTRAG K_ED_AUSS_KAT_Z2.DEC_VOR_EINTRAG K_ED_AUSS_KAT_Z2.FEHLERSCHWELLE K_ED_AUSS_KAT_Z2.INC_NACH_EINTRAG K_ED_AUSS_KAT_Z2.INC_VOR_EINTRAG K_ED_AUSS_KAT_Z2.KLASSENINDEX K_ED_AUSS_KAT_Z2.OK_SCHWELLE K_ED_AUSS_KAT_Z2.P_CODE_OPENLOAD K_ED_AUSS_KAT_Z2.P_CODE_SH_TO_GND K_ED_AUSS_KAT_Z2.P_CODE_SH_TO_UB K_ED_AUSS_KAT_Z2.P_CODE_UNPLAUSIBEL K_ED_AUSS_KAT_Z3.DEC_NACH_EINTRAG K_ED_AUSS_KAT_Z3.DEC_VOR_EINTRAG K_ED_AUSS_KAT_Z3.FEHLERSCHWELLE K_ED_AUSS_KAT_Z3.INC_NACH_EINTRAG K_ED_AUSS_KAT_Z3.INC_VOR_EINTRAG K_ED_AUSS_KAT_Z3.KLASSENINDEX K_ED_AUSS_KAT_Z3.OK_SCHWELLE K_ED_AUSS_KAT_Z3.P_CODE_OPENLOAD K_ED_AUSS_KAT_Z3.P_CODE_SH_TO_GND K_ED_AUSS_KAT_Z3.P_CODE_SH_TO_UB K_ED_AUSS_KAT_Z3.P_CODE_UNPLAUSIBEL K_ED_AUSS_KAT_Z4.DEC_NACH_EINTRAG K_ED_AUSS_KAT_Z4.DEC_VOR_EINTRAG K_ED_AUSS_KAT_Z4.FEHLERSCHWELLE K_ED_AUSS_KAT_Z4.INC_NACH_EINTRAG K_ED_AUSS_KAT_Z4.INC_VOR_EINTRAG K_ED_AUSS_KAT_Z4.KLASSENINDEX K_ED_AUSS_KAT_Z4.OK_SCHWELLE K_ED_AUSS_KAT_Z4.P_CODE_OPENLOAD K_ED_AUSS_KAT_Z4.P_CODE_SH_TO_GND K_ED_AUSS_KAT_Z4.P_CODE_SH_TO_UB K_ED_AUSS_KAT_Z4.P_CODE_UNPLAUSIBEL K_ED_AUSS_KAT_Z5.DEC_NACH_EINTRAG K_ED_AUSS_KAT_Z5.DEC_VOR_EINTRAG K_ED_AUSS_KAT_Z5.FEHLERSCHWELLE K_ED_AUSS_KAT_Z5.INC_NACH_EINTRAG K_ED_AUSS_KAT_Z5.INC_VOR_EINTRAG K_ED_AUSS_KAT_Z5.KLASSENINDEX K_ED_AUSS_KAT_Z5.OK_SCHWELLE K_ED_AUSS_KAT_Z5.P_CODE_OPENLOAD K_ED_AUSS_KAT_Z5.P_CODE_SH_TO_GND K_ED_AUSS_KAT_Z5.P_CODE_SH_TO_UB K_ED_AUSS_KAT_Z5.P_CODE_UNPLAUSIBEL K_ED_AUSS_KAT_Z6.DEC_NACH_EINTRAG K_ED_AUSS_KAT_Z6.DEC_VOR_EINTRAG K_ED_AUSS_KAT_Z6.FEHLERSCHWELLE K_ED_AUSS_KAT_Z6.INC_NACH_EINTRAG K_ED_AUSS_KAT_Z6.INC_VOR_EINTRAG K_ED_AUSS_KAT_Z6.KLASSENINDEX K_ED_AUSS_KAT_Z6.OK_SCHWELLE K_ED_AUSS_KAT_Z6.P_CODE_OPENLOAD K_ED_AUSS_KAT_Z6.P_CODE_SH_TO_GND K_ED_AUSS_KAT_Z6.P_CODE_SH_TO_UB K_ED_AUSS_KAT_Z6.P_CODE_UNPLAUSIBEL K_ED_AUSS_KAT_Z7.DEC_NACH_EINTRAG K_ED_AUSS_KAT_Z7.DEC_VOR_EINTRAG K_ED_AUSS_KAT_Z7.FEHLERSCHWELLE K_ED_AUSS_KAT_Z7.INC_NACH_EINTRAG K_ED_AUSS_KAT_Z7.INC_VOR_EINTRAG K_ED_AUSS_KAT_Z7.KLASSENINDEX K_ED_AUSS_KAT_Z7.OK_SCHWELLE K_ED_AUSS_KAT_Z7.P_CODE_OPENLOAD K_ED_AUSS_KAT_Z7.P_CODE_SH_TO_GND K_ED_AUSS_KAT_Z7.P_CODE_SH_TO_UB K_ED_AUSS_KAT_Z7.P_CODE_UNPLAUSIBEL K_ED_AUSS_KAT_Z8.DEC_NACH_EINTRAG K_ED_AUSS_KAT_Z8.DEC_VOR_EINTRAG K_ED_AUSS_KAT_Z8.FEHLERSCHWELLE K_ED_AUSS_KAT_Z8.INC_NACH_EINTRAG K_ED_AUSS_KAT_Z8.INC_VOR_EINTRAG K_ED_AUSS_KAT_Z8.KLASSENINDEX K_ED_AUSS_KAT_Z8.OK_SCHWELLE K_ED_AUSS_KAT_Z8.P_CODE_OPENLOAD K_ED_AUSS_KAT_Z8.P_CODE_SH_TO_GND K_ED_AUSS_KAT_Z8.P_CODE_SH_TO_UB K_ED_AUSS_KAT_Z8.P_CODE_UNPLAUSIBEL K_ED_AUSS_KAT_Z9.DEC_NACH_EINTRAG K_ED_AUSS_KAT_Z9.DEC_VOR_EINTRAG K_ED_AUSS_KAT_Z9.FEHLERSCHWELLE K_ED_AUSS_KAT_Z9.INC_NACH_EINTRAG K_ED_AUSS_KAT_Z9.INC_VOR_EINTRAG K_ED_AUSS_KAT_Z9.KLASSENINDEX K_ED_AUSS_KAT_Z9.OK_SCHWELLE K_ED_AUSS_KAT_Z9.P_CODE_OPENLOAD K_ED_AUSS_KAT_Z9.P_CODE_SH_TO_GND K_ED_AUSS_KAT_Z9.P_CODE_SH_TO_UB K_ED_AUSS_KAT_Z9.P_CODE_UNPLAUSIBEL K_ED_BLS_PLAU.DEC_NACH_EINTRAG K_ED_BLS_PLAU.DEC_VOR_EINTRAG K_ED_BLS_PLAU.FEHLERSCHWELLE K_ED_BLS_PLAU.INC_NACH_EINTRAG K_ED_BLS_PLAU.INC_VOR_EINTRAG K_ED_BLS_PLAU.KLASSENINDEX K_ED_BLS_PLAU.OK_SCHWELLE K_ED_BLS_PLAU.P_CODE_OPENLOAD K_ED_BLS_PLAU.P_CODE_SH_TO_GND K_ED_BLS_PLAU.P_CODE_SH_TO_UB K_ED_BLS_PLAU.P_CODE_UNPLAUSIBEL K_ED_DK1_ADAPT.DEC_NACH_EINTRAG K_ED_DK1_ADAPT.DEC_VOR_EINTRAG K_ED_DK1_ADAPT.FEHLERSCHWELLE K_ED_DK1_ADAPT.INC_NACH_EINTRAG K_ED_DK1_ADAPT.INC_VOR_EINTRAG K_ED_DK1_ADAPT.KLASSENINDEX K_ED_DK1_ADAPT.OK_SCHWELLE K_ED_DK1_ADAPT.P_CODE_OPENLOAD K_ED_DK1_ADAPT.P_CODE_SH_TO_GND K_ED_DK1_ADAPT.P_CODE_SH_TO_UB K_ED_DK1_ADAPT.P_CODE_UNPLAUSIBEL K_ED_DK1_CAN.DEC_NACH_EINTRAG K_ED_DK1_CAN.DEC_VOR_EINTRAG K_ED_DK1_CAN.FEHLERSCHWELLE K_ED_DK1_CAN.INC_NACH_EINTRAG K_ED_DK1_CAN.INC_VOR_EINTRAG K_ED_DK1_CAN.KLASSENINDEX K_ED_DK1_CAN.OK_SCHWELLE K_ED_DK1_CAN.P_CODE_OPENLOAD K_ED_DK1_CAN.P_CODE_SH_TO_GND K_ED_DK1_CAN.P_CODE_SH_TO_UB K_ED_DK1_CAN.P_CODE_UNPLAUSIBEL K_ED_DK1_CMD.DEC_NACH_EINTRAG K_ED_DK1_CMD.DEC_VOR_EINTRAG K_ED_DK1_CMD.FEHLERSCHWELLE K_ED_DK1_CMD.INC_NACH_EINTRAG K_ED_DK1_CMD.INC_VOR_EINTRAG K_ED_DK1_CMD.KLASSENINDEX K_ED_DK1_CMD.OK_SCHWELLE K_ED_DK1_CMD.P_CODE_OPENLOAD K_ED_DK1_CMD.P_CODE_SH_TO_GND K_ED_DK1_CMD.P_CODE_SH_TO_UB K_ED_DK1_CMD.P_CODE_UNPLAUSIBEL K_ED_DK1_FEDERN.DEC_NACH_EINTRAG K_ED_DK1_FEDERN.DEC_VOR_EINTRAG K_ED_DK1_FEDERN.FEHLERSCHWELLE K_ED_DK1_FEDERN.INC_NACH_EINTRAG K_ED_DK1_FEDERN.INC_VOR_EINTRAG K_ED_DK1_FEDERN.KLASSENINDEX K_ED_DK1_FEDERN.OK_SCHWELLE K_ED_DK1_FEDERN.P_CODE_OPENLOAD K_ED_DK1_FEDERN.P_CODE_SH_TO_GND K_ED_DK1_FEDERN.P_CODE_SH_TO_UB K_ED_DK1_FEDERN.P_CODE_UNPLAUSIBEL K_ED_DK1_PDR.DEC_NACH_EINTRAG K_ED_DK1_PDR.DEC_VOR_EINTRAG K_ED_DK1_PDR.FEHLERSCHWELLE K_ED_DK1_PDR.INC_NACH_EINTRAG K_ED_DK1_PDR.INC_VOR_EINTRAG K_ED_DK1_PDR.KLASSENINDEX K_ED_DK1_PDR.OK_SCHWELLE K_ED_DK1_PDR.P_CODE_OPENLOAD K_ED_DK1_PDR.P_CODE_SH_TO_GND K_ED_DK1_PDR.P_CODE_SH_TO_UB K_ED_DK1_PDR.P_CODE_UNPLAUSIBEL K_ED_DK1_REGLER.DEC_NACH_EINTRAG K_ED_DK1_REGLER.DEC_VOR_EINTRAG K_ED_DK1_REGLER.FEHLERSCHWELLE K_ED_DK1_REGLER.INC_NACH_EINTRAG K_ED_DK1_REGLER.INC_VOR_EINTRAG K_ED_DK1_REGLER.KLASSENINDEX K_ED_DK1_REGLER.OK_SCHWELLE K_ED_DK1_REGLER.P_CODE_OPENLOAD K_ED_DK1_REGLER.P_CODE_SH_TO_GND K_ED_DK1_REGLER.P_CODE_SH_TO_UB K_ED_DK1_REGLER.P_CODE_UNPLAUSIBEL K_ED_DK1_SK_ERR.DEC_NACH_EINTRAG K_ED_DK1_SK_ERR.DEC_VOR_EINTRAG K_ED_DK1_SK_ERR.FEHLERSCHWELLE K_ED_DK1_SK_ERR.INC_NACH_EINTRAG K_ED_DK1_SK_ERR.INC_VOR_EINTRAG K_ED_DK1_SK_ERR.KLASSENINDEX K_ED_DK1_SK_ERR.OK_SCHWELLE K_ED_DK1_SK_ERR.P_CODE_OPENLOAD K_ED_DK1_SK_ERR.P_CODE_SH_TO_GND K_ED_DK1_SK_ERR.P_CODE_SH_TO_UB K_ED_DK1_SK_ERR.P_CODE_UNPLAUSIBEL K_ED_DK1_WDK.DEC_NACH_EINTRAG K_ED_DK1_WDK.DEC_VOR_EINTRAG /end REF_CHARACTERISTIC
/end GROUP
/end MODULE
/end PROJECT
