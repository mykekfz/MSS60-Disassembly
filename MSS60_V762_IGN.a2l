ASAP2_VERSION 1 60
/begin PROJECT MSS60_V762_IGN "MSS60 (S65) V762 IGN CPU - production calibration 7848136 (V762.01-B500.02)"
/begin HEADER "Calibration description. Measurements: V530 RAM names transferred to V762 addresses (confidence in each long identifier). Status tag in every long identifier: verified (checked against the code) / A2L-ref (placed from the V530 A2L) / EST (estimated) / unassigned (unidentified)." VERSION "V762-RE-04112026" /end HEADER
/begin MODULE IGN "MSS60 V762 IGN"
/begin MOD_COMMON "" BYTE_ORDER MSB_FIRST ALIGNMENT_BYTE 1 ALIGNMENT_WORD 2 ALIGNMENT_LONG 4 /end MOD_COMMON
/begin MEASUREMENT ed_st_fehler_ign "ED-Gesamtstatus IGN-Fehler [RAM name from V530, voted 12]" ULONG M_FORMULA_0000 0 0 0 4294967295 ECU_ADDRESS 0x3F85C8 /end MEASUREMENT
/begin MEASUREMENT ed_st_filter_ign "ED-Gesamtstatus IGN-Filter [RAM name from V530, voted 5]" ULONG M_FORMULA_0000 0 0 0 4294967295 ECU_ADDRESS 0x3F85D8 /end MEASUREMENT
/begin MEASUREMENT ed_mil_bmw_ign "Mil-Status IGN [RAM name from V530, voted 22]" UBYTE NO_COMPU_METHOD 0 0 0 255 ECU_ADDRESS 0x3F85E8 FORMAT "%.4g" /end MEASUREMENT
/begin MEASUREMENT ed_mil_dme_ign "Mil-Status IGN [RAM name from V530, voted 22]" UBYTE NO_COMPU_METHOD 0 0 0 255 ECU_ADDRESS 0x3F85E8 FORMAT "%.4g" /end MEASUREMENT
/begin MEASUREMENT ed_mil_predrive_ign "Mil-Status IGN [RAM name from V530, voted 22]" UBYTE NO_COMPU_METHOD 0 0 0 255 ECU_ADDRESS 0x3F85E8 FORMAT "%.4g" /end MEASUREMENT
/begin MEASUREMENT ed_mil_smg_ign "Mil-Status IGN [RAM name from V530, voted 22]" UBYTE NO_COMPU_METHOD 0 0 0 255 ECU_ADDRESS 0x3F85E8 FORMAT "%.4g" /end MEASUREMENT
/begin MEASUREMENT ed_mil_st_ign "Mil-Status IGN [RAM name from V530, voted 22]" UBYTE M_FORMULA_0037 0 0 0 255 ECU_ADDRESS 0x3F85E8 /end MEASUREMENT
/begin MEASUREMENT ed_mil_zyl_off_ign "Mil-Status IGN [RAM name from V530, voted 22]" UBYTE NO_COMPU_METHOD 0 0 0 255 ECU_ADDRESS 0x3F85E8 FORMAT "%.4g" /end MEASUREMENT
/begin MEASUREMENT llr_state "LLR-Zustand [RAM name from V530, voted 4]" UBYTE NO_COMPU_METHOD 0 0 0 255 ECU_ADDRESS 0x3F85EC FORMAT "%.4g" /end MEASUREMENT
/begin MEASUREMENT uext_pin_111_219_514 "Versorgungsspannung [RAM name from V530, voted 2]" UWORD M_FORMULA_0247 0 0 0 6.666564941 ECU_ADDRESS 0x3F85F4 /end MEASUREMENT
/begin MEASUREMENT uext_korr_pin_111_219_514 "Korrekturfaktor fuer UEXT [RAM name from V530, voted 4]" UWORD M_FORMULA_0073 0 0 0 63.99902344 ECU_ADDRESS 0x3F85F8 /end MEASUREMENT
/begin MEASUREMENT uext_korr_pin_124_512 "Korrekturfaktor fuer UEXT [RAM name from V530, voted 1]" UWORD M_FORMULA_0073 0 0 0 63.99902344 ECU_ADDRESS 0x3F85FA /end MEASUREMENT
/begin MEASUREMENT pwg_kd_st "Kickdown-Status [RAM name from V530, voted 4]" UBYTE M_FORMULA_0003 0 0 0 255 ECU_ADDRESS 0x3F85FC /end MEASUREMENT
/begin MEASUREMENT pwg_kd_st_kickdown "Kickdown-Status [RAM name from V530, voted 4]" UBYTE NO_COMPU_METHOD 0 0 0 255 ECU_ADDRESS 0x3F85FC FORMAT "%.4g" /end MEASUREMENT
/begin MEASUREMENT pwg_mode "Ausgabezustand der Pedalwertgebererfassung [RAM name from V530, voted 7]" UBYTE NO_COMPU_METHOD 0 0 0 255 ECU_ADDRESS 0x3F85FD FORMAT "%.4g" /end MEASUREMENT
/begin MEASUREMENT pwg_soll "Ausgegebener Pedalwert fuer andere Module [RAM name from V530, voted 23]" SWORD M_FORMULA_0001 0 0 -3276.8 3276.7 ECU_ADDRESS 0x3F85FE /end MEASUREMENT
/begin MEASUREMENT pwg2_abs_roh "Ungefilterter mit UEXT-korrigierter Messwert PWG2 [RAM name from V530, voted 4]" SWORD M_FORMULA_0251 0 0 -80 79.99755859 ECU_ADDRESS 0x3FD46A /end MEASUREMENT
/begin MEASUREMENT md_fw_rel "rel. Wunschmoment [RAM name from V530, voted 6]" SWORD M_FORMULA_0001 0 0 -3276.8 3276.7 ECU_ADDRESS 0x3F8606 /end MEASUREMENT
/begin MEASUREMENT md_wunsch_rel "Ergebnis der Max-Auswahl [RAM name from V530, voted 5]" SWORD M_FORMULA_0001 0 0 -3276.8 3276.7 ECU_ADDRESS 0x3F8608 /end MEASUREMENT
/begin MEASUREMENT md_kupp_wunsch "Wunschmoment [RAM name from V530, voted 16]" SWORD M_FORMULA_0009 0 0 -3276.8 3276.7 ECU_ADDRESS 0x3F860A /end MEASUREMENT
/begin MEASUREMENT md_kupp_wunsch_begr "begrenztes Wunschmoment fuer CAN [RAM name from V530, voted 2]" SWORD M_FORMULA_0009 0 0 -3276.8 3276.7 ECU_ADDRESS 0x3F860C /end MEASUREMENT
/begin MEASUREMENT md_kupp_wunsch_filter_rel "gefiltertes Wunschmoment [RAM name from V530, voted 3]" SWORD M_FORMULA_0001 0 0 -3276.8 3276.7 ECU_ADDRESS 0x3F860E /end MEASUREMENT
/begin MEASUREMENT md_kupp_wunsch_tz "Wunschmoment fuer den Zuendwinkelpfad [RAM name from V530, voted 3]" SWORD M_FORMULA_0009 0 0 -3276.8 3276.7 ECU_ADDRESS 0x3F8610 /end MEASUREMENT
/begin MEASUREMENT md_max_fak_power "Powerfaktor [RAM name from V530, voted 3]" UWORD M_FORMULA_0073 0 0 0 63.99902344 ECU_ADDRESS 0x3F8612 /end MEASUREMENT
/begin MEASUREMENT md_st "MD-Stati [RAM name from V530, voted 17]" UWORD M_FORMULA_0010 0 0 0 65535 ECU_ADDRESS 0x3F8614 /end MEASUREMENT
/begin MEASUREMENT md_nbegr_t "Zeit im Begrenzer [RAM name from V530, voted 1]" UWORD M_FORMULA_0109 0 0 0 327.675 ECU_ADDRESS 0x3F8616 /end MEASUREMENT
/begin MEASUREMENT md_can_begr_st "MD-Begrenzungen [RAM name from V530, voted 6]" UBYTE NO_COMPU_METHOD 0 0 0 255 ECU_ADDRESS 0x3F8618 FORMAT "%.4g" /end MEASUREMENT
/begin MEASUREMENT md_dsc_sperr_st "Sperre DSC-Eingriff [RAM name from V530, voted 10]" UBYTE NO_COMPU_METHOD 0 0 0 255 ECU_ADDRESS 0x3F8619 FORMAT "%.4g" /end MEASUREMENT
/begin MEASUREMENT md_can_kkos_max "max. Moment fuer KKOS [RAM name from V530, voted 1]" SWORD M_FORMULA_0009 0 0 -3276.8 3276.7 ECU_ADDRESS 0x3F861A /end MEASUREMENT
/begin MEASUREMENT md_vbegr_st "Status v-Begrenzung [RAM name from V530, voted 11]" UBYTE NO_COMPU_METHOD 0 0 0 255 ECU_ADDRESS 0x3F861C FORMAT "%.4g" /end MEASUREMENT
/begin MEASUREMENT md_nbegr_st "Status n-Begrenzung [RAM name from V530, voted 5]" UBYTE NO_COMPU_METHOD 0 0 0 255 ECU_ADDRESS 0x3F861D FORMAT "%.4g" /end MEASUREMENT
/begin MEASUREMENT egas_soll_dk_b1 "DK-Sollwert [RAM name from V530, voted 12]" SWORD M_FORMULA_0001 0 0 -3276.8 3276.7 ECU_ADDRESS 0x3F8624 /end MEASUREMENT
/begin MEASUREMENT egas_soll_lls_b1 "LLS-Sollwert [RAM name from V530, voted 8]" SWORD M_FORMULA_0001 0 0 -3276.8 3276.7 ECU_ADDRESS 0x3F8628 /end MEASUREMENT
/begin MEASUREMENT egas_ist_dk_b2 "Istwert (CAN) [RAM name from V530, voted 7]" SWORD M_FORMULA_0001 0 0 -3276.8 3276.7 ECU_ADDRESS 0x3F8632 /end MEASUREMENT
/begin MEASUREMENT egas_ist_lls_b2 "Istwert (CAN) [RAM name from V530, voted 6]" SWORD M_FORMULA_0001 0 0 -3276.8 3276.7 ECU_ADDRESS 0x3F862E /end MEASUREMENT
/begin MEASUREMENT egas_st_b1 "DPR-Status [RAM name from V530, voted 22]" UBYTE M_FORMULA_0003 0 0 0 255 ECU_ADDRESS 0x3F8636 /end MEASUREMENT
/begin MEASUREMENT egas_st_dk_b1 "Status Klappen [RAM name from V530, voted 22]" UBYTE NO_COMPU_METHOD 0 0 0 255 ECU_ADDRESS 0x3F8636 FORMAT "%.4g" /end MEASUREMENT
/begin MEASUREMENT egas_st_ft_b1 "Status Federntest [RAM name from V530, voted 22]" UBYTE NO_COMPU_METHOD 0 0 0 255 ECU_ADDRESS 0x3F8636 FORMAT "%.4g" /end MEASUREMENT
/begin MEASUREMENT egas_st_b2 "DPR-Status [RAM name from V530, voted 12]" UBYTE M_FORMULA_0003 0 0 0 255 ECU_ADDRESS 0x3F8637 /end MEASUREMENT
/begin MEASUREMENT egas_st_dk_b2 "Status Klappen [RAM name from V530, voted 12]" UBYTE NO_COMPU_METHOD 0 0 0 255 ECU_ADDRESS 0x3F8637 FORMAT "%.4g" /end MEASUREMENT
/begin MEASUREMENT egas_st_ft_b2 "Status Federntest [RAM name from V530, voted 12]" UBYTE NO_COMPU_METHOD 0 0 0 255 ECU_ADDRESS 0x3F8637 FORMAT "%.4g" /end MEASUREMENT
/begin MEASUREMENT egas_sk_ti_st "SK-Ausblendmaske vom Egas [RAM name from V530, voted 5]" UWORD M_FORMULA_0010 0 0 0 65535 ECU_ADDRESS 0x3F8638 /end MEASUREMENT
/begin MEASUREMENT egas_aq_soll_roh_b1 "AQ-Soll Rohwert [RAM name from V530, voted 1]" UWORD M_FORMULA_0143 0 0 0 6553.5 ECU_ADDRESS 0x3F863A /end MEASUREMENT
/begin MEASUREMENT md_dsc_freig_st "DSC-Freigabe [RAM name from V530, voted 10]" UBYTE NO_COMPU_METHOD 0 0 0 255 ECU_ADDRESS 0x3F8646 FORMAT "%.4g" /end MEASUREMENT
/begin MEASUREMENT ub "Spannungswert U_KL87 [RAM name from V530, voted 17]" SWORD M_FORMULA_0008 0 0 -3276.8 3276.7 ECU_ADDRESS 0x3F865A /end MEASUREMENT
/begin MEASUREMENT smg_can_error "Fehlerbits [RAM name from V530, voted 28]" UBYTE NO_COMPU_METHOD 0 0 0 255 ECU_ADDRESS 0x3F8662 FORMAT "%.4g" /end MEASUREMENT
/begin MEASUREMENT smg_can_n_getr_ziel "Getriebezieldrehzahl [RAM name from V530, voted 13]" SWORD M_FORMULA_0006 0 0 -32768 32767 ECU_ADDRESS 0x3F8664 /end MEASUREMENT
/begin MEASUREMENT smg_can_n_getr_ein "Getriebeeingangsdrehzahl [RAM name from V530, voted 14]" SWORD M_FORMULA_0006 0 0 -32768 32767 ECU_ADDRESS 0x3F8666 /end MEASUREMENT
/begin MEASUREMENT smg_can_prog_info "Programminfo [RAM name from V530, voted 5]" UBYTE M_FORMULA_0263 0 0 0 255 ECU_ADDRESS 0x3F8668 /end MEASUREMENT
/begin MEASUREMENT smg_can_flags "Allg. CAN-Flags [RAM name from V530, voted 20]" UBYTE M_FORMULA_0003 0 0 0 255 ECU_ADDRESS 0x3F8669 /end MEASUREMENT
/begin MEASUREMENT smg_can_flags_kl87 "KL87 durch SMG ein [RAM name from V530, voted 20]" UBYTE NO_COMPU_METHOD 0 0 0 255 ECU_ADDRESS 0x3F8669 FORMAT "%.4g" /end MEASUREMENT
/begin MEASUREMENT smg_can_flags_mm "Status MM-SMG [RAM name from V530, voted 20]" UBYTE NO_COMPU_METHOD 0 0 0 255 ECU_ADDRESS 0x3F8669 FORMAT "%.4g" /end MEASUREMENT
/begin MEASUREMENT egas_ist_wdk_b1 "Istwert (analog) [RAM name from V530, voted 3]" SWORD M_FORMULA_0001 0 0 -3276.8 3276.7 ECU_ADDRESS 0x3F866A /end MEASUREMENT
/begin MEASUREMENT egas_wdk_adapt_b1 "Adaptionsstatus [RAM name from V530, voted 6]" UBYTE NO_COMPU_METHOD 0 0 0 255 ECU_ADDRESS 0x3F866E FORMAT "%.4g" /end MEASUREMENT
/begin MEASUREMENT smg_st_mot "SMG-Motoreingriff [RAM name from V530, voted 31]" UBYTE NO_COMPU_METHOD 0 0 0 255 ECU_ADDRESS 0x3F8670 FORMAT "%.4g" /end MEASUREMENT
/begin MEASUREMENT smg_st_mot_sa "SMG-SA-Sperre [RAM name from V530, voted 31]" UBYTE NO_COMPU_METHOD 0 0 0 255 ECU_ADDRESS 0x3F8670 FORMAT "%.4g" /end MEASUREMENT
/begin MEASUREMENT smg_st_mot_ti "SMG-TI-Eingriff [RAM name from V530, voted 31]" UBYTE NO_COMPU_METHOD 0 0 0 255 ECU_ADDRESS 0x3F8670 FORMAT "%.4g" /end MEASUREMENT
/begin MEASUREMENT smg_st_mot_tl "SMG-TL-Eingriff [RAM name from V530, voted 31]" UBYTE NO_COMPU_METHOD 0 0 0 255 ECU_ADDRESS 0x3F8670 FORMAT "%.4g" /end MEASUREMENT
/begin MEASUREMENT smg_can_modul "Modulstatus [RAM name from V530, voted 13]" UBYTE NO_COMPU_METHOD 0 0 0 255 ECU_ADDRESS 0x3F8671 FORMAT "%.4g" /end MEASUREMENT
/begin MEASUREMENT aq_eingeregelt_st "Status AQ eingeregelt [RAM name from V530, voted 4]" UBYTE M_FORMULA_0003 0 0 0 255 ECU_ADDRESS 0x3F8672 /end MEASUREMENT
/begin MEASUREMENT egas_aq_soll_grad_b1 "Gradient AQ-Soll [RAM name from V530, voted 5]" SWORD M_FORMULA_0020 0 0 -655360 655340 ECU_ADDRESS 0x3F8674 /end MEASUREMENT
/begin MEASUREMENT egas_aq_soll_grad_b2 "Gradient AQ-Soll [RAM name from V530, voted 1]" SWORD M_FORMULA_0020 0 0 -655360 655340 ECU_ADDRESS 0x3F8676 /end MEASUREMENT
/begin MEASUREMENT md_rad_min "min. Radmoment [RAM name from V530, voted 1]" SLONG M_FORMULA_0272 0 0 -214748364.8 214748364.7 ECU_ADDRESS 0x3F867C /end MEASUREMENT
/begin MEASUREMENT md_rad_can_mdrv "max. Radmoment [RAM name from V530, voted 1]" SLONG M_FORMULA_0272 0 0 -214748364.8 214748364.7 ECU_ADDRESS 0x3F8684 /end MEASUREMENT
/begin MEASUREMENT md_rad_soll "Radsollmoment [RAM name from V530, voted 1]" SLONG M_FORMULA_0272 0 0 -214748364.8 214748364.7 ECU_ADDRESS 0x3F8688 /end MEASUREMENT
/begin MEASUREMENT md_rad_ist "Radistmoment [RAM name from V530, voted 1]" SLONG M_FORMULA_0272 0 0 -214748364.8 214748364.7 ECU_ADDRESS 0x3F868C /end MEASUREMENT
/begin MEASUREMENT dkg_freig_st "DKG-Freigabe [RAM name from V530, voted 3]" UBYTE NO_COMPU_METHOD 0 0 0 255 ECU_ADDRESS 0x3F8690 FORMAT "%.4g" /end MEASUREMENT
/begin MEASUREMENT md_kupp_wunsch_ml "Wunschmoment fuer den Luftpfad [RAM name from V530, voted 1]" SWORD M_FORMULA_0009 0 0 -3276.8 3276.7 ECU_ADDRESS 0x3F8694 /end MEASUREMENT
/begin MEASUREMENT md_kupp_min_filter "SAWE-Filter bei min Moment [RAM name from V530, voted 5]" SWORD M_FORMULA_0009 0 0 -3276.8 3276.7 ECU_ADDRESS 0x3F8696 /end MEASUREMENT
/begin MEASUREMENT n_getr_ein "Getriebeeingangsdrehzahl [RAM name from V530, voted 6]" SWORD M_FORMULA_0006 0 0 -32768 32767 ECU_ADDRESS 0x3F869A /end MEASUREMENT
/begin MEASUREMENT n_getr_abtrieb "Getriebeabtriebsdrehzahl [RAM name from V530, voted 2]" SWORD M_FORMULA_0006 0 0 -32768 32767 ECU_ADDRESS 0x3F869C /end MEASUREMENT
/begin MEASUREMENT j_gesamt "ges. Tr???gheitsmoment [RAM name from V530, voted 5]" UWORD M_FORMULA_0276 0 0 0 127.9980469 ECU_ADDRESS 0x3F869E /end MEASUREMENT
/begin MEASUREMENT n_lw_b1 "Ladungswechseldrehzahloffset. [RAM name from V530, voted 2]" SWORD M_FORMULA_0006 0 0 -32768 32767 ECU_ADDRESS 0x3FD3B8 /end MEASUREMENT
/begin MEASUREMENT s_kraftschluss_smg "Kraftschluss beim SMG [RAM name from V530, voted 24]" UWORD NO_COMPU_METHOD 0 0 0 65535 ECU_ADDRESS 0x3F86CE FORMAT "%.4g" /end MEASUREMENT
/begin MEASUREMENT schalter_bls_ign "Schalterstatus [RAM name from V530, voted 24]" UWORD NO_COMPU_METHOD 0 0 0 65535 ECU_ADDRESS 0x3F86CE FORMAT "%.4g" /end MEASUREMENT
/begin MEASUREMENT schalter_blts "Schalterstatus [RAM name from V530, voted 24]" UWORD NO_COMPU_METHOD 0 0 0 65535 ECU_ADDRESS 0x3F86CE FORMAT "%.4g" /end MEASUREMENT
/begin MEASUREMENT schalter_kl87 "Schalterstatus [RAM name from V530, voted 24]" UWORD NO_COMPU_METHOD 0 0 0 65535 ECU_ADDRESS 0x3F86CE FORMAT "%.4g" /end MEASUREMENT
/begin MEASUREMENT schalter_st_ign "Schalterstatus [RAM name from V530, voted 24]" UWORD M_FORMULA_0080 0 0 0 65535 ECU_ADDRESS 0x3F86CE /end MEASUREMENT
/begin MEASUREMENT schalter_wakeup_ign "Schalterstatus [RAM name from V530, voted 24]" UWORD NO_COMPU_METHOD 0 0 0 65535 ECU_ADDRESS 0x3F86CE FORMAT "%.4g" /end MEASUREMENT
/begin MEASUREMENT s_kraftschluss_smg_e2 "Kraftschluss beim SMG Ebene 2 [RAM name from V530, voted 2]" UWORD NO_COMPU_METHOD 0 0 0 65535 ECU_ADDRESS 0x3F86D0 FORMAT "%.4g" /end MEASUREMENT
/begin MEASUREMENT schalter_bls_ign_e2 "Schalterstatus Ebene 2 [RAM name from V530, voted 2]" UWORD NO_COMPU_METHOD 0 0 0 65535 ECU_ADDRESS 0x3F86D0 FORMAT "%.4g" /end MEASUREMENT
/begin MEASUREMENT schalter_blts_e2 "Schalterstatus Ebene 2 [RAM name from V530, voted 2]" UWORD NO_COMPU_METHOD 0 0 0 65535 ECU_ADDRESS 0x3F86D0 FORMAT "%.4g" /end MEASUREMENT
/begin MEASUREMENT schalter_kl87_e2 "Schalterstatus Ebene 2 [RAM name from V530, voted 2]" UWORD NO_COMPU_METHOD 0 0 0 65535 ECU_ADDRESS 0x3F86D0 FORMAT "%.4g" /end MEASUREMENT
/begin MEASUREMENT schalter_st_ign_e2 "Schalterstatus Ebene 2 [RAM name from V530, voted 2]" UWORD M_FORMULA_0080 0 0 0 65535 ECU_ADDRESS 0x3F86D0 /end MEASUREMENT
/begin MEASUREMENT schalter_wakeup_ign_e2 "Schalterstatus Ebene 2 [RAM name from V530, voted 2]" UWORD NO_COMPU_METHOD 0 0 0 65535 ECU_ADDRESS 0x3F86D0 FORMAT "%.4g" /end MEASUREMENT
/begin MEASUREMENT md_kupp_min "Minimalmoment an der Kupplung [RAM name from V530, voted 5]" SWORD M_FORMULA_0009 0 0 -3276.8 3276.7 ECU_ADDRESS 0x3F86D2 /end MEASUREMENT
/begin MEASUREMENT toel_start_ok "Bedingung Oeltemperatur gemessen [RAM name from V530, voted 8]" UBYTE M_FORMULA_0003 0 0 0 255 ECU_ADDRESS 0x3F86D8 /end MEASUREMENT
/begin MEASUREMENT tz_min_b1 "minimal zulaessiger Zuendwinkel [RAM name from V530, voted 5]" SWORD M_FORMULA_0102 0 0 -3276.8 3276.7 ECU_ADDRESS 0x3FD98C /end MEASUREMENT
/begin MEASUREMENT tz_min_b2 "minimal zulaessiger Zuendwinkel [RAM name from V530, voted 3]" SWORD M_FORMULA_0102 0 0 -3276.8 3276.7 ECU_ADDRESS 0x3FD98E /end MEASUREMENT
/begin MEASUREMENT kh_van_fakt_kf_Einlass "Gewichtungsfaktor Kennfeld-KH [RAM name from V530, voted 5]" UWORD M_FORMULA_0199 0 0 0 3.999938965 ECU_ADDRESS 0x3F86E2 /end MEASUREMENT
/begin MEASUREMENT kh_van_fakt_kf_Auslass "Gewichtungsfaktor Kennfeld-KH [RAM name from V530, voted 1]" UWORD M_FORMULA_0199 0 0 0 3.999938965 ECU_ADDRESS 0x3F86E4 /end MEASUREMENT
/begin MEASUREMENT kh_st "Katheizstatus Aktiv bzw. Inaktiv [RAM name from V530, voted 8]" UWORD NO_COMPU_METHOD 0 0 0 65535 ECU_ADDRESS 0x3F86E6 FORMAT "%.4g" /end MEASUREMENT
/begin MEASUREMENT kh_st_ed "KH Sperrstatus wegen ED(Fehlermatrix) [RAM name from V530, voted 8]" UWORD NO_COMPU_METHOD 0 0 0 65535 ECU_ADDRESS 0x3F86E6 FORMAT "%.4g" /end MEASUREMENT
/begin MEASUREMENT kh_st_eingriff "aktive, KH Eingriffe [RAM name from V530, voted 8]" UWORD NO_COMPU_METHOD 0 0 0 65535 ECU_ADDRESS 0x3F86E6 FORMAT "%.4g" /end MEASUREMENT
/begin MEASUREMENT kh_st_n "KH Sperrstatus wegen Drehzahlschwelle [RAM name from V530, voted 8]" UWORD NO_COMPU_METHOD 0 0 0 65535 ECU_ADDRESS 0x3F86E6 FORMAT "%.4g" /end MEASUREMENT
/begin MEASUREMENT kh_st_pksrpl "KH Sperrstatus wegen pksr PL [RAM name from V530, voted 8]" UWORD NO_COMPU_METHOD 0 0 0 65535 ECU_ADDRESS 0x3F86E6 FORMAT "%.4g" /end MEASUREMENT
/begin MEASUREMENT kh_st_pumg "KH Sperrstatus wegen pumg [RAM name from V530, voted 8]" UWORD NO_COMPU_METHOD 0 0 0 65535 ECU_ADDRESS 0x3F86E6 FORMAT "%.4g" /end MEASUREMENT
/begin MEASUREMENT kh_st_rf "KH Sperrstatus wegen rf-Schwelle [RAM name from V530, voted 8]" UWORD NO_COMPU_METHOD 0 0 0 65535 ECU_ADDRESS 0x3F86E6 FORMAT "%.4g" /end MEASUREMENT
/begin MEASUREMENT kh_st_sk "KH Sperrstatus wegen SK [RAM name from V530, voted 8]" UWORD NO_COMPU_METHOD 0 0 0 65535 ECU_ADDRESS 0x3F86E6 FORMAT "%.4g" /end MEASUREMENT
/begin MEASUREMENT kh_st_sl "KH Sperrstatus SL [RAM name from V530, voted 8]" UWORD NO_COMPU_METHOD 0 0 0 65535 ECU_ADDRESS 0x3F86E6 FORMAT "%.4g" /end MEASUREMENT
/begin MEASUREMENT kh_st_smg "KH BIT fuer SMG [RAM name from V530, voted 8]" UWORD NO_COMPU_METHOD 0 0 0 65535 ECU_ADDRESS 0x3F86E6 FORMAT "%.4g" /end MEASUREMENT
/begin MEASUREMENT kh_st_t_ml "KH Sperrstatus wegen Zeit seit Motor laeuft [RAM name from V530, voted 8]" UWORD NO_COMPU_METHOD 0 0 0 65535 ECU_ADDRESS 0x3F86E6 FORMAT "%.4g" /end MEASUREMENT
/begin MEASUREMENT kh_st_tan "KH Sperrstatus wegen tan [RAM name from V530, voted 8]" UWORD NO_COMPU_METHOD 0 0 0 65535 ECU_ADDRESS 0x3F86E6 FORMAT "%.4g" /end MEASUREMENT
/begin MEASUREMENT kh_st_tkat "KH Sperrstatus wegen tkat [RAM name from V530, voted 8]" UWORD NO_COMPU_METHOD 0 0 0 65535 ECU_ADDRESS 0x3F86E6 FORMAT "%.4g" /end MEASUREMENT
/begin MEASUREMENT kh_st_tkat_zyklus "KH Zyklusflag fuer TKAT Schwelle erreicht [RAM name from V530, voted 8]" UWORD NO_COMPU_METHOD 0 0 0 65535 ECU_ADDRESS 0x3F86E6 FORMAT "%.4g" /end MEASUREMENT
/begin MEASUREMENT kh_st_van "KH Sperrstatus, Vanos Katheizen [RAM name from V530, voted 8]" UWORD NO_COMPU_METHOD 0 0 0 65535 ECU_ADDRESS 0x3F86E6 FORMAT "%.4g" /end MEASUREMENT
/begin MEASUREMENT kh_st_vtkat "KH Sperrstatus wegen v [RAM name from V530, voted 8]" UWORD NO_COMPU_METHOD 0 0 0 65535 ECU_ADDRESS 0x3F86E6 FORMAT "%.4g" /end MEASUREMENT
/begin MEASUREMENT kh_st_vtkat_zyklus "KH Zyklusflag fuer v ungleich 0 und TKAT erreicht [RAM name from V530, voted 8]" UWORD NO_COMPU_METHOD 0 0 0 65535 ECU_ADDRESS 0x3F86E6 FORMAT "%.4g" /end MEASUREMENT
/begin MEASUREMENT kh_st_xx "Alle Statusflags vom kh_st [RAM name from V530, voted 8]" UWORD M_FORMULA_0010 0 0 0 65535 ECU_ADDRESS 0x3F86E6 /end MEASUREMENT
/begin MEASUREMENT smg_st_dme "DME-Status [RAM name from V530, voted 33]" UBYTE NO_COMPU_METHOD 0 0 0 255 ECU_ADDRESS 0x3F86E9 FORMAT "%.4g" /end MEASUREMENT
/begin MEASUREMENT smg_schaltart "Schaltart [RAM name from V530, voted 58]" UWORD M_FORMULA_0010 0 0 0 65535 ECU_ADDRESS 0x3F86EA /end MEASUREMENT
/begin MEASUREMENT smg_schaltart_aks "Schaltart (AKS) [RAM name from V530, voted 58]" UWORD NO_COMPU_METHOD 0 0 0 65535 ECU_ADDRESS 0x3F86EA FORMAT "%.4g" /end MEASUREMENT
/begin MEASUREMENT smg_schaltart_automat "Schaltart (Automat) [RAM name from V530, voted 58]" UWORD NO_COMPU_METHOD 0 0 0 65535 ECU_ADDRESS 0x3F86EA FORMAT "%.4g" /end MEASUREMENT
/begin MEASUREMENT smg_schaltart_eingr "Schaltart (Eingriff) [RAM name from V530, voted 58]" UWORD NO_COMPU_METHOD 0 0 0 65535 ECU_ADDRESS 0x3F86EA FORMAT "%.4g" /end MEASUREMENT
/begin MEASUREMENT smg_schaltart_hr "Schaltart (Zug-Schub-Hoch) [RAM name from V530, voted 58]" UWORD NO_COMPU_METHOD 0 0 0 65535 ECU_ADDRESS 0x3F86EA FORMAT "%.4g" /end MEASUREMENT
/begin MEASUREMENT smg_schaltart_lw "Schaltart (Lastwechsel) [RAM name from V530, voted 58]" UWORD NO_COMPU_METHOD 0 0 0 65535 ECU_ADDRESS 0x3F86EA FORMAT "%.4g" /end MEASUREMENT
/begin MEASUREMENT smg_schaltart_rs "Schaltart (Rennstart) [RAM name from V530, voted 58]" UWORD NO_COMPU_METHOD 0 0 0 65535 ECU_ADDRESS 0x3F86EA FORMAT "%.4g" /end MEASUREMENT
/begin MEASUREMENT smg_schaltart_zs "Schaltart (Zug-Schub-Hoch) [RAM name from V530, voted 58]" UWORD NO_COMPU_METHOD 0 0 0 65535 ECU_ADDRESS 0x3F86EA FORMAT "%.4g" /end MEASUREMENT
/begin MEASUREMENT smg_n_getr_anschluss "gerechnete Ziel-Drehzahl am Getriebeeingang im naechsten Gang [RAM name from V530, voted 1]" SWORD M_FORMULA_0006 0 0 -32768 32767 ECU_ADDRESS 0x3F86EC /end MEASUREMENT
/begin MEASUREMENT smg_t_abregel "Abregelzeit [RAM name from V530, voted 14]" UBYTE M_FORMULA_0306 0 0 0 2.55 ECU_ADDRESS 0x3F86EE /end MEASUREMENT
/begin MEASUREMENT smg_t_aufregel "Aufregelzeit [RAM name from V530, voted 12]" UBYTE M_FORMULA_0306 0 0 0 2.55 ECU_ADDRESS 0x3F86EF /end MEASUREMENT
/begin MEASUREMENT smg_sk_mode "SK-Mode SMG [RAM name from V530, voted 8]" UBYTE NO_COMPU_METHOD 0 0 0 255 ECU_ADDRESS 0x3F86F0 FORMAT "%.4g" /end MEASUREMENT
/begin MEASUREMENT md_sk_mode "SK-Mode Momentenmanager [RAM name from V530, voted 4]" UBYTE NO_COMPU_METHOD 0 0 0 255 ECU_ADDRESS 0x3F86F1 FORMAT "%.4g" /end MEASUREMENT
/begin MEASUREMENT gang_n_verh "Getriebeeingangsdrehzahl / Getriebeabtriebsdrehzahl [RAM name from V530, voted 2]" SWORD M_FORMULA_0073 0 0 -32 31.99902344 ECU_ADDRESS 0x3F86F2 /end MEASUREMENT
/begin MEASUREMENT gang_berech "berechneter Gang inkl. R und N [RAM name from V530, voted 3]" SBYTE M_FORMULA_0135 0 0 -128 127 ECU_ADDRESS 0x3F86F4 /end MEASUREMENT
/begin MEASUREMENT gang_berech_st "Status berechneter Gang [RAM name from V530, voted 13]" UWORD M_FORMULA_0080 0 0 0 65535 ECU_ADDRESS 0x3F86F6 /end MEASUREMENT
/begin MEASUREMENT gang_berech_st_aktion "Aktion am Schalthebel [RAM name from V530, voted 13]" UWORD NO_COMPU_METHOD 0 0 0 65535 ECU_ADDRESS 0x3F86F6 FORMAT "%.4g" /end MEASUREMENT
/begin MEASUREMENT gang_berech_st_gerade "berechneter Gang gerade [RAM name from V530, voted 13]" UWORD NO_COMPU_METHOD 0 0 0 65535 ECU_ADDRESS 0x3F86F6 FORMAT "%.4g" /end MEASUREMENT
/begin MEASUREMENT gang_berech_st_neu "Gang neu berechnen [RAM name from V530, voted 13]" UWORD NO_COMPU_METHOD 0 0 0 65535 ECU_ADDRESS 0x3F86F6 FORMAT "%.4g" /end MEASUREMENT
/begin MEASUREMENT gang_berech_st_plaus "berechneter Gang plausibel [RAM name from V530, voted 13]" UWORD NO_COMPU_METHOD 0 0 0 65535 ECU_ADDRESS 0x3F86F6 FORMAT "%.4g" /end MEASUREMENT
/begin MEASUREMENT gang_berech_st_uebern "Gang neu berechnen [RAM name from V530, voted 13]" UWORD NO_COMPU_METHOD 0 0 0 65535 ECU_ADDRESS 0x3F86F6 FORMAT "%.4g" /end MEASUREMENT
/begin MEASUREMENT gang_berech_st_unbek "berechneter Gang unbekannt [RAM name from V530, voted 13]" UWORD NO_COMPU_METHOD 0 0 0 65535 ECU_ADDRESS 0x3F86F6 FORMAT "%.4g" /end MEASUREMENT
/begin MEASUREMENT gang_berech_st_ungerade "berechneter Gang ungerade [RAM name from V530, voted 13]" UWORD NO_COMPU_METHOD 0 0 0 65535 ECU_ADDRESS 0x3F86F6 FORMAT "%.4g" /end MEASUREMENT
/begin MEASUREMENT gang_berech_kl_i "Getriebeuebersetzungsverhaeltnis aus Kennlinie [RAM name from V530, voted 5]" SWORD M_FORMULA_0073 0 0 -32 31.99902344 ECU_ADDRESS 0x3F86F8 /end MEASUREMENT
/begin MEASUREMENT gang_berech_kl_i_dist "Abstand Getriebeuebersetzungsverhaeltnis naechster Gang [RAM name from V530, voted 1]" SWORD M_FORMULA_0073 0 0 -32 31.99902344 ECU_ADDRESS 0x3F86FA /end MEASUREMENT
/begin MEASUREMENT gang "Gang [RAM name from V530, voted 45]" SBYTE M_FORMULA_0135 0 0 -128 127 ECU_ADDRESS 0x3F86FC /end MEASUREMENT
/begin MEASUREMENT gang_ks "Gang mit Kraftschluss [RAM name from V530, voted 1]" SBYTE M_FORMULA_0135 0 0 -128 127 ECU_ADDRESS 0x3F86FD /end MEASUREMENT
/begin MEASUREMENT gang_can "Gang CAN Botschaftswert fuer Kombi [RAM name from V530, voted 2]" SBYTE M_FORMULA_0135 0 0 -128 127 ECU_ADDRESS 0x3F86FE /end MEASUREMENT
/begin MEASUREMENT egas_sk_mode "SK-Mode Egas [RAM name from V530, voted 23]" UBYTE NO_COMPU_METHOD 0 0 0 255 ECU_ADDRESS 0x3F86FF FORMAT "%.4g" /end MEASUREMENT
/begin MEASUREMENT sk_egas_off_ign "SK-Egasstufe [RAM name from V530, voted 7]" UBYTE NO_COMPU_METHOD 0 0 0 255 ECU_ADDRESS 0x3F8700 FORMAT "%.4g" /end MEASUREMENT
/begin MEASUREMENT sk_md_begr_ign "SK-Begrenzungsstufe [RAM name from V530, voted 4]" UBYTE NO_COMPU_METHOD 0 0 0 255 ECU_ADDRESS 0x3F8701 FORMAT "%.4g" /end MEASUREMENT
/begin MEASUREMENT sk_md_eingr_ign "SK-Md-Eingriff [RAM name from V530, voted 6]" UBYTE M_FORMULA_0003 0 0 0 255 ECU_ADDRESS 0x3F8702 /end MEASUREMENT
/begin MEASUREMENT sk_ti_eingr_ign "SK-TI-Eingriff [RAM name from V530, voted 6]" UBYTE NO_COMPU_METHOD 0 0 0 255 ECU_ADDRESS 0x3F8702 FORMAT "%.4g" /end MEASUREMENT
/begin MEASUREMENT sk_tz_eingr_ign "SK-TZ-Eingriff [RAM name from V530, voted 6]" UBYTE NO_COMPU_METHOD 0 0 0 255 ECU_ADDRESS 0x3F8702 FORMAT "%.4g" /end MEASUREMENT
/begin MEASUREMENT sk_lam_st_ign_b1 "SK-LAM-Eingriff [RAM name from V530, voted 1]" UBYTE NO_COMPU_METHOD 0 0 0 255 ECU_ADDRESS 0x3F8703 FORMAT "%.4g" /end MEASUREMENT
/begin MEASUREMENT sk_lam_st_ign_b2 "SK-LAM-Eingriff [RAM name from V530, voted 1]" UBYTE NO_COMPU_METHOD 0 0 0 255 ECU_ADDRESS 0x3F8703 FORMAT "%.4g" /end MEASUREMENT
/begin MEASUREMENT sk_van_st_ign "SK-Vanos-Eingriff [RAM name from V530, voted 1]" UBYTE NO_COMPU_METHOD 0 0 0 255 ECU_ADDRESS 0x3F8704 FORMAT "%.4g" /end MEASUREMENT
/begin MEASUREMENT sk_eingr_st_ign "SK-Eingriff [RAM name from V530, voted 3]" UBYTE M_FORMULA_0003 0 0 0 255 ECU_ADDRESS 0x3F8705 /end MEASUREMENT
/begin MEASUREMENT sk_fr_st_ign "SK-Eingriff FR [RAM name from V530, voted 3]" UBYTE NO_COMPU_METHOD 0 0 0 255 ECU_ADDRESS 0x3F8705 FORMAT "%.4g" /end MEASUREMENT
/begin MEASUREMENT sk_fra_st_ign "SK-Eingriff FRA [RAM name from V530, voted 3]" UBYTE NO_COMPU_METHOD 0 0 0 255 ECU_ADDRESS 0x3F8705 FORMAT "%.4g" /end MEASUREMENT
/begin MEASUREMENT sk_kh_st_ign "SK-Eingriff KH [RAM name from V530, voted 3]" UBYTE NO_COMPU_METHOD 0 0 0 255 ECU_ADDRESS 0x3F8705 FORMAT "%.4g" /end MEASUREMENT
/begin MEASUREMENT sk_llra_st_ign "SK-Eingriff LLRA [RAM name from V530, voted 3]" UBYTE NO_COMPU_METHOD 0 0 0 255 ECU_ADDRESS 0x3F8705 FORMAT "%.4g" /end MEASUREMENT
/begin MEASUREMENT sk_mzyl_st_ign "SK-Eingriff MZYL [RAM name from V530, voted 3]" UBYTE NO_COMPU_METHOD 0 0 0 255 ECU_ADDRESS 0x3F8705 FORMAT "%.4g" /end MEASUREMENT
/begin MEASUREMENT sk_pks_st_ign "SK-Eingriff PKS [RAM name from V530, voted 3]" UBYTE NO_COMPU_METHOD 0 0 0 255 ECU_ADDRESS 0x3F8705 FORMAT "%.4g" /end MEASUREMENT
/begin MEASUREMENT sk_ti_zyl_off_ign "SK-Ausblendungen [RAM name from V530, voted 1]" UWORD NO_COMPU_METHOD 0 0 0 65535 ECU_ADDRESS 0x3F8706 FORMAT "%.4g" /end MEASUREMENT
/begin MEASUREMENT fgr_status_kombi "FGR Status zum Kombi [RAM name from V530, voted 2]" UBYTE NO_COMPU_METHOD 0 0 0 255 ECU_ADDRESS 0x3F8708 FORMAT "%.4g" /end MEASUREMENT
/begin MEASUREMENT fgr_status_hud "FGR Status HUD [RAM name from V530, voted 6]" UBYTE NO_COMPU_METHOD 0 0 0 255 ECU_ADDRESS 0x3F870A FORMAT "%.4g" /end MEASUREMENT
/begin MEASUREMENT fgr_v_kombi "FGR Geschwindigkeit zum Kombi [RAM name from V530, voted 2]" SWORD M_FORMULA_0317 0 0 -3276.8 3276.7 ECU_ADDRESS 0x3F870C /end MEASUREMENT
/begin MEASUREMENT fgr_status "Fgr Status [RAM name from V530, voted 16]" UBYTE NO_COMPU_METHOD 0 0 0 255 ECU_ADDRESS 0x3F870E FORMAT "%.4g" /end MEASUREMENT
/begin MEASUREMENT fgr_sa_sperre "Fgr SA Sperre [RAM name from V530, voted 3]" UBYTE NO_COMPU_METHOD 0 0 0 255 ECU_ADDRESS 0x3F870F FORMAT "%.4g" /end MEASUREMENT
/begin MEASUREMENT sk_tr_resp "Beantwortete Testrechnung vom IGN [RAM name from V530, voted 4]" UBYTE M_FORMULA_0003 0 0 0 255 ECU_ADDRESS 0x3F8710 /end MEASUREMENT
/begin MEASUREMENT sk_tr_result "Ergebnis vom IGN [RAM name from V530, voted 4]" UWORD M_FORMULA_0010 0 0 0 65535 ECU_ADDRESS 0x3F8712 /end MEASUREMENT
/begin MEASUREMENT md_sk_ti_st "Freigabemaske fuer Einspritzkanaele [RAM name from V530, voted 1]" UWORD M_FORMULA_0010 0 0 0 65535 ECU_ADDRESS 0x3F8714 /end MEASUREMENT
/begin MEASUREMENT n_e2 "Motordrehzahl der Ebene 2. [RAM name from V530, voted 26]" SWORD M_FORMULA_0006 0 0 -32768 32767 ECU_ADDRESS 0x3F8716 /end MEASUREMENT
/begin MEASUREMENT fr_einger_st "Status FR eingeregelt [RAM name from V530, voted 2]" UBYTE NO_COMPU_METHOD 0 0 0 255 ECU_ADDRESS 0x3F8718 FORMAT "%.4g" /end MEASUREMENT
/begin MEASUREMENT fr_ramp_st "diverse Aktivierung Bits fuer Fr-Rampen [RAM name from V530, voted 6]" ULONG M_FORMULA_0000 0 0 0 4294967295 ECU_ADDRESS 0x3F871C /end MEASUREMENT
/begin MEASUREMENT fr_ramp_st.aq_grad "Aktivierung fuer FR-Abrampen aus aq_grad [RAM name from V530, voted 6]" ULONG NO_COMPU_METHOD 0 0 0 4294967295 ECU_ADDRESS 0x3F871C FORMAT "%.4g" /end MEASUREMENT
/begin MEASUREMENT fr_ramp_st.dkfail "Aktivierung fuer FR-Abrampen aus dkfail [RAM name from V530, voted 6]" ULONG NO_COMPU_METHOD 0 0 0 4294967295 ECU_ADDRESS 0x3F871C FORMAT "%.4g" /end MEASUREMENT
/begin MEASUREMENT fr_ramp_st.egasdif "Aktivierung fuer FR-Abrampen aus egasdif [RAM name from V530, voted 6]" ULONG NO_COMPU_METHOD 0 0 0 4294967295 ECU_ADDRESS 0x3F871C FORMAT "%.4g" /end MEASUREMENT
/begin MEASUREMENT fr_ramp_st.lamreg_off "Aktivierung fuer FR-Abrampen aus lamreg [RAM name from V530, voted 6]" ULONG NO_COMPU_METHOD 0 0 0 4294967295 ECU_ADDRESS 0x3F871C FORMAT "%.4g" /end MEASUREMENT
/begin MEASUREMENT fr_ramp_st.llsfail "Aktivierung fuer FR-Abrampen aus llsfail [RAM name from V530, voted 6]" ULONG NO_COMPU_METHOD 0 0 0 4294967295 ECU_ADDRESS 0x3F871C FORMAT "%.4g" /end MEASUREMENT
/begin MEASUREMENT fr_ramp_st.pumgmax "Aktivierung fuer FR-Abrampen aus pumgmax [RAM name from V530, voted 6]" ULONG NO_COMPU_METHOD 0 0 0 4294967295 ECU_ADDRESS 0x3F871C FORMAT "%.4g" /end MEASUREMENT
/begin MEASUREMENT fr_ramp_st.pumgmin "Aktivierung fuer FR-Abrampen aus pumgmin [RAM name from V530, voted 6]" ULONG NO_COMPU_METHOD 0 0 0 4294967295 ECU_ADDRESS 0x3F871C FORMAT "%.4g" /end MEASUREMENT
/begin MEASUREMENT fr_ramp_st.rfmax "Aktivierung fuer FR-Abrampen aus md_rf_soll_max [RAM name from V530, voted 6]" ULONG NO_COMPU_METHOD 0 0 0 4294967295 ECU_ADDRESS 0x3F871C FORMAT "%.4g" /end MEASUREMENT
/begin MEASUREMENT fr_ramp_st.sasb "Aktivierung fuer FR-Abrampen aus SA bzw. SB [RAM name from V530, voted 6]" ULONG NO_COMPU_METHOD 0 0 0 4294967295 ECU_ADDRESS 0x3F871C FORMAT "%.4g" /end MEASUREMENT
/begin MEASUREMENT fr_ramp_st.start_delay "Aktivierung fuer FR-Abrampen aus Start-Delay [RAM name from V530, voted 6]" ULONG NO_COMPU_METHOD 0 0 0 4294967295 ECU_ADDRESS 0x3F871C FORMAT "%.4g" /end MEASUREMENT
/begin MEASUREMENT fr_ramp_st.tanmax "Aktivierung fuer FR-Abrampen aus tanmax [RAM name from V530, voted 6]" ULONG NO_COMPU_METHOD 0 0 0 4294967295 ECU_ADDRESS 0x3F871C FORMAT "%.4g" /end MEASUREMENT
/begin MEASUREMENT fr_ramp_st.tanmin "Aktivierung fuer FR-Abrampen aus tanmin [RAM name from V530, voted 6]" ULONG NO_COMPU_METHOD 0 0 0 4294967295 ECU_ADDRESS 0x3F871C FORMAT "%.4g" /end MEASUREMENT
/begin MEASUREMENT fr_ramp_st.te_c_akf "Aktivierung fuer FR-Abrampen aus te_c_akf [RAM name from V530, voted 6]" ULONG NO_COMPU_METHOD 0 0 0 4294967295 ECU_ADDRESS 0x3F871C FORMAT "%.4g" /end MEASUREMENT
/begin MEASUREMENT fr_ramp_st.te_mvac "Aktivierung fuer FR-Abrampen aus te_mvac [RAM name from V530, voted 6]" ULONG NO_COMPU_METHOD 0 0 0 4294967295 ECU_ADDRESS 0x3F871C FORMAT "%.4g" /end MEASUREMENT
/begin MEASUREMENT fr_ramp_st.tevc_on "Aktivierung fuer FR-Abrampen aus tevcheck [RAM name from V530, voted 6]" ULONG NO_COMPU_METHOD 0 0 0 4294967295 ECU_ADDRESS 0x3F871C FORMAT "%.4g" /end MEASUREMENT
/begin MEASUREMENT fr_ramp_st.tkasmmin "Aktivierung fuer FR-Abrampen aus tksmmin [RAM name from V530, voted 6]" ULONG NO_COMPU_METHOD 0 0 0 4294967295 ECU_ADDRESS 0x3F871C FORMAT "%.4g" /end MEASUREMENT
/begin MEASUREMENT fr_ramp_st.tksmmax "Aktivierung fuer FR-Abrampen aus tksmmax [RAM name from V530, voted 6]" ULONG NO_COMPU_METHOD 0 0 0 4294967295 ECU_ADDRESS 0x3F871C FORMAT "%.4g" /end MEASUREMENT
/begin MEASUREMENT fr_ramp_st.tmotmax "Aktivierung fuer FR-Abrampen aus tmotmax [RAM name from V530, voted 6]" ULONG NO_COMPU_METHOD 0 0 0 4294967295 ECU_ADDRESS 0x3F871C FORMAT "%.4g" /end MEASUREMENT
/begin MEASUREMENT fr_ramp_st.tmotmin "Aktivierung fuer FR-Abrampen aus tmotmin [RAM name from V530, voted 6]" ULONG NO_COMPU_METHOD 0 0 0 4294967295 ECU_ADDRESS 0x3F871C FORMAT "%.4g" /end MEASUREMENT
/begin MEASUREMENT fr_ramp_st.zust_ml "Aktivierung fuer FR-Abrampen aus ZUST_ML [RAM name from V530, voted 6]" ULONG NO_COMPU_METHOD 0 0 0 4294967295 ECU_ADDRESS 0x3F871C FORMAT "%.4g" /end MEASUREMENT
/begin MEASUREMENT tmot_abstell_nv "Abstelltemperatur des Motors [RAM name from V530, voted 7]" SWORD M_FORMULA_0023 0 0 -3550 3003.5 ECU_ADDRESS 0x3F872C /end MEASUREMENT
/begin MEASUREMENT tabg_nkat_b2 "Abgastemperatur nach dem Kat [RAM name from V530, voted 1]" SWORD M_FORMULA_0023 0 0 -3550 3003.5 ECU_ADDRESS 0x3F874C /end MEASUREMENT
/begin MEASUREMENT tabg_lw_verh_b1 "Verhaeltnis der Ladungswechseltemperaturen [RAM name from V530, voted 1]" UWORD M_FORMULA_0073 0 0 0 63.99902344 ECU_ADDRESS 0x3F8752 /end MEASUREMENT
/begin MEASUREMENT tan_b1 "Ansauglufttemperatur [RAM name from V530, voted 5]" SWORD M_FORMULA_0023 0 0 -3550 3003.5 ECU_ADDRESS 0x3F875C /end MEASUREMENT
/begin MEASUREMENT tan_mw "Mittelwert der Ansauglufttemperatur [RAM name from V530, voted 4]" SWORD M_FORMULA_0023 0 0 -3550 3003.5 ECU_ADDRESS 0x3F8760 /end MEASUREMENT
/begin MEASUREMENT tdme "Steuergeraetetemperatur [RAM name from V530, voted 7]" SWORD M_FORMULA_0023 0 0 -3550 3003.5 ECU_ADDRESS 0x3F8762 /end MEASUREMENT
/begin MEASUREMENT tmot "Motortemperatur-Kuehlwasser [RAM name from V530, voted 47]" SWORD M_FORMULA_0023 0 0 -3550 3003.5 ECU_ADDRESS 0x3F8764 /end MEASUREMENT
/begin MEASUREMENT tmot_modell "OBD-Modelltemperatur [RAM name from V530, voted 4]" SLONG M_FORMULA_0343 0 0 -209988.35 209442.0499 ECU_ADDRESS 0x3F8768 /end MEASUREMENT
/begin MEASUREMENT tmot_sta "Status Uebertemperaturanzeige [RAM name from V530, voted 18]" UBYTE NO_COMPU_METHOD 0 0 0 255 ECU_ADDRESS 0x3F876C FORMAT "%.4g" /end MEASUREMENT
/begin MEASUREMENT tmot_sta_zws "Status Zwangsschaltung [RAM name from V530, voted 18]" UBYTE NO_COMPU_METHOD 0 0 0 255 ECU_ADDRESS 0x3F876C FORMAT "%.4g" /end MEASUREMENT
/begin MEASUREMENT toel "Temperatur am Oelfilterkopf [RAM name from V530, voted 17]" SWORD M_FORMULA_0023 0 0 -3550 3003.5 ECU_ADDRESS 0x3F8770 /end MEASUREMENT
/begin MEASUREMENT tsgrw_m "Mittelwert Saugrohrwandtemperatur [RAM name from V530, voted 2]" SWORD M_FORMULA_0023 0 0 -3550 3003.5 ECU_ADDRESS 0x3F8774 /end MEASUREMENT
/begin MEASUREMENT tsgrw_b1 "Saugrohrwandtemperatur [RAM name from V530, voted 3]" SWORD M_FORMULA_0023 0 0 -3550 3003.5 ECU_ADDRESS 0x3F8776 /end MEASUREMENT
/begin MEASUREMENT tsgrw_b2 "Saugrohrwandtemperatur [RAM name from V530, voted 1]" SWORD M_FORMULA_0023 0 0 -3550 3003.5 ECU_ADDRESS 0x3F8778 /end MEASUREMENT
/begin MEASUREMENT tumg_ersatz "Ersatzwert der Umgebungstemperatur [RAM name from V530, voted 1]" SWORD M_FORMULA_0023 0 0 -3550 3003.5 ECU_ADDRESS 0x3F877A /end MEASUREMENT
/begin MEASUREMENT llr_n_soll "Leerlaufdrehzahl [RAM name from V530, voted 16]" SWORD M_FORMULA_0006 0 0 -32768 32767 ECU_ADDRESS 0x3F877C /end MEASUREMENT
/begin MEASUREMENT kw_diag "AD-Wert Kurbelwellendiagnose [RAM name from V530, voted 1]" SWORD M_FORMULA_0114 0 0 -32768 32767 ECU_ADDRESS 0x3F8788 /end MEASUREMENT
/begin MEASUREMENT start_rl_diag_dpr "Bestaetigung der Treiberinfo [RAM name from V530, voted 3]" UBYTE M_FORMULA_0003 0 0 0 255 ECU_ADDRESS 0x3F8798 /end MEASUREMENT
/begin MEASUREMENT md_kupp_max "Maximalmoment an der Kupplung [RAM name from V530, voted 5]" SWORD M_FORMULA_0009 0 0 -3276.8 3276.7 ECU_ADDRESS 0x3F879A /end MEASUREMENT
/begin MEASUREMENT md_kupp_max_can "CAN-Maximalmoment an der Kupplung [RAM name from V530, voted 3]" SWORD M_FORMULA_0009 0 0 -3276.8 3276.7 ECU_ADDRESS 0x3F879C /end MEASUREMENT
/begin MEASUREMENT md_ind_schlepp_ist "Schleppmoment (aktuell) [RAM name from V530, voted 12]" SWORD M_FORMULA_0009 0 0 -3276.8 3276.7 ECU_ADDRESS 0x3F879E /end MEASUREMENT
/begin MEASUREMENT md_ind_schlepp_min "Schleppmoment bei MIN [RAM name from V530, voted 1]" SWORD M_FORMULA_0009 0 0 -3276.8 3276.7 ECU_ADDRESS 0x3F87A0 /end MEASUREMENT
/begin MEASUREMENT md_rf_max "rf_max mit pt-Korr [RAM name from V530, voted 1]" SWORD M_FORMULA_0007 0 0 -3.2768 3.2767 ECU_ADDRESS 0x3F87A4 /end MEASUREMENT
/begin MEASUREMENT md_rf_max_roh "rf_max [RAM name from V530, voted 1]" SWORD M_FORMULA_0007 0 0 -3.2768 3.2767 ECU_ADDRESS 0x3F87A6 /end MEASUREMENT
/begin MEASUREMENT md_rf_min_pt "rf_min mit Komp. [RAM name from V530, voted 2]" SWORD M_FORMULA_0007 0 0 -3.2768 3.2767 ECU_ADDRESS 0x3F87A8 /end MEASUREMENT
/begin MEASUREMENT auss_obd_zyl_off "Abgeschaltene Zylinder. [RAM name from V530, voted 1]" UWORD NO_COMPU_METHOD 0 0 0 65535 ECU_ADDRESS 0x3F87B0 FORMAT "%.4g" /end MEASUREMENT
/begin MEASUREMENT ccp_fp_st_ign "Status CCP-FP [RAM name from V530, voted 8]" UBYTE NO_COMPU_METHOD 0 0 0 255 ECU_ADDRESS 0x3F87B2 FORMAT "%.4g" /end MEASUREMENT
/begin MEASUREMENT kwp_fp_st_ign "Status KWP-FP [RAM name from V530, voted 5]" UBYTE M_FORMULA_0003 0 0 0 255 ECU_ADDRESS 0x3F87B3 /end MEASUREMENT
/begin MEASUREMENT egas_rec_dk_r_hw_vers_b1 "HW-Version [RAM name from V530, voted 2]" UWORD M_FORMULA_0010 0 0 0 65535 ECU_ADDRESS 0x3F87B4 /end MEASUREMENT
/begin MEASUREMENT egas_rec_dk_r_hw_vers_b2 "HW-Version [RAM name from V530, voted 1]" UWORD M_FORMULA_0010 0 0 0 65535 ECU_ADDRESS 0x3F87B6 /end MEASUREMENT
/begin MEASUREMENT pks_can_st "Empfangsstatus PKS [RAM name from V530, voted 5]" UWORD NO_COMPU_METHOD 0 0 0 65535 ECU_ADDRESS 0x3F87B8 FORMAT "%.4g" /end MEASUREMENT
/begin MEASUREMENT pks_can_n "PKS-Drehzahl [RAM name from V530, voted 2]" SWORD M_FORMULA_0006 0 0 -32768 32767 ECU_ADDRESS 0x3F87BA /end MEASUREMENT
/begin MEASUREMENT pks_can_diag_st "PKS-Diagnosestatus [RAM name from V530, voted 2]" UBYTE M_FORMULA_0003 0 0 0 255 ECU_ADDRESS 0x3F87BC /end MEASUREMENT
/begin MEASUREMENT pks_can_u_kl30 "PKS-Klemme 30 [RAM name from V530, voted 2]" UBYTE M_FORMULA_0348 0 0 0 25.5 ECU_ADDRESS 0x3F87BD /end MEASUREMENT
/begin MEASUREMENT pks_can_i "PKS-Strom [RAM name from V530, voted 2]" UBYTE M_FORMULA_0349 0 0 0 25.5 ECU_ADDRESS 0x3F87BE /end MEASUREMENT
/begin MEASUREMENT k2KB_resp_ign "KWP [RAM name from V530, voted 4]" UBYTE NO_COMPU_METHOD 0 0 0 255 ECU_ADDRESS 0x3F87C4 FORMAT "%.4g" /end MEASUREMENT
/begin MEASUREMENT k2KB_sid_ign "KWP [RAM name from V530, voted 2]" UBYTE M_FORMULA_0003 0 0 0 255 ECU_ADDRESS 0x3F87C5 /end MEASUREMENT
/begin MEASUREMENT k2KB_bytes_ign "KWP [RAM name from V530, voted 2]" UWORD M_FORMULA_0010 0 0 0 65535 ECU_ADDRESS 0x3F87C6 /end MEASUREMENT
/begin MEASUREMENT lam_soll_b1 "ausgegebenes SOLL-Lambda [RAM name from V530, voted 3]" UWORD M_FORMULA_0025 0 0 0 3.999938965 ECU_ADDRESS 0x3F8860 /end MEASUREMENT
/begin MEASUREMENT lam_soll_b2 "ausgegebenes SOLL-Lambda [RAM name from V530, voted 1]" UWORD M_FORMULA_0025 0 0 0 3.999938965 ECU_ADDRESS 0x3F8862 /end MEASUREMENT
/begin MEASUREMENT lam_reg_f_b1 "Regeleingriff [RAM name from V530, voted 2]" UWORD M_FORMULA_0024 0 0 0 1.999969482 ECU_ADDRESS 0x3F8864 /end MEASUREMENT
/begin MEASUREMENT lam_reg_f_b2 "Regeleingriff [RAM name from V530, voted 1]" UWORD M_FORMULA_0024 0 0 0 1.999969482 ECU_ADDRESS 0x3F8866 /end MEASUREMENT
/begin MEASUREMENT lam_reg_max_b1 "max. Reglereingriff [RAM name from V530, voted 3]" UWORD NO_COMPU_METHOD 0 0 0 65535 ECU_ADDRESS 0x3F8868 FORMAT "%.4g" /end MEASUREMENT
/begin MEASUREMENT lam_reg_min_b1 "min. Reglereingriff [RAM name from V530, voted 3]" UWORD NO_COMPU_METHOD 0 0 0 65535 ECU_ADDRESS 0x3F8868 FORMAT "%.4g" /end MEASUREMENT
/begin MEASUREMENT lam_reg_reset_sa_b1 "LA-Regler RESET - SA [RAM name from V530, voted 3]" UWORD NO_COMPU_METHOD 0 0 0 65535 ECU_ADDRESS 0x3F8868 FORMAT "%.4g" /end MEASUREMENT
/begin MEASUREMENT lam_reg_reset_slp_b1 "LA-Regler-RESET - SLP [RAM name from V530, voted 3]" UWORD NO_COMPU_METHOD 0 0 0 65535 ECU_ADDRESS 0x3F8868 FORMAT "%.4g" /end MEASUREMENT
/begin MEASUREMENT lam_reg_st_b1 "LA-Regler-Status [RAM name from V530, voted 3]" UWORD M_FORMULA_0080 0 0 0 65535 ECU_ADDRESS 0x3F8868 /end MEASUREMENT
/begin MEASUREMENT lam_reg_stat_b1 "LA-Regler Position [RAM name from V530, voted 3]" UWORD NO_COMPU_METHOD 0 0 0 65535 ECU_ADDRESS 0x3F8868 FORMAT "%.4g" /end MEASUREMENT
/begin MEASUREMENT lam_reg_stat_trim_b1 "LA-Regler Position fuer TRIM-Regelung [RAM name from V530, voted 3]" UWORD NO_COMPU_METHOD 0 0 0 65535 ECU_ADDRESS 0x3F8868 FORMAT "%.4g" /end MEASUREMENT
/begin MEASUREMENT lam_regler_st_b1 "LA-Regler-Status [RAM name from V530, voted 3]" UWORD NO_COMPU_METHOD 0 0 0 65535 ECU_ADDRESS 0x3F8868 FORMAT "%.4g" /end MEASUREMENT
/begin MEASUREMENT lam_ti_min_b1 "min. TI fuer LA-Regelung [RAM name from V530, voted 3]" UWORD NO_COMPU_METHOD 0 0 0 65535 ECU_ADDRESS 0x3F8868 FORMAT "%.4g" /end MEASUREMENT
/begin MEASUREMENT lam_wf_verz_b1 "WF-Verzoegerung [RAM name from V530, voted 3]" UWORD NO_COMPU_METHOD 0 0 0 65535 ECU_ADDRESS 0x3F8868 FORMAT "%.4g" /end MEASUREMENT
/begin MEASUREMENT lam_reg_max_b2 "max. Reglereingriff [RAM name from V530, voted 2]" UWORD NO_COMPU_METHOD 0 0 0 65535 ECU_ADDRESS 0x3F886A FORMAT "%.4g" /end MEASUREMENT
/begin MEASUREMENT lam_reg_min_b2 "min. Reglereingriff [RAM name from V530, voted 2]" UWORD NO_COMPU_METHOD 0 0 0 65535 ECU_ADDRESS 0x3F886A FORMAT "%.4g" /end MEASUREMENT
/begin MEASUREMENT lam_reg_reset_sa_b2 "LA-Regler RESET - SA [RAM name from V530, voted 2]" UWORD NO_COMPU_METHOD 0 0 0 65535 ECU_ADDRESS 0x3F886A FORMAT "%.4g" /end MEASUREMENT
/begin MEASUREMENT lam_reg_reset_slp_b2 "LA-Regler-RESET - SLP [RAM name from V530, voted 2]" UWORD NO_COMPU_METHOD 0 0 0 65535 ECU_ADDRESS 0x3F886A FORMAT "%.4g" /end MEASUREMENT
/begin MEASUREMENT lam_reg_st_b2 "LA-Regler-Status [RAM name from V530, voted 2]" UWORD M_FORMULA_0080 0 0 0 65535 ECU_ADDRESS 0x3F886A /end MEASUREMENT
/begin MEASUREMENT lam_reg_stat_b2 "LA-Regler Position [RAM name from V530, voted 2]" UWORD NO_COMPU_METHOD 0 0 0 65535 ECU_ADDRESS 0x3F886A FORMAT "%.4g" /end MEASUREMENT
/begin MEASUREMENT lam_reg_stat_trim_b2 "LA-Regler Position fuer TRIM-Regelung [RAM name from V530, voted 2]" UWORD NO_COMPU_METHOD 0 0 0 65535 ECU_ADDRESS 0x3F886A FORMAT "%.4g" /end MEASUREMENT
/begin MEASUREMENT lam_regler_st_b2 "LA-Regler-Status [RAM name from V530, voted 2]" UWORD NO_COMPU_METHOD 0 0 0 65535 ECU_ADDRESS 0x3F886A FORMAT "%.4g" /end MEASUREMENT
/begin MEASUREMENT lam_ti_min_b2 "min. TI fuer LA-Regelung [RAM name from V530, voted 2]" UWORD NO_COMPU_METHOD 0 0 0 65535 ECU_ADDRESS 0x3F886A FORMAT "%.4g" /end MEASUREMENT
/begin MEASUREMENT lam_wf_verz_b2 "WF-Verzoegerung [RAM name from V530, voted 2]" UWORD NO_COMPU_METHOD 0 0 0 65535 ECU_ADDRESS 0x3F886A FORMAT "%.4g" /end MEASUREMENT
/begin MEASUREMENT lam_ist_mw_b1 "Mittelwert IST-Lambda [RAM name from V530, voted 4]" UWORD M_FORMULA_0025 0 0 0 3.999938965 ECU_ADDRESS 0x3F886C /end MEASUREMENT
/begin MEASUREMENT lam_ist_mw_b2 "Mittelwert IST-Lambda [RAM name from V530, voted 1]" UWORD M_FORMULA_0025 0 0 0 3.999938965 ECU_ADDRESS 0x3F886E /end MEASUREMENT
/begin MEASUREMENT lam_ist_ers_b1 "LAM-IST - Ersatz [RAM name from V530, voted 1]" UWORD M_FORMULA_0025 0 0 0 3.999938965 ECU_ADDRESS 0x3F8870 /end MEASUREMENT
/begin MEASUREMENT rf_b1 "relative Fuellung [RAM name from V530, voted 5]" SWORD M_FORMULA_0007 0 0 -3.2768 3.2767 ECU_ADDRESS 0x3F89CE /end MEASUREMENT
/begin MEASUREMENT nw_st "Synchronisationsstatus Nockenwelle [RAM name from V530, voted 9]" UBYTE NO_COMPU_METHOD 0 0 0 255 ECU_ADDRESS 0x3F8882 FORMAT "%.4g" /end MEASUREMENT
/begin MEASUREMENT ti_ev_ed_b2 "EV-Treiberdiag. [RAM name from V530, voted 1]" UWORD M_FORMULA_0010 0 0 0 65535 ECU_ADDRESS 0x3F8888 /end MEASUREMENT
/begin MEASUREMENT van_ist_E1 "Istposition [RAM name from V530, voted 1]" SWORD M_FORMULA_0102 0 0 -3276.8 3276.7 ECU_ADDRESS 0x3F888A /end MEASUREMENT
/begin MEASUREMENT rf_m "relative Fuellung Mittel zwischen Bank 1 und 2 [RAM name from V530, voted 14]" SWORD M_FORMULA_0007 0 0 -3.2768 3.2767 ECU_ADDRESS 0x3F88A0 /end MEASUREMENT
/begin MEASUREMENT n "Motordrehzahl [RAM name from V530, voted 155]" SWORD M_FORMULA_0006 0 0 -32768 32767 ECU_ADDRESS 0x3F88AC /end MEASUREMENT
/begin MEASUREMENT n_grad_segment "Drehzahlgradient [RAM name from V530, voted 1]" SWORD M_FORMULA_0105 0 0 -32768 32767 ECU_ADDRESS 0x3F88AE /end MEASUREMENT
/begin MEASUREMENT n_grad_asp "Drehzahlgradient (Arbeitsspiel) [RAM name from V530, voted 7]" SWORD M_FORMULA_0105 0 0 -32768 32767 ECU_ADDRESS 0x3F88B0 /end MEASUREMENT
/begin MEASUREMENT lam_soll_vl_max "Soll-Lambda bei max VL [RAM name from V530, voted 1]" UWORD M_FORMULA_0025 0 0 0 3.999938965 ECU_ADDRESS 0x3F88B2 /end MEASUREMENT
/begin MEASUREMENT rf_e2_b1 "relative Fuellung Ebene 2 [RAM name from V530, voted 1]" SWORD M_FORMULA_0007 0 0 -3.2768 3.2767 ECU_ADDRESS 0x3FDC06 /end MEASUREMENT
/begin MEASUREMENT rf_e2_b2 "relative Fuellung Ebene 2 [RAM name from V530, voted 1]" SWORD M_FORMULA_0007 0 0 -3.2768 3.2767 ECU_ADDRESS 0x3FDC08 /end MEASUREMENT
/begin MEASUREMENT rf_e2_m "relative Fuellung Ebene 2 Mittelwert [RAM name from V530, voted 3]" SWORD M_FORMULA_0007 0 0 -3.2768 3.2767 ECU_ADDRESS 0x3FDC0A /end MEASUREMENT
/begin MEASUREMENT te_tv_b1 "auszugebendes TE-Tastverhaeltnis [RAM name from V530, voted 4]" UWORD M_FORMULA_0107 0 0 0 6399.902344 ECU_ADDRESS 0x3F8A36 /end MEASUREMENT
/begin MEASUREMENT te_tv_b2 "auszugebendes TE-Tastverhaeltnis [RAM name from V530, voted 2]" UWORD M_FORMULA_0107 0 0 0 6399.902344 ECU_ADDRESS 0x3F8A38 /end MEASUREMENT
/begin MEASUREMENT ed_st_fehler_inj "ED-Gesamtstatus INJ-Fehler [RAM name from V530, voted 19]" ULONG M_FORMULA_0000 0 0 0 4294967295 ECU_ADDRESS 0x3F88DC /end MEASUREMENT
/begin MEASUREMENT sa_we_st "SAWE-Status [RAM name from V530, voted 7]" UBYTE NO_COMPU_METHOD 0 0 0 255 ECU_ADDRESS 0x3F8922 FORMAT "%.4g" /end MEASUREMENT
/begin MEASUREMENT sa_n_we "Drehzahlschwelle fuer Wiedereinsetzdrehzahl [RAM name from V530, voted 1]" SWORD M_FORMULA_0006 0 0 -32768 32767 ECU_ADDRESS 0x3F8924 /end MEASUREMENT
/begin MEASUREMENT pks_rel "Kraftstoffdruck, relativ [RAM name from V530, voted 1]" SWORD M_FORMULA_0110 0 0 -32.768 32.767 ECU_ADDRESS 0x3F892A /end MEASUREMENT
/begin MEASUREMENT ti_tpu_st "TI-TPU-Status [RAM name from V530, voted 8]" UWORD M_FORMULA_0010 0 0 0 65535 ECU_ADDRESS 0x3F8936 /end MEASUREMENT
/begin MEASUREMENT ti_ausblend_ist_b1 "Zyl-Ausblendung pro Bank [RAM name from V530, voted 4]" UBYTE M_FORMULA_0003 0 0 0 255 ECU_ADDRESS 0x3F8930 /end MEASUREMENT
/begin MEASUREMENT ti_ausblend_ist_b2 "Zyl-Ausblendung pro Bank [RAM name from V530, voted 2]" UBYTE M_FORMULA_0003 0 0 0 255 ECU_ADDRESS 0x3F8931 /end MEASUREMENT
/begin MEASUREMENT B_genoff_copy "Kopie von (St_ugenkor0 & 0x08) [RAM name from V530, voted 1]" UBYTE M_FORMULA_0037 0 0 0 255 ECU_ADDRESS 0x3F892D /end MEASUREMENT
/begin MEASUREMENT B_oztemp_bsd_ok "Status FI_QLT (vorh. j/n) [RAM name from V530, voted 1]" UBYTE M_FORMULA_0037 0 0 0 255 ECU_ADDRESS 0x3F892E /end MEASUREMENT
/begin MEASUREMENT B_oztemp_copy "QLT-Temperatur gemessen [RAM name from V530, voted 1]" UBYTE NO_COMPU_METHOD 0 0 0 255 ECU_ADDRESS 0x3F892F FORMAT "%.4g" /end MEASUREMENT
/begin MEASUREMENT Md_gennm_copy "gefiltertes Generatormoment absolut [RAM name from V530, voted 1]" SWORD M_FORMULA_0113 0 0 -3276.8 3276.7 ECU_ADDRESS 0x3F893C /end MEASUREMENT
/begin MEASUREMENT can_st_empf_hys "Empfangsstatus pro SG-Zyklus [RAM name from V530, voted 3]" UWORD M_FORMULA_0010 0 0 0 65535 ECU_ADDRESS 0x3F894C /end MEASUREMENT
/begin MEASUREMENT can_st_torqdsc "Empfangsstatus TorqDSC [RAM name from V530, voted 2]" UWORD NO_COMPU_METHOD 0 0 0 65535 ECU_ADDRESS 0x3F894E FORMAT "%.4g" /end MEASUREMENT
/begin MEASUREMENT can_st_dsc "Empfangsstatus DSC [RAM name from V530, voted 1]" UWORD NO_COMPU_METHOD 0 0 0 65535 ECU_ADDRESS 0x3F8950 FORMAT "%.4g" /end MEASUREMENT
/begin MEASUREMENT can_st_vrad "Empfangsstatus vRad [RAM name from V530, voted 3]" UWORD NO_COMPU_METHOD 0 0 0 65535 ECU_ADDRESS 0x3F8952 FORMAT "%.4g" /end MEASUREMENT
/begin MEASUREMENT can_st_vfzg "Empfangsstatus vFzg [RAM name from V530, voted 2]" UWORD NO_COMPU_METHOD 0 0 0 65535 ECU_ADDRESS 0x3F8956 FORMAT "%.4g" /end MEASUREMENT
/begin MEASUREMENT can_kkos_st "Stati KKOS [RAM name from V530, voted 2]" UBYTE M_FORMULA_0003 0 0 0 255 ECU_ADDRESS 0x3F8B18 /end MEASUREMENT
/begin MEASUREMENT can_kkos_st_nll "Stati KKOS - n_ll [RAM name from V530, voted 2]" UBYTE NO_COMPU_METHOD 0 0 0 255 ECU_ADDRESS 0x3F8B18 FORMAT "%.4g" /end MEASUREMENT
/begin MEASUREMENT can_kkos_st_zh "Stati KKOS - ZH [RAM name from V530, voted 2]" UBYTE NO_COMPU_METHOD 0 0 0 255 ECU_ADDRESS 0x3F8B18 FORMAT "%.4g" /end MEASUREMENT
/begin MEASUREMENT v_vorne "v-Vorderachse [RAM name from V530, voted 40]" SWORD M_FORMULA_0076 0 0 -2048 2047.9375 ECU_ADDRESS 0x3F8966 /end MEASUREMENT
/begin MEASUREMENT v_hinten "v-Hinterachse [RAM name from V530, voted 9]" SWORD M_FORMULA_0076 0 0 -2048 2047.9375 ECU_ADDRESS 0x3F8968 /end MEASUREMENT
/begin MEASUREMENT can_v_st "v-CAN-Status [RAM name from V530, voted 8]" UWORD NO_COMPU_METHOD 0 0 0 65535 ECU_ADDRESS 0x3F896A FORMAT "%.4g" /end MEASUREMENT
/begin MEASUREMENT can_fzg_st "Fzg-Zustand [RAM name from V530, voted 16]" UBYTE NO_COMPU_METHOD 0 0 0 255 ECU_ADDRESS 0x3F897A FORMAT "%.4g" /end MEASUREMENT
/begin MEASUREMENT can_ay "Querbeschleunigung (roh) [RAM name from V530, voted 5]" SWORD M_FORMULA_0123 0 0 -819.2 819.175 ECU_ADDRESS 0x3F896E /end MEASUREMENT
/begin MEASUREMENT can_a_st "A-Status [RAM name from V530, voted 1]" UBYTE NO_COMPU_METHOD 0 0 0 255 ECU_ADDRESS 0x3F8974 FORMAT "%.4g" /end MEASUREMENT
/begin MEASUREMENT can_dsc_eingr "DSC-Eingriff [RAM name from V530, voted 7]" UBYTE NO_COMPU_METHOD 0 0 0 255 ECU_ADDRESS 0x3F8975 FORMAT "%.4g" /end MEASUREMENT
/begin MEASUREMENT can_dsc_md_soll_pos "DSC-Sollmoment positiv [RAM name from V530, voted 2]" SWORD M_FORMULA_0120 0 0 -16384 16383.5 ECU_ADDRESS 0x3F8976 /end MEASUREMENT
/begin MEASUREMENT can_dsc_md_soll "DSC-Sollmoment [RAM name from V530, voted 2]" SWORD M_FORMULA_0120 0 0 -16384 16383.5 ECU_ADDRESS 0x3F8978 /end MEASUREMENT
/begin MEASUREMENT can_dsc_st "DSC-Status [RAM name from V530, voted 4]" UBYTE NO_COMPU_METHOD 0 0 0 255 ECU_ADDRESS 0x3F897B FORMAT "%.4g" /end MEASUREMENT
/begin MEASUREMENT can_dsc_reg "Regelungs-Status [RAM name from V530, voted 3]" UBYTE NO_COMPU_METHOD 0 0 0 255 ECU_ADDRESS 0x3F897C FORMAT "%.4g" /end MEASUREMENT
/begin MEASUREMENT can_brp_st "Bremsdruck-Status [RAM name from V530, voted 1]" UBYTE NO_COMPU_METHOD 0 0 0 255 ECU_ADDRESS 0x3F897D FORMAT "%.4g" /end MEASUREMENT
/begin MEASUREMENT can_brp "Bremsdruck [RAM name from V530, voted 5]" UBYTE M_FORMULA_0129 0 0 0 255 ECU_ADDRESS 0x3F897E /end MEASUREMENT
/begin MEASUREMENT can_lrw "Lenkradwinkel [RAM name from V530, voted 3]" SWORD M_FORMULA_0132 0 0 -1440.1536 1440.10965 ECU_ADDRESS 0x3F8984 /end MEASUREMENT
/begin MEASUREMENT can_lrw_v "Lenkradwinkel-Geschw [RAM name from V530, voted 1]" SWORD M_FORMULA_0133 0 0 -1440.1536 1440.10965 ECU_ADDRESS 0x3F8986 /end MEASUREMENT
/begin MEASUREMENT can_klst_s "Klemmenstatus [RAM name from V530, voted 23]" UBYTE NO_COMPU_METHOD 0 0 0 255 ECU_ADDRESS 0x3F8988 FORMAT "%.4g" /end MEASUREMENT
/begin MEASUREMENT can_dkg_istgang "DKG-Istgang [RAM name from V530, voted 1]" SBYTE M_FORMULA_0135 0 0 -128 127 ECU_ADDRESS 0x3F898A /end MEASUREMENT
/begin MEASUREMENT can_st_bedfgr "Empfangsstatus BedFgr [RAM name from V530, voted 2]" UWORD NO_COMPU_METHOD 0 0 0 65535 ECU_ADDRESS 0x3F8B10 FORMAT "%.4g" /end MEASUREMENT
/begin MEASUREMENT can_bedfgr "FGR-Taster [RAM name from V530, voted 2]" UBYTE NO_COMPU_METHOD 0 0 0 255 ECU_ADDRESS 0x3F8B12 FORMAT "%.4g" /end MEASUREMENT
/begin MEASUREMENT kl87_st "KL87-Status [RAM name from V530, voted 6]" UBYTE NO_COMPU_METHOD 0 0 0 255 ECU_ADDRESS 0x3F89C9 FORMAT "%.4g" /end MEASUREMENT
/begin MEASUREMENT zust_tmot_start "tmot im Zustand START [RAM name from V530, voted 6]" SWORD M_FORMULA_0023 0 0 -3550 3003.5 ECU_ADDRESS 0x3F89A0 /end MEASUREMENT
/begin MEASUREMENT zustand_motor "Betriebszustand der Motorsteuerung [RAM name from V530, voted 97]" UWORD NO_COMPU_METHOD 0 0 0 65535 ECU_ADDRESS 0x3F89A6 FORMAT "%.4g" /end MEASUREMENT
/begin MEASUREMENT mvac_aq_bre "AQ-Offset LL-Steller Bank 2 [RAM name from V530, voted 1]" UWORD M_FORMULA_0143 0 0 0 6553.5 ECU_ADDRESS 0x3F89AA /end MEASUREMENT
/begin MEASUREMENT mvac_rf_sr "Fuellung MVAC [RAM name from V530, voted 1]" SWORD M_FORMULA_0007 0 0 -3.2768 3.2767 ECU_ADDRESS 0x3F89B0 /end MEASUREMENT
/begin MEASUREMENT kva_can "Letzter Kraftstoffverbrauch in ul (0xFFFF = Fehler) [RAM name from V530, voted 1]" UWORD M_FORMULA_0144 0 0 0 65.535 ECU_ADDRESS 0x3F89B6 /end MEASUREMENT
/begin MEASUREMENT v_max_delta "Delta zur Maximalgeschwindigkeit [RAM name from V530, voted 1]" SWORD M_FORMULA_0076 0 0 -2048 2047.9375 ECU_ADDRESS 0x3F89B8 /end MEASUREMENT
/begin MEASUREMENT time_ms "Zeit seit Motor steht [RAM name from V530, voted 8]" ULONG M_FORMULA_0145 0 0 0 71582788.25 ECU_ADDRESS 0x3F89BC /end MEASUREMENT
/begin MEASUREMENT mvac_p "gemessener Differenzdruck(Senor) Mastervac/Umgebung [RAM name from V530, voted 1]" SWORD M_FORMULA_0075 0 0 -2048 2047.9375 ECU_ADDRESS 0x3F89C6 /end MEASUREMENT
/begin MEASUREMENT time_ml "3HaxenSchnurrZeit [RAM name from V530, voted 14]" ULONG M_FORMULA_0147 0 0 0 42949672.95 ECU_ADDRESS 0x3F89F0 /end MEASUREMENT
/begin MEASUREMENT time_ll "Zeit seit Eintritt LL [RAM name from V530, voted 1]" ULONG M_FORMULA_0147 0 0 0 42949672.95 ECU_ADDRESS 0x3F89F8 /end MEASUREMENT
/begin MEASUREMENT time_kl15_on "Zeit seit Kl15 an [RAM name from V530, voted 3]" ULONG M_FORMULA_0147 0 0 0 42949672.95 ECU_ADDRESS 0x3F89FC /end MEASUREMENT
/begin MEASUREMENT time_kl15_off "Zeit seit Kl15 aus [RAM name from V530, voted 4]" ULONG M_FORMULA_0147 0 0 0 42949672.95 ECU_ADDRESS 0x3F8A00 /end MEASUREMENT
/begin MEASUREMENT time_sa "Zeit seit SA [RAM name from V530, voted 1]" ULONG M_FORMULA_0147 0 0 0 42949672.95 ECU_ADDRESS 0x3F8A04 /end MEASUREMENT
/begin MEASUREMENT n_begr_egas "Drehzahlbegrenzung ueber Momenteneingriff [RAM name from V530, voted 8]" SWORD M_FORMULA_0006 0 0 -32768 32767 ECU_ADDRESS 0x3F8A0E /end MEASUREMENT
/begin MEASUREMENT n_begr_st "Statusvariable Drehzahlbegrenzung [RAM name from V530, voted 1]" UBYTE NO_COMPU_METHOD 0 0 0 255 ECU_ADDRESS 0x3F8A10 FORMAT "%.4g" /end MEASUREMENT
/begin MEASUREMENT schalter_bls_inj "Schalterstatus [RAM name from V530, voted 27]" UWORD NO_COMPU_METHOD 0 0 0 65535 ECU_ADDRESS 0x3F8A12 FORMAT "%.4g" /end MEASUREMENT
/begin MEASUREMENT schalter_getriebe "Schalterstatus [RAM name from V530, voted 27]" UWORD NO_COMPU_METHOD 0 0 0 65535 ECU_ADDRESS 0x3F8A12 FORMAT "%.4g" /end MEASUREMENT
/begin MEASUREMENT schalter_kraft_hs "Kraftschluss beim Handschalter [RAM name from V530, voted 27]" UWORD NO_COMPU_METHOD 0 0 0 65535 ECU_ADDRESS 0x3F8A12 FORMAT "%.4g" /end MEASUREMENT
/begin MEASUREMENT schalter_kupplung "Schalterstatus [RAM name from V530, voted 27]" UWORD NO_COMPU_METHOD 0 0 0 65535 ECU_ADDRESS 0x3F8A12 FORMAT "%.4g" /end MEASUREMENT
/begin MEASUREMENT schalter_poel "Schalterstatus [RAM name from V530, voted 27]" UWORD NO_COMPU_METHOD 0 0 0 65535 ECU_ADDRESS 0x3F8A12 FORMAT "%.4g" /end MEASUREMENT
/begin MEASUREMENT schalter_power "Schalterstatus [RAM name from V530, voted 27]" UWORD NO_COMPU_METHOD 0 0 0 65535 ECU_ADDRESS 0x3F8A12 FORMAT "%.4g" /end MEASUREMENT
/begin MEASUREMENT schalter_schaltung "Schalterstatus [RAM name from V530, voted 27]" UWORD NO_COMPU_METHOD 0 0 0 65535 ECU_ADDRESS 0x3F8A12 FORMAT "%.4g" /end MEASUREMENT
/begin MEASUREMENT schalter_st_inj "Schalterstatus [RAM name from V530, voted 27]" UWORD M_FORMULA_0080 0 0 0 65535 ECU_ADDRESS 0x3F8A12 /end MEASUREMENT
/begin MEASUREMENT schalter_wakeup_inj "Schalterstatus [RAM name from V530, voted 27]" UWORD NO_COMPU_METHOD 0 0 0 65535 ECU_ADDRESS 0x3F8A12 FORMAT "%.4g" /end MEASUREMENT
/begin MEASUREMENT schalter_zustand_poel "Schalterstatus [RAM name from V530, voted 27]" UWORD NO_COMPU_METHOD 0 0 0 65535 ECU_ADDRESS 0x3F8A12 FORMAT "%.4g" /end MEASUREMENT
/begin MEASUREMENT schalter_bls_inj_e2 "Schalterstatus Ebene 2 [RAM name from V530, voted 2]" UWORD NO_COMPU_METHOD 0 0 0 65535 ECU_ADDRESS 0x3F8A14 FORMAT "%.4g" /end MEASUREMENT
/begin MEASUREMENT schalter_getriebe_e2 "Schalterstatus Ebene 2 [RAM name from V530, voted 2]" UWORD NO_COMPU_METHOD 0 0 0 65535 ECU_ADDRESS 0x3F8A14 FORMAT "%.4g" /end MEASUREMENT
/begin MEASUREMENT schalter_kraft_hs_e2 "Kraftschluss beim Handschalter Ebene 2 [RAM name from V530, voted 2]" UWORD NO_COMPU_METHOD 0 0 0 65535 ECU_ADDRESS 0x3F8A14 FORMAT "%.4g" /end MEASUREMENT
/begin MEASUREMENT schalter_kupplung_e2 "Schalterstatus Ebene 2 [RAM name from V530, voted 2]" UWORD NO_COMPU_METHOD 0 0 0 65535 ECU_ADDRESS 0x3F8A14 FORMAT "%.4g" /end MEASUREMENT
/begin MEASUREMENT schalter_poel_e2 "Schalterstatus Ebene 2 [RAM name from V530, voted 2]" UWORD NO_COMPU_METHOD 0 0 0 65535 ECU_ADDRESS 0x3F8A14 FORMAT "%.4g" /end MEASUREMENT
/begin MEASUREMENT schalter_power_e2 "Schalterstatus Ebene 2 [RAM name from V530, voted 2]" UWORD NO_COMPU_METHOD 0 0 0 65535 ECU_ADDRESS 0x3F8A14 FORMAT "%.4g" /end MEASUREMENT
/begin MEASUREMENT schalter_schaltung_e2 "Schalterstatus Ebene 2 [RAM name from V530, voted 2]" UWORD NO_COMPU_METHOD 0 0 0 65535 ECU_ADDRESS 0x3F8A14 FORMAT "%.4g" /end MEASUREMENT
/begin MEASUREMENT schalter_st_inj_e2 "Schalterstatus Ebene 2 [RAM name from V530, voted 2]" UWORD M_FORMULA_0080 0 0 0 65535 ECU_ADDRESS 0x3F8A14 /end MEASUREMENT
/begin MEASUREMENT schalter_wakeup_inj_e2 "Schalterstatus Ebene 2 [RAM name from V530, voted 2]" UWORD NO_COMPU_METHOD 0 0 0 65535 ECU_ADDRESS 0x3F8A14 FORMAT "%.4g" /end MEASUREMENT
/begin MEASUREMENT schalter_zustand_poel_e2 "Schalterstatus Ebene 2 [RAM name from V530, voted 2]" UWORD NO_COMPU_METHOD 0 0 0 65535 ECU_ADDRESS 0x3F8A14 FORMAT "%.4g" /end MEASUREMENT
/begin MEASUREMENT pksr_ekp_ansteuerung_cfg "Configuration EKP Ansteuerung [RAM name from V530, voted 2]" UBYTE NO_COMPU_METHOD 0 0 0 255 ECU_ADDRESS 0x3F8A19 FORMAT "%.4g" /end MEASUREMENT
/begin MEASUREMENT pctrl_t_inj "Werte fuer die Prozessorkontrolle [RAM name from V530, voted 1]" ULONG M_FORMULA_0000 0 0 0 4294967295 ECU_ADDRESS 0x3F8A20 /end MEASUREMENT
/begin MEASUREMENT can_flags "Allg. CAN-Flags [RAM name from V530, voted 7]" UBYTE M_FORMULA_0003 0 0 0 255 ECU_ADDRESS 0x3F8A25 /end MEASUREMENT
/begin MEASUREMENT mdrv_st "MDRV-Status (CAN) [RAM name from V530, voted 1]" UBYTE NO_COMPU_METHOD 0 0 0 255 ECU_ADDRESS 0x3F8A26 FORMAT "%.4g" /end MEASUREMENT
/begin MEASUREMENT mdrv_st_dme "MDRV-Status [RAM name from V530, voted 6]" UBYTE NO_COMPU_METHOD 0 0 0 255 ECU_ADDRESS 0x3F8A27 FORMAT "%.4g" /end MEASUREMENT
/begin MEASUREMENT toel_can "gefilterte Motoroeltemperatur (0xFF = Fehler). [RAM name from V530, voted 2]" UBYTE M_FORMULA_0165 0 0 -48 207 ECU_ADDRESS 0x3F8A28 /end MEASUREMENT
/begin MEASUREMENT dwf_n_orange "oranger Drehzahlbereich [RAM name from V530, voted 1]" UBYTE M_FORMULA_0166 0 0 0 12750 ECU_ADDRESS 0x3F8A29 /end MEASUREMENT
/begin MEASUREMENT sk_egas_off_inj "SK-Egasstufe [RAM name from V530, voted 7]" UBYTE NO_COMPU_METHOD 0 0 0 255 ECU_ADDRESS 0x3F8A2A FORMAT "%.4g" /end MEASUREMENT
/begin MEASUREMENT sk_md_begr_inj "SK-Begrenzungsstufe [RAM name from V530, voted 3]" UBYTE NO_COMPU_METHOD 0 0 0 255 ECU_ADDRESS 0x3F8A2B FORMAT "%.4g" /end MEASUREMENT
/begin MEASUREMENT sk_md_eingr_inj "SK-Md-Eingriff [RAM name from V530, voted 5]" UBYTE M_FORMULA_0003 0 0 0 255 ECU_ADDRESS 0x3F8A2C /end MEASUREMENT
/begin MEASUREMENT sk_ti_eingr_inj "SK-TI-Eingriff [RAM name from V530, voted 5]" UBYTE NO_COMPU_METHOD 0 0 0 255 ECU_ADDRESS 0x3F8A2C FORMAT "%.4g" /end MEASUREMENT
/begin MEASUREMENT sk_tz_eingr_inj "SK-TZ-Eingriff [RAM name from V530, voted 5]" UBYTE NO_COMPU_METHOD 0 0 0 255 ECU_ADDRESS 0x3F8A2C FORMAT "%.4g" /end MEASUREMENT
/begin MEASUREMENT sk_van_st_inj "SK-Vanos-Eingriff [RAM name from V530, voted 1]" UBYTE NO_COMPU_METHOD 0 0 0 255 ECU_ADDRESS 0x3F8A2E FORMAT "%.4g" /end MEASUREMENT
/begin MEASUREMENT sk_eingr_st_inj "SK-Eingriff [RAM name from V530, voted 3]" UBYTE M_FORMULA_0003 0 0 0 255 ECU_ADDRESS 0x3F8A2F /end MEASUREMENT
/begin MEASUREMENT sk_fr_st_inj "SK-Eingriff FR [RAM name from V530, voted 3]" UBYTE NO_COMPU_METHOD 0 0 0 255 ECU_ADDRESS 0x3F8A2F FORMAT "%.4g" /end MEASUREMENT
/begin MEASUREMENT sk_fra_st_inj "SK-Eingriff FRA [RAM name from V530, voted 3]" UBYTE NO_COMPU_METHOD 0 0 0 255 ECU_ADDRESS 0x3F8A2F FORMAT "%.4g" /end MEASUREMENT
/begin MEASUREMENT sk_kh_st_inj "SK-Eingriff KH [RAM name from V530, voted 3]" UBYTE NO_COMPU_METHOD 0 0 0 255 ECU_ADDRESS 0x3F8A2F FORMAT "%.4g" /end MEASUREMENT
/begin MEASUREMENT sk_llra_st_inj "SK-Eingriff LLRA [RAM name from V530, voted 3]" UBYTE NO_COMPU_METHOD 0 0 0 255 ECU_ADDRESS 0x3F8A2F FORMAT "%.4g" /end MEASUREMENT
/begin MEASUREMENT sk_mzyl_st_inj "SK-Eingriff MZYL [RAM name from V530, voted 3]" UBYTE NO_COMPU_METHOD 0 0 0 255 ECU_ADDRESS 0x3F8A2F FORMAT "%.4g" /end MEASUREMENT
/begin MEASUREMENT sk_pks_st_inj "SK-Eingriff PKS [RAM name from V530, voted 3]" UBYTE NO_COMPU_METHOD 0 0 0 255 ECU_ADDRESS 0x3F8A2F FORMAT "%.4g" /end MEASUREMENT
/begin MEASUREMENT sk_ti_zyl_off_inj "SK-Ausblendungen [RAM name from V530, voted 1]" UWORD NO_COMPU_METHOD 0 0 0 65535 ECU_ADDRESS 0x3F8A30 FORMAT "%.4g" /end MEASUREMENT
/begin MEASUREMENT zust_time_st "Zustandsstatus fuer CAN Zeiten [RAM name from V530, voted 6]" UBYTE NO_COMPU_METHOD 0 0 0 255 ECU_ADDRESS 0x3F899F FORMAT "%.4g" /end MEASUREMENT
/begin MEASUREMENT pksr_exd_zust_pl "Zustand Statemaschine Prueflauf [RAM name from V530, voted 1]" UWORD NO_COMPU_METHOD 0 0 0 65535 ECU_ADDRESS 0x3F8A44 FORMAT "%.4g" /end MEASUREMENT
/begin MEASUREMENT toel_wanne "Oeltemperatur am QLT (Oelwanne) [RAM name from V530, voted 7]" SWORD M_FORMULA_0023 0 0 -3550 3003.5 ECU_ADDRESS 0x3F8A70 /end MEASUREMENT
/begin MEASUREMENT kat_obd_wert_nv_b1 "gem., gewichtete Abweichung z. MW [RAM name from V530, voted 1]" UWORD M_FORMULA_0025 0 0 0 3.999938965 ECU_ADDRESS 0x3F8A76 /end MEASUREMENT
/begin MEASUREMENT kat_obd_wert_nv_b2 "gem., gewichtete Abweichung z. MW [RAM name from V530, voted 1]" UWORD M_FORMULA_0025 0 0 0 3.999938965 ECU_ADDRESS 0x3F8A78 /end MEASUREMENT
/begin MEASUREMENT kwp_fetrawe_st "kwp_fetrawe_st [RAM name from V530, voted 4]" UBYTE NO_COMPU_METHOD 0 0 0 255 ECU_ADDRESS 0x3F8A7C FORMAT "%.4g" /end MEASUREMENT
/begin MEASUREMENT ed_fsp_inj_fehlerzaehler_nv "Zaehler zum Fehlersortieren [RAM name from V530, voted 1]" UWORD M_FORMULA_0010 0 0 0 65535 ECU_ADDRESS 0x3F8A7E /end MEASUREMENT
/begin MEASUREMENT can_km_stand_nv "Kilometerstand [RAM name from V530, voted 9]" ULONG M_FORMULA_0027 0 0 0 4294967295 ECU_ADDRESS 0x3F8A80 /end MEASUREMENT
/begin MEASUREMENT can_fzgtyp_grb_nv "Getriebevariante [RAM name from V530, voted 39]" UBYTE NO_COMPU_METHOD 0 0 0 255 ECU_ADDRESS 0x3F8A88 FORMAT "%.4g" /end MEASUREMENT
/begin MEASUREMENT rf_dyn_delta "Delta gefiltert zum ungefiltertem [RAM name from V530, voted 2]" SWORD M_FORMULA_0186 0 0 -3.2768 3.2767 ECU_ADDRESS 0x3F8AAA /end MEASUREMENT
/begin MEASUREMENT pumg "Gefilterter Messwert [RAM name from V530, voted 3]" SWORD M_FORMULA_0075 0 0 -2048 2047.9375 ECU_ADDRESS 0x3F8AB4 /end MEASUREMENT
/begin MEASUREMENT tumg "Umgebungstemperatur [RAM name from V530, voted 4]" SWORD M_FORMULA_0023 0 0 -3550 3003.5 ECU_ADDRESS 0x3F8AC0 /end MEASUREMENT
/begin MEASUREMENT time_st "Status Zeiten [RAM name from V530, voted 5]" UBYTE NO_COMPU_METHOD 0 0 0 255 ECU_ADDRESS 0x3F8AC3 FORMAT "%.4g" /end MEASUREMENT
/begin MEASUREMENT time_rel "Relativzeit [RAM name from V530, voted 5]" ULONG M_FORMULA_0145 0 0 0 71582788.25 ECU_ADDRESS 0x3F8AC4 /end MEASUREMENT
/begin MEASUREMENT slp_st "SLP Status [RAM name from V530, voted 3]" UWORD NO_COMPU_METHOD 0 0 0 65535 ECU_ADDRESS 0x3F8AD0 FORMAT "%.4g" /end MEASUREMENT
/begin MEASUREMENT v_tacho "Tachogeschwindigkeit [RAM name from V530, voted 2]" SWORD M_FORMULA_0076 0 0 -2048 2047.9375 ECU_ADDRESS 0x3F8AD4 /end MEASUREMENT
/begin MEASUREMENT can_stkombi_fgr "FGR-Info vom Kombi [RAM name from V530, voted 2]" UBYTE NO_COMPU_METHOD 0 0 0 255 ECU_ADDRESS 0x3F8AD6 FORMAT "%.4g" /end MEASUREMENT
/begin MEASUREMENT B_CAN_ANHAENGER "Anhaenger [RAM name from V530, voted 5]" UBYTE NO_COMPU_METHOD 0 0 0 255 ECU_ADDRESS 0x3F8AD7 FORMAT "%.4g" /end MEASUREMENT
/begin MEASUREMENT B_CAN_HBR "Handbremse [RAM name from V530, voted 5]" UBYTE NO_COMPU_METHOD 0 0 0 255 ECU_ADDRESS 0x3F8AD7 FORMAT "%.4g" /end MEASUREMENT
/begin MEASUREMENT B_CAN_KOMBI_MIL "HMIL-Info vom Kombi [RAM name from V530, voted 5]" UBYTE NO_COMPU_METHOD 0 0 0 255 ECU_ADDRESS 0x3F8AD7 FORMAT "%.4g" /end MEASUREMENT
/begin MEASUREMENT can_stkombi_s "Schalter-Infos vom Kombi [RAM name from V530, voted 5]" UBYTE M_FORMULA_0003 0 0 0 255 ECU_ADDRESS 0x3F8AD7 /end MEASUREMENT
/begin MEASUREMENT te_x_ml_soll_b1 "ausgegebener Spuelluftanteil [RAM name from V530, voted 2]" UWORD M_FORMULA_0024 0 0 0 1.999969482 ECU_ADDRESS 0x3F8ADC /end MEASUREMENT
/begin MEASUREMENT te_x_ml_soll_b2 "ausgegebener Spuelluftanteil [RAM name from V530, voted 1]" UWORD M_FORMULA_0024 0 0 0 1.999969482 ECU_ADDRESS 0x3F8ADE /end MEASUREMENT
/begin MEASUREMENT te_c_akf "Konzentration - AKF [RAM name from V530, voted 2]" UWORD M_FORMULA_0199 0 0 0 3.999938965 ECU_ADDRESS 0x3F8AE0 /end MEASUREMENT
/begin MEASUREMENT B_TE_OBD_ABBRUCH "Abbruch der LL-Messung [RAM name from V530, voted 3]" UBYTE NO_COMPU_METHOD 0 0 0 255 ECU_ADDRESS 0x3F8AE8 FORMAT "%.4g" /end MEASUREMENT
/begin MEASUREMENT B_TE_OBD_CHECK "TEV-Check laeuft [RAM name from V530, voted 3]" UBYTE NO_COMPU_METHOD 0 0 0 255 ECU_ADDRESS 0x3F8AE8 FORMAT "%.4g" /end MEASUREMENT
/begin MEASUREMENT B_TE_OBD_KKOS_ABSCH "Abwurf KKOS wegen Fehlmessung TE_OBD [RAM name from V530, voted 3]" UBYTE NO_COMPU_METHOD 0 0 0 255 ECU_ADDRESS 0x3F8AE8 FORMAT "%.4g" /end MEASUREMENT
/begin MEASUREMENT B_TE_OBD_KKOS_FAIL "Merker Fehler mit KKOS [RAM name from V530, voted 3]" UBYTE NO_COMPU_METHOD 0 0 0 255 ECU_ADDRESS 0x3F8AE8 FORMAT "%.4g" /end MEASUREMENT
/begin MEASUREMENT B_TE_OBD_LAM_REG_OFF "Abwurf Lambda Regler wegen TE_OBD [RAM name from V530, voted 3]" UBYTE NO_COMPU_METHOD 0 0 0 255 ECU_ADDRESS 0x3F8AE8 FORMAT "%.4g" /end MEASUREMENT
/begin MEASUREMENT B_TE_OBD_PRE_CHECK "TEV-Check laeuft (bald) [RAM name from V530, voted 3]" UBYTE NO_COMPU_METHOD 0 0 0 255 ECU_ADDRESS 0x3F8AE8 FORMAT "%.4g" /end MEASUREMENT
/begin MEASUREMENT B_TE_OBD_S_BLS_OLD "Merker Bremslichtschalter [RAM name from V530, voted 3]" UBYTE NO_COMPU_METHOD 0 0 0 255 ECU_ADDRESS 0x3F8AE8 FORMAT "%.4g" /end MEASUREMENT
/begin MEASUREMENT B_TE_OBD_START_EXD "Start ueber Tester [RAM name from V530, voted 3]" UBYTE NO_COMPU_METHOD 0 0 0 255 ECU_ADDRESS 0x3F8AE8 FORMAT "%.4g" /end MEASUREMENT
/begin MEASUREMENT te_obd_flags "Flags der TE_OBD [RAM name from V530, voted 3]" UBYTE M_FORMULA_0003 0 0 0 255 ECU_ADDRESS 0x3F8AE8 /end MEASUREMENT
/begin MEASUREMENT pksr_exd_md_fw_st "100Proz FW-Anforderungsstatus von PKSR [RAM name from V530, voted 3]" UWORD M_FORMULA_0010 0 0 0 65535 ECU_ADDRESS 0x3F8AF8 /end MEASUREMENT
/begin MEASUREMENT sk_tr_req "Angefragte Testrechnung vom INJ [RAM name from V530, voted 3]" UBYTE M_FORMULA_0003 0 0 0 255 ECU_ADDRESS 0x3F8AFA /end MEASUREMENT
/begin MEASUREMENT sw_confg_betriebsmode_exd "vom Tester eingestellter Betriebsmode [RAM name from V530, voted 11]" UBYTE NO_COMPU_METHOD 0 0 0 255 ECU_ADDRESS 0x3F8AFB FORMAT "%.4g" /end MEASUREMENT
/begin MEASUREMENT start_rl_atic39_dpr "Treiberinfo vom Startrelais [RAM name from V530, voted 4]" UBYTE NO_COMPU_METHOD 0 0 0 255 ECU_ADDRESS 0x3F8B20 FORMAT "%.4g" /end MEASUREMENT
/begin MEASUREMENT rf_pt_korr_zyl "Korrektur der relativen Fuellung im Zylinder [RAM name from V530, voted 3]" UWORD M_FORMULA_0073 0 0 0 63.99902344 ECU_ADDRESS 0x3F8B24 /end MEASUREMENT
/begin MEASUREMENT ti_zyl_tz "Zylinder selektive Abschaltung von TI und TZ [RAM name from V530, voted 1]" UWORD M_FORMULA_0080 0 0 0 65535 ECU_ADDRESS 0x3F8B26 /end MEASUREMENT
/begin MEASUREMENT B_VAN_NICHT_NORM "Vanos Fehler oder ext. Diag [RAM name from V530, voted 1]" UBYTE NO_COMPU_METHOD 0 0 0 255 ECU_ADDRESS 0x3F8B28 FORMAT "%.4g" /end MEASUREMENT
/begin MEASUREMENT van_exd_st "Diagnosestatus Vanos [RAM name from V530, voted 1]" UBYTE NO_COMPU_METHOD 0 0 0 255 ECU_ADDRESS 0x3F8B28 FORMAT "%.4g" /end MEASUREMENT
/begin MEASUREMENT ccp_fp_st_inj "Status CCP-FP [RAM name from V530, voted 3]" UBYTE NO_COMPU_METHOD 0 0 0 255 ECU_ADDRESS 0x3F8B2A FORMAT "%.4g" /end MEASUREMENT
/begin MEASUREMENT exd_tester_timeout "Testertimeout [RAM name from V530, voted 17]" UBYTE M_FORMULA_0214 0 0 0 255 ECU_ADDRESS 0x3F8B2C /end MEASUREMENT
/begin MEASUREMENT mdrv_st_dsc_akt "MDRV-Status DSC (CAN) [RAM name from V530, voted 1]" UBYTE NO_COMPU_METHOD 0 0 0 255 ECU_ADDRESS 0x3F8B2D FORMAT "%.4g" /end MEASUREMENT
/begin MEASUREMENT mdrv_st_mod_smg_akt "MDRV-Status SMG (CAN) [RAM name from V530, voted 1]" UBYTE NO_COMPU_METHOD 0 0 0 255 ECU_ADDRESS 0x3F8B2E FORMAT "%.4g" /end MEASUREMENT
/begin MEASUREMENT mdrv_st_stg_smg_akt "MDRV-Status Drivelogic (CAN) [RAM name from V530, voted 1]" UBYTE NO_COMPU_METHOD 0 0 0 255 ECU_ADDRESS 0x3F8B2F FORMAT "%.4g" /end MEASUREMENT
/begin MEASUREMENT mdrv_st_mod_eng_akt "MDRV-Status Motor (CAN) [RAM name from V530, voted 1]" UBYTE NO_COMPU_METHOD 0 0 0 255 ECU_ADDRESS 0x3F8B30 FORMAT "%.4g" /end MEASUREMENT
/begin MEASUREMENT mdrv_st_mod_edck_akt "MDRV-Status EDCK (CAN) [RAM name from V530, voted 1]" UBYTE NO_COMPU_METHOD 0 0 0 255 ECU_ADDRESS 0x3F8B31 FORMAT "%.4g" /end MEASUREMENT
/begin MEASUREMENT mdrv_st_mod_albv_akt "MDRV-Status aLBV (CAN) [RAM name from V530, voted 1]" UBYTE NO_COMPU_METHOD 0 0 0 255 ECU_ADDRESS 0x3F8B32 FORMAT "%.4g" /end MEASUREMENT
/begin MEASUREMENT mdrv_st_mod_hud_akt "MDRV-Status HUD (CAN) [RAM name from V530, voted 1]" UBYTE NO_COMPU_METHOD 0 0 0 255 ECU_ADDRESS 0x3F8B33 FORMAT "%.4g" /end MEASUREMENT
/begin MEASUREMENT v_max_schw_direkt "Maximalgeschwindigkeit [RAM name from V530, voted 2]" SWORD M_FORMULA_0076 0 0 -2048 2047.9375 ECU_ADDRESS 0x3F8B36 /end MEASUREMENT
/begin MEASUREMENT v_max_schw_can "Maximalgeschwindigkeit [RAM name from V530, voted 3]" SWORD M_FORMULA_0076 0 0 -2048 2047.9375 ECU_ADDRESS 0x3F8B38 /end MEASUREMENT
/begin MEASUREMENT v_max_anh_st "Status v_max-Anhebung durch CAS bzw. BMW-Nachruestung [RAM name from V530, voted 3]" UBYTE NO_COMPU_METHOD 0 0 0 255 ECU_ADDRESS 0x3F8B3A FORMAT "%.4g" /end MEASUREMENT
/begin MEASUREMENT can_gang_r "Empfangsstatus StatR [RAM name from V530, voted 2]" UBYTE NO_COMPU_METHOD 0 0 0 255 ECU_ADDRESS 0x3F8B3B FORMAT "%.4g" /end MEASUREMENT
/begin MEASUREMENT can_crash_ctr "Crash-Kontrolle [RAM name from V530, voted 1]" UBYTE NO_COMPU_METHOD 0 0 0 255 ECU_ADDRESS 0x3F8B3C FORMAT "%.4g" /end MEASUREMENT
/begin MEASUREMENT rps_tz_offs "RPS-TZ-Offset [RAM name from V530, voted 1]" SWORD M_FORMULA_0102 0 0 -3276.8 3276.7 ECU_ADDRESS 0x3F8B3E /end MEASUREMENT
/begin MEASUREMENT k2KB_req_inj "KWP [RAM name from V530, voted 1]" UBYTE M_FORMULA_0003 0 0 0 255 ECU_ADDRESS 0x3F8B62 /end MEASUREMENT
/begin MEASUREMENT eeprom_crc_wichtig_nv "Lebensdauer Adaptionsdaten [RAM name from V530, voted 11]" ULONG M_FORMULA_0000 0 0 0 4294967295 ECU_ADDRESS 0x3F956C /end MEASUREMENT
/begin MEASUREMENT eeprom_anzahl_schreiben_nv "Anzahl der Schreibvorgaenge ins Flash [RAM name from V530, voted 6]" ULONG M_FORMULA_0449 0 0 0 4294967295 ECU_ADDRESS 0x3F9570 /end MEASUREMENT
/begin MEASUREMENT eeprom_datenlaenge_wichtig_nv "Anzahl der Datenbytes [RAM name from V530, voted 4]" UWORD M_FORMULA_0450 0 0 0 262140 ECU_ADDRESS 0x3F9574 /end MEASUREMENT
/begin MEASUREMENT eeprom_version_prog_nv "Programmversion beim Abspeichern [RAM name from V530, voted 6]" UWORD M_FORMULA_0451 0 0 0 65535 ECU_ADDRESS 0x3F9576 /end MEASUREMENT
/begin MEASUREMENT eeprom_crc_nv "Standstabile Adaptionsdaten [RAM name from V530, voted 3]" ULONG M_FORMULA_0000 0 0 0 4294967295 ECU_ADDRESS 0x3F9578 /end MEASUREMENT
/begin MEASUREMENT eeprom_datenlaenge_nv "Anzahl der Datenbytes [RAM name from V530, voted 2]" UWORD M_FORMULA_0450 0 0 0 262140 ECU_ADDRESS 0x3F957C /end MEASUREMENT
/begin MEASUREMENT eeprom_date "Erstelldatum beim Abspeichern [RAM name from V530, voted 4]" UBYTE NO_COMPU_METHOD 0 0 0 255 ECU_ADDRESS 0x3F957E FORMAT "%.4g" /end MEASUREMENT
/begin MEASUREMENT eeprom_time "Erstellzeit beim Abspeichern [RAM name from V530, voted 4]" UBYTE NO_COMPU_METHOD 0 0 0 255 ECU_ADDRESS 0x3F9587 FORMAT "%.4g" /end MEASUREMENT
/begin MEASUREMENT hdw_1_nv "HDW [RAM name from V530, voted 5]" ULONG M_FORMULA_0000 0 0 0 4294967295 ECU_ADDRESS 0x3F9590 /end MEASUREMENT
/begin MEASUREMENT tdme_max_nv "Maximale DME-Temperatur ueber alle Zyklen [RAM name from V530, voted 9]" SWORD M_FORMULA_0023 0 0 -3550 3003.5 ECU_ADDRESS 0x3F959C /end MEASUREMENT
/begin MEASUREMENT tdme_min_nv "Minimale DME-Temperatur ueber alle Zyklen [RAM name from V530, voted 9]" SWORD M_FORMULA_0023 0 0 -3550 3003.5 ECU_ADDRESS 0x3F959E /end MEASUREMENT
/begin MEASUREMENT tdme_time_zaehler_nv "Zeit fuer Temperatur oberhalb Schwelle [RAM name from V530, voted 9]" ULONG M_FORMULA_0452 0 0 0 429496729.5 ECU_ADDRESS 0x3F95A0 /end MEASUREMENT
/begin MEASUREMENT tdme_zyklen_nv "Fahrzyklen oberhalb der Temperatur Schwelle [RAM name from V530, voted 9]" UWORD M_FORMULA_0453 0 0 0 65535 ECU_ADDRESS 0x3F95A4 /end MEASUREMENT
/begin MEASUREMENT crc32_prog_carb_nv "Programm-CRC fuer Mode 9 [RAM name from V530, voted 1]" ULONG M_FORMULA_0000 0 0 0 4294967295 ECU_ADDRESS 0x3F96C8 /end MEASUREMENT
/begin MEASUREMENT crc32_data_carb_nv "Daten-CRC fuer Mode 9 [RAM name from V530, voted 1]" ULONG M_FORMULA_0000 0 0 0 4294967295 ECU_ADDRESS 0x3F96CC /end MEASUREMENT
/begin MEASUREMENT ram_chk_err_adr_nv "Fehleradresse vom RamCheck [RAM name from V530, voted 3]" ULONG M_FORMULA_0000 0 0 0 4294967295 ECU_ADDRESS 0x3F96D0 /end MEASUREMENT
/begin MEASUREMENT sys_zust_cpu_last_max_nv "Maximale CPU Last [RAM name from V530, voted 4]" UWORD M_FORMULA_0001 0 0 0 6553.5 ECU_ADDRESS 0x3F96D4 /end MEASUREMENT
/begin MEASUREMENT spim_errorcode_reinit_nv "Errorcode weswegen ein SPI-Reinit ausgefuehrt wurde [RAM name from V530, voted 1]" UBYTE NO_COMPU_METHOD 0 0 0 255 ECU_ADDRESS 0x3F96D7 FORMAT "%.4g" /end MEASUREMENT
/begin MEASUREMENT spim_error_reinit_ctr_nv "SPI-reinits durch Fehlverhalten [RAM name from V530, voted 3]" UBYTE M_FORMULA_0003 0 0 0 255 ECU_ADDRESS 0x3F96D8 /end MEASUREMENT
/begin MEASUREMENT ipk_sync_errorcount_nv "Fehlerzaehler fuer Sync-Timeout [RAM name from V530, voted 1]" UBYTE M_FORMULA_0003 0 0 0 255 ECU_ADDRESS 0x3F96DA /end MEASUREMENT
/begin MEASUREMENT ipk_sync_error_st_nv "IPK Sync Error im Hochlauf [RAM name from V530, voted 2]" UBYTE NO_COMPU_METHOD 0 0 0 255 ECU_ADDRESS 0x3F96DB FORMAT "%.4g" /end MEASUREMENT
/begin MEASUREMENT sk_ff.n "Drehzahl [RAM name from V530, voted 9]" SWORD M_FORMULA_0006 0 0 -32768 32767 ECU_ADDRESS 0x3F96DC /end MEASUREMENT
/begin MEASUREMENT sk_ff.rf_m "Fuellung [RAM name from V530, voted 1]" SWORD M_FORMULA_0007 0 0 -3.2768 3.2767 ECU_ADDRESS 0x3F96DE /end MEASUREMENT
/begin MEASUREMENT sk_ff.ub "Spannung [RAM name from V530, voted 1]" SWORD M_FORMULA_0008 0 0 -3276.8 3276.7 ECU_ADDRESS 0x3F96E0 /end MEASUREMENT
/begin MEASUREMENT sk_ff.kupp_wunsch_ges "Wunschmoment [RAM name from V530, voted 1]" SWORD M_FORMULA_0009 0 0 -3276.8 3276.7 ECU_ADDRESS 0x3F96E2 /end MEASUREMENT
/begin MEASUREMENT sk_ff.kupp_ist "Istmoment [RAM name from V530, voted 5]" SWORD M_FORMULA_0009 0 0 -3276.8 3276.7 ECU_ADDRESS 0x3F96E4 /end MEASUREMENT
/begin MEASUREMENT sk_ff.pwg_soll "Pedalwert [RAM name from V530, voted 3]" SWORD M_FORMULA_0001 0 0 -3276.8 3276.7 ECU_ADDRESS 0x3F96E6 /end MEASUREMENT
/begin MEASUREMENT sk_ff.fail_st_zyl "Ausblender [RAM name from V530, voted 1]" UWORD M_FORMULA_0010 0 0 0 65535 ECU_ADDRESS 0x3F96E8 /end MEASUREMENT
/begin MEASUREMENT sk_ff.ursache "Ursache fuer SK-Eingriff [RAM name from V530, voted 1]" UWORD NO_COMPU_METHOD 0 0 0 65535 ECU_ADDRESS 0x3F96EA FORMAT "%.4g" /end MEASUREMENT
/begin MEASUREMENT sk_ff.egas_sk_mode "SK-Mode Egas [RAM name from V530, voted 1]" UBYTE NO_COMPU_METHOD 0 0 0 255 ECU_ADDRESS 0x3F96EC FORMAT "%.4g" /end MEASUREMENT
/begin MEASUREMENT sk_ff.md_sk_mode "SK-Mode Momentenmanager [RAM name from V530, voted 1]" UBYTE NO_COMPU_METHOD 0 0 0 255 ECU_ADDRESS 0x3F96ED FORMAT "%.4g" /end MEASUREMENT
/begin MEASUREMENT sk_ff.smg_sk_mode "SK-Mode SMG [RAM name from V530, voted 1]" UBYTE NO_COMPU_METHOD 0 0 0 255 ECU_ADDRESS 0x3F96EE FORMAT "%.4g" /end MEASUREMENT
/begin MEASUREMENT sk_ff.crc32_result "CRC-Fehler [RAM name from V530, voted 1]" UBYTE NO_COMPU_METHOD 0 0 0 255 ECU_ADDRESS 0x3F96EF FORMAT "%.4g" /end MEASUREMENT
/begin MEASUREMENT sk_ff.os_err_cnt "OS-Err: Summe [RAM name from V530, voted 1]" UBYTE M_FORMULA_0003 0 0 0 255 ECU_ADDRESS 0x3F96F0 /end MEASUREMENT
/begin MEASUREMENT sk_ff.os_err_type "Fehlertyp [RAM name from V530, voted 1]" UBYTE NO_COMPU_METHOD 0 0 0 255 ECU_ADDRESS 0x3F96F1 FORMAT "%.4g" /end MEASUREMENT
/begin MEASUREMENT sk_ff.reset_cnt "Resetzaehler [RAM name from V530, voted 1]" UBYTE M_FORMULA_0003 0 0 0 255 ECU_ADDRESS 0x3F96F2 /end MEASUREMENT
/begin MEASUREMENT sk_ff.stufe "SK-Stufe [RAM name from V530, voted 1]" UBYTE M_FORMULA_0003 0 0 0 255 ECU_ADDRESS 0x3F96F3 /end MEASUREMENT
/begin MEASUREMENT sk_ff.os_err_addr "OS-Err: Adresse [RAM name from V530, voted 1]" ULONG M_FORMULA_0000 0 0 0 4294967295 ECU_ADDRESS 0x3F96F4 /end MEASUREMENT
/begin MEASUREMENT sk_ff.proz_err "Prozess-Fehler [RAM name from V530, voted 1]" UWORD M_FORMULA_0010 0 0 0 65535 ECU_ADDRESS 0x3F96F8 /end MEASUREMENT
/begin MEASUREMENT sk_ff.task_err "Task-Fehler [RAM name from V530, voted 1]" UWORD M_FORMULA_0010 0 0 0 65535 ECU_ADDRESS 0x3F96FA /end MEASUREMENT
/begin MEASUREMENT tpu_kw_irq_info_cnt_nv_a "Anzahl Infointerrupts (+/- ein Zahn). [RAM name from V530, voted 7]" UBYTE M_FORMULA_0003 0 0 0 255 ECU_ADDRESS 0x3F96FC /end MEASUREMENT
/begin MEASUREMENT tpu_kw_irq_info_cnt_nv_b "Anzahl Infointerrupts (+/- ein Zahn). [RAM name from V530, voted 2]" UBYTE M_FORMULA_0003 0 0 0 255 ECU_ADDRESS 0x3F96FD /end MEASUREMENT
/begin MEASUREMENT pctrl_task_err_nv "Fehler Taskueberwachung [RAM name from V530, voted 3]" UBYTE M_FORMULA_0003 0 0 0 255 ECU_ADDRESS 0x3F96FE /end MEASUREMENT
/begin MEASUREMENT pctrl_proz_err_nv "Fehler Prozessueberwachung [RAM name from V530, voted 3]" UWORD M_FORMULA_0010 0 0 0 65535 ECU_ADDRESS 0x3F9700 /end MEASUREMENT
/begin MEASUREMENT sys_exc_vec_nv "Exception-Vector [RAM name from V530, voted 2]" UWORD NO_COMPU_METHOD 0 0 0 65535 ECU_ADDRESS 0x3F9702 FORMAT "%.4g" /end MEASUREMENT
/begin MEASUREMENT sys_exc_lr_nv "Exception-Linkregister [RAM name from V530, voted 2]" ULONG M_FORMULA_0000 0 0 0 4294967295 ECU_ADDRESS 0x3F9704 /end MEASUREMENT
/begin MEASUREMENT sys_exc_addr_nv "Exception-Adresse [RAM name from V530, voted 2]" ULONG M_FORMULA_0000 0 0 0 4294967295 ECU_ADDRESS 0x3F9708 /end MEASUREMENT
/begin MEASUREMENT sys_rsr_cnt_nv.ehrs "ExtHardReset [RAM name from V530, voted 4]" UBYTE M_FORMULA_0003 0 0 0 255 ECU_ADDRESS 0x3F970C /end MEASUREMENT
/begin MEASUREMENT sys_rsr_cnt_nv.esrs "ExtSoftReset [RAM name from V530, voted 1]" UBYTE M_FORMULA_0003 0 0 0 255 ECU_ADDRESS 0x3F970D /end MEASUREMENT
/begin MEASUREMENT ccp_retry_cnt_nv "Download Retryzaehler [RAM name from V530, voted 4]" UWORD M_FORMULA_0010 0 0 0 65535 ECU_ADDRESS 0x3F971A /end MEASUREMENT
/begin MEASUREMENT tpu_kw_err_ff_a.state "Zustand der TPU [RAM name from V530, voted 3]" UBYTE NO_COMPU_METHOD 0 0 0 255 ECU_ADDRESS 0x3F971C FORMAT "%.4g" /end MEASUREMENT
/begin MEASUREMENT os_proz_ff.mtime "Maximale Prozess Zeit [RAM name from V530, voted 4]" UWORD M_FORMULA_0018 0 0 0 65535 ECU_ADDRESS 0x3F9770 /end MEASUREMENT
/begin MEASUREMENT os_proz_ff.mtime_pid "PID des Prozesses mit max Zeit [RAM name from V530, voted 1]" UWORD M_FORMULA_0010 0 0 0 65535 ECU_ADDRESS 0x3F9772 /end MEASUREMENT
/begin MEASUREMENT os_proz_ff.n "Motordrehzahl [RAM name from V530, voted 1]" SWORD M_FORMULA_0006 0 0 -32768 32767 ECU_ADDRESS 0x3F9774 /end MEASUREMENT
/begin MEASUREMENT os_proz_ff.rf "relative Fuellung Mittel zwischen Bank 1 und 2 [RAM name from V530, voted 1]" SWORD M_FORMULA_0007 0 0 -3.2768 3.2767 ECU_ADDRESS 0x3F9776 /end MEASUREMENT
/begin MEASUREMENT os_proz_ff.zustand_motor "Betriebszustand der Motorsteuerung [RAM name from V530, voted 1]" UWORD NO_COMPU_METHOD 0 0 0 65535 ECU_ADDRESS 0x3F9778 FORMAT "%.4g" /end MEASUREMENT
/begin MEASUREMENT os_proz_ff.aq_soll_grad "Gradient AQ-Soll von Bank1 [RAM name from V530, voted 1]" SWORD M_FORMULA_0020 0 0 -655360 655340 ECU_ADDRESS 0x3F977A /end MEASUREMENT
/begin MEASUREMENT os_proz_ff.time_ml "Motor laeuft Zeit [RAM name from V530, voted 1]" UWORD M_FORMULA_0021 0 0 0 655.35 ECU_ADDRESS 0x3F977C /end MEASUREMENT
/begin MEASUREMENT os_proz_irq_ff.mtime "Maximale Prozess Zeit [RAM name from V530, voted 2]" UWORD M_FORMULA_0018 0 0 0 65535 ECU_ADDRESS 0x3F977E /end MEASUREMENT
/begin MEASUREMENT os_proz_irq_ff.mtime_pid "PID des Prozesses mit max Zeit [RAM name from V530, voted 1]" UWORD M_FORMULA_0010 0 0 0 65535 ECU_ADDRESS 0x3F9780 /end MEASUREMENT
/begin MEASUREMENT os_proz_irq_ff.n "Motordrehzahl [RAM name from V530, voted 1]" SWORD M_FORMULA_0006 0 0 -32768 32767 ECU_ADDRESS 0x3F9782 /end MEASUREMENT
/begin MEASUREMENT os_proz_irq_ff.rf "relative Fuellung Mittel zwischen Bank 1 und 2 [RAM name from V530, voted 1]" SWORD M_FORMULA_0007 0 0 -3.2768 3.2767 ECU_ADDRESS 0x3F9784 /end MEASUREMENT
/begin MEASUREMENT os_proz_irq_ff.zustand_motor "Betriebszustand der Motorsteuerung [RAM name from V530, voted 1]" UWORD NO_COMPU_METHOD 0 0 0 65535 ECU_ADDRESS 0x3F9786 FORMAT "%.4g" /end MEASUREMENT
/begin MEASUREMENT os_proz_irq_ff.aq_soll_grad "Gradient AQ-Soll von Bank1 [RAM name from V530, voted 1]" SWORD M_FORMULA_0020 0 0 -655360 655340 ECU_ADDRESS 0x3F9788 /end MEASUREMENT
/begin MEASUREMENT os_proz_irq_ff.time_ml "Motor laeuft Zeit [RAM name from V530, voted 1]" UWORD M_FORMULA_0021 0 0 0 655.35 ECU_ADDRESS 0x3F978A /end MEASUREMENT
/begin MEASUREMENT os_proz_irq_last_nv "CPU Last fuer diesen IRQ [RAM name from V530, voted 1]" UWORD M_FORMULA_0022 0 0 0 655.35 ECU_ADDRESS 0x3F978C /end MEASUREMENT
/begin MEASUREMENT ed_st_nv "Status-Eigendiagnose [RAM name from V530, voted 6]" UBYTE M_FORMULA_0037 0 0 0 255 ECU_ADDRESS 0x3F97A4 /end MEASUREMENT
/begin MEASUREMENT ed_st_nv_css_den "CSS-Denominator [RAM name from V530, voted 6]" UBYTE NO_COMPU_METHOD 0 0 0 255 ECU_ADDRESS 0x3F97A4 FORMAT "%.4g" /end MEASUREMENT
/begin MEASUREMENT ed_st_nv_css_num "CSS-Numerator [RAM name from V530, voted 6]" UBYTE NO_COMPU_METHOD 0 0 0 255 ECU_ADDRESS 0x3F97A4 FORMAT "%.4g" /end MEASUREMENT
/begin MEASUREMENT ed_st_nv_rbm_abbruch "Abbruch des RBM [RAM name from V530, voted 6]" UBYTE NO_COMPU_METHOD 0 0 0 255 ECU_ADDRESS 0x3F97A4 FORMAT "%.4g" /end MEASUREMENT
/begin MEASUREMENT ed_st_nv_rbm_dcy "Rate-Based-DCY [RAM name from V530, voted 6]" UBYTE NO_COMPU_METHOD 0 0 0 255 ECU_ADDRESS 0x3F97A4 FORMAT "%.4g" /end MEASUREMENT
/begin MEASUREMENT ed_st_nv_rbm_evap "RBM-EVAP-Bedingung [RAM name from V530, voted 6]" UBYTE NO_COMPU_METHOD 0 0 0 255 ECU_ADDRESS 0x3F97A4 FORMAT "%.4g" /end MEASUREMENT
/begin MEASUREMENT ed_st_nv_rbm_slp "RBM-SLP-Bedingung [RAM name from V530, voted 6]" UBYTE NO_COMPU_METHOD 0 0 0 255 ECU_ADDRESS 0x3F97A4 FORMAT "%.4g" /end MEASUREMENT
/begin MEASUREMENT ed_st_nv_wuc "Warmupcycleerkennung [RAM name from V530, voted 6]" UBYTE NO_COMPU_METHOD 0 0 0 255 ECU_ADDRESS 0x3F97A4 FORMAT "%.4g" /end MEASUREMENT
/begin MEASUREMENT ed_rbm_denominator_nv "Status der Denominatorerhoehung [RAM name from V530, voted 3]" UBYTE M_FORMULA_0003 0 0 0 255 ECU_ADDRESS 0x3F97A5 /end MEASUREMENT
/begin MEASUREMENT ed_mil_on_km_stand_nv "Kilometerstand MIL on [RAM name from V530, voted 6]" ULONG M_FORMULA_0027 0 0 0 4294967295 ECU_ADDRESS 0x3F97A8 /end MEASUREMENT
/begin MEASUREMENT ed_scdn_st_nv "Welche Fehler muessen mit similar Conditions behandelt werden [RAM name from V530, voted 7]" ULONG M_FORMULA_0000 0 0 0 4294967295 ECU_ADDRESS 0x3F97B0 /end MEASUREMENT
/begin MEASUREMENT ed_fil_sk_tr_ign.filter_nv "Filterwert vor und nach Eintrag [RAM name from V530, voted 17]" UBYTE M_FORMULA_0003 0 0 0 255 ECU_ADDRESS 0x3F97B4 /end MEASUREMENT
/begin MEASUREMENT ed_fil_sk_tr_ign.art_aktuell_nv "Fehlerart und Statusbits [RAM name from V530, voted 4]" UWORD NO_COMPU_METHOD 0 0 0 65535 ECU_ADDRESS 0x3F97B6 FORMAT "%.4g" /end MEASUREMENT
/begin MEASUREMENT ed_fil_tmot.art_aktuell_nv "Fehlerart und Statusbits [RAM name from V530, voted 6]" UWORD NO_COMPU_METHOD 0 0 0 65535 ECU_ADDRESS 0x3F97BC FORMAT "%.4g" /end MEASUREMENT
/begin MEASUREMENT ed_fil_tmot_obd.art_aktuell_nv "Fehlerart und Statusbits [RAM name from V530, voted 1]" UWORD NO_COMPU_METHOD 0 0 0 65535 ECU_ADDRESS 0x3F97C2 FORMAT "%.4g" /end MEASUREMENT
/begin MEASUREMENT ed_fil_tan1.art_aktuell_nv "Fehlerart und Statusbits [RAM name from V530, voted 1]" UWORD NO_COMPU_METHOD 0 0 0 65535 ECU_ADDRESS 0x3F97C8 FORMAT "%.4g" /end MEASUREMENT
/begin MEASUREMENT ed_fil_time_rel_obd.art_aktuell_nv "Fehlerart und Statusbits [RAM name from V530, voted 2]" UWORD NO_COMPU_METHOD 0 0 0 65535 ECU_ADDRESS 0x3F97D4 FORMAT "%.4g" /end MEASUREMENT
/begin MEASUREMENT ed_fil_ub.art_aktuell_nv "Fehlerart und Statusbits [RAM name from V530, voted 3]" UWORD NO_COMPU_METHOD 0 0 0 65535 ECU_ADDRESS 0x3F97DA FORMAT "%.4g" /end MEASUREMENT
/begin MEASUREMENT ed_fil_tdme.art_aktuell_nv "Fehlerart und Statusbits [RAM name from V530, voted 1]" UWORD NO_COMPU_METHOD 0 0 0 65535 ECU_ADDRESS 0x3F97E6 FORMAT "%.4g" /end MEASUREMENT
/begin MEASUREMENT ed_fil_appl_data_ign.art_aktuell_nv "Fehlerart und Statusbits [RAM name from V530, voted 2]" UWORD NO_COMPU_METHOD 0 0 0 65535 ECU_ADDRESS 0x3F97F8 FORMAT "%.4g" /end MEASUREMENT
/begin MEASUREMENT ed_fil_pwg1.art_aktuell_nv "Fehlerart und Statusbits [RAM name from V530, voted 3]" UWORD NO_COMPU_METHOD 0 0 0 65535 ECU_ADDRESS 0x3F9804 FORMAT "%.4g" /end MEASUREMENT
/begin MEASUREMENT ed_fil_pwg2.art_aktuell_nv "Fehlerart und Statusbits [RAM name from V530, voted 3]" UWORD NO_COMPU_METHOD 0 0 0 65535 ECU_ADDRESS 0x3F980A FORMAT "%.4g" /end MEASUREMENT
/begin MEASUREMENT ed_fil_pwg_vgl.art_aktuell_nv "Fehlerart und Statusbits [RAM name from V530, voted 2]" UWORD NO_COMPU_METHOD 0 0 0 65535 ECU_ADDRESS 0x3F9810 FORMAT "%.4g" /end MEASUREMENT
/begin MEASUREMENT ed_fil_pctrl_ign.art_aktuell_nv "Fehlerart und Statusbits [RAM name from V530, voted 1]" UWORD NO_COMPU_METHOD 0 0 0 65535 ECU_ADDRESS 0x3F9816 FORMAT "%.4g" /end MEASUREMENT
/begin MEASUREMENT ed_fil_smg_schaltab.art_aktuell_nv "Fehlerart und Statusbits [RAM name from V530, voted 2]" UWORD NO_COMPU_METHOD 0 0 0 65535 ECU_ADDRESS 0x3F9840 FORMAT "%.4g" /end MEASUREMENT
/begin MEASUREMENT ed_fil_smg_sk.art_aktuell_nv "Fehlerart und Statusbits [RAM name from V530, voted 1]" UWORD NO_COMPU_METHOD 0 0 0 65535 ECU_ADDRESS 0x3F9846 FORMAT "%.4g" /end MEASUREMENT
/begin MEASUREMENT ed_fil_smg_sk_n.art_aktuell_nv "Fehlerart und Statusbits [RAM name from V530, voted 1]" UWORD NO_COMPU_METHOD 0 0 0 65535 ECU_ADDRESS 0x3F984C FORMAT "%.4g" /end MEASUREMENT
/begin MEASUREMENT ed_fil_dk_init.art_aktuell_nv "Fehlerart und Statusbits [RAM name from V530, voted 1]" UWORD NO_COMPU_METHOD 0 0 0 65535 ECU_ADDRESS 0x3F985E FORMAT "%.4g" /end MEASUREMENT
/begin MEASUREMENT ed_fil_dk1_regler.art_aktuell_nv "Fehlerart und Statusbits [RAM name from V530, voted 1]" UWORD NO_COMPU_METHOD 0 0 0 65535 ECU_ADDRESS 0x3F9864 FORMAT "%.4g" /end MEASUREMENT
/begin MEASUREMENT ed_fil_dk2_regler.art_aktuell_nv "Fehlerart und Statusbits [RAM name from V530, voted 1]" UWORD NO_COMPU_METHOD 0 0 0 65535 ECU_ADDRESS 0x3F986A FORMAT "%.4g" /end MEASUREMENT
/begin MEASUREMENT ed_fil_dk1_wdk.art_aktuell_nv "Fehlerart und Statusbits [RAM name from V530, voted 4]" UWORD NO_COMPU_METHOD 0 0 0 65535 ECU_ADDRESS 0x3F98A0 FORMAT "%.4g" /end MEASUREMENT
/begin MEASUREMENT ed_fil_dk1_pdr.art_aktuell_nv "Fehlerart und Statusbits [RAM name from V530, voted 1]" UWORD NO_COMPU_METHOD 0 0 0 65535 ECU_ADDRESS 0x3F98AC FORMAT "%.4g" /end MEASUREMENT
/begin MEASUREMENT ed_fil_dk2_pdr.art_aktuell_nv "Fehlerart und Statusbits [RAM name from V530, voted 1]" UWORD NO_COMPU_METHOD 0 0 0 65535 ECU_ADDRESS 0x3F98B2 FORMAT "%.4g" /end MEASUREMENT
/begin MEASUREMENT ed_fil_dk1_sk_err.art_aktuell_nv "Fehlerart und Statusbits [RAM name from V530, voted 1]" UWORD NO_COMPU_METHOD 0 0 0 65535 ECU_ADDRESS 0x3F98C4 FORMAT "%.4g" /end MEASUREMENT
/begin MEASUREMENT ed_fil_dk2_sk_err.art_aktuell_nv "Fehlerart und Statusbits [RAM name from V530, voted 1]" UWORD NO_COMPU_METHOD 0 0 0 65535 ECU_ADDRESS 0x3F98CA FORMAT "%.4g" /end MEASUREMENT
/begin MEASUREMENT ed_fil_dk1_federn.art_aktuell_nv "Fehlerart und Statusbits [RAM name from V530, voted 4]" UWORD NO_COMPU_METHOD 0 0 0 65535 ECU_ADDRESS 0x3F98D0 FORMAT "%.4g" /end MEASUREMENT
/begin MEASUREMENT ed_fil_dk2_federn.art_aktuell_nv "Fehlerart und Statusbits [RAM name from V530, voted 1]" UWORD NO_COMPU_METHOD 0 0 0 65535 ECU_ADDRESS 0x3F98D6 FORMAT "%.4g" /end MEASUREMENT
/begin MEASUREMENT ed_fil_md_sk_err.art_aktuell_nv "Fehlerart und Statusbits [RAM name from V530, voted 1]" UWORD NO_COMPU_METHOD 0 0 0 65535 ECU_ADDRESS 0x3F98DC FORMAT "%.4g" /end MEASUREMENT
/begin MEASUREMENT ed_fil_dk1_cmd.art_aktuell_nv "Fehlerart und Statusbits [RAM name from V530, voted 1]" UWORD NO_COMPU_METHOD 0 0 0 65535 ECU_ADDRESS 0x3F98EE FORMAT "%.4g" /end MEASUREMENT
/begin MEASUREMENT ed_fil_dk2_cmd.art_aktuell_nv "Fehlerart und Statusbits [RAM name from V530, voted 1]" UWORD NO_COMPU_METHOD 0 0 0 65535 ECU_ADDRESS 0x3F98F4 FORMAT "%.4g" /end MEASUREMENT
/begin MEASUREMENT ed_fil_lls1_cmd.art_aktuell_nv "Fehlerart und Statusbits [RAM name from V530, voted 1]" UWORD NO_COMPU_METHOD 0 0 0 65535 ECU_ADDRESS 0x3F98FA FORMAT "%.4g" /end MEASUREMENT
/begin MEASUREMENT ed_fil_sc_smg1.art_aktuell_nv "Fehlerart und Statusbits [RAM name from V530, voted 1]" UWORD NO_COMPU_METHOD 0 0 0 65535 ECU_ADDRESS 0x3F9906 FORMAT "%.4g" /end MEASUREMENT
/begin MEASUREMENT ed_fil_sc_smg2.art_aktuell_nv "Fehlerart und Statusbits [RAM name from V530, voted 1]" UWORD NO_COMPU_METHOD 0 0 0 65535 ECU_ADDRESS 0x3F990C FORMAT "%.4g" /end MEASUREMENT
/begin MEASUREMENT ed_fil_sc_busoff.art_aktuell_nv "Fehlerart und Statusbits [RAM name from V530, voted 6]" UWORD NO_COMPU_METHOD 0 0 0 65535 ECU_ADDRESS 0x3F9918 FORMAT "%.4g" /end MEASUREMENT
/begin MEASUREMENT ed_fil_ec_busoff.art_aktuell_nv "Fehlerart und Statusbits [RAM name from V530, voted 4]" UWORD NO_COMPU_METHOD 0 0 0 65535 ECU_ADDRESS 0x3F991E FORMAT "%.4g" /end MEASUREMENT
/begin MEASUREMENT ed_fil_auss_kat_mult.art_aktuell_nv "Fehlerart und Statusbits [RAM name from V530, voted 1]" UWORD NO_COMPU_METHOD 0 0 0 65535 ECU_ADDRESS 0x3F996C FORMAT "%.4g" /end MEASUREMENT
/begin MEASUREMENT ed_fil_auss_abg_z1.art_aktuell_nv "Fehlerart und Statusbits [RAM name from V530, voted 1]" UWORD NO_COMPU_METHOD 0 0 0 65535 ECU_ADDRESS 0x3F9972 FORMAT "%.4g" /end MEASUREMENT
/begin MEASUREMENT ed_fil_auss_abg_z2.art_aktuell_nv "Fehlerart und Statusbits [RAM name from V530, voted 1]" UWORD NO_COMPU_METHOD 0 0 0 65535 ECU_ADDRESS 0x3F9978 FORMAT "%.4g" /end MEASUREMENT
/begin MEASUREMENT ed_fil_auss_abg_z3.art_aktuell_nv "Fehlerart und Statusbits [RAM name from V530, voted 1]" UWORD NO_COMPU_METHOD 0 0 0 65535 ECU_ADDRESS 0x3F997E FORMAT "%.4g" /end MEASUREMENT
/begin MEASUREMENT ed_fil_auss_abg_z4.art_aktuell_nv "Fehlerart und Statusbits [RAM name from V530, voted 2]" UWORD NO_COMPU_METHOD 0 0 0 65535 ECU_ADDRESS 0x3F9984 FORMAT "%.4g" /end MEASUREMENT
/begin MEASUREMENT ed_fil_auss_abg_z6.art_aktuell_nv "Fehlerart und Statusbits [RAM name from V530, voted 1]" UWORD NO_COMPU_METHOD 0 0 0 65535 ECU_ADDRESS 0x3F992A FORMAT "%.4g" /end MEASUREMENT
/begin MEASUREMENT ed_fil_auss_abg_z7.art_aktuell_nv "Fehlerart und Statusbits [RAM name from V530, voted 1]" UWORD NO_COMPU_METHOD 0 0 0 65535 ECU_ADDRESS 0x3F9930 FORMAT "%.4g" /end MEASUREMENT
/begin MEASUREMENT ed_fil_auss_abg_z8.art_aktuell_nv "Fehlerart und Statusbits [RAM name from V530, voted 1]" UWORD NO_COMPU_METHOD 0 0 0 65535 ECU_ADDRESS 0x3F9936 FORMAT "%.4g" /end MEASUREMENT
/begin MEASUREMENT ed_fil_auss_abg_z9.art_aktuell_nv "Fehlerart und Statusbits [RAM name from V530, voted 1]" UWORD NO_COMPU_METHOD 0 0 0 65535 ECU_ADDRESS 0x3F993C FORMAT "%.4g" /end MEASUREMENT
/begin MEASUREMENT ed_fil_auss_abg_z10.art_aktuell_nv "Fehlerart und Statusbits [RAM name from V530, voted 1]" UWORD NO_COMPU_METHOD 0 0 0 65535 ECU_ADDRESS 0x3F9942 FORMAT "%.4g" /end MEASUREMENT
/begin MEASUREMENT ed_fil_auss_abg_mult.art_aktuell_nv "Fehlerart und Statusbits [RAM name from V530, voted 1]" UWORD NO_COMPU_METHOD 0 0 0 65535 ECU_ADDRESS 0x3F99BA FORMAT "%.4g" /end MEASUREMENT
/begin MEASUREMENT ed_fil_sc_pks.art_aktuell_nv "Fehlerart und Statusbits [RAM name from V530, voted 1]" UWORD NO_COMPU_METHOD 0 0 0 65535 ECU_ADDRESS 0x3F99CC FORMAT "%.4g" /end MEASUREMENT
/begin MEASUREMENT ed_fil_zoelp1.art_aktuell_nv "Fehlerart und Statusbits [RAM name from V530, voted 1]" UWORD NO_COMPU_METHOD 0 0 0 65535 ECU_ADDRESS 0x3F99D2 FORMAT "%.4g" /end MEASUREMENT
/begin MEASUREMENT ed_fil_e2_ign.art_aktuell_nv "Fehlerart und Statusbits [RAM name from V530, voted 1]" UWORD NO_COMPU_METHOD 0 0 0 65535 ECU_ADDRESS 0x3F99E4 FORMAT "%.4g" /end MEASUREMENT
/begin MEASUREMENT ed_fil_bls_plau.art_aktuell_nv "Fehlerart und Statusbits [RAM name from V530, voted 3]" UWORD NO_COMPU_METHOD 0 0 0 65535 ECU_ADDRESS 0x3F99EA FORMAT "%.4g" /end MEASUREMENT
/begin MEASUREMENT ed_fil_thermostat.art_aktuell_nv "Fehlerart und Statusbits [RAM name from V530, voted 2]" UWORD NO_COMPU_METHOD 0 0 0 65535 ECU_ADDRESS 0x3F99FC FORMAT "%.4g" /end MEASUREMENT
/begin MEASUREMENT ed_fil_pwg_bls.art_aktuell_nv "Fehlerart und Statusbits [RAM name from V530, voted 1]" UWORD NO_COMPU_METHOD 0 0 0 65535 ECU_ADDRESS 0x3F9A1A FORMAT "%.4g" /end MEASUREMENT
/begin MEASUREMENT ed_fil_start_rl.art_aktuell_nv "Fehlerart und Statusbits [RAM name from V530, voted 1]" UWORD NO_COMPU_METHOD 0 0 0 65535 ECU_ADDRESS 0x3F9A20 FORMAT "%.4g" /end MEASUREMENT
/begin MEASUREMENT ed_fil_n_getr_ein_hs.art_aktuell_nv "Fehlerart und Statusbits [RAM name from V530, voted 1]" UWORD NO_COMPU_METHOD 0 0 0 65535 ECU_ADDRESS 0x3F9A2C FORMAT "%.4g" /end MEASUREMENT
/begin MEASUREMENT ed_fil_servo_v.art_aktuell_nv "Fehlerart und Statusbits [RAM name from V530, voted 1]" UWORD NO_COMPU_METHOD 0 0 0 65535 ECU_ADDRESS 0x3F9A38 FORMAT "%.4g" /end MEASUREMENT
/begin MEASUREMENT ed_fil_tmot_obd_high.art_aktuell_nv "Fehlerart und Statusbits [RAM name from V530, voted 2]" UWORD NO_COMPU_METHOD 0 0 0 65535 ECU_ADDRESS 0x3F9A4A FORMAT "%.4g" /end MEASUREMENT
/begin MEASUREMENT ed_fsp_1of20_.fehlercode_nv "Externer Fehlerort [RAM name from V530, voted 10]" UWORD NO_COMPU_METHOD 0 0 0 65535 ECU_ADDRESS 0x3F9CB4 FORMAT "%.4g" /end MEASUREMENT
/begin MEASUREMENT pwg_max_diff_adapt_nv "Maximal aufgetretene Differenz der Pedalwertgeber [RAM name from V530, voted 6]" SWORD M_FORMULA_0001 0 0 -3276.8 3276.7 ECU_ADDRESS 0x3FA320 /end MEASUREMENT
/begin MEASUREMENT pwg1_a0_nv "Absolute Potentiometerspannung 1 fuer LL [RAM name from V530, voted 11]" SWORD M_FORMULA_0250 0 0 -160 159.9951172 ECU_ADDRESS 0x3FA322 /end MEASUREMENT
/begin MEASUREMENT pwg2_a0_nv "Absolute Potentiometerspannung 2 fuer LL [RAM name from V530, voted 9]" SWORD M_FORMULA_0251 0 0 -80 79.99755859 ECU_ADDRESS 0x3FA324 /end MEASUREMENT
/begin MEASUREMENT tabg_lw_stand_nv_b1 "Offset zu TUMG beim Abstellen [RAM name from V530, voted 4]" SWORD M_FORMULA_0074 0 0 -3276.8 3276.7 ECU_ADDRESS 0x3FA32A /end MEASUREMENT
/begin MEASUREMENT tabg_vkat_stand_nv_b1 "Offset zu TUMG beim Abstellen [RAM name from V530, voted 3]" SWORD M_FORMULA_0074 0 0 -3276.8 3276.7 ECU_ADDRESS 0x3FA32E /end MEASUREMENT
/begin MEASUREMENT tabg_nkat_stand_nv_b1 "Offset zu TUMG beim Abstellen [RAM name from V530, voted 4]" SWORD M_FORMULA_0074 0 0 -3276.8 3276.7 ECU_ADDRESS 0x3FA332 /end MEASUREMENT
/begin MEASUREMENT tabg_nkat_max_nv_b1 "Maximale Nachkattemperatur [RAM name from V530, voted 3]" SWORD M_FORMULA_0023 0 0 -3550 3003.5 ECU_ADDRESS 0x3FA336 /end MEASUREMENT
/begin MEASUREMENT fpga_lade_errors_nv "Anzahl fehlgeschlagener FPGA loads [RAM name from V530, voted 5]" UBYTE M_FORMULA_0423 0 0 0 255 ECU_ADDRESS 0x3FA33A /end MEASUREMENT
/begin MEASUREMENT auss_erk_nv_zyl1 "Zaehler Zuendaussetzer. [RAM name from V530, voted 1]" UWORD M_FORMULA_0010 0 0 0 65535 ECU_ADDRESS 0x3FA356 /end MEASUREMENT
/begin MEASUREMENT auss_erk_ti_nv_zyl1 "Zaehler Verbrennungsaussetzererkennung. [RAM name from V530, voted 1]" UWORD M_FORMULA_0010 0 0 0 65535 ECU_ADDRESS 0x3FA36A /end MEASUREMENT
/begin MEASUREMENT auss_erk_ns_nv_zyl1 "Zaehler Nebenschlusserkennung. [RAM name from V530, voted 1]" UWORD M_FORMULA_0010 0 0 0 65535 ECU_ADDRESS 0x3FA37E /end MEASUREMENT
/begin MEASUREMENT llr_ad_md_norm "Adaptionswert [RAM name from V530, voted 8]" SWORD M_FORMULA_0009 0 0 -3276.8 3276.7 ECU_ADDRESS 0x3FA728 /end MEASUREMENT
/begin MEASUREMENT llr_ad_md_ac "Adaptionswert mit Klima [RAM name from V530, voted 7]" SWORD M_FORMULA_0009 0 0 -3276.8 3276.7 ECU_ADDRESS 0x3FA72A /end MEASUREMENT
/begin MEASUREMENT zoelp_ans_cnt_nv "Anzahl der Ansteuerungen [RAM name from V530, voted 4]" UWORD M_FORMULA_0010 0 0 0 65535 ECU_ADDRESS 0x3FA72C /end MEASUREMENT
/begin MEASUREMENT egas_lls_ff_b1.n "Drehzahl [RAM name from V530, voted 1]" SWORD M_FORMULA_0006 0 0 -32768 32767 ECU_ADDRESS 0x3FA760 /end MEASUREMENT
/begin MEASUREMENT smg_adapt_ihar_nv "Hinterachs- und Raduebersetzung [RAM name from V530, voted 6]" UWORD M_FORMULA_0073 0 0 0 63.99902344 ECU_ADDRESS 0x3FA7EE /end MEASUREMENT
/begin MEASUREMENT schalter_bls_counter_nv "Haeufigkeitszaehler Bremse [RAM name from V530, voted 3]" ULONG M_FORMULA_0000 0 0 0 4294967295 ECU_ADDRESS 0x3FA7F0 /end MEASUREMENT
/begin MEASUREMENT md_sk_timer_0_nv "SK-Timer bei pwg=0 - NV [RAM name from V530, voted 3]" UWORD M_FORMULA_0021 0 0 0 655.35 ECU_ADDRESS 0x3FA80C /end MEASUREMENT
/begin MEASUREMENT md_sk_timer_1_nv "SK-Timer bei pwg>0 - NV [RAM name from V530, voted 1]" UWORD M_FORMULA_0021 0 0 0 655.35 ECU_ADDRESS 0x3FA80E /end MEASUREMENT
/begin MEASUREMENT md_sk_vergl_diff_nv "Soll-/Istabweichung - NV [RAM name from V530, voted 2]" SWORD M_FORMULA_0009 0 0 -3276.8 3276.7 ECU_ADDRESS 0x3FA810 /end MEASUREMENT
/begin MEASUREMENT md_ff_e2.n "Drehzzahl [RAM name from V530, voted 5]" SWORD M_FORMULA_0006 0 0 -32768 32767 ECU_ADDRESS 0x3FA812 /end MEASUREMENT
/begin MEASUREMENT md_ff_e2.rf_m "Fuellung [RAM name from V530, voted 1]" SWORD M_FORMULA_0007 0 0 -3.2768 3.2767 ECU_ADDRESS 0x3FA814 /end MEASUREMENT
/begin MEASUREMENT md_ff_e2.rf_pt_korr "Fuellungskorrektur [RAM name from V530, voted 1]" UWORD M_FORMULA_0073 0 0 0 63.99902344 ECU_ADDRESS 0x3FA816 /end MEASUREMENT
/begin MEASUREMENT md_ff_e2.toel "Oeltemperatur [RAM name from V530, voted 1]" SWORD M_FORMULA_0023 0 0 -3550 3003.5 ECU_ADDRESS 0x3FA818 /end MEASUREMENT
/begin MEASUREMENT md_ff_e2.fw_rel "Rel. Fahrerwunsch [RAM name from V530, voted 2]" SWORD M_FORMULA_0001 0 0 -3276.8 3276.7 ECU_ADDRESS 0x3FA81A /end MEASUREMENT
/begin MEASUREMENT md_ff_e2.fw_rel_diff "Rel. Fahrerwunsch - Differenz [RAM name from V530, voted 2]" SWORD M_FORMULA_0001 0 0 -3276.8 3276.7 ECU_ADDRESS 0x3FA81C /end MEASUREMENT
/begin MEASUREMENT md_ff_e2.kupp_max "Maximalmoment [RAM name from V530, voted 1]" SWORD M_FORMULA_0009 0 0 -3276.8 3276.7 ECU_ADDRESS 0x3FA81E /end MEASUREMENT
/begin MEASUREMENT md_ff_e2.kupp_max_diff "Maximalmoment - Differenz [RAM name from V530, voted 1]" SWORD M_FORMULA_0009 0 0 -3276.8 3276.7 ECU_ADDRESS 0x3FA820 /end MEASUREMENT
/begin MEASUREMENT md_ff_e2.kupp_min "Minimalmoment [RAM name from V530, voted 1]" SWORD M_FORMULA_0009 0 0 -3276.8 3276.7 ECU_ADDRESS 0x3FA822 /end MEASUREMENT
/begin MEASUREMENT md_ff_e2.kupp_min_diff "Minimalmoment - Differenz [RAM name from V530, voted 1]" SWORD M_FORMULA_0009 0 0 -3276.8 3276.7 ECU_ADDRESS 0x3FA824 /end MEASUREMENT
/begin MEASUREMENT md_ff_e2.schlepp "Schleppmoment [RAM name from V530, voted 1]" SWORD M_FORMULA_0009 0 0 -3276.8 3276.7 ECU_ADDRESS 0x3FA826 /end MEASUREMENT
/begin MEASUREMENT md_ff_e2.schlepp_diff "Schleppmoment - Differenz [RAM name from V530, voted 1]" SWORD M_FORMULA_0009 0 0 -3276.8 3276.7 ECU_ADDRESS 0x3FA828 /end MEASUREMENT
/begin MEASUREMENT md_ff_e2.kupp_wunsch "Wunschmoment (Fahrer, FGR) [RAM name from V530, voted 1]" SWORD M_FORMULA_0009 0 0 -3276.8 3276.7 ECU_ADDRESS 0x3FA82A /end MEASUREMENT
/begin MEASUREMENT md_ff_e2.kupp_soll "Sollmoment [RAM name from V530, voted 1]" SWORD M_FORMULA_0009 0 0 -3276.8 3276.7 ECU_ADDRESS 0x3FA82C /end MEASUREMENT
/begin MEASUREMENT md_ff_e2.kupp_ist "Istmoment [RAM name from V530, voted 1]" SWORD M_FORMULA_0009 0 0 -3276.8 3276.7 ECU_ADDRESS 0x3FA82E /end MEASUREMENT
/begin MEASUREMENT md_ff_e2.ind_opt "ind. Optimal [RAM name from V530, voted 1]" SWORD M_FORMULA_0009 0 0 -3276.8 3276.7 ECU_ADDRESS 0x3FA830 /end MEASUREMENT
/begin MEASUREMENT md_ff_e2.ind_opt_diff "ind. Optimal - Differenz [RAM name from V530, voted 1]" SWORD M_FORMULA_0009 0 0 -3276.8 3276.7 ECU_ADDRESS 0x3FA832 /end MEASUREMENT
/begin MEASUREMENT md_ff_e2.eta_zw_ne_e2 "Eta aus Ebene 2 [RAM name from V530, voted 1]" UWORD M_FORMULA_0437 0 0 0 199.9969482 ECU_ADDRESS 0x3FA834 /end MEASUREMENT
/begin MEASUREMENT md_ff_e2.eta_zw_ne "Eta aus Ebene 1 [RAM name from V530, voted 1]" UWORD M_FORMULA_0437 0 0 0 199.9969482 ECU_ADDRESS 0x3FA836 /end MEASUREMENT
/begin MEASUREMENT md_ff_e2.ti_tpu_st "Ausblendstatus [RAM name from V530, voted 1]" UWORD M_FORMULA_0010 0 0 0 65535 ECU_ADDRESS 0x3FA838 /end MEASUREMENT
/begin MEASUREMENT time_rel_diag_nl_nv "Relativzeit aus letztem Nachlauf [RAM name from V530, voted 5]" ULONG M_FORMULA_0145 0 0 0 71582788.25 ECU_ADDRESS 0x3FA83C /end MEASUREMENT
/begin MEASUREMENT time_rel_diag_nl_2_nv "Relativzeit aus vorletztem Nachlauf [RAM name from V530, voted 2]" ULONG M_FORMULA_0145 0 0 0 71582788.25 ECU_ADDRESS 0x3FA840 /end MEASUREMENT
/begin MEASUREMENT time_rel_zero_cnt_nv "time_rel-Reset-Zaehler [RAM name from V530, voted 8]" UBYTE M_FORMULA_0003 0 0 0 255 ECU_ADDRESS 0x3FA844 /end MEASUREMENT
/begin MEASUREMENT auss_ff.st "FF-Zustand [RAM name from V530, voted 6]" UWORD NO_COMPU_METHOD 0 0 0 65535 ECU_ADDRESS 0x3FA848 FORMAT "%.4g" /end MEASUREMENT
/begin MEASUREMENT auss_ff.n "Drehzahl [RAM name from V530, voted 1]" SWORD M_FORMULA_0006 0 0 -32768 32767 ECU_ADDRESS 0x3FA84A /end MEASUREMENT
/begin MEASUREMENT auss_ff.ub "Spannung [RAM name from V530, voted 1]" SWORD M_FORMULA_0008 0 0 -3276.8 3276.7 ECU_ADDRESS 0x3FA84C /end MEASUREMENT
/begin MEASUREMENT auss_ff.pks_rel "rel. Kraftstoffdruck [RAM name from V530, voted 1]" SWORD M_FORMULA_0110 0 0 -32.768 32.767 ECU_ADDRESS 0x3FA84E /end MEASUREMENT
/begin MEASUREMENT auss_ff.ti_tpu_st "Freigabe Einspritzung [RAM name from V530, voted 1]" UWORD M_FORMULA_0010 0 0 0 65535 ECU_ADDRESS 0x3FA850 /end MEASUREMENT
/begin MEASUREMENT auss_ff.zustand_motor "Betriebszustand [RAM name from V530, voted 1]" UWORD NO_COMPU_METHOD 0 0 0 65535 ECU_ADDRESS 0x3FA852 FORMAT "%.4g" /end MEASUREMENT
/begin MEASUREMENT auss_ff.time_ml "Zeit seit Motor laeuft [RAM name from V530, voted 1]" ULONG M_FORMULA_0147 0 0 0 42949672.95 ECU_ADDRESS 0x3FA854 /end MEASUREMENT
/begin MEASUREMENT auss_ff.rf "Fuellung [RAM name from V530, voted 1]" SWORD M_FORMULA_0007 0 0 -3.2768 3.2767 ECU_ADDRESS 0x3FA858 /end MEASUREMENT
/begin MEASUREMENT auss_ff.rf_hfm "Fuellung vom HFM [RAM name from V530, voted 1]" SWORD M_FORMULA_0007 0 0 -3.2768 3.2767 ECU_ADDRESS 0x3FA85A /end MEASUREMENT
/begin MEASUREMENT auss_ff.rf_aq "Fuellung vom AQ [RAM name from V530, voted 1]" SWORD M_FORMULA_0007 0 0 -3.2768 3.2767 ECU_ADDRESS 0x3FA85C /end MEASUREMENT
/begin MEASUREMENT auss_ff.lam_ist_mw "Mittelwert IST-Lambda [RAM name from V530, voted 1]" UWORD M_FORMULA_0025 0 0 0 3.999938965 ECU_ADDRESS 0x3FA85E /end MEASUREMENT
/begin MEASUREMENT auss_ff.laa_f_ber_nv "Faktor-Lambdaadaption ohne TE [RAM name from V530, voted 1]" UWORD M_FORMULA_0024 0 0 0 1.999969482 ECU_ADDRESS 0x3FA860 /end MEASUREMENT
/begin MEASUREMENT auss_ff.van_ist_e "Einlassvanos Istposition [RAM name from V530, voted 1]" SWORD M_FORMULA_0102 0 0 -3276.8 3276.7 ECU_ADDRESS 0x3FA862 /end MEASUREMENT
/begin MEASUREMENT auss_ff.van_soll_e "Einlassvanos Sollwert [RAM name from V530, voted 1]" SWORD M_FORMULA_0102 0 0 -3276.8 3276.7 ECU_ADDRESS 0x3FA864 /end MEASUREMENT
/begin MEASUREMENT auss_ff.van_ist_a "Auslassvanos Istposition [RAM name from V530, voted 1]" SWORD M_FORMULA_0102 0 0 -3276.8 3276.7 ECU_ADDRESS 0x3FA866 /end MEASUREMENT
/begin MEASUREMENT auss_ff.van_soll_a "Auslassvanos Sollwert [RAM name from V530, voted 1]" SWORD M_FORMULA_0102 0 0 -3276.8 3276.7 ECU_ADDRESS 0x3FA868 /end MEASUREMENT
/begin MEASUREMENT auss_ff.egas_wdk_abs "korr. U_WDK [RAM name from V530, voted 1]" SWORD M_FORMULA_0250 0 0 -160 159.9951172 ECU_ADDRESS 0x3FA86A /end MEASUREMENT
/begin MEASUREMENT auss_ff.egas_ist_lls "Istwert LLS (CAN) [RAM name from V530, voted 1]" SWORD M_FORMULA_0001 0 0 -3276.8 3276.7 ECU_ADDRESS 0x3FA86C /end MEASUREMENT
/begin MEASUREMENT auss_ff.auss_lp_int "TP-Integral-Leitwert im Aussetzerfenster [RAM name from V530, voted 1]" SWORD M_FORMULA_0227 0 0 -639.6988621 639.67934 ECU_ADDRESS 0x3FA870 /end MEASUREMENT
/begin MEASUREMENT auss_ff.auss_spark_time "Funkenbrenndauer. [RAM name from V530, voted 1]" SWORD M_FORMULA_0445 0 0 -4.681142857 4.681 ECU_ADDRESS 0x3FA872 /end MEASUREMENT
/begin MEASUREMENT auss_ff.auss_ns_time "Nebenschlusszeit im Aussetzerfenster. [RAM name from V530, voted 1]" UWORD M_FORMULA_0446 0 0 0 262.14 ECU_ADDRESS 0x3FA874 /end MEASUREMENT
/begin MEASUREMENT auss_ff.auss_lp_min "Offset Leitwert im Aussetzerfenster. [RAM name from V530, voted 1]" SWORD M_FORMULA_0442 0 0 -26.39986688 26.39906122 ECU_ADDRESS 0x3FA876 /end MEASUREMENT
/begin MEASUREMENT pwg_bls_ff.can_km_stand_nv "Kilometerstand [RAM name from V530, voted 4]" ULONG M_FORMULA_0027 0 0 0 4294967295 ECU_ADDRESS 0x3FA8B8 /end MEASUREMENT
/begin MEASUREMENT pwg_bls_ff.anzahl_nv "Anzahl der Gas-Bremse-Betaetigungen [RAM name from V530, voted 1]" UWORD M_FORMULA_0010 0 0 0 65535 ECU_ADDRESS 0x3FA8BC /end MEASUREMENT
/begin MEASUREMENT pwg_bls_ff.can_brp_nv "Bremsdruck [RAM name from V530, voted 1]" UBYTE M_FORMULA_0129 0 0 0 255 ECU_ADDRESS 0x3FA8BF /end MEASUREMENT
/begin MEASUREMENT pwg_bls_ff.mvac_p_nv "gemessener Differenzdruck(Senor) Mastervac/Umgebung [RAM name from V530, voted 1]" SWORD M_FORMULA_0075 0 0 -2048 2047.9375 ECU_ADDRESS 0x3FA8C0 /end MEASUREMENT
/begin MEASUREMENT pwg_bls_ff.v_vorne_nv "v-Vorderachse [RAM name from V530, voted 1]" SWORD M_FORMULA_0076 0 0 -2048 2047.9375 ECU_ADDRESS 0x3FA8C8 /end MEASUREMENT
/begin MEASUREMENT eth_ok "Ethernet Controller OK [RAM name from V530, voted 13]" UBYTE NO_COMPU_METHOD 0 0 0 255 ECU_ADDRESS 0x3FB020 FORMAT "%.4g" /end MEASUREMENT
/begin MEASUREMENT ccp_aramStatus "CCP RAM-Status [RAM name from V530, voted 3]" UBYTE NO_COMPU_METHOD 0 0 0 255 ECU_ADDRESS 0x3FB18C FORMAT "%.4g" /end MEASUREMENT
/begin MEASUREMENT ccp_reqSwitch "CCP Umschalt-Status [RAM name from V530, voted 5]" UBYTE NO_COMPU_METHOD 0 0 0 255 ECU_ADDRESS 0x3FB18D FORMAT "%.4g" /end MEASUREMENT
/begin MEASUREMENT ccp_stateChecksum "CCP ChkSum-Status [RAM name from V530, voted 2]" UBYTE NO_COMPU_METHOD 0 0 0 255 ECU_ADDRESS 0x3FB1A0 FORMAT "%.4g" /end MEASUREMENT
/begin MEASUREMENT ccp_moveStatus "CCP Move-Status [RAM name from V530, voted 6]" UBYTE NO_COMPU_METHOD 0 0 0 255 ECU_ADDRESS 0x3FB1B0 FORMAT "%.4g" /end MEASUREMENT
/begin MEASUREMENT ag_tz_zyl "Naechster Zylinder der ausgeblendet wird. [RAM name from V530, voted 9]" UBYTE M_FORMULA_0408 0 0 1 256 ECU_ADDRESS 0x3FBBEC /end MEASUREMENT
/begin MEASUREMENT ag_tz_exd_state "Exd-State. [RAM name from V530, voted 1]" UBYTE NO_COMPU_METHOD 0 0 0 255 ECU_ADDRESS 0x3FBBED FORMAT "%.4g" /end MEASUREMENT
/begin MEASUREMENT ag_tz_cfg_ctrl "Welcher Aussetzergenerator [RAM name from V530, voted 4]" UBYTE NO_COMPU_METHOD 0 0 0 255 ECU_ADDRESS 0x3FBBEE FORMAT "%.4g" /end MEASUREMENT
/begin MEASUREMENT ag_tz_zyl_ctrl "Statisches Ausblendmuster. [RAM name from V530, voted 2]" UWORD M_FORMULA_0010 0 0 0 65535 ECU_ADDRESS 0x3FBBF0 /end MEASUREMENT
/begin MEASUREMENT ag_tz_anz_ctrl "Anzahl der unmittelbar aufeinanderfolgenden Ausblendungen. [RAM name from V530, voted 4]" UWORD M_FORMULA_0010 0 0 0 65535 ECU_ADDRESS 0x3FBBF2 /end MEASUREMENT
/begin MEASUREMENT ag_tz_pause_ctrl "Anzahl der Arbeitsspiele zwischen Ausblendungen. [RAM name from V530, voted 4]" UWORD M_FORMULA_0010 0 0 0 65535 ECU_ADDRESS 0x3FBBF4 /end MEASUREMENT
/begin MEASUREMENT ag_tz_anz "Zaehler der unmittelbar aufeinanderfolgenden Ausblendungen. [RAM name from V530, voted 12]" UWORD M_FORMULA_0010 0 0 0 65535 ECU_ADDRESS 0x3FBBF6 /end MEASUREMENT
/begin MEASUREMENT ag_tz_pause "Zaehler der Arbeitsspiele zwischen Ausblendungen. [RAM name from V530, voted 10]" UWORD M_FORMULA_0010 0 0 0 65535 ECU_ADDRESS 0x3FBBF8 /end MEASUREMENT
/begin MEASUREMENT ag_tz_mask "Status Aussetzergenerator. [RAM name from V530, voted 9]" UWORD NO_COMPU_METHOD 0 0 0 65535 ECU_ADDRESS 0x3FBBFA FORMAT "%.4g" /end MEASUREMENT
/begin MEASUREMENT ag_tz_mask_zyl1 "Ausblendung Zylinder 1. [RAM name from V530, voted 9]" UWORD NO_COMPU_METHOD 0 0 0 65535 ECU_ADDRESS 0x3FBBFA FORMAT "%.4g" /end MEASUREMENT
/begin MEASUREMENT ag_tz_mask_zyl10 "Ausblendung Zylinder 10. [RAM name from V530, voted 9]" UWORD NO_COMPU_METHOD 0 0 0 65535 ECU_ADDRESS 0x3FBBFA FORMAT "%.4g" /end MEASUREMENT
/begin MEASUREMENT ag_tz_mask_zyl2 "Ausblendung Zylinder 2. [RAM name from V530, voted 9]" UWORD NO_COMPU_METHOD 0 0 0 65535 ECU_ADDRESS 0x3FBBFA FORMAT "%.4g" /end MEASUREMENT
/begin MEASUREMENT ag_tz_mask_zyl3 "Ausblendung Zylinder 3. [RAM name from V530, voted 9]" UWORD NO_COMPU_METHOD 0 0 0 65535 ECU_ADDRESS 0x3FBBFA FORMAT "%.4g" /end MEASUREMENT
/begin MEASUREMENT ag_tz_mask_zyl4 "Ausblendung Zylinder 4. [RAM name from V530, voted 9]" UWORD NO_COMPU_METHOD 0 0 0 65535 ECU_ADDRESS 0x3FBBFA FORMAT "%.4g" /end MEASUREMENT
/begin MEASUREMENT ag_tz_mask_zyl5 "Ausblendung Zylinder 5. [RAM name from V530, voted 9]" UWORD NO_COMPU_METHOD 0 0 0 65535 ECU_ADDRESS 0x3FBBFA FORMAT "%.4g" /end MEASUREMENT
/begin MEASUREMENT ag_tz_mask_zyl6 "Ausblendung Zylinder 6. [RAM name from V530, voted 9]" UWORD NO_COMPU_METHOD 0 0 0 65535 ECU_ADDRESS 0x3FBBFA FORMAT "%.4g" /end MEASUREMENT
/begin MEASUREMENT ag_tz_mask_zyl7 "Ausblendung Zylinder 7. [RAM name from V530, voted 9]" UWORD NO_COMPU_METHOD 0 0 0 65535 ECU_ADDRESS 0x3FBBFA FORMAT "%.4g" /end MEASUREMENT
/begin MEASUREMENT ag_tz_mask_zyl8 "Ausblendung Zylinder 8. [RAM name from V530, voted 9]" UWORD NO_COMPU_METHOD 0 0 0 65535 ECU_ADDRESS 0x3FBBFA FORMAT "%.4g" /end MEASUREMENT
/begin MEASUREMENT ag_tz_mask_zyl9 "Ausblendung Zylinder 9. [RAM name from V530, voted 9]" UWORD NO_COMPU_METHOD 0 0 0 65535 ECU_ADDRESS 0x3FBBFA FORMAT "%.4g" /end MEASUREMENT
/begin MEASUREMENT aq_abs_roh_b1 "Abs.roh Oeffnungsquerschnitt ohne sek. Einfluesse [RAM name from V530, voted 1]" UWORD M_FORMULA_0143 0 0 0 6553.5 ECU_ADDRESS 0x3FBBFC /end MEASUREMENT
/begin MEASUREMENT aq_abs_max_lls "Max. abs. Oeffnungsquerschnitt Leerlaufsystem [RAM name from V530, voted 2]" UWORD M_FORMULA_0143 0 0 0 6553.5 ECU_ADDRESS 0x3FBC08 /end MEASUREMENT
/begin MEASUREMENT aq_abs_max_dk "Max. abs. Oeffnungsquerschnitt Drosselklappen [RAM name from V530, voted 2]" UWORD M_FORMULA_0143 0 0 0 6553.5 ECU_ADDRESS 0x3FBC0A /end MEASUREMENT
/begin MEASUREMENT aq_rf_roh_inv_b1 "Fuellung aus Inv. Ipol.nicht gefiltert und keine korrektur [RAM name from V530, voted 1]" SWORD M_FORMULA_0007 0 0 -3.2768 3.2767 ECU_ADDRESS 0x3FBC1C /end MEASUREMENT
/begin MEASUREMENT aq_rf_inv_b1 "Istfuellung Korrigiert mit FR+FRA+EGAS_AQ_WL [RAM name from V530, voted 1]" SWORD M_FORMULA_0007 0 0 -3.2768 3.2767 ECU_ADDRESS 0x3FBC20 /end MEASUREMENT
/begin MEASUREMENT aq_rf_van_inv_b1 "Istfuellung Korrigiert mit FR+FRA+EGAS_AQ_WL+VANOS [RAM name from V530, voted 1]" SWORD M_FORMULA_0007 0 0 -3.2768 3.2767 ECU_ADDRESS 0x3FBC24 /end MEASUREMENT
/begin MEASUREMENT ar_st "Status AR [RAM name from V530, voted 15]" UBYTE NO_COMPU_METHOD 0 0 0 255 ECU_ADDRESS 0x3FBC40 FORMAT "%.4g" /end MEASUREMENT
/begin MEASUREMENT ar_state "State AR [RAM name from V530, voted 3]" UBYTE NO_COMPU_METHOD 0 0 0 255 ECU_ADDRESS 0x3FBC41 FORMAT "%.4g" /end MEASUREMENT
/begin MEASUREMENT ar_t_pas_delay "Delay nach Sperre [RAM name from V530, voted 5]" UWORD M_FORMULA_0109 0 0 0 327.675 ECU_ADDRESS 0x3FBC42 /end MEASUREMENT
/begin MEASUREMENT ar_t_max "max. AR-Eingriffszeit [RAM name from V530, voted 6]" UWORD M_FORMULA_0109 0 0 0 327.675 ECU_ADDRESS 0x3FBC44 /end MEASUREMENT
/begin MEASUREMENT ar_n_dif "Differenz [RAM name from V530, voted 6]" SWORD M_FORMULA_0006 0 0 -32768 32767 ECU_ADDRESS 0x3FBC46 /end MEASUREMENT
/begin MEASUREMENT ar_n_dif_last "letzte Differenz [RAM name from V530, voted 3]" SWORD M_FORMULA_0006 0 0 -32768 32767 ECU_ADDRESS 0x3FBC48 /end MEASUREMENT
/begin MEASUREMENT ar_md_kupp_korr "Korrektur fuer nRef [RAM name from V530, voted 1]" SWORD M_FORMULA_0009 0 0 -3276.8 3276.7 ECU_ADDRESS 0x3FBC4A /end MEASUREMENT
/begin MEASUREMENT ar_dn "nDelta [RAM name from V530, voted 2]" SWORD M_FORMULA_0475 0 0 -6553600 6553400 ECU_ADDRESS 0x3FBC4C /end MEASUREMENT
/begin MEASUREMENT ar_n_ref "Referenzdrehzahl [RAM name from V530, voted 5]" SWORD M_FORMULA_0006 0 0 -32768 32767 ECU_ADDRESS 0x3FBC4E /end MEASUREMENT
/begin MEASUREMENT ar_n_dif_ref_temp "Differenz ohne Begr [RAM name from V530, voted 4]" SWORD M_FORMULA_0006 0 0 -32768 32767 ECU_ADDRESS 0x3FBC50 /end MEASUREMENT
/begin MEASUREMENT ar_n_dif_ref "Differenz zu nRef [RAM name from V530, voted 5]" SWORD M_FORMULA_0006 0 0 -32768 32767 ECU_ADDRESS 0x3FBC52 /end MEASUREMENT
/begin MEASUREMENT ar_n_dif_ref_filt "gefilt. Differenz zu nRef [RAM name from V530, voted 1]" SWORD M_FORMULA_0006 0 0 -32768 32767 ECU_ADDRESS 0x3FBC54 /end MEASUREMENT
/begin MEASUREMENT ar_md "Stellgroesse [RAM name from V530, voted 1]" SWORD M_FORMULA_0009 0 0 -3276.8 3276.7 ECU_ADDRESS 0x3FBC56 /end MEASUREMENT
/begin MEASUREMENT auss_obd_sa_cnt "Anzahl der SA-Bereiche fuer Wiedereinsetzen. [RAM name from V530, voted 4]" UBYTE M_FORMULA_0003 0 0 0 255 ECU_ADDRESS 0x3FBD1C /end MEASUREMENT
/begin MEASUREMENT auss_obd_phase "OBD-Phase. [RAM name from V530, voted 2]" UBYTE NO_COMPU_METHOD 0 0 0 255 ECU_ADDRESS 0x3FBD1D FORMAT "%.4g" /end MEASUREMENT
/begin MEASUREMENT auss_obd_scdn_st "Status Betriebsfensterbildung. [RAM name from V530, voted 3]" UBYTE M_FORMULA_0003 0 0 0 255 ECU_ADDRESS 0x3FBD1E /end MEASUREMENT
/begin MEASUREMENT auss_obd_abg_ueberschr "Intervalle mit Abgasschwellen-Ueberschr in diesem DC. [RAM name from V530, voted 1]" UBYTE M_FORMULA_0003 0 0 0 255 ECU_ADDRESS 0x3FBD1F /end MEASUREMENT
/begin MEASUREMENT auss_obd_sa_time "Timer fuer SA-Dauer Wiedereinsetzen. [RAM name from V530, voted 2]" UBYTE M_FORMULA_0492 0 0 0 25.5 ECU_ADDRESS 0x3FBD20 /end MEASUREMENT
/begin MEASUREMENT auss_obd_wicht_kat_b1 "Gewichtungsfaktors fuer Katschaedigung. [RAM name from V530, voted 2]" UBYTE M_FORMULA_0493 0 0 0 1 ECU_ADDRESS 0x3FBD21 /end MEASUREMENT
/begin MEASUREMENT auss_obd_kat "Status Aussetzer Kat. [RAM name from V530, voted 4]" UWORD NO_COMPU_METHOD 0 0 0 65535 ECU_ADDRESS 0x3FBD2A FORMAT "%.4g" /end MEASUREMENT
/begin MEASUREMENT auss_obd_kat_zyl1 "Aussetzererkennung Zylinder 1. [RAM name from V530, voted 4]" UWORD NO_COMPU_METHOD 0 0 0 65535 ECU_ADDRESS 0x3FBD2A FORMAT "%.4g" /end MEASUREMENT
/begin MEASUREMENT auss_obd_kat_zyl10 "Aussetzererkennung Zylinder 10. [RAM name from V530, voted 4]" UWORD NO_COMPU_METHOD 0 0 0 65535 ECU_ADDRESS 0x3FBD2A FORMAT "%.4g" /end MEASUREMENT
/begin MEASUREMENT auss_obd_kat_zyl2 "Aussetzererkennung Zylinder 2. [RAM name from V530, voted 4]" UWORD NO_COMPU_METHOD 0 0 0 65535 ECU_ADDRESS 0x3FBD2A FORMAT "%.4g" /end MEASUREMENT
/begin MEASUREMENT auss_obd_kat_zyl3 "Aussetzererkennung Zylinder 3. [RAM name from V530, voted 4]" UWORD NO_COMPU_METHOD 0 0 0 65535 ECU_ADDRESS 0x3FBD2A FORMAT "%.4g" /end MEASUREMENT
/begin MEASUREMENT auss_obd_kat_zyl4 "Aussetzererkennung Zylinder 4. [RAM name from V530, voted 4]" UWORD NO_COMPU_METHOD 0 0 0 65535 ECU_ADDRESS 0x3FBD2A FORMAT "%.4g" /end MEASUREMENT
/begin MEASUREMENT auss_obd_kat_zyl5 "Aussetzererkennung Zylinder 5. [RAM name from V530, voted 4]" UWORD NO_COMPU_METHOD 0 0 0 65535 ECU_ADDRESS 0x3FBD2A FORMAT "%.4g" /end MEASUREMENT
/begin MEASUREMENT auss_obd_kat_zyl6 "Aussetzererkennung Zylinder 6. [RAM name from V530, voted 4]" UWORD NO_COMPU_METHOD 0 0 0 65535 ECU_ADDRESS 0x3FBD2A FORMAT "%.4g" /end MEASUREMENT
/begin MEASUREMENT auss_obd_kat_zyl7 "Aussetzererkennung Zylinder 7. [RAM name from V530, voted 4]" UWORD NO_COMPU_METHOD 0 0 0 65535 ECU_ADDRESS 0x3FBD2A FORMAT "%.4g" /end MEASUREMENT
/begin MEASUREMENT auss_obd_kat_zyl8 "Aussetzererkennung Zylinder 8. [RAM name from V530, voted 4]" UWORD NO_COMPU_METHOD 0 0 0 65535 ECU_ADDRESS 0x3FBD2A FORMAT "%.4g" /end MEASUREMENT
/begin MEASUREMENT auss_obd_kat_zyl9 "Aussetzererkennung Zylinder 9. [RAM name from V530, voted 4]" UWORD NO_COMPU_METHOD 0 0 0 65535 ECU_ADDRESS 0x3FBD2A FORMAT "%.4g" /end MEASUREMENT
/begin MEASUREMENT auss_obd_abg "Status Aussetzer Abgas. [RAM name from V530, voted 6]" UWORD NO_COMPU_METHOD 0 0 0 65535 ECU_ADDRESS 0x3FBD2C FORMAT "%.4g" /end MEASUREMENT
/begin MEASUREMENT auss_obd_abg_zyl1 "Aussetzererkennung Zylinder 1. [RAM name from V530, voted 6]" UWORD NO_COMPU_METHOD 0 0 0 65535 ECU_ADDRESS 0x3FBD2C FORMAT "%.4g" /end MEASUREMENT
/begin MEASUREMENT auss_obd_abg_zyl10 "Aussetzererkennung Zylinder 10. [RAM name from V530, voted 6]" UWORD NO_COMPU_METHOD 0 0 0 65535 ECU_ADDRESS 0x3FBD2C FORMAT "%.4g" /end MEASUREMENT
/begin MEASUREMENT auss_obd_abg_zyl2 "Aussetzererkennung Zylinder 2. [RAM name from V530, voted 6]" UWORD NO_COMPU_METHOD 0 0 0 65535 ECU_ADDRESS 0x3FBD2C FORMAT "%.4g" /end MEASUREMENT
/begin MEASUREMENT auss_obd_abg_zyl3 "Aussetzererkennung Zylinder 3. [RAM name from V530, voted 6]" UWORD NO_COMPU_METHOD 0 0 0 65535 ECU_ADDRESS 0x3FBD2C FORMAT "%.4g" /end MEASUREMENT
/begin MEASUREMENT auss_obd_abg_zyl4 "Aussetzererkennung Zylinder 4. [RAM name from V530, voted 6]" UWORD NO_COMPU_METHOD 0 0 0 65535 ECU_ADDRESS 0x3FBD2C FORMAT "%.4g" /end MEASUREMENT
/begin MEASUREMENT auss_obd_abg_zyl5 "Aussetzererkennung Zylinder 5. [RAM name from V530, voted 6]" UWORD NO_COMPU_METHOD 0 0 0 65535 ECU_ADDRESS 0x3FBD2C FORMAT "%.4g" /end MEASUREMENT
/begin MEASUREMENT auss_obd_abg_zyl6 "Aussetzererkennung Zylinder 6. [RAM name from V530, voted 6]" UWORD NO_COMPU_METHOD 0 0 0 65535 ECU_ADDRESS 0x3FBD2C FORMAT "%.4g" /end MEASUREMENT
/begin MEASUREMENT auss_obd_abg_zyl7 "Aussetzererkennung Zylinder 7. [RAM name from V530, voted 6]" UWORD NO_COMPU_METHOD 0 0 0 65535 ECU_ADDRESS 0x3FBD2C FORMAT "%.4g" /end MEASUREMENT
/begin MEASUREMENT auss_obd_abg_zyl8 "Aussetzererkennung Zylinder 8. [RAM name from V530, voted 6]" UWORD NO_COMPU_METHOD 0 0 0 65535 ECU_ADDRESS 0x3FBD2C FORMAT "%.4g" /end MEASUREMENT
/begin MEASUREMENT auss_obd_abg_zyl9 "Aussetzererkennung Zylinder 9. [RAM name from V530, voted 6]" UWORD NO_COMPU_METHOD 0 0 0 65535 ECU_ADDRESS 0x3FBD2C FORMAT "%.4g" /end MEASUREMENT
/begin MEASUREMENT auss_obd_tz_grad "Deaktivierungsschwelle fuer tz_grad. [RAM name from V530, voted 1]" SWORD M_FORMULA_0231 0 0 -3276.8 3276.7 ECU_ADDRESS 0x3FBD30 /end MEASUREMENT
/begin MEASUREMENT auss_n_ed "n fuer Fehlereintrag. [RAM name from V530, voted 5]" SWORD M_FORMULA_0006 0 0 -32768 32767 ECU_ADDRESS 0x3FBD38 /end MEASUREMENT
/begin MEASUREMENT auss_n_ed_ti "n fuer Fehlereintrag Verbrennungsaussetzer. [RAM name from V530, voted 5]" SWORD M_FORMULA_0006 0 0 -32768 32767 ECU_ADDRESS 0x3FBD3A /end MEASUREMENT
/begin MEASUREMENT auss_n_ed_ns "n fuer Fehlereintrag Nebenschluss. [RAM name from V530, voted 2]" SWORD M_FORMULA_0006 0 0 -32768 32767 ECU_ADDRESS 0x3FBD3C /end MEASUREMENT
/begin MEASUREMENT auss_obd_pos_md_dyn_b1 "Maximal zul. pos. Dynamik. [RAM name from V530, voted 1]" SWORD M_FORMULA_0562 0 0 -655360 655340 ECU_ADDRESS 0x3FBD4E /end MEASUREMENT
/begin MEASUREMENT auss_obd_neg_md_dyn_b1 "Maximal zul. neg. Dynamik. [RAM name from V530, voted 1]" SWORD M_FORMULA_0562 0 0 -655360 655340 ECU_ADDRESS 0x3FBD52 /end MEASUREMENT
/begin MEASUREMENT auss_obd_t_min_lam_b1 "Abschaltzeit wegen Lamda-Unterschreitung. [RAM name from V530, voted 2]" UWORD M_FORMULA_0021 0 0 0 655.35 ECU_ADDRESS 0x3FBD5A /end MEASUREMENT
/begin MEASUREMENT auss_tz_ed_zyl1 "tz fuer Fehlereintrag. [RAM name from V530, voted 6]" SWORD M_FORMULA_0102 0 0 -3276.8 3276.7 ECU_ADDRESS 0x3FBD86 /end MEASUREMENT
/begin MEASUREMENT auss_tz_ed_ti_zyl1 "tz fuer Fehlereintrag Verbrennungsaussetzer. [RAM name from V530, voted 5]" SWORD M_FORMULA_0102 0 0 -3276.8 3276.7 ECU_ADDRESS 0x3FBD9A /end MEASUREMENT
/begin MEASUREMENT auss_lp_int_ed_zyl1 "Integral fuer Fehlereintrag. [RAM name from V530, voted 6]" SWORD M_FORMULA_0227 0 0 -639.6988621 639.67934 ECU_ADDRESS 0x3FBDC2 /end MEASUREMENT
/begin MEASUREMENT auss_lp_int_ed_ti_zyl1 "Integral fuer Fehlereintrag Verbrennungsaussetzer. [RAM name from V530, voted 5]" SWORD M_FORMULA_0227 0 0 -639.6988621 639.67934 ECU_ADDRESS 0x3FBDD6 /end MEASUREMENT
/begin MEASUREMENT auss_lp_int_ed_ns_zyl1 "Integral fuer Fehlereintrag Nebenschluss. [RAM name from V530, voted 1]" SWORD M_FORMULA_0227 0 0 -639.6988621 639.67934 ECU_ADDRESS 0x3FBDEA /end MEASUREMENT
/begin MEASUREMENT auss_obd_sum_abg_spark_zyl1 "Summe Zuendauss. Abgas in 1000 Umdrehungen. [RAM name from V530, voted 4]" UWORD M_FORMULA_0010 0 0 0 65535 ECU_ADDRESS 0x3FBE4E /end MEASUREMENT
/begin MEASUREMENT auss_obd_sum_abg_ev_zyl1 "Summe Einspritzauss. Abgas in 1000 Umdrehungen. [RAM name from V530, voted 4]" UWORD M_FORMULA_0010 0 0 0 65535 ECU_ADDRESS 0x3FBE62 /end MEASUREMENT
/begin MEASUREMENT auss_obd_sum_kat_ns_zyl1 "Gew. Summe kat. Nebenschlussauss. in 200 Umdrehungen. [RAM name from V530, voted 3]" UWORD M_FORMULA_0563 0 0 0 257 ECU_ADDRESS 0x3FBE8A /end MEASUREMENT
/begin MEASUREMENT auss_obd_kat_dreh_cnt "Arbeitsspielzaehler Katschutz. [RAM name from V530, voted 2]" ULONG M_FORMULA_0000 0 0 0 4294967295 ECU_ADDRESS 0x3FBEC8 /end MEASUREMENT
/begin MEASUREMENT auss_obd_abg_dreh_cnt "Arbeitsspielzaehler Abgas. [RAM name from V530, voted 2]" ULONG M_FORMULA_0000 0 0 0 4294967295 ECU_ADDRESS 0x3FBECC /end MEASUREMENT
/begin MEASUREMENT crc32_result "Ergebnis der CRC-Berechnungen [RAM name from V530, voted 14]" UBYTE NO_COMPU_METHOD 0 0 0 255 ECU_ADDRESS 0x3FBF08 FORMAT "%.4g" /end MEASUREMENT
/begin MEASUREMENT crc32_data_st "Status CRC-Berechnung [RAM name from V530, voted 4]" UBYTE NO_COMPU_METHOD 0 0 0 255 ECU_ADDRESS 0x3FBF09 FORMAT "%.4g" /end MEASUREMENT
/begin MEASUREMENT crc32_prog_st "Status CRC-Berechnung [RAM name from V530, voted 2]" UBYTE NO_COMPU_METHOD 0 0 0 255 ECU_ADDRESS 0x3FBF0A FORMAT "%.4g" /end MEASUREMENT
/begin MEASUREMENT crc32_boot_st "Status CRC-Berechnung [RAM name from V530, voted 2]" UBYTE NO_COMPU_METHOD 0 0 0 255 ECU_ADDRESS 0x3FBF0B FORMAT "%.4g" /end MEASUREMENT
/begin MEASUREMENT crc32_boot "Booter-CRC [RAM name from V530, voted 3]" ULONG M_FORMULA_0000 0 0 0 4294967295 ECU_ADDRESS 0x3FBF0C /end MEASUREMENT
/begin MEASUREMENT crc32_prog "Programm-CRC [RAM name from V530, voted 3]" ULONG M_FORMULA_0000 0 0 0 4294967295 ECU_ADDRESS 0x3FBF10 /end MEASUREMENT
/begin MEASUREMENT crc32_data "Daten-CRC [RAM name from V530, voted 5]" ULONG M_FORMULA_0000 0 0 0 4294967295 ECU_ADDRESS 0x3FBF14 /end MEASUREMENT
/begin MEASUREMENT hwTaskCtr "Counter [RAM name from V530, voted 4]" UWORD M_FORMULA_0010 0 0 0 65535 ECU_ADDRESS 0x3FBF24 /end MEASUREMENT
/begin MEASUREMENT syncTaskCtr "Counter [RAM name from V530, voted 4]" UWORD M_FORMULA_0010 0 0 0 65535 ECU_ADDRESS 0x3FBF26 /end MEASUREMENT
/begin MEASUREMENT r1msTaskCtr "Counter [RAM name from V530, voted 4]" UWORD M_FORMULA_0010 0 0 0 65535 ECU_ADDRESS 0x3FBF28 /end MEASUREMENT
/begin MEASUREMENT r5msTaskCtr "Counter [RAM name from V530, voted 6]" UWORD M_FORMULA_0010 0 0 0 65535 ECU_ADDRESS 0x3FBF2A /end MEASUREMENT
/begin MEASUREMENT r10msTaskCtr "Counter [RAM name from V530, voted 5]" ULONG M_FORMULA_0000 0 0 0 4294967295 ECU_ADDRESS 0x3FBF2C /end MEASUREMENT
/begin MEASUREMENT r100msTaskCtr "Counter [RAM name from V530, voted 4]" UWORD M_FORMULA_0010 0 0 0 65535 ECU_ADDRESS 0x3FBF30 /end MEASUREMENT
/begin MEASUREMENT r1sTaskCtr "Counter [RAM name from V530, voted 3]" UWORD M_FORMULA_0010 0 0 0 65535 ECU_ADDRESS 0x3FBF32 /end MEASUREMENT
/begin MEASUREMENT bgTaskCtr "Counter [RAM name from V530, voted 4]" UWORD M_FORMULA_0010 0 0 0 65535 ECU_ADDRESS 0x3FBF34 /end MEASUREMENT
/begin MEASUREMENT cana_ctBoffDbounce "BusOff-Counter [RAM name from V530, voted 1]" UBYTE M_FORMULA_0003 0 0 0 255 ECU_ADDRESS 0x3FBF36 /end MEASUREMENT
/begin MEASUREMENT canb_ctBoffDbounce "BusOff-Counter [RAM name from V530, voted 1]" UBYTE M_FORMULA_0003 0 0 0 255 ECU_ADDRESS 0x3FBF37 /end MEASUREMENT
/begin MEASUREMENT dkg_kupp_kriech "Kriechmoment der Kupplung [RAM name from V530, voted 1]" SWORD M_FORMULA_0009 0 0 -3276.8 3276.7 ECU_ADDRESS 0x3FBF56 /end MEASUREMENT
/begin MEASUREMENT ed_rbm_time "Motor laeuft fuer Rate Based [RAM name from V530, voted 2]" UWORD M_FORMULA_0071 0 0 0 6553.5 ECU_ADDRESS 0x3FC03A /end MEASUREMENT
/begin MEASUREMENT ed_rbm_time_ll "Zeit im Leerlauf [RAM name from V530, voted 3]" UWORD M_FORMULA_0071 0 0 0 6553.5 ECU_ADDRESS 0x3FC03C /end MEASUREMENT
/begin MEASUREMENT ed_rbm_time_v "Zeit mit Mindestgeschwindigkeit [RAM name from V530, voted 2]" UWORD M_FORMULA_0071 0 0 0 6553.5 ECU_ADDRESS 0x3FC03E /end MEASUREMENT
/begin MEASUREMENT eeprom_seite_lesen "Wo wurde der letzte Datensatz gefunden [RAM name from V530, voted 14]" UBYTE NO_COMPU_METHOD 0 0 0 255 ECU_ADDRESS 0x3FC044 FORMAT "%.4g" /end MEASUREMENT
/begin MEASUREMENT eeprom_seite_lesen_hdw "Wo wurde der letzte HDW-Datensatz gefunden [RAM name from V530, voted 7]" UBYTE NO_COMPU_METHOD 0 0 0 255 ECU_ADDRESS 0x3FC045 FORMAT "%.4g" /end MEASUREMENT
/begin MEASUREMENT eeprom_seite_schreiben "Wo hin soll der naechste Datensatz geschrieben werden [RAM name from V530, voted 34]" UBYTE NO_COMPU_METHOD 0 0 0 255 ECU_ADDRESS 0x3FC046 FORMAT "%.4g" /end MEASUREMENT
/begin MEASUREMENT eeprom_st "Status der EEPROM-Emulation [RAM name from V530, voted 38]" UBYTE NO_COMPU_METHOD 0 0 0 255 ECU_ADDRESS 0x3FC047 FORMAT "%.4g" /end MEASUREMENT
/begin MEASUREMENT egas_can_ed_tsperr_lls "Wartezeit CAN-LLS [RAM name from V530, voted 8]" UBYTE M_FORMULA_0581 0 0 0 1.275 ECU_ADDRESS 0x3FC056 /end MEASUREMENT
/begin MEASUREMENT egas_can_ed_tsperr_dk "Wartezeit CAN-DK [RAM name from V530, voted 9]" UBYTE M_FORMULA_0581 0 0 0 1.275 ECU_ADDRESS 0x3FC057 /end MEASUREMENT
/begin MEASUREMENT egas_st_empf "Egas-Empfangsstaus [RAM name from V530, voted 11]" UBYTE NO_COMPU_METHOD 0 0 0 255 ECU_ADDRESS 0x3FC058 FORMAT "%.4g" /end MEASUREMENT
/begin MEASUREMENT egas_st_empf_hys "Egas-Empfangsstaus pro SG-Lauf [RAM name from V530, voted 22]" UBYTE NO_COMPU_METHOD 0 0 0 255 ECU_ADDRESS 0x3FC059 FORMAT "%.4g" /end MEASUREMENT
/begin MEASUREMENT egas_aq_soll_lls_b1 "AQ-Soll fuer LLS [RAM name from V530, voted 1]" UWORD M_FORMULA_0143 0 0 0 6553.5 ECU_ADDRESS 0x3FC05E /end MEASUREMENT
/begin MEASUREMENT egas_aq_soll_dk_b1 "AQ-Soll fuer DK [RAM name from V530, voted 2]" UWORD M_FORMULA_0143 0 0 0 6553.5 ECU_ADDRESS 0x3FC062 /end MEASUREMENT
/begin MEASUREMENT egas_wdk_b1.abs_roh "nicht korr. U_WDK [RAM name from V530, voted 6]" SWORD M_FORMULA_0250 0 0 -160 159.9951172 ECU_ADDRESS 0x3FC068 /end MEASUREMENT
/begin MEASUREMENT egas_wdk_b1.abs "korr. U_WDK [RAM name from V530, voted 1]" SWORD M_FORMULA_0250 0 0 -160 159.9951172 ECU_ADDRESS 0x3FC06A /end MEASUREMENT
/begin MEASUREMENT egas_wdk_b1.a0_cnt "Adaptionszaehler [RAM name from V530, voted 1]" UBYTE M_FORMULA_0003 0 0 0 255 ECU_ADDRESS 0x3FC078 /end MEASUREMENT
/begin MEASUREMENT egas_dk_b1.r_mode "R-Mode [RAM name from V530, voted 25]" UBYTE NO_COMPU_METHOD 0 0 0 255 ECU_ADDRESS 0x3FC090 FORMAT "%.4g" /end MEASUREMENT
/begin MEASUREMENT egas_dk_b1.r_diag_st "Diagnosestatus [RAM name from V530, voted 2]" UWORD NO_COMPU_METHOD 0 0 0 65535 ECU_ADDRESS 0x3FC092 FORMAT "%.4g" /end MEASUREMENT
/begin MEASUREMENT egas_dk_b1.r_sollw "R-Sollwert [RAM name from V530, voted 3]" SWORD M_FORMULA_0001 0 0 -3276.8 3276.7 ECU_ADDRESS 0x3FC0CC /end MEASUREMENT
/begin MEASUREMENT egas_dk_b1.r_enable "R-Enable [RAM name from V530, voted 2]" UBYTE NO_COMPU_METHOD 0 0 0 255 ECU_ADDRESS 0x3FC098 FORMAT "%.4g" /end MEASUREMENT
/begin MEASUREMENT egas_dk_b1.r_alive "R-Alive [RAM name from V530, voted 1]" UBYTE M_FORMULA_0003 0 0 0 255 ECU_ADDRESS 0x3FC099 /end MEASUREMENT
/begin MEASUREMENT egas_dk_b1.r_tv "Tastverhaeltnis [RAM name from V530, voted 4]" UBYTE M_FORMULA_0585 0 0 -100 99.21875 ECU_ADDRESS 0x3FC0D2 /end MEASUREMENT
/begin MEASUREMENT egas_dk_b1.can_st "CAN-Status [RAM name from V530, voted 1]" UBYTE NO_COMPU_METHOD 0 0 0 255 ECU_ADDRESS 0x3FC09B FORMAT "%.4g" /end MEASUREMENT
/begin MEASUREMENT egas_dk_b1.mode "Mode [RAM name from V530, voted 3]" UBYTE NO_COMPU_METHOD 0 0 0 255 ECU_ADDRESS 0x3FC09C FORMAT "%.4g" /end MEASUREMENT
/begin MEASUREMENT egas_dk_b1.mode_can "DK-Mode CAN [RAM name from V530, voted 1]" UBYTE NO_COMPU_METHOD 0 0 0 255 ECU_ADDRESS 0x3FC09D FORMAT "%.4g" /end MEASUREMENT
/begin MEASUREMENT egas_dk_b1.state "State [RAM name from V530, voted 3]" UBYTE NO_COMPU_METHOD 0 0 0 255 ECU_ADDRESS 0x3FC09E FORMAT "%.4g" /end MEASUREMENT
/begin MEASUREMENT egas_dk.flags_en_b1 "Enable-Flag [RAM name from V530, voted 17]" UBYTE NO_COMPU_METHOD 0 0 0 255 ECU_ADDRESS 0x3FC0A2 FORMAT "%.4g" /end MEASUREMENT
/begin MEASUREMENT egas_dk.flags_ftime_b1 "Failtimer abgelaufen [RAM name from V530, voted 17]" UBYTE NO_COMPU_METHOD 0 0 0 255 ECU_ADDRESS 0x3FC0A2 FORMAT "%.4g" /end MEASUREMENT
/begin MEASUREMENT egas_dk.flags_kh_b1 "KH-Querschnitt [RAM name from V530, voted 17]" UBYTE NO_COMPU_METHOD 0 0 0 255 ECU_ADDRESS 0x3FC0A2 FORMAT "%.4g" /end MEASUREMENT
/begin MEASUREMENT egas_dk.flags_nachadapt_b1 "Nachadaption [RAM name from V530, voted 17]" UBYTE NO_COMPU_METHOD 0 0 0 255 ECU_ADDRESS 0x3FC0A2 FORMAT "%.4g" /end MEASUREMENT
/begin MEASUREMENT egas_dk.flags_tst_b1 "durchgef???hrte Tests [RAM name from V530, voted 17]" UBYTE NO_COMPU_METHOD 0 0 0 255 ECU_ADDRESS 0x3FC0A2 FORMAT "%.4g" /end MEASUREMENT
/begin MEASUREMENT egas_dk_b1.flags "Flags [RAM name from V530, voted 17]" UBYTE M_FORMULA_0003 0 0 0 255 ECU_ADDRESS 0x3FC0A2 /end MEASUREMENT
/begin MEASUREMENT egas_dk_b1.fail_st "Failsafe-Status [RAM name from V530, voted 10]" UWORD NO_COMPU_METHOD 0 0 0 65535 ECU_ADDRESS 0x3FC0A4 FORMAT "%.4g" /end MEASUREMENT
/begin MEASUREMENT egas_dk_b1.r_diag_clr "Zaehler DiagClr [RAM name from V530, voted 3]" UBYTE M_FORMULA_0003 0 0 0 255 ECU_ADDRESS 0x3FC0A9 /end MEASUREMENT
/begin MEASUREMENT egas_dk_b2.r_mode "R-Mode [RAM name from V530, voted 2]" UBYTE NO_COMPU_METHOD 0 0 0 255 ECU_ADDRESS 0x3FC0AC FORMAT "%.4g" /end MEASUREMENT
/begin MEASUREMENT egas_dk_b2.r_diag_st "Diagnosestatus [RAM name from V530, voted 2]" UWORD NO_COMPU_METHOD 0 0 0 65535 ECU_ADDRESS 0x3FC0AE FORMAT "%.4g" /end MEASUREMENT
/begin MEASUREMENT egas_dk_b2.r_sollw "R-Sollwert [RAM name from V530, voted 2]" SWORD M_FORMULA_0001 0 0 -3276.8 3276.7 ECU_ADDRESS 0x3FC0E8 /end MEASUREMENT
/begin MEASUREMENT egas_dk_b2.r_enable "R-Enable [RAM name from V530, voted 2]" UBYTE NO_COMPU_METHOD 0 0 0 255 ECU_ADDRESS 0x3FC0B4 FORMAT "%.4g" /end MEASUREMENT
/begin MEASUREMENT egas_dk_b2.r_alive "R-Alive [RAM name from V530, voted 1]" UBYTE M_FORMULA_0003 0 0 0 255 ECU_ADDRESS 0x3FC0B5 /end MEASUREMENT
/begin MEASUREMENT egas_dk_b2.r_tv "Tastverhaeltnis [RAM name from V530, voted 4]" UBYTE M_FORMULA_0585 0 0 -100 99.21875 ECU_ADDRESS 0x3FC0EE /end MEASUREMENT
/begin MEASUREMENT egas_dk_b2.can_st "CAN-Status [RAM name from V530, voted 1]" UBYTE NO_COMPU_METHOD 0 0 0 255 ECU_ADDRESS 0x3FC0B7 FORMAT "%.4g" /end MEASUREMENT
/begin MEASUREMENT egas_dk_b2.mode_can "DK-Mode CAN [RAM name from V530, voted 1]" UBYTE NO_COMPU_METHOD 0 0 0 255 ECU_ADDRESS 0x3FC0B9 FORMAT "%.4g" /end MEASUREMENT
/begin MEASUREMENT egas_dk_b2.state "State [RAM name from V530, voted 3]" UBYTE NO_COMPU_METHOD 0 0 0 255 ECU_ADDRESS 0x3FC0BA FORMAT "%.4g" /end MEASUREMENT
/begin MEASUREMENT egas_dk.flags_en_b2 "Enable-Flag [RAM name from V530, voted 16]" UBYTE NO_COMPU_METHOD 0 0 0 255 ECU_ADDRESS 0x3FC0BE FORMAT "%.4g" /end MEASUREMENT
/begin MEASUREMENT egas_dk.flags_ftime_b2 "Failtimer abgelaufen [RAM name from V530, voted 16]" UBYTE NO_COMPU_METHOD 0 0 0 255 ECU_ADDRESS 0x3FC0BE FORMAT "%.4g" /end MEASUREMENT
/begin MEASUREMENT egas_dk.flags_kh_b2 "KH-Querschnitt [RAM name from V530, voted 16]" UBYTE NO_COMPU_METHOD 0 0 0 255 ECU_ADDRESS 0x3FC0BE FORMAT "%.4g" /end MEASUREMENT
/begin MEASUREMENT egas_dk.flags_nachadapt_b2 "Nachadaption [RAM name from V530, voted 16]" UBYTE NO_COMPU_METHOD 0 0 0 255 ECU_ADDRESS 0x3FC0BE FORMAT "%.4g" /end MEASUREMENT
/begin MEASUREMENT egas_dk.flags_tst_b2 "durchgef???hrte Tests [RAM name from V530, voted 16]" UBYTE NO_COMPU_METHOD 0 0 0 255 ECU_ADDRESS 0x3FC0BE FORMAT "%.4g" /end MEASUREMENT
/begin MEASUREMENT egas_dk_b2.flags "Flags [RAM name from V530, voted 16]" UBYTE M_FORMULA_0003 0 0 0 255 ECU_ADDRESS 0x3FC0BE /end MEASUREMENT
/begin MEASUREMENT egas_dk_b2.fail_st "Failsafe-Status [RAM name from V530, voted 10]" UWORD NO_COMPU_METHOD 0 0 0 65535 ECU_ADDRESS 0x3FC0C0 FORMAT "%.4g" /end MEASUREMENT
/begin MEASUREMENT egas_dk_b2.r_diag_clr "Zaehler DiagClr [RAM name from V530, voted 3]" UBYTE M_FORMULA_0003 0 0 0 255 ECU_ADDRESS 0x3FC0C5 /end MEASUREMENT
/begin MEASUREMENT egas_lls_b1.r_mode "R-Mode [RAM name from V530, voted 13]" UBYTE NO_COMPU_METHOD 0 0 0 255 ECU_ADDRESS 0x3FC0C8 FORMAT "%.4g" /end MEASUREMENT
/begin MEASUREMENT egas_lls_b1.r_diag_st "Diagnosestatus [RAM name from V530, voted 2]" UWORD NO_COMPU_METHOD 0 0 0 65535 ECU_ADDRESS 0x3FC0CA FORMAT "%.4g" /end MEASUREMENT
/begin MEASUREMENT egas_lls_b1.r_sollw "R-Sollwert [RAM name from V530, voted 2]" SWORD M_FORMULA_0001 0 0 -3276.8 3276.7 ECU_ADDRESS 0x3FC094 /end MEASUREMENT
/begin MEASUREMENT egas_lls_b1.r_alive "R-Alive [RAM name from V530, voted 1]" UBYTE M_FORMULA_0003 0 0 0 255 ECU_ADDRESS 0x3FC0D1 /end MEASUREMENT
/begin MEASUREMENT egas_lls_b1.r_tv "Tastverhaeltnis [RAM name from V530, voted 3]" UBYTE M_FORMULA_0585 0 0 -100 99.21875 ECU_ADDRESS 0x3FC09A /end MEASUREMENT
/begin MEASUREMENT egas_lls_b1.can_st "CAN-Status [RAM name from V530, voted 1]" UBYTE NO_COMPU_METHOD 0 0 0 255 ECU_ADDRESS 0x3FC0D3 FORMAT "%.4g" /end MEASUREMENT
/begin MEASUREMENT egas_lls_b1.mode "LLS-Mode [RAM name from V530, voted 3]" UBYTE NO_COMPU_METHOD 0 0 0 255 ECU_ADDRESS 0x3FC0D4 FORMAT "%.4g" /end MEASUREMENT
/begin MEASUREMENT egas_lls_b1.mode_can "LLS-Mode CAN [RAM name from V530, voted 1]" UBYTE NO_COMPU_METHOD 0 0 0 255 ECU_ADDRESS 0x3FC0D5 FORMAT "%.4g" /end MEASUREMENT
/begin MEASUREMENT egas_lls_b1.state "State [RAM name from V530, voted 1]" UBYTE NO_COMPU_METHOD 0 0 0 255 ECU_ADDRESS 0x3FC0D6 FORMAT "%.4g" /end MEASUREMENT
/begin MEASUREMENT egas_lls.flags_adpt_b1 "Adaptionsflag [RAM name from V530, voted 2]" UBYTE NO_COMPU_METHOD 0 0 0 255 ECU_ADDRESS 0x3FC0DA FORMAT "%.4g" /end MEASUREMENT
/begin MEASUREMENT egas_lls_b1.flags "LLS-Flags [RAM name from V530, voted 2]" UBYTE M_FORMULA_0003 0 0 0 255 ECU_ADDRESS 0x3FC0DA /end MEASUREMENT
/begin MEASUREMENT egas_lls_b1.fail_st "Failsafe-Status [RAM name from V530, voted 7]" UWORD NO_COMPU_METHOD 0 0 0 65535 ECU_ADDRESS 0x3FC0DC FORMAT "%.4g" /end MEASUREMENT
/begin MEASUREMENT egas_lls_b1.fail_cnt "Zaehler Fail-Status [RAM name from V530, voted 1]" UBYTE M_FORMULA_0003 0 0 0 255 ECU_ADDRESS 0x3FC0A8 /end MEASUREMENT
/begin MEASUREMENT egas_lls_b1.r_diag_clr "Zaehler DiagClr [RAM name from V530, voted 3]" UBYTE M_FORMULA_0003 0 0 0 255 ECU_ADDRESS 0x3FC0E1 /end MEASUREMENT
/begin MEASUREMENT egas_lls_b2.r_diag_st "Diagnosestatus [RAM name from V530, voted 2]" UWORD NO_COMPU_METHOD 0 0 0 65535 ECU_ADDRESS 0x3FC0E6 FORMAT "%.4g" /end MEASUREMENT
/begin MEASUREMENT egas_lls_b2.r_sollw "R-Sollwert [RAM name from V530, voted 2]" SWORD M_FORMULA_0001 0 0 -3276.8 3276.7 ECU_ADDRESS 0x3FC0B0 /end MEASUREMENT
/begin MEASUREMENT egas_lls_b2.r_tv "Tastverhaeltnis [RAM name from V530, voted 3]" UBYTE M_FORMULA_0585 0 0 -100 99.21875 ECU_ADDRESS 0x3FC0B6 /end MEASUREMENT
/begin MEASUREMENT egas_lls_b2.can_st "CAN-Status [RAM name from V530, voted 1]" UBYTE NO_COMPU_METHOD 0 0 0 255 ECU_ADDRESS 0x3FC0EF FORMAT "%.4g" /end MEASUREMENT
/begin MEASUREMENT egas_lls_b2.mode "LLS-Mode [RAM name from V530, voted 3]" UBYTE NO_COMPU_METHOD 0 0 0 255 ECU_ADDRESS 0x3FC0F0 FORMAT "%.4g" /end MEASUREMENT
/begin MEASUREMENT egas_lls_b2.mode_can "LLS-Mode CAN [RAM name from V530, voted 1]" UBYTE NO_COMPU_METHOD 0 0 0 255 ECU_ADDRESS 0x3FC0F1 FORMAT "%.4g" /end MEASUREMENT
/begin MEASUREMENT egas_lls_b2.state "State [RAM name from V530, voted 1]" UBYTE NO_COMPU_METHOD 0 0 0 255 ECU_ADDRESS 0x3FC0F2 FORMAT "%.4g" /end MEASUREMENT
/begin MEASUREMENT egas_lls.flags_adpt_b2 "Adaptionsflag [RAM name from V530, voted 2]" UBYTE NO_COMPU_METHOD 0 0 0 255 ECU_ADDRESS 0x3FC0F6 FORMAT "%.4g" /end MEASUREMENT
/begin MEASUREMENT egas_lls_b2.flags "LLS-Flags [RAM name from V530, voted 2]" UBYTE M_FORMULA_0003 0 0 0 255 ECU_ADDRESS 0x3FC0F6 /end MEASUREMENT
/begin MEASUREMENT egas_lls_b2.fail_st "Failsafe-Status [RAM name from V530, voted 2]" UWORD NO_COMPU_METHOD 0 0 0 65535 ECU_ADDRESS 0x3FC0F8 FORMAT "%.4g" /end MEASUREMENT
/begin MEASUREMENT egas_lls_b2.fail_cnt "Zaehler Fail-Status [RAM name from V530, voted 1]" UBYTE M_FORMULA_0003 0 0 0 255 ECU_ADDRESS 0x3FC0C4 /end MEASUREMENT
/begin MEASUREMENT egas_lls_b2.r_diag_clr "Zaehler DiagClr [RAM name from V530, voted 2]" UBYTE M_FORMULA_0003 0 0 0 255 ECU_ADDRESS 0x3FC0FD /end MEASUREMENT
/begin MEASUREMENT egas_aq_rf_wl_f "Warmlauffaktor [RAM name from V530, voted 2]" UWORD M_FORMULA_0073 0 0 0 63.99902344 ECU_ADDRESS 0x3FC100 /end MEASUREMENT
/begin MEASUREMENT egas_t_kl50 "KL50-Einfluss auf Istposition [RAM name from V530, voted 5]" UBYTE M_FORMULA_0357 0 0 0 1.275 ECU_ADDRESS 0x3FC102 /end MEASUREMENT
/begin MEASUREMENT egas_snd_lls.cmd_b1 "CMD-B1 [RAM name from V530, voted 15]" UBYTE NO_COMPU_METHOD 0 0 0 255 ECU_ADDRESS 0x3FC104 FORMAT "%.4g" /end MEASUREMENT
/begin MEASUREMENT egas_snd_lls.cmd_b2 "CMD-B2 [RAM name from V530, voted 10]" UBYTE NO_COMPU_METHOD 0 0 0 255 ECU_ADDRESS 0x3FC105 FORMAT "%.4g" /end MEASUREMENT
/begin MEASUREMENT egas_snd_lls.cmd_b1_fifo_1of5_ "CMD-B2 [RAM name from V530, voted 1]" UBYTE NO_COMPU_METHOD 0 0 0 255 ECU_ADDRESS 0x3FC106 FORMAT "%.4g" /end MEASUREMENT
/begin MEASUREMENT egas_snd_lls.cmd_b1_fifo_5of5_ "CMD-B2 [RAM name from V530, voted 1]" UBYTE NO_COMPU_METHOD 0 0 0 255 ECU_ADDRESS 0x3FC10A FORMAT "%.4g" /end MEASUREMENT
/begin MEASUREMENT egas_snd_lls.cmd_b2_fifo_1of5_ "CMD-B2 [RAM name from V530, voted 1]" UBYTE NO_COMPU_METHOD 0 0 0 255 ECU_ADDRESS 0x3FC10B FORMAT "%.4g" /end MEASUREMENT
/begin MEASUREMENT egas_snd_lls.cmd_b2_fifo_5of5_ "CMD-B2 [RAM name from V530, voted 1]" UBYTE NO_COMPU_METHOD 0 0 0 255 ECU_ADDRESS 0x3FC10F FORMAT "%.4g" /end MEASUREMENT
/begin MEASUREMENT egas_snd_lls.time "Timeout [RAM name from V530, voted 4]" UWORD M_FORMULA_0071 0 0 0 6553.5 ECU_ADDRESS 0x3FC110 /end MEASUREMENT
/begin MEASUREMENT egas_snd_lls.v_ko_vers "Vorgabe KOMM [RAM name from V530, voted 1]" UBYTE M_FORMULA_0003 0 0 0 255 ECU_ADDRESS 0x3FC112 /end MEASUREMENT
/begin MEASUREMENT egas_snd_lls.v_bank "Vorgabe BANK [RAM name from V530, voted 1]" UBYTE M_FORMULA_0003 0 0 0 255 ECU_ADDRESS 0x3FC113 /end MEASUREMENT
/begin MEASUREMENT egas_snd_lls.v_clr_diag_b1 "Diag Bank1 [RAM name from V530, voted 1]" UWORD M_FORMULA_0010 0 0 0 65535 ECU_ADDRESS 0x3FC114 /end MEASUREMENT
/begin MEASUREMENT egas_snd_lls.v_clr_diag_b2 "Diag Bank1 [RAM name from V530, voted 1]" UWORD M_FORMULA_0010 0 0 0 65535 ECU_ADDRESS 0x3FC116 /end MEASUREMENT
/begin MEASUREMENT egas_rec_lls_b1.r_ko_vers "Kommunikationsversion [RAM name from V530, voted 1]" UBYTE M_FORMULA_0003 0 0 0 255 ECU_ADDRESS 0x3FC11D /end MEASUREMENT
/begin MEASUREMENT egas_rec_lls_b1.r_sw_vers "SW-Version [RAM name from V530, voted 1]" UWORD M_FORMULA_0010 0 0 0 65535 ECU_ADDRESS 0x3FC120 /end MEASUREMENT
/begin MEASUREMENT egas_rec_lls_b1.status "Empfangsstatus [RAM name from V530, voted 3]" UBYTE NO_COMPU_METHOD 0 0 0 255 ECU_ADDRESS 0x3FC126 FORMAT "%.4g" /end MEASUREMENT
/begin MEASUREMENT egas_rec_lls_b1.rec_ack "Receive-Ack [RAM name from V530, voted 8]" UWORD M_FORMULA_0080 0 0 0 65535 ECU_ADDRESS 0x3FC128 /end MEASUREMENT
/begin MEASUREMENT egas_rec_lls_b1.rec_err "Receive-Error [RAM name from V530, voted 4]" UWORD M_FORMULA_0080 0 0 0 65535 ECU_ADDRESS 0x3FC12A /end MEASUREMENT
/begin MEASUREMENT egas_rec_lls_b2.status "Empfangsstatus [RAM name from V530, voted 3]" UBYTE NO_COMPU_METHOD 0 0 0 255 ECU_ADDRESS 0x3FC13A FORMAT "%.4g" /end MEASUREMENT
/begin MEASUREMENT egas_rec_lls_b2.rec_ack "Receive-Ack [RAM name from V530, voted 4]" UWORD M_FORMULA_0080 0 0 0 65535 ECU_ADDRESS 0x3FC13C /end MEASUREMENT
/begin MEASUREMENT egas_rec_lls_b2.rec_err "Receive-Error [RAM name from V530, voted 2]" UWORD M_FORMULA_0080 0 0 0 65535 ECU_ADDRESS 0x3FC13E /end MEASUREMENT
/begin MEASUREMENT egas_rec_lls_bX.status "Empfangsstatus [RAM name from V530, voted 2]" UBYTE NO_COMPU_METHOD 0 0 0 255 ECU_ADDRESS 0x3FC14E FORMAT "%.4g" /end MEASUREMENT
/begin MEASUREMENT egas_rec_lls_bX.rec_ack "Receive-Ack [RAM name from V530, voted 2]" UWORD M_FORMULA_0080 0 0 0 65535 ECU_ADDRESS 0x3FC150 /end MEASUREMENT
/begin MEASUREMENT egas_snd_dk.cmd_b1 "CMD-B1 [RAM name from V530, voted 18]" UBYTE NO_COMPU_METHOD 0 0 0 255 ECU_ADDRESS 0x3FC156 FORMAT "%.4g" /end MEASUREMENT
/begin MEASUREMENT egas_snd_dk.cmd_b2 "CMD-B2 [RAM name from V530, voted 11]" UBYTE NO_COMPU_METHOD 0 0 0 255 ECU_ADDRESS 0x3FC157 FORMAT "%.4g" /end MEASUREMENT
/begin MEASUREMENT egas_snd_dk.cmd_b1_fifo_1of5_ "CMD-B2 [RAM name from V530, voted 1]" UBYTE NO_COMPU_METHOD 0 0 0 255 ECU_ADDRESS 0x3FC158 FORMAT "%.4g" /end MEASUREMENT
/begin MEASUREMENT egas_snd_dk.cmd_b1_fifo_5of5_ "CMD-B2 [RAM name from V530, voted 1]" UBYTE NO_COMPU_METHOD 0 0 0 255 ECU_ADDRESS 0x3FC15C FORMAT "%.4g" /end MEASUREMENT
/begin MEASUREMENT egas_snd_dk.cmd_b2_fifo_1of5_ "CMD-B2 [RAM name from V530, voted 1]" UBYTE NO_COMPU_METHOD 0 0 0 255 ECU_ADDRESS 0x3FC15D FORMAT "%.4g" /end MEASUREMENT
/begin MEASUREMENT egas_snd_dk.cmd_b2_fifo_5of5_ "CMD-B2 [RAM name from V530, voted 1]" UBYTE NO_COMPU_METHOD 0 0 0 255 ECU_ADDRESS 0x3FC161 FORMAT "%.4g" /end MEASUREMENT
/begin MEASUREMENT egas_snd_dk.time "Timeout [RAM name from V530, voted 4]" UWORD M_FORMULA_0071 0 0 0 6553.5 ECU_ADDRESS 0x3FC162 /end MEASUREMENT
/begin MEASUREMENT egas_snd_dk.v_ko_vers "Vorgabe KOMM [RAM name from V530, voted 1]" UBYTE M_FORMULA_0003 0 0 0 255 ECU_ADDRESS 0x3FC164 /end MEASUREMENT
/begin MEASUREMENT egas_snd_dk.v_bank "Vorgabe BANK [RAM name from V530, voted 3]" UBYTE M_FORMULA_0003 0 0 0 255 ECU_ADDRESS 0x3FC165 /end MEASUREMENT
/begin MEASUREMENT egas_snd_dk.v_clr_diag_b1 "Diag Bank1 [RAM name from V530, voted 3]" UWORD M_FORMULA_0010 0 0 0 65535 ECU_ADDRESS 0x3FC166 /end MEASUREMENT
/begin MEASUREMENT egas_snd_dk.v_clr_diag_b2 "Diag Bank1 [RAM name from V530, voted 3]" UWORD M_FORMULA_0010 0 0 0 65535 ECU_ADDRESS 0x3FC168 /end MEASUREMENT
/begin MEASUREMENT egas_rec_dk_b1.r_bank "Zylinder [RAM name from V530, voted 2]" UBYTE M_FORMULA_0003 0 0 0 255 ECU_ADDRESS 0x3FC16E /end MEASUREMENT
/begin MEASUREMENT egas_rec_dk_b1.r_ko_vers "Kommunikationsversion [RAM name from V530, voted 1]" UBYTE M_FORMULA_0003 0 0 0 255 ECU_ADDRESS 0x3FC16F /end MEASUREMENT
/begin MEASUREMENT egas_rec_dk_b1.r_hw_vers "HW-Version [RAM name from V530, voted 2]" UWORD M_FORMULA_0010 0 0 0 65535 ECU_ADDRESS 0x3FC170 /end MEASUREMENT
/begin MEASUREMENT egas_rec_dk_b1.r_sw_vers "SW-Version [RAM name from V530, voted 3]" UWORD M_FORMULA_0010 0 0 0 65535 ECU_ADDRESS 0x3FC172 /end MEASUREMENT
/begin MEASUREMENT egas_rec_dk_b1.r_set_vers "Kommunikationsversion [RAM name from V530, voted 2]" UBYTE M_FORMULA_0003 0 0 0 255 ECU_ADDRESS 0x3FC176 /end MEASUREMENT
/begin MEASUREMENT egas_rec_dk_b1.status "Empfangsstatus [RAM name from V530, voted 3]" UBYTE NO_COMPU_METHOD 0 0 0 255 ECU_ADDRESS 0x3FC178 FORMAT "%.4g" /end MEASUREMENT
/begin MEASUREMENT egas_rec_dk_b1.rec_ack "Receive-Ack [RAM name from V530, voted 8]" UWORD M_FORMULA_0080 0 0 0 65535 ECU_ADDRESS 0x3FC17A /end MEASUREMENT
/begin MEASUREMENT egas_rec_dk_b1.rec_err "Receive-Error [RAM name from V530, voted 5]" UWORD M_FORMULA_0080 0 0 0 65535 ECU_ADDRESS 0x3FC17C /end MEASUREMENT
/begin MEASUREMENT egas_rec_dk_b2.r_bank "Zylinder [RAM name from V530, voted 2]" UBYTE M_FORMULA_0003 0 0 0 255 ECU_ADDRESS 0x3FC182 /end MEASUREMENT
/begin MEASUREMENT egas_rec_dk_b2.r_ko_vers "Kommunikationsversion [RAM name from V530, voted 1]" UBYTE M_FORMULA_0003 0 0 0 255 ECU_ADDRESS 0x3FC183 /end MEASUREMENT
/begin MEASUREMENT egas_rec_dk_b2.r_hw_vers "HW-Version [RAM name from V530, voted 1]" UWORD M_FORMULA_0010 0 0 0 65535 ECU_ADDRESS 0x3FC184 /end MEASUREMENT
/begin MEASUREMENT egas_rec_dk_b2.r_set_vers "Kommunikationsversion [RAM name from V530, voted 2]" UBYTE M_FORMULA_0003 0 0 0 255 ECU_ADDRESS 0x3FC18A /end MEASUREMENT
/begin MEASUREMENT egas_rec_dk_b2.status "Empfangsstatus [RAM name from V530, voted 3]" UBYTE NO_COMPU_METHOD 0 0 0 255 ECU_ADDRESS 0x3FC18C FORMAT "%.4g" /end MEASUREMENT
/begin MEASUREMENT egas_rec_dk_b2.rec_ack "Receive-Ack [RAM name from V530, voted 8]" UWORD M_FORMULA_0080 0 0 0 65535 ECU_ADDRESS 0x3FC18E /end MEASUREMENT
/begin MEASUREMENT egas_rec_dk_b2.rec_err "Receive-Error [RAM name from V530, voted 6]" UWORD M_FORMULA_0080 0 0 0 65535 ECU_ADDRESS 0x3FC190 /end MEASUREMENT
/begin MEASUREMENT egas_rec_dk_bX.status "Empfangsstatus [RAM name from V530, voted 2]" UBYTE NO_COMPU_METHOD 0 0 0 255 ECU_ADDRESS 0x3FC1A0 FORMAT "%.4g" /end MEASUREMENT
/begin MEASUREMENT egas_rec_dk_bX.rec_ack "Receive-Ack [RAM name from V530, voted 4]" UWORD M_FORMULA_0080 0 0 0 65535 ECU_ADDRESS 0x3FC1A2 /end MEASUREMENT
/begin MEASUREMENT egas_sk_b1.zust_lls "SK-Zustand der LLS [RAM name from V530, voted 5]" UBYTE NO_COMPU_METHOD 0 0 0 255 ECU_ADDRESS 0x3FC1A8 FORMAT "%.4g" /end MEASUREMENT
/begin MEASUREMENT egas_sk.fzust_dk_b1 "SK-Zustand der DK [RAM name from V530, voted 8]" UBYTE NO_COMPU_METHOD 0 0 0 255 ECU_ADDRESS 0x3FC1A9 FORMAT "%.4g" /end MEASUREMENT
/begin MEASUREMENT egas_sk_b1.zust_dk "SK-Zustand der DK [RAM name from V530, voted 8]" UBYTE NO_COMPU_METHOD 0 0 0 255 ECU_ADDRESS 0x3FC1A9 FORMAT "%.4g" /end MEASUREMENT
/begin MEASUREMENT egas_sk_b1.dk_off_rampe "DK-Abschaltungrampe [RAM name from V530, voted 2]" SWORD M_FORMULA_0617 0 0 -655360 655340 ECU_ADDRESS 0x3FC1C0 /end MEASUREMENT
/begin MEASUREMENT egas_lls_startup "LLS-Startstate [RAM name from V530, voted 9]" UBYTE NO_COMPU_METHOD 0 0 0 255 ECU_ADDRESS 0x3FC1FC FORMAT "%.4g" /end MEASUREMENT
/begin MEASUREMENT egas_dk_startup "DK-Startstate [RAM name from V530, voted 9]" UBYTE NO_COMPU_METHOD 0 0 0 255 ECU_ADDRESS 0x3FC1FE FORMAT "%.4g" /end MEASUREMENT
/begin MEASUREMENT egas_lls_neuinit_cnt "Anzahl LLS-Neuinits [RAM name from V530, voted 3]" UBYTE M_FORMULA_0003 0 0 0 255 ECU_ADDRESS 0x3FC200 /end MEASUREMENT
/begin MEASUREMENT egas_dk_neuinit_cnt "Anzahl DK-Neuinits [RAM name from V530, voted 5]" UBYTE M_FORMULA_0003 0 0 0 255 ECU_ADDRESS 0x3FC201 /end MEASUREMENT
/begin MEASUREMENT egas_stm_lls_time_oa "letzte Adaptionszeit [RAM name from V530, voted 4]" UWORD M_FORMULA_0620 0 0 0 1092.25 ECU_ADDRESS 0x3FC202 /end MEASUREMENT
/begin MEASUREMENT egas_exd_timer "Timer ext. Diagnose [RAM name from V530, voted 20]" UWORD M_FORMULA_0590 0 0 0 327.675 ECU_ADDRESS 0x3FC208 /end MEASUREMENT
/begin MEASUREMENT egas_exd_dk_soll "Sollwert ext. DK-Diagnose [RAM name from V530, voted 9]" SWORD M_FORMULA_0001 0 0 -3276.8 3276.7 ECU_ADDRESS 0x3FC20C /end MEASUREMENT
/begin MEASUREMENT egas_exd_lls_soll "Sollwert ext. LLS-Diagnose [RAM name from V530, voted 7]" SWORD M_FORMULA_0001 0 0 -3276.8 3276.7 ECU_ADDRESS 0x3FC20A /end MEASUREMENT
/begin MEASUREMENT egas_exd_ks_time_up_b1 "Zeit Kleinsprung Up [RAM name from V530, voted 12]" UWORD M_FORMULA_0623 0 0 0 327.675 ECU_ADDRESS 0x3FC20E /end MEASUREMENT
/begin MEASUREMENT egas_exd_ks_time_up_b2 "Zeit Kleinsprung Up [RAM name from V530, voted 3]" UWORD M_FORMULA_0623 0 0 0 327.675 ECU_ADDRESS 0x3FC210 /end MEASUREMENT
/begin MEASUREMENT egas_exd_ks_time_dn_b1 "Zeit Kleinsprung Down [RAM name from V530, voted 5]" UWORD M_FORMULA_0623 0 0 0 327.675 ECU_ADDRESS 0x3FC212 /end MEASUREMENT
/begin MEASUREMENT egas_exd_gs_time_up_b1 "Zeit Grosssprung Up [RAM name from V530, voted 7]" UWORD M_FORMULA_0623 0 0 0 327.675 ECU_ADDRESS 0x3FC216 /end MEASUREMENT
/begin MEASUREMENT egas_exd_r1_ra_max_b1 "max. Regeldifferenz Oeffnen 1 [RAM name from V530, voted 8]" SWORD M_FORMULA_0001 0 0 -3276.8 3276.7 ECU_ADDRESS 0x3FC21E /end MEASUREMENT
/begin MEASUREMENT egas_exd_r1_ra_max_b2 "max. Regeldifferenz Oeffnen 1 [RAM name from V530, voted 5]" SWORD M_FORMULA_0001 0 0 -3276.8 3276.7 ECU_ADDRESS 0x3FC220 /end MEASUREMENT
/begin MEASUREMENT egas_exd_r2_ra_max_b1 "max. Regeldifferenz Oeffnen 2 [RAM name from V530, voted 7]" SWORD M_FORMULA_0001 0 0 -3276.8 3276.7 ECU_ADDRESS 0x3FC222 /end MEASUREMENT
/begin MEASUREMENT egas_exd_r3_ra_max_b1 "max. Regeldifferenz Schliessen [RAM name from V530, voted 16]" SWORD M_FORMULA_0001 0 0 -3276.8 3276.7 ECU_ADDRESS 0x3FC226 /end MEASUREMENT
/begin MEASUREMENT egas_exd_r3_ra_max_b2 "max. Regeldifferenz Schliessen [RAM name from V530, voted 3]" SWORD M_FORMULA_0001 0 0 -3276.8 3276.7 ECU_ADDRESS 0x3FC228 /end MEASUREMENT
/begin MEASUREMENT egas_exd_r1_tv_sum_b1 "Integral Tastverhaeltnis Oeffnen 1 [RAM name from V530, voted 6]" ULONG M_FORMULA_0624 0 0 0 3355443199 ECU_ADDRESS 0x3FC22C /end MEASUREMENT
/begin MEASUREMENT egas_exd_r2_tv_sum_b1 "Integral Tastverhaeltnis Oeffnen 2 [RAM name from V530, voted 5]" ULONG M_FORMULA_0624 0 0 0 3355443199 ECU_ADDRESS 0x3FC234 /end MEASUREMENT
/begin MEASUREMENT egas_exd_r3_tv_sum_b1 "Integral Tastverhaeltnis Schliessen [RAM name from V530, voted 5]" ULONG M_FORMULA_0624 0 0 0 3355443199 ECU_ADDRESS 0x3FC23C /end MEASUREMENT
/begin MEASUREMENT egas_exd_r3_tv_sum_b2 "Integral Tastverhaeltnis Schliessen [RAM name from V530, voted 2]" ULONG M_FORMULA_0624 0 0 0 3355443199 ECU_ADDRESS 0x3FC240 /end MEASUREMENT
/begin MEASUREMENT egas_exd_r1_tv_mw_b1 "Mittelwert Tastverhaeltnis Oeffnen 1 [RAM name from V530, voted 6]" SLONG M_FORMULA_0624 0 0 -1677721600 1677721599 ECU_ADDRESS 0x3FC244 /end MEASUREMENT
/begin MEASUREMENT egas_exd_r2_tv_mw_b1 "Mittelwert Tastverhaeltnis Oeffnen 2 [RAM name from V530, voted 7]" SLONG M_FORMULA_0624 0 0 -1677721600 1677721599 ECU_ADDRESS 0x3FC24C /end MEASUREMENT
/begin MEASUREMENT egas_exd_r3_tv_mw_b1 "Mittelwert Tastverhaeltnis Schliessen [RAM name from V530, voted 7]" SLONG M_FORMULA_0624 0 0 -1677721600 1677721599 ECU_ADDRESS 0x3FC254 /end MEASUREMENT
/begin MEASUREMENT egas_exd_r3_tv_mw_b2 "Mittelwert Tastverhaeltnis Schliessen [RAM name from V530, voted 3]" SLONG M_FORMULA_0624 0 0 -1677721600 1677721599 ECU_ADDRESS 0x3FC258 /end MEASUREMENT
/begin MEASUREMENT egas_exd_r1_ra_sum_b1 "Integral Regelabweichung Oeffnen 1 [RAM name from V530, voted 10]" ULONG M_FORMULA_0625 0 0 0 429496729.5 ECU_ADDRESS 0x3FC25C /end MEASUREMENT
/begin MEASUREMENT egas_exd_r1_ra_sum_b2 "Integral Regelabweichung Oeffnen 1 [RAM name from V530, voted 4]" ULONG M_FORMULA_0625 0 0 0 429496729.5 ECU_ADDRESS 0x3FC260 /end MEASUREMENT
/begin MEASUREMENT egas_exd_r2_ra_sum_b1 "Integral Regelabweichung Oeffnen 1 [RAM name from V530, voted 7]" ULONG M_FORMULA_0625 0 0 0 429496729.5 ECU_ADDRESS 0x3FC264 /end MEASUREMENT
/begin MEASUREMENT egas_exd_r3_ra_sum_b1 "Integral Regelabweichung Oeffnen 1 [RAM name from V530, voted 5]" ULONG M_FORMULA_0625 0 0 0 429496729.5 ECU_ADDRESS 0x3FC26C /end MEASUREMENT
/begin MEASUREMENT egas_exd_r3_ra_sum_b2 "Integral Regelabweichung Oeffnen 1 [RAM name from V530, voted 3]" ULONG M_FORMULA_0625 0 0 0 429496729.5 ECU_ADDRESS 0x3FC270 /end MEASUREMENT
/begin MEASUREMENT egas_exd_soll "Sollwert ext. Diagnose [RAM name from V530, voted 3]" SWORD M_FORMULA_0001 0 0 -3276.8 3276.7 ECU_ADDRESS 0x3FC274 /end MEASUREMENT
/begin MEASUREMENT egas_exd_timeout "Sollwert Timeout [RAM name from V530, voted 4]" UWORD M_FORMULA_0626 0 0 0 65535 ECU_ADDRESS 0x3FC27C /end MEASUREMENT
/begin MEASUREMENT egas_exd_timeout_en "EnLtg Timeout [RAM name from V530, voted 6]" UWORD M_FORMULA_0626 0 0 0 65535 ECU_ADDRESS 0x3FC284 /end MEASUREMENT
/begin MEASUREMENT fgr_b_rgl_init "Init Regler [RAM name from V530, voted 3]" UBYTE NO_COMPU_METHOD 0 0 0 255 ECU_ADDRESS 0x3FC502 FORMAT "%.4g" /end MEASUREMENT
/begin MEASUREMENT fgr_init_beschl_set "Init Beschl. -> Set [RAM name from V530, voted 1]" UBYTE NO_COMPU_METHOD 0 0 0 255 ECU_ADDRESS 0x3FC503 FORMAT "%.4g" /end MEASUREMENT
/begin MEASUREMENT fgr_init_verzoeg_set "Init Verzoeg. -> Set [RAM name from V530, voted 1]" UBYTE NO_COMPU_METHOD 0 0 0 255 ECU_ADDRESS 0x3FC504 FORMAT "%.4g" /end MEASUREMENT
/begin MEASUREMENT fgr_md_fw_fgr_sum "Regler Summenwert [RAM name from V530, voted 1]" UWORD M_FORMULA_0630 0 0 0 102.3984375 ECU_ADDRESS 0x3FC506 /end MEASUREMENT
/begin MEASUREMENT fgr_b_wa_first "First WA [RAM name from V530, voted 4]" UBYTE NO_COMPU_METHOD 0 0 0 255 ECU_ADDRESS 0x3FC508 FORMAT "%.4g" /end MEASUREMENT
/begin MEASUREMENT fgr_fsp_code "Fehlerspeicher Code [RAM name from V530, voted 8]" UBYTE NO_COMPU_METHOD 0 0 0 255 ECU_ADDRESS 0x3FC509 FORMAT "%.4g" /end MEASUREMENT
/begin MEASUREMENT fgr_b_dsc_reg_dsc "DSC im Regelbetrieb DSC [RAM name from V530, voted 2]" UBYTE NO_COMPU_METHOD 0 0 0 255 ECU_ADDRESS 0x3FC50A FORMAT "%.4g" /end MEASUREMENT
/begin MEASUREMENT fgr_b_dsc_eingriff "DSC Eingriff [RAM name from V530, voted 2]" UBYTE NO_COMPU_METHOD 0 0 0 255 ECU_ADDRESS 0x3FC50B FORMAT "%.4g" /end MEASUREMENT
/begin MEASUREMENT fgr_b_dsc_reg_abs_asc_msr "DSC im Regelbetrieb ABS,ASC,MSR [RAM name from V530, voted 2]" UBYTE NO_COMPU_METHOD 0 0 0 255 ECU_ADDRESS 0x3FC50E FORMAT "%.4g" /end MEASUREMENT
/begin MEASUREMENT fgr_b_dsc_soft_off "FGR soft off wegen DSC [RAM name from V530, voted 2]" UBYTE NO_COMPU_METHOD 0 0 0 255 ECU_ADDRESS 0x3FC511 FORMAT "%.4g" /end MEASUREMENT
/begin MEASUREMENT fgr_can_stat_msw "Fgr CAN-Empfangsstatus [RAM name from V530, voted 3]" UBYTE NO_COMPU_METHOD 0 0 0 255 ECU_ADDRESS 0x3FC512 FORMAT "%.4g" /end MEASUREMENT
/begin MEASUREMENT fgr_stat_anf_msw "Fgr Status Anforderung [RAM name from V530, voted 24]" UBYTE NO_COMPU_METHOD 0 0 0 255 ECU_ADDRESS 0x3FC513 FORMAT "%.4g" /end MEASUREMENT
/begin MEASUREMENT fgr_stat_abschalten "Fgr Status Abschalten [RAM name from V530, voted 10]" UBYTE NO_COMPU_METHOD 0 0 0 255 ECU_ADDRESS 0x3FC515 FORMAT "%.4g" /end MEASUREMENT
/begin MEASUREMENT fgr_stat_soft_off_rev "Fgr Status weiches Abschalten [RAM name from V530, voted 5]" UBYTE NO_COMPU_METHOD 0 0 0 255 ECU_ADDRESS 0x3FC516 FORMAT "%.4g" /end MEASUREMENT
/begin MEASUREMENT fgr_stat_hard_off_rev "Fgr Status harter Abwurf reversibel [RAM name from V530, voted 9]" UBYTE NO_COMPU_METHOD 0 0 0 255 ECU_ADDRESS 0x3FC517 FORMAT "%.4g" /end MEASUREMENT
/begin MEASUREMENT fgr_stat_hard_off_irr "Fgr Status harter Abwurf irreversibel [RAM name from V530, voted 4]" UBYTE NO_COMPU_METHOD 0 0 0 255 ECU_ADDRESS 0x3FC518 FORMAT "%.4g" /end MEASUREMENT
/begin MEASUREMENT fgr_stat_hard_off_irr_old "Fgr Status harter Abwurf irreversibel old [RAM name from V530, voted 1]" UBYTE NO_COMPU_METHOD 0 0 0 255 ECU_ADDRESS 0x3FC519 FORMAT "%.4g" /end MEASUREMENT
/begin MEASUREMENT fgr_status_stufe "FGR Status Stufe [RAM name from V530, voted 10]" UBYTE NO_COMPU_METHOD 0 0 0 255 ECU_ADDRESS 0x3FC51A FORMAT "%.4g" /end MEASUREMENT
/begin MEASUREMENT fgr_status_can "Fgr CAN Status [RAM name from V530, voted 18]" UBYTE NO_COMPU_METHOD 0 0 0 255 ECU_ADDRESS 0x3FC51B FORMAT "%.4g" /end MEASUREMENT
/begin MEASUREMENT fgr_hud_aus "FGR HUD Anzeige [RAM name from V530, voted 1]" UBYTE NO_COMPU_METHOD 0 0 0 255 ECU_ADDRESS 0x3FC51D FORMAT "%.4g" /end MEASUREMENT
/begin MEASUREMENT fgr_hud_state "FGR HUD State [RAM name from V530, voted 8]" UBYTE NO_COMPU_METHOD 0 0 0 255 ECU_ADDRESS 0x3FC51E FORMAT "%.4g" /end MEASUREMENT
/begin MEASUREMENT fgr_hud_bedien "FGR HUD Bedienbefehl abgesetzt [RAM name from V530, voted 1]" UBYTE NO_COMPU_METHOD 0 0 0 255 ECU_ADDRESS 0x3FC51F FORMAT "%.4g" /end MEASUREMENT
/begin MEASUREMENT fgr_b_smg_rs "SMG Rennstart aktiv [RAM name from V530, voted 1]" UBYTE NO_COMPU_METHOD 0 0 0 255 ECU_ADDRESS 0x3FC520 FORMAT "%.4g" /end MEASUREMENT
/begin MEASUREMENT fgr_v_tacho_fil "Kombi Geschwindigkeit gefiltert [RAM name from V530, voted 1]" SWORD M_FORMULA_0076 0 0 -2048 2047.9375 ECU_ADDRESS 0x3FC522 /end MEASUREMENT
/begin MEASUREMENT fgr_v_veh_kombi "FGR Geschw. f???r Anzeige Kombi [RAM name from V530, voted 3]" SWORD M_FORMULA_0317 0 0 -3276.8 3276.7 ECU_ADDRESS 0x3FC524 /end MEASUREMENT
/begin MEASUREMENT fgr_v_soll_min "minimale Geschwindigkeit FGR [RAM name from V530, voted 4]" SWORD M_FORMULA_0076 0 0 -2048 2047.9375 ECU_ADDRESS 0x3FC526 /end MEASUREMENT
/begin MEASUREMENT fgr_v_soll_max "maximale Geschwindigkeit FGR [RAM name from V530, voted 6]" SWORD M_FORMULA_0076 0 0 -2048 2047.9375 ECU_ADDRESS 0x3FC528 /end MEASUREMENT
/begin MEASUREMENT fgr_v_veh_ist "Ist Geschwindigkeit [RAM name from V530, voted 19]" SLONG M_FORMULA_0646 0 0 -131072 131071.9999 ECU_ADDRESS 0x3FC52C /end MEASUREMENT
/begin MEASUREMENT fgr_v_veh_ziel "Ziel Geschwindigkeit [RAM name from V530, voted 5]" SLONG M_FORMULA_0646 0 0 -131072 131071.9999 ECU_ADDRESS 0x3FC530 /end MEASUREMENT
/begin MEASUREMENT fgr_v_veh_soll "Soll Geschwindigkeit [RAM name from V530, voted 10]" SLONG M_FORMULA_0646 0 0 -131072 131071.9999 ECU_ADDRESS 0x3FC534 /end MEASUREMENT
/begin MEASUREMENT fgr_v_veh_soll_dif "Soll Geschwindigkeit PID Regler [RAM name from V530, voted 6]" SLONG M_FORMULA_0646 0 0 -131072 131071.9999 ECU_ADDRESS 0x3FC538 /end MEASUREMENT
/begin MEASUREMENT fgr_v_veh_dif "Geschwindigkeitsabweichung PID Regler [RAM name from V530, voted 7]" SLONG M_FORMULA_0646 0 0 -131072 131071.9999 ECU_ADDRESS 0x3FC53C /end MEASUREMENT
/begin MEASUREMENT fgr_v_veh_soll_dif_roh "Geschwindigkeits Rohwert Ziel-/ Sollabweichung [RAM name from V530, voted 1]" SLONG M_FORMULA_0646 0 0 -131072 131071.9999 ECU_ADDRESS 0x3FC540 /end MEASUREMENT
/begin MEASUREMENT fgr_v_veh_soll_roh "Geschwindigkeits Rohwert [RAM name from V530, voted 2]" SLONG M_FORMULA_0646 0 0 -131072 131071.9999 ECU_ADDRESS 0x3FC544 /end MEASUREMENT
/begin MEASUREMENT fgr_v_veh_fil "Gefilterte Geschwindigkeit [RAM name from V530, voted 3]" SLONG M_FORMULA_0646 0 0 -131072 131071.9999 ECU_ADDRESS 0x3FC548 /end MEASUREMENT
/begin MEASUREMENT fgr_v_veh_stufe "Geschwindigkeit Stufe [RAM name from V530, voted 3]" SLONG M_FORMULA_0646 0 0 -131072 131071.9999 ECU_ADDRESS 0x3FC54C /end MEASUREMENT
/begin MEASUREMENT fgr_v_veh_soll_inc "Rampeninkrement bei Aufsteuerung [RAM name from V530, voted 2]" UWORD M_FORMULA_0647 0 0 0 3.999938965 ECU_ADDRESS 0x3FC550 /end MEASUREMENT
/begin MEASUREMENT fgr_v_veh_soll_inc_akt "Rampeninkrement bei Aufsteuerung gewichtet [RAM name from V530, voted 1]" UWORD M_FORMULA_0647 0 0 0 3.999938965 ECU_ADDRESS 0x3FC552 /end MEASUREMENT
/begin MEASUREMENT fgr_v_veh_soll_dec "Rampendekrement bei Absteuerung [RAM name from V530, voted 2]" UWORD M_FORMULA_0647 0 0 0 3.999938965 ECU_ADDRESS 0x3FC554 /end MEASUREMENT
/begin MEASUREMENT fgr_v_veh_soll_dec_akt "Rampendekrement bei Absteuerung gewichtet [RAM name from V530, voted 1]" UWORD M_FORMULA_0647 0 0 0 3.999938965 ECU_ADDRESS 0x3FC556 /end MEASUREMENT
/begin MEASUREMENT fgr_fak_v_veh_soll "V-Soll Wichtungsfaktor [RAM name from V530, voted 2]" UBYTE M_FORMULA_0648 0 0 0 1 ECU_ADDRESS 0x3FC558 /end MEASUREMENT
/begin MEASUREMENT fgr_fak_t_aktiv "Zeitabh???niger Wichtungsfaktor [RAM name from V530, voted 3]" UBYTE M_FORMULA_0649 0 0 0 1.9921875 ECU_ADDRESS 0x3FC559 /end MEASUREMENT
/begin MEASUREMENT fgr_t_err_v_veh "Fehlzeit eines Geschwindigkeitssignals [RAM name from V530, voted 4]" UWORD M_FORMULA_0021 0 0 0 655.35 ECU_ADDRESS 0x3FC55A /end MEASUREMENT
/begin MEASUREMENT fgr_t_kli "Zeit f???r Kennlineninterpolation [RAM name from V530, voted 6]" UWORD M_FORMULA_0021 0 0 0 655.35 ECU_ADDRESS 0x3FC55C /end MEASUREMENT
/begin MEASUREMENT fgr_kw "Koeffizienten Wichtungsfaktor [RAM name from V530, voted 1]" SWORD M_FORMULA_0650 0 0 -327.68 327.67 ECU_ADDRESS 0x3FC55E /end MEASUREMENT
/begin MEASUREMENT fgr_ax_ist "Fahrzeug L???ngsbeschleunigung [RAM name from V530, voted 4]" SWORD M_FORMULA_0123 0 0 -819.2 819.175 ECU_ADDRESS 0x3FC560 /end MEASUREMENT
/begin MEASUREMENT fgr_ax_pos_soll "Sollbeschleunigung [RAM name from V530, voted 4]" SWORD M_FORMULA_0123 0 0 -819.2 819.175 ECU_ADDRESS 0x3FC562 /end MEASUREMENT
/begin MEASUREMENT fgr_ax_neg_soll "Sollverz???gerung [RAM name from V530, voted 5]" SWORD M_FORMULA_0123 0 0 -819.2 819.175 ECU_ADDRESS 0x3FC564 /end MEASUREMENT
/begin MEASUREMENT fgr_n_dif "n dif. Getriebeeingang [RAM name from V530, voted 1]" SWORD M_FORMULA_0651 0 0 -32768 32767 ECU_ADDRESS 0x3FC566 /end MEASUREMENT
/begin MEASUREMENT fgr_a1 "Reglerkoeffizient a1 [RAM name from V530, voted 2]" SWORD M_FORMULA_0488 0 0 -327.68 327.67 ECU_ADDRESS 0x3FC568 /end MEASUREMENT
/begin MEASUREMENT fgr_b0 "Reglerkoeffizient b0 [RAM name from V530, voted 2]" SWORD M_FORMULA_0488 0 0 -327.68 327.67 ECU_ADDRESS 0x3FC56A /end MEASUREMENT
/begin MEASUREMENT fgr_b1 "Reglerkoeffizient b1 [RAM name from V530, voted 2]" SWORD M_FORMULA_0488 0 0 -327.68 327.67 ECU_ADDRESS 0x3FC56C /end MEASUREMENT
/begin MEASUREMENT fgr_b2 "Reglerkoeffizient b2 [RAM name from V530, voted 2]" SWORD M_FORMULA_0488 0 0 -327.68 327.67 ECU_ADDRESS 0x3FC56E /end MEASUREMENT
/begin MEASUREMENT fgr_kr "Regler Zwischenfaktor kr [RAM name from V530, voted 1]" SWORD M_FORMULA_0488 0 0 -327.68 327.67 ECU_ADDRESS 0x3FC570 /end MEASUREMENT
/begin MEASUREMENT fgr_tn "Regler Zwischenfaktor tn [RAM name from V530, voted 1]" SWORD M_FORMULA_0488 0 0 -327.68 327.67 ECU_ADDRESS 0x3FC572 /end MEASUREMENT
/begin MEASUREMENT fgr_tv "Regler Zwischenfaktor tv [RAM name from V530, voted 1]" SWORD M_FORMULA_0488 0 0 -327.68 327.67 ECU_ADDRESS 0x3FC574 /end MEASUREMENT
/begin MEASUREMENT fgr_fil_a1 "Filterkoeffizient a1 [RAM name from V530, voted 2]" SWORD M_FORMULA_0199 0 0 -2 1.999938965 ECU_ADDRESS 0x3FC576 /end MEASUREMENT
/begin MEASUREMENT fgr_fil_b1 "Filterkoeffizient b1 [RAM name from V530, voted 2]" UWORD M_FORMULA_0652 0 0 0 0.2499961853 ECU_ADDRESS 0x3FC578 /end MEASUREMENT
/begin MEASUREMENT fgr_fil_b2 "Filterkoeffizient b2 [RAM name from V530, voted 1]" UWORD M_FORMULA_0652 0 0 0 0.2499961853 ECU_ADDRESS 0x3FC57A /end MEASUREMENT
/begin MEASUREMENT fgr_md_fw_roh "Rohwert des Reglereingriffs [RAM name from V530, voted 2]" UWORD M_FORMULA_0630 0 0 0 102.3984375 ECU_ADDRESS 0x3FC57C /end MEASUREMENT
/begin MEASUREMENT fgr_md_fw_sa "Rohwert des Reglereingriffs incl. SA [RAM name from V530, voted 2]" UWORD M_FORMULA_0630 0 0 0 102.3984375 ECU_ADDRESS 0x3FC57E /end MEASUREMENT
/begin MEASUREMENT fgr_pwg "PWG Moment vom FGR [RAM name from V530, voted 4]" SWORD M_FORMULA_0001 0 0 -3276.8 3276.7 ECU_ADDRESS 0x3FC580 /end MEASUREMENT
/begin MEASUREMENT fgr_b_ueberhol_anf "Anforderung ???berholen [RAM name from V530, voted 10]" UBYTE NO_COMPU_METHOD 0 0 0 255 ECU_ADDRESS 0x3FC582 FORMAT "%.4g" /end MEASUREMENT
/begin MEASUREMENT fgr_t_constfahrt "Zeit Konstantfahrt [RAM name from V530, voted 6]" ULONG M_FORMULA_0653 0 0 0 42949672.95 ECU_ADDRESS 0x3FC584 /end MEASUREMENT
/begin MEASUREMENT fgr_t_ueberhol "Zeit ???berholen [RAM name from V530, voted 6]" ULONG M_FORMULA_0653 0 0 0 42949672.95 ECU_ADDRESS 0x3FC588 /end MEASUREMENT
/begin MEASUREMENT fgr_t_aktiv "Zeit FGR aktiv [RAM name from V530, voted 8]" ULONG M_FORMULA_0653 0 0 0 42949672.95 ECU_ADDRESS 0x3FC58C /end MEASUREMENT
/begin MEASUREMENT fr_iant_b1 "I-Anteil [RAM name from V530, voted 1]" SWORD M_FORMULA_0671 0 0 -100 99.99694824 ECU_ADDRESS 0x3FC600 /end MEASUREMENT
/begin MEASUREMENT fr_pant_b1 "P-Anteil [RAM name from V530, voted 1]" SWORD M_FORMULA_0672 0 0 -1.000030519 1 ECU_ADDRESS 0x3FC604 /end MEASUREMENT
/begin MEASUREMENT fr_reg_i_b1 "I-Anteil FR-Regler [RAM name from V530, voted 5]" SWORD M_FORMULA_0670 0 0 -1.000030519 1 ECU_ADDRESS 0x3FC608 /end MEASUREMENT
/begin MEASUREMENT fr_reg_i_b2 "I-Anteil FR-Regler [RAM name from V530, voted 2]" SWORD M_FORMULA_0670 0 0 -1.000030519 1 ECU_ADDRESS 0x3FC60A /end MEASUREMENT
/begin MEASUREMENT fr_reg_out_b1 "Korrekturfaktor FR-Regler [RAM name from V530, voted 2]" UWORD M_FORMULA_0024 0 0 0 1.999969482 ECU_ADDRESS 0x3FC60C /end MEASUREMENT
/begin MEASUREMENT fr_rf_delta_rel_hys "Schwelle rel. Regelabweichung [RAM name from V530, voted 2]" SWORD M_FORMULA_0670 0 0 -1.000030519 1 ECU_ADDRESS 0x3FC610 /end MEASUREMENT
/begin MEASUREMENT fr_in_b1 "Fuellungsregler Eingang [RAM name from V530, voted 2]" UWORD M_FORMULA_0024 0 0 0 1.999969482 ECU_ADDRESS 0x3FC616 /end MEASUREMENT
/begin MEASUREMENT fr_md_rf_soll_pt_schw "md_rf_soll_pt-Schwelle zum Einfrieren FR-Regler [RAM name from V530, voted 2]" SWORD M_FORMULA_0007 0 0 -3.2768 3.2767 ECU_ADDRESS 0x3FC61A /end MEASUREMENT
/begin MEASUREMENT fr_ramp_t "Zaehler fuer die Verzoegerung beim Abrampen vom fr [RAM name from V530, voted 5]" UWORD M_FORMULA_0021 0 0 0 655.35 ECU_ADDRESS 0x3FC61C /end MEASUREMENT
/begin MEASUREMENT fr_halt_t "Zaehler fuer die Verzoegerung beim Halten vom fr [RAM name from V530, voted 6]" UWORD M_FORMULA_0109 0 0 0 327.675 ECU_ADDRESS 0x3FC61E /end MEASUREMENT
/begin MEASUREMENT fr_rf_delta_b1 "Regelabweichung (Soll-Ist) [RAM name from V530, voted 1]" SWORD M_FORMULA_0024 0 0 -1 0.9999694824 ECU_ADDRESS 0x3FC620 /end MEASUREMENT
/begin MEASUREMENT fr_status "Allgemeiner FR-Status [RAM name from V530, voted 2]" UBYTE NO_COMPU_METHOD 0 0 0 255 ECU_ADDRESS 0x3FC624 FORMAT "%.4g" /end MEASUREMENT
/begin MEASUREMENT fra_loli_out_f_b1 "FRA Lolimot Ausgang [RAM name from V530, voted 2]" FLOAT32_IEEE M_FORMULA_0044 0 0 -1e+30 1e+30 ECU_ADDRESS 0x3FC6DC /end MEASUREMENT
/begin MEASUREMENT fra_loli_out_b1 "FRA Lolimot Ausgang [RAM name from V530, voted 1]" UWORD M_FORMULA_0024 0 0 0 1.999969482 ECU_ADDRESS 0x3FC6E4 /end MEASUREMENT
/begin MEASUREMENT fra_loli_z_norm "Standart float32 [RAM name from V530, voted 3]" FLOAT32_IEEE M_FORMULA_0044 0 0 -1e+30 1e+30 ECU_ADDRESS 0x3FC6F4 /end MEASUREMENT
/begin MEASUREMENT gang_richtung "ermittelte Fahrtrichtung fuer Ganganzeige [RAM name from V530, voted 3]" UBYTE NO_COMPU_METHOD 0 0 0 255 ECU_ADDRESS 0x3FC738 FORMAT "%.4g" /end MEASUREMENT
/begin MEASUREMENT gang_richtung_cnt "ermittelte Fahrtrichtung fuer Ganganzeige [RAM name from V530, voted 6]" SBYTE M_FORMULA_0003 0 0 -128 127 ECU_ADDRESS 0x3FC739 /end MEASUREMENT
/begin MEASUREMENT gang_1_timer "aktuelles Delay fuer Anzeige 1.Gang [RAM name from V530, voted 4]" SWORD M_FORMULA_0691 0 0 -327680 327670 ECU_ADDRESS 0x3FC73A /end MEASUREMENT
/begin MEASUREMENT gang_berech_neu_verz "vorhergehende Schalterstellung Gang neu berechnen [RAM name from V530, voted 1]" UWORD M_FORMULA_0010 0 0 0 65535 ECU_ADDRESS 0x3FC73C /end MEASUREMENT
/begin MEASUREMENT gang_berech_kl "berechneter Gang aus Kennlinie [RAM name from V530, voted 12]" SWORD M_FORMULA_0010 0 0 -32768 32767 ECU_ADDRESS 0x3FC73E /end MEASUREMENT
/begin MEASUREMENT gang_berech_roh "berechneter Gang ohne R und N [RAM name from V530, voted 3]" SBYTE M_FORMULA_0135 0 0 -128 127 ECU_ADDRESS 0x3FC740 /end MEASUREMENT
/begin MEASUREMENT gang_can_sperre_irre_cnt "Counter fuer irreversible Sperre Ganganzeige [RAM name from V530, voted 2]" UBYTE M_FORMULA_0003 0 0 0 255 ECU_ADDRESS 0x3FC741 /end MEASUREMENT
/begin MEASUREMENT gang_can_sperre_irre "irreversible Sperre fuer Ganganzeige [RAM name from V530, voted 2]" UBYTE NO_COMPU_METHOD 0 0 0 255 ECU_ADDRESS 0x3FC742 FORMAT "%.4g" /end MEASUREMENT
/begin MEASUREMENT gang_ik "kuerzestes Getriebeuebersetzungsverhaeltnis [RAM name from V530, voted 4]" SWORD M_FORMULA_0073 0 0 -32 31.99902344 ECU_ADDRESS 0x3FC744 /end MEASUREMENT
/begin MEASUREMENT gang_il "laengstes Getriebeuebersetzungsverhaeltnis [RAM name from V530, voted 6]" SWORD M_FORMULA_0073 0 0 -32 31.99902344 ECU_ADDRESS 0x3FC746 /end MEASUREMENT
/begin MEASUREMENT gang_i "aktuelles Getriebeuebersetzungsverhaeltnis [RAM name from V530, voted 4]" SWORD M_FORMULA_0073 0 0 -32 31.99902344 ECU_ADDRESS 0x3FC748 /end MEASUREMENT
/begin MEASUREMENT gang_i_rad "Getriebeuebersetzungsverhaeltnis Strang [RAM name from V530, voted 1]" SWORD M_FORMULA_0073 0 0 -32 31.99902344 ECU_ADDRESS 0x3FC756 /end MEASUREMENT
/begin MEASUREMENT gang_r_rad_dyn_nv "Radhalbmesser dynamisch adaptiert [RAM name from V530, voted 1]" SWORD M_FORMULA_0693 0 0 -32 31.99902344 ECU_ADDRESS 0x3FC758 /end MEASUREMENT
/begin MEASUREMENT gang_glg_timer "aktuelles Delay fuer Anzeige Getriebeleergasse [RAM name from V530, voted 4]" SWORD M_FORMULA_0691 0 0 -327680 327670 ECU_ADDRESS 0x3FC75A /end MEASUREMENT
/begin MEASUREMENT gang_glg_getr_verz "vorhergehende Schalterstellung Getriebeleergasse [RAM name from V530, voted 2]" UWORD M_FORMULA_0010 0 0 0 65535 ECU_ADDRESS 0x3FC75C /end MEASUREMENT
/begin MEASUREMENT sst_n8 "SST [RAM name from V530, voted 1]" ULONG M_FORMULA_0000 0 0 0 4294967295 ECU_ADDRESS 0x3FC760 /end MEASUREMENT
/begin MEASUREMENT sst_n10 "SST [RAM name from V530, voted 2]" ULONG M_FORMULA_0000 0 0 0 4294967295 ECU_ADDRESS 0x3FC764 /end MEASUREMENT
/begin MEASUREMENT sst_n12 "SST [RAM name from V530, voted 2]" ULONG M_FORMULA_0000 0 0 0 4294967295 ECU_ADDRESS 0x3FC768 /end MEASUREMENT
/begin MEASUREMENT sst_n16 "SST [RAM name from V530, voted 1]" ULONG M_FORMULA_0000 0 0 0 4294967295 ECU_ADDRESS 0x3FC76C /end MEASUREMENT
/begin MEASUREMENT sst_n_grad6 "SST [RAM name from V530, voted 2]" ULONG M_FORMULA_0000 0 0 0 4294967295 ECU_ADDRESS 0x3FC770 /end MEASUREMENT
/begin MEASUREMENT sst_rf5_b1 "SST [RAM name from V530, voted 1]" ULONG M_FORMULA_0000 0 0 0 4294967295 ECU_ADDRESS 0x3FC774 /end MEASUREMENT
/begin MEASUREMENT sst_rf10_b1 "SST [RAM name from V530, voted 1]" ULONG M_FORMULA_0000 0 0 0 4294967295 ECU_ADDRESS 0x3FC77C /end MEASUREMENT
/begin MEASUREMENT ioncom_destaddr "IP-Adresse des Empf???ngers der Messdaten [RAM name from V530, voted 2]" ULONG M_FORMULA_0044 0 0 0 4294967295 ECU_ADDRESS 0x3FC7E8 /end MEASUREMENT
/begin MEASUREMENT ipk_error_segm.type "Fehlertype [RAM name from V530, voted 3]" UBYTE NO_COMPU_METHOD 0 0 0 255 ECU_ADDRESS 0x3FC7ED FORMAT "%.4g" /end MEASUREMENT
/begin MEASUREMENT j_fzg "Traegheitsmoment Fzg [RAM name from V530, voted 2]" UWORD M_FORMULA_0276 0 0 0 127.9980469 ECU_ADDRESS 0x3FC7FA /end MEASUREMENT
/begin MEASUREMENT kh_van_fakt_max "Max. Gewichtungsfaktor KH [RAM name from V530, voted 2]" UWORD M_FORMULA_0199 0 0 0 3.999938965 ECU_ADDRESS 0x3FC92A /end MEASUREMENT
/begin MEASUREMENT kr_st_erk "Status Klopferkennung ueber Mittelwert. [RAM name from V530, voted 1]" UWORD NO_COMPU_METHOD 0 0 0 65535 ECU_ADDRESS 0x3FCC2A FORMAT "%.4g" /end MEASUREMENT
/begin MEASUREMENT kr_st_erk_zyl1 "Status Klopferkennung ueber Mittelwert 1. [RAM name from V530, voted 1]" UWORD NO_COMPU_METHOD 0 0 0 65535 ECU_ADDRESS 0x3FCC2A FORMAT "%.4g" /end MEASUREMENT
/begin MEASUREMENT kr_st_erk_zyl10 "Status Klopferkennung ueber Mittelwert 10. [RAM name from V530, voted 1]" UWORD NO_COMPU_METHOD 0 0 0 65535 ECU_ADDRESS 0x3FCC2A FORMAT "%.4g" /end MEASUREMENT
/begin MEASUREMENT kr_st_erk_zyl2 "Status Klopferkennung ueber Mittelwert 2. [RAM name from V530, voted 1]" UWORD NO_COMPU_METHOD 0 0 0 65535 ECU_ADDRESS 0x3FCC2A FORMAT "%.4g" /end MEASUREMENT
/begin MEASUREMENT kr_st_erk_zyl3 "Status Klopferkennung ueber Mittelwert 3. [RAM name from V530, voted 1]" UWORD NO_COMPU_METHOD 0 0 0 65535 ECU_ADDRESS 0x3FCC2A FORMAT "%.4g" /end MEASUREMENT
/begin MEASUREMENT kr_st_erk_zyl4 "Status Klopferkennung ueber Mittelwert 4. [RAM name from V530, voted 1]" UWORD NO_COMPU_METHOD 0 0 0 65535 ECU_ADDRESS 0x3FCC2A FORMAT "%.4g" /end MEASUREMENT
/begin MEASUREMENT kr_st_erk_zyl5 "Status Klopferkennung ueber Mittelwert 5. [RAM name from V530, voted 1]" UWORD NO_COMPU_METHOD 0 0 0 65535 ECU_ADDRESS 0x3FCC2A FORMAT "%.4g" /end MEASUREMENT
/begin MEASUREMENT kr_st_erk_zyl6 "Status Klopferkennung ueber Mittelwert 6. [RAM name from V530, voted 1]" UWORD NO_COMPU_METHOD 0 0 0 65535 ECU_ADDRESS 0x3FCC2A FORMAT "%.4g" /end MEASUREMENT
/begin MEASUREMENT kr_st_erk_zyl7 "Status Klopferkennung ueber Mittelwert 7. [RAM name from V530, voted 1]" UWORD NO_COMPU_METHOD 0 0 0 65535 ECU_ADDRESS 0x3FCC2A FORMAT "%.4g" /end MEASUREMENT
/begin MEASUREMENT kr_st_erk_zyl8 "Status Klopferkennung ueber Mittelwert 8. [RAM name from V530, voted 1]" UWORD NO_COMPU_METHOD 0 0 0 65535 ECU_ADDRESS 0x3FCC2A FORMAT "%.4g" /end MEASUREMENT
/begin MEASUREMENT kr_st_erk_zyl9 "Status Klopferkennung ueber Mittelwert 9. [RAM name from V530, voted 1]" UWORD NO_COMPU_METHOD 0 0 0 65535 ECU_ADDRESS 0x3FCC2A FORMAT "%.4g" /end MEASUREMENT
/begin MEASUREMENT kr_akt_st "Status Abregelung. [RAM name from V530, voted 1]" UWORD M_FORMULA_0010 0 0 0 65535 ECU_ADDRESS 0x3FCC2C /end MEASUREMENT
/begin MEASUREMENT kr_akt_st_zyl1 "Abregelung Zylinder 1 aktiv. [RAM name from V530, voted 1]" UWORD NO_COMPU_METHOD 0 0 0 65535 ECU_ADDRESS 0x3FCC2C FORMAT "%.4g" /end MEASUREMENT
/begin MEASUREMENT kr_akt_st_zyl10 "Abregelung Zylinder 10 aktiv. [RAM name from V530, voted 1]" UWORD NO_COMPU_METHOD 0 0 0 65535 ECU_ADDRESS 0x3FCC2C FORMAT "%.4g" /end MEASUREMENT
/begin MEASUREMENT kr_akt_st_zyl2 "Abregelung Zylinder 2 aktiv. [RAM name from V530, voted 1]" UWORD NO_COMPU_METHOD 0 0 0 65535 ECU_ADDRESS 0x3FCC2C FORMAT "%.4g" /end MEASUREMENT
/begin MEASUREMENT kr_akt_st_zyl3 "Abregelung Zylinder 3 aktiv. [RAM name from V530, voted 1]" UWORD NO_COMPU_METHOD 0 0 0 65535 ECU_ADDRESS 0x3FCC2C FORMAT "%.4g" /end MEASUREMENT
/begin MEASUREMENT kr_akt_st_zyl4 "Abregelung Zylinder 4 aktiv. [RAM name from V530, voted 1]" UWORD NO_COMPU_METHOD 0 0 0 65535 ECU_ADDRESS 0x3FCC2C FORMAT "%.4g" /end MEASUREMENT
/begin MEASUREMENT kr_akt_st_zyl5 "Abregelung Zylinder 5 aktiv. [RAM name from V530, voted 1]" UWORD NO_COMPU_METHOD 0 0 0 65535 ECU_ADDRESS 0x3FCC2C FORMAT "%.4g" /end MEASUREMENT
/begin MEASUREMENT kr_akt_st_zyl6 "Abregelung Zylinder 6 aktiv. [RAM name from V530, voted 1]" UWORD NO_COMPU_METHOD 0 0 0 65535 ECU_ADDRESS 0x3FCC2C FORMAT "%.4g" /end MEASUREMENT
/begin MEASUREMENT kr_akt_st_zyl7 "Abregelung Zylinder 7 aktiv. [RAM name from V530, voted 1]" UWORD NO_COMPU_METHOD 0 0 0 65535 ECU_ADDRESS 0x3FCC2C FORMAT "%.4g" /end MEASUREMENT
/begin MEASUREMENT kr_akt_st_zyl8 "Abregelung Zylinder 8 aktiv. [RAM name from V530, voted 1]" UWORD NO_COMPU_METHOD 0 0 0 65535 ECU_ADDRESS 0x3FCC2C FORMAT "%.4g" /end MEASUREMENT
/begin MEASUREMENT kr_akt_st_zyl9 "Abregelung Zylinder 9 aktiv. [RAM name from V530, voted 1]" UWORD NO_COMPU_METHOD 0 0 0 65535 ECU_ADDRESS 0x3FCC2C FORMAT "%.4g" /end MEASUREMENT
/begin MEASUREMENT kr_asp_cnt "KR Arbeitsspielzaehler. [RAM name from V530, voted 2]" UWORD M_FORMULA_0010 0 0 0 65535 ECU_ADDRESS 0x3FCC30 /end MEASUREMENT
/begin MEASUREMENT kr_dtz_max "Maximal zulaessiger Klopfregelungseingriff. [RAM name from V530, voted 1]" SWORD M_FORMULA_0102 0 0 -3276.8 3276.7 ECU_ADDRESS 0x3FCC32 /end MEASUREMENT
/begin MEASUREMENT kus_st "Status Kupplungsschlupf-Funktion [RAM name from V530, voted 6]" UBYTE M_FORMULA_0037 0 0 0 255 ECU_ADDRESS 0x3FCEAE /end MEASUREMENT
/begin MEASUREMENT kus_st_enable "Status Kupplungsschlupf-Funktion Enable [RAM name from V530, voted 6]" UBYTE NO_COMPU_METHOD 0 0 0 255 ECU_ADDRESS 0x3FCEAE FORMAT "%.4g" /end MEASUREMENT
/begin MEASUREMENT kus_timer "Timer Motor Teillast oder Volllast [RAM name from V530, voted 2]" UWORD M_FORMULA_0109 0 0 0 327.675 ECU_ADDRESS 0x3FCEB0 /end MEASUREMENT
/begin MEASUREMENT kus_n_max "maximale Motordrehzahl, Kupplungsschlupfregelung [RAM name from V530, voted 4]" SWORD M_FORMULA_0006 0 0 -32768 32767 ECU_ADDRESS 0x3FCEB2 /end MEASUREMENT
/begin MEASUREMENT kus_n_schlupf "Kupplungsschlupf [RAM name from V530, voted 6]" SWORD M_FORMULA_0006 0 0 -32768 32767 ECU_ADDRESS 0x3FCEB4 /end MEASUREMENT
/begin MEASUREMENT kus_gang "Gang mit Zwischenstufen, Kupplungsschlupfregelung [RAM name from V530, voted 5]" SWORD M_FORMULA_0073 0 0 -32 31.99902344 ECU_ADDRESS 0x3FCEB6 /end MEASUREMENT
/begin MEASUREMENT kus_n_getr_ein_alt "Getriebeeingangsdrehzahl [RAM name from V530, voted 2]" SWORD M_FORMULA_0006 0 0 -32768 32767 ECU_ADDRESS 0x3FCEB8 /end MEASUREMENT
/begin MEASUREMENT llr_diag_state "Diagnose Status [RAM name from V530, voted 4]" UBYTE NO_COMPU_METHOD 0 0 0 255 ECU_ADDRESS 0x3FCFC9 FORMAT "%.4g" /end MEASUREMENT
/begin MEASUREMENT llr_exd_state "Exd-State [RAM name from V530, voted 2]" UBYTE NO_COMPU_METHOD 0 0 0 255 ECU_ADDRESS 0x3FCFCA FORMAT "%.4g" /end MEASUREMENT
/begin MEASUREMENT llr_md_i "I-Anteil [RAM name from V530, voted 6]" SWORD M_FORMULA_0009 0 0 -3276.8 3276.7 ECU_ADDRESS 0x3FCFEE /end MEASUREMENT
/begin MEASUREMENT llr_md_d_roh "einmaliger D-Anteil ohne Begr [RAM name from V530, voted 1]" SWORD M_FORMULA_0009 0 0 -3276.8 3276.7 ECU_ADDRESS 0x3FCFF4 /end MEASUREMENT
/begin MEASUREMENT llr_md_d "einmaliger D-Anteil [RAM name from V530, voted 6]" SWORD M_FORMULA_0009 0 0 -3276.8 3276.7 ECU_ADDRESS 0x3FCFF6 /end MEASUREMENT
/begin MEASUREMENT llr_omega_grad_ist "Omega [RAM name from V530, voted 2]" SWORD M_FORMULA_0741 0 0 -327.68 327.67 ECU_ADDRESS 0x3FCFFC /end MEASUREMENT
/begin COMPU_METHOD M_FORMULA_0000 "V530 FORMULA_0000" RAT_FUNC "%.4g" "-" COEFFS 0 1 0 0 0 1 /end COMPU_METHOD
/begin COMPU_METHOD M_FORMULA_0001 "V530 FORMULA_0001" RAT_FUNC "%.4g" "%" COEFFS 0 10 0 0 0 1 /end COMPU_METHOD
/begin COMPU_METHOD M_FORMULA_0003 "V530 FORMULA_0003" RAT_FUNC "%.4g" "-" COEFFS 0 1 0 0 0 1 /end COMPU_METHOD
/begin COMPU_METHOD M_FORMULA_0006 "V530 FORMULA_0006" RAT_FUNC "%.4g" "Upm" COEFFS 0 1 0 0 0 1 /end COMPU_METHOD
/begin COMPU_METHOD M_FORMULA_0007 "V530 FORMULA_0007" RAT_FUNC "%.4g" "-" COEFFS 0 10000 0 0 0 1 /end COMPU_METHOD
/begin COMPU_METHOD M_FORMULA_0008 "V530 FORMULA_0008" RAT_FUNC "%.4g" "V" COEFFS 0 10 0 0 0 1 /end COMPU_METHOD
/begin COMPU_METHOD M_FORMULA_0009 "V530 FORMULA_0009" RAT_FUNC "%.4g" "Nm" COEFFS 0 10 0 0 0 1 /end COMPU_METHOD
/begin COMPU_METHOD M_FORMULA_0010 "V530 FORMULA_0010" RAT_FUNC "%.4g" "-" COEFFS 0 1 0 0 0 1 /end COMPU_METHOD
/begin COMPU_METHOD M_FORMULA_0018 "V530 FORMULA_0018" RAT_FUNC "%.4g" "us" COEFFS 0 1 0 0 0 1 /end COMPU_METHOD
/begin COMPU_METHOD M_FORMULA_0020 "V530 FORMULA_0020" RAT_FUNC "%.4g" "qmm/s" COEFFS 0 0.05 0 0 0 1 /end COMPU_METHOD
/begin COMPU_METHOD M_FORMULA_0021 "V530 FORMULA_0021" RAT_FUNC "%.4g" "s" COEFFS 0 100 0 0 0 1 /end COMPU_METHOD
/begin COMPU_METHOD M_FORMULA_0022 "V530 FORMULA_0022" RAT_FUNC "%.4g" "%" COEFFS 0 100 0 0 0 1 /end COMPU_METHOD
/begin COMPU_METHOD M_FORMULA_0023 "V530 FORMULA_0023" RAT_FUNC "%.4g" "???C" COEFFS 0 10 2732 0 0 1 /end COMPU_METHOD
/begin COMPU_METHOD M_FORMULA_0024 "V530 FORMULA_0024" RAT_FUNC "%.4g" "-" COEFFS 0 32768 0 0 0 1 /end COMPU_METHOD
/begin COMPU_METHOD M_FORMULA_0025 "V530 FORMULA_0025" RAT_FUNC "%.4g" "-" COEFFS 0 16384 0 0 0 1 /end COMPU_METHOD
/begin COMPU_METHOD M_FORMULA_0027 "V530 FORMULA_0027" RAT_FUNC "%.4g" "km" COEFFS 0 1 0 0 0 1 /end COMPU_METHOD
/begin COMPU_METHOD M_FORMULA_0037 "V530 FORMULA_0037" RAT_FUNC "%.4g" "-" COEFFS 0 1 0 0 0 1 /end COMPU_METHOD
/begin COMPU_METHOD M_FORMULA_0044 "V530 FORMULA_0044" RAT_FUNC "%.4g" "-" COEFFS 0 1 0 0 0 1 /end COMPU_METHOD
/begin COMPU_METHOD M_FORMULA_0071 "V530 FORMULA_0071" RAT_FUNC "%.4g" "s" COEFFS 0 10 0 0 0 1 /end COMPU_METHOD
/begin COMPU_METHOD M_FORMULA_0073 "V530 FORMULA_0073" RAT_FUNC "%.4g" "-" COEFFS 0 1024 0 0 0 1 /end COMPU_METHOD
/begin COMPU_METHOD M_FORMULA_0074 "V530 FORMULA_0074" RAT_FUNC "%.4g" "Kelvin" COEFFS 0 10 0 0 0 1 /end COMPU_METHOD
/begin COMPU_METHOD M_FORMULA_0075 "V530 FORMULA_0075" RAT_FUNC "%.4g" "mbar" COEFFS 0 16 0 0 0 1 /end COMPU_METHOD
/begin COMPU_METHOD M_FORMULA_0076 "V530 FORMULA_0076" RAT_FUNC "%.4g" "km/h" COEFFS 0 16 0 0 0 1 /end COMPU_METHOD
/begin COMPU_METHOD M_FORMULA_0080 "V530 FORMULA_0080" RAT_FUNC "%.4g" "-" COEFFS 0 1 0 0 0 1 /end COMPU_METHOD
/begin COMPU_METHOD M_FORMULA_0102 "V530 FORMULA_0102" RAT_FUNC "%.4g" "???KW" COEFFS 0 10 0 0 0 1 /end COMPU_METHOD
/begin COMPU_METHOD M_FORMULA_0105 "V530 FORMULA_0105" RAT_FUNC "%.4g" "Upm/s" COEFFS 0 1 0 0 0 1 /end COMPU_METHOD
/begin COMPU_METHOD M_FORMULA_0107 "V530 FORMULA_0107" RAT_FUNC "%.4g" "%" COEFFS 0 10.24 0 0 0 1 /end COMPU_METHOD
/begin COMPU_METHOD M_FORMULA_0109 "V530 FORMULA_0109" RAT_FUNC "%.4g" "s" COEFFS 0 200 0 0 0 1 /end COMPU_METHOD
/begin COMPU_METHOD M_FORMULA_0110 "V530 FORMULA_0110" RAT_FUNC "%.4g" "bar" COEFFS 0 1000 0 0 0 1 /end COMPU_METHOD
/begin COMPU_METHOD M_FORMULA_0113 "V530 FORMULA_0113" RAT_FUNC "%.4g" "Nm" COEFFS 0 10 0 0 0 1 /end COMPU_METHOD
/begin COMPU_METHOD M_FORMULA_0114 "V530 FORMULA_0114" RAT_FUNC "%.4g" "digit" COEFFS 0 1 0 0 0 1 /end COMPU_METHOD
/begin COMPU_METHOD M_FORMULA_0120 "V530 FORMULA_0120" RAT_FUNC "%.4g" "Nm" COEFFS 0 2 0 0 0 1 /end COMPU_METHOD
/begin COMPU_METHOD M_FORMULA_0123 "V530 FORMULA_0123" RAT_FUNC "%.4g" "m/(s*s)" COEFFS 0 40 0 0 0 1 /end COMPU_METHOD
/begin COMPU_METHOD M_FORMULA_0129 "V530 FORMULA_0129" RAT_FUNC "%.4g" "bar" COEFFS 0 1 0 0 0 1 /end COMPU_METHOD
/begin COMPU_METHOD M_FORMULA_0132 "V530 FORMULA_0132" RAT_FUNC "%.4g" "Grad" COEFFS 0 22.75312856 0 0 0 1 /end COMPU_METHOD
/begin COMPU_METHOD M_FORMULA_0133 "V530 FORMULA_0133" RAT_FUNC "%.4g" "Grad/s" COEFFS 0 22.75312856 0 0 0 1 /end COMPU_METHOD
/begin COMPU_METHOD M_FORMULA_0135 "V530 FORMULA_0135" RAT_FUNC "%.4g" ".Gang" COEFFS 0 1 0 0 0 1 /end COMPU_METHOD
/begin COMPU_METHOD M_FORMULA_0143 "V530 FORMULA_0143" RAT_FUNC "%.4g" "qmm" COEFFS 0 10 0 0 0 1 /end COMPU_METHOD
/begin COMPU_METHOD M_FORMULA_0144 "V530 FORMULA_0144" RAT_FUNC "%.4g" "ml" COEFFS 0 1000 0 0 0 1 /end COMPU_METHOD
/begin COMPU_METHOD M_FORMULA_0145 "V530 FORMULA_0145" RAT_FUNC "%.4g" "min" COEFFS 0 60 0 0 0 1 /end COMPU_METHOD
/begin COMPU_METHOD M_FORMULA_0147 "V530 FORMULA_0147" RAT_FUNC "%.4g" "s" COEFFS 0 100 0 0 0 1 /end COMPU_METHOD
/begin COMPU_METHOD M_FORMULA_0165 "V530 FORMULA_0165" RAT_FUNC "%.4g" "???C" COEFFS 0 1 48 0 0 1 /end COMPU_METHOD
/begin COMPU_METHOD M_FORMULA_0166 "V530 FORMULA_0166" RAT_FUNC "%.4g" "Upm" COEFFS 0 0.02 0 0 0 1 /end COMPU_METHOD
/begin COMPU_METHOD M_FORMULA_0186 "V530 FORMULA_0186" RAT_FUNC "%.4g" "-/10ms" COEFFS 0 10000 0 0 0 1 /end COMPU_METHOD
/begin COMPU_METHOD M_FORMULA_0199 "V530 FORMULA_0199" RAT_FUNC "%.4g" "-" COEFFS 0 16384 0 0 0 1 /end COMPU_METHOD
/begin COMPU_METHOD M_FORMULA_0214 "V530 FORMULA_0214" RAT_FUNC "%.4g" "s" COEFFS 0 1 0 0 0 1 /end COMPU_METHOD
/begin COMPU_METHOD M_FORMULA_0227 "V530 FORMULA_0227" RAT_FUNC "%.4g" "nSs" COEFFS 0 51.22410237 0 0 0 1 /end COMPU_METHOD
/begin COMPU_METHOD M_FORMULA_0231 "V530 FORMULA_0231" RAT_FUNC "%.4g" "???KW/Segm" COEFFS 0 10 0 0 0 1 /end COMPU_METHOD
/begin COMPU_METHOD M_FORMULA_0247 "V530 FORMULA_0247" RAT_FUNC "%.4g" "V" COEFFS 0 9830.4 0 0 0 1 /end COMPU_METHOD
/begin COMPU_METHOD M_FORMULA_0250 "V530 FORMULA_0250" RAT_FUNC "%.4g" "V" COEFFS 0 204.8 0 0 0 1 /end COMPU_METHOD
/begin COMPU_METHOD M_FORMULA_0251 "V530 FORMULA_0251" RAT_FUNC "%.4g" "V" COEFFS 0 409.6 0 0 0 1 /end COMPU_METHOD
/begin COMPU_METHOD M_FORMULA_0263 "V530 FORMULA_0263" RAT_FUNC "%.4g" ".Prog" COEFFS 0 1 0 0 0 1 /end COMPU_METHOD
/begin COMPU_METHOD M_FORMULA_0272 "V530 FORMULA_0272" RAT_FUNC "%.4g" "Nm" COEFFS 0 10 0 0 0 1 /end COMPU_METHOD
/begin COMPU_METHOD M_FORMULA_0276 "V530 FORMULA_0276" RAT_FUNC "%.4g" "Nms2" COEFFS 0 512 0 0 0 1 /end COMPU_METHOD
/begin COMPU_METHOD M_FORMULA_0306 "V530 FORMULA_0306" RAT_FUNC "%.4g" "s" COEFFS 0 100 0 0 0 1 /end COMPU_METHOD
/begin COMPU_METHOD M_FORMULA_0317 "V530 FORMULA_0317" RAT_FUNC "%.4g" "km/h" COEFFS 0 10 0 0 0 1 /end COMPU_METHOD
/begin COMPU_METHOD M_FORMULA_0343 "V530 FORMULA_0343" RAT_FUNC "%.4g" "???C" COEFFS 0 10240 2797056 0 0 1 /end COMPU_METHOD
/begin COMPU_METHOD M_FORMULA_0348 "V530 FORMULA_0348" RAT_FUNC "%.4g" "V" COEFFS 0 10 0 0 0 1 /end COMPU_METHOD
/begin COMPU_METHOD M_FORMULA_0349 "V530 FORMULA_0349" RAT_FUNC "%.4g" "A" COEFFS 0 10 0 0 0 1 /end COMPU_METHOD
/begin COMPU_METHOD M_FORMULA_0357 "V530 FORMULA_0357" RAT_FUNC "%.4g" "s" COEFFS 0 200 0 0 0 1 /end COMPU_METHOD
/begin COMPU_METHOD M_FORMULA_0408 "V530 FORMULA_0408" RAT_FUNC "%.4g" "-" COEFFS 0 1 -1 0 0 1 /end COMPU_METHOD
/begin COMPU_METHOD M_FORMULA_0423 "V530 FORMULA_0423" RAT_FUNC "%.4g" "mal" COEFFS 0 1 0 0 0 1 /end COMPU_METHOD
/begin COMPU_METHOD M_FORMULA_0437 "V530 FORMULA_0437" RAT_FUNC "%.4g" "%" COEFFS 0 327.68 0 0 0 1 /end COMPU_METHOD
/begin COMPU_METHOD M_FORMULA_0442 "V530 FORMULA_0442" RAT_FUNC "%.4g" "V" COEFFS 0 1241.21838 0 0 0 1 /end COMPU_METHOD
/begin COMPU_METHOD M_FORMULA_0445 "V530 FORMULA_0445" RAT_FUNC "%.4g" "ms" COEFFS 0 7000 0 0 0 1 /end COMPU_METHOD
/begin COMPU_METHOD M_FORMULA_0446 "V530 FORMULA_0446" RAT_FUNC "%.4g" "ms" COEFFS 0 250 0 0 0 1 /end COMPU_METHOD
/begin COMPU_METHOD M_FORMULA_0449 "V530 FORMULA_0449" RAT_FUNC "%.4g" "mal" COEFFS 0 1 0 0 0 1 /end COMPU_METHOD
/begin COMPU_METHOD M_FORMULA_0450 "V530 FORMULA_0450" RAT_FUNC "%.4g" "bytes" COEFFS 0 0.25 0 0 0 1 /end COMPU_METHOD
/begin COMPU_METHOD M_FORMULA_0451 "V530 FORMULA_0451" RAT_FUNC "%.4g" "VERS" COEFFS 0 1 0 0 0 1 /end COMPU_METHOD
/begin COMPU_METHOD M_FORMULA_0452 "V530 FORMULA_0452" RAT_FUNC "%.4g" "s" COEFFS 0 10 0 0 0 1 /end COMPU_METHOD
/begin COMPU_METHOD M_FORMULA_0453 "V530 FORMULA_0453" RAT_FUNC "%.4g" "zyklen" COEFFS 0 1 0 0 0 1 /end COMPU_METHOD
/begin COMPU_METHOD M_FORMULA_0475 "V530 FORMULA_0475" RAT_FUNC "%.4g" "Upm/s" COEFFS 0 0.005 0 0 0 1 /end COMPU_METHOD
/begin COMPU_METHOD M_FORMULA_0488 "V530 FORMULA_0488" RAT_FUNC "%.4g" "-" COEFFS 0 100 0 0 0 1 /end COMPU_METHOD
/begin COMPU_METHOD M_FORMULA_0492 "V530 FORMULA_0492" RAT_FUNC "%.4g" "s" COEFFS 0 10 0 0 0 1 /end COMPU_METHOD
/begin COMPU_METHOD M_FORMULA_0493 "V530 FORMULA_0493" RAT_FUNC "%.4g" "-" COEFFS 0 255 0 0 0 1 /end COMPU_METHOD
/begin COMPU_METHOD M_FORMULA_0562 "V530 FORMULA_0562" RAT_FUNC "%.4g" "Nm/s" COEFFS 0 0.05 0 0 0 1 /end COMPU_METHOD
/begin COMPU_METHOD M_FORMULA_0563 "V530 FORMULA_0563" RAT_FUNC "%.4g" "-" COEFFS 0 255 0 0 0 1 /end COMPU_METHOD
/begin COMPU_METHOD M_FORMULA_0581 "V530 FORMULA_0581" RAT_FUNC "%.4g" "sec" COEFFS 0 200 0 0 0 1 /end COMPU_METHOD
/begin COMPU_METHOD M_FORMULA_0585 "V530 FORMULA_0585" RAT_FUNC "%.4g" "%" COEFFS 0 1.28 128 0 0 1 /end COMPU_METHOD
/begin COMPU_METHOD M_FORMULA_0590 "V530 FORMULA_0590" RAT_FUNC "%.4g" "sec" COEFFS 0 200 0 0 0 1 /end COMPU_METHOD
/begin COMPU_METHOD M_FORMULA_0617 "V530 FORMULA_0617" RAT_FUNC "%.4g" "%/sec" COEFFS 0 0.05 0 0 0 1 /end COMPU_METHOD
/begin COMPU_METHOD M_FORMULA_0620 "V530 FORMULA_0620" RAT_FUNC "%.4g" "min" COEFFS 0 60 0 0 0 1 /end COMPU_METHOD
/begin COMPU_METHOD M_FORMULA_0623 "V530 FORMULA_0623" RAT_FUNC "%.4g" "s" COEFFS 0 200 0 0 0 1 /end COMPU_METHOD
/begin COMPU_METHOD M_FORMULA_0624 "V530 FORMULA_0624" RAT_FUNC "%.4g" "%" COEFFS 0 1.28 0 0 0 1 /end COMPU_METHOD
/begin COMPU_METHOD M_FORMULA_0625 "V530 FORMULA_0625" RAT_FUNC "%.4g" "%" COEFFS 0 10 0 0 0 1 /end COMPU_METHOD
/begin COMPU_METHOD M_FORMULA_0626 "V530 FORMULA_0626" RAT_FUNC "%.4g" "s" COEFFS 0 1 0 0 0 1 /end COMPU_METHOD
/begin COMPU_METHOD M_FORMULA_0630 "V530 FORMULA_0630" RAT_FUNC "%.4g" "%" COEFFS 0 640 0 0 0 1 /end COMPU_METHOD
/begin COMPU_METHOD M_FORMULA_0646 "V530 FORMULA_0646" RAT_FUNC "%.4g" "km/h" COEFFS 0 16384 0 0 0 1 /end COMPU_METHOD
/begin COMPU_METHOD M_FORMULA_0647 "V530 FORMULA_0647" RAT_FUNC "%.4g" "kmh/10mS" COEFFS 0 16384 0 0 0 1 /end COMPU_METHOD
/begin COMPU_METHOD M_FORMULA_0648 "V530 FORMULA_0648" RAT_FUNC "%.4g" "-" COEFFS 0 255 0 0 0 1 /end COMPU_METHOD
/begin COMPU_METHOD M_FORMULA_0649 "V530 FORMULA_0649" RAT_FUNC "%.4g" "-" COEFFS 0 128 0 0 0 1 /end COMPU_METHOD
/begin COMPU_METHOD M_FORMULA_0650 "V530 FORMULA_0650" RAT_FUNC "%.4g" "-" COEFFS 0 100 0 0 0 1 /end COMPU_METHOD
/begin COMPU_METHOD M_FORMULA_0651 "V530 FORMULA_0651" RAT_FUNC "%.4g" "n" COEFFS 0 1 0 0 0 1 /end COMPU_METHOD
/begin COMPU_METHOD M_FORMULA_0652 "V530 FORMULA_0652" RAT_FUNC "%.4g" "-" COEFFS 0 262144 0 0 0 1 /end COMPU_METHOD
/begin COMPU_METHOD M_FORMULA_0653 "V530 FORMULA_0653" RAT_FUNC "%.4g" "sec" COEFFS 0 100 0 0 0 1 /end COMPU_METHOD
/begin COMPU_METHOD M_FORMULA_0670 "V530 FORMULA_0670" RAT_FUNC "%.4g" "-" COEFFS 0 32767 0 0 0 1 /end COMPU_METHOD
/begin COMPU_METHOD M_FORMULA_0671 "V530 FORMULA_0671" RAT_FUNC "%.4g" "1/s" COEFFS 0 327.68 0 0 0 1 /end COMPU_METHOD
/begin COMPU_METHOD M_FORMULA_0672 "V530 FORMULA_0672" RAT_FUNC "%.4g" "1/s" COEFFS 0 32767 0 0 0 1 /end COMPU_METHOD
/begin COMPU_METHOD M_FORMULA_0691 "V530 FORMULA_0691" RAT_FUNC "%.4g" "ms" COEFFS 0 0.1 0 0 0 1 /end COMPU_METHOD
/begin COMPU_METHOD M_FORMULA_0693 "V530 FORMULA_0693" RAT_FUNC "%.4g" "m" COEFFS 0 1024 0 0 0 1 /end COMPU_METHOD
/begin COMPU_METHOD M_FORMULA_0741 "V530 FORMULA_0741" RAT_FUNC "%.4g" "rad/s" COEFFS 0 100 0 0 0 1 /end COMPU_METHOD
/begin COMPU_METHOD CM_0124 "X" RAT_FUNC "%.4g" "Kelvin" COEFFS 0 1 0 0 0 1 /end COMPU_METHOD
/begin COMPU_METHOD CM_0125 "X*0.296735905" RAT_FUNC "%.4g" "mm" COEFFS 0 1 0 0 0 0.296735905 /end COMPU_METHOD
/begin COMPU_METHOD CM_0126 "X*12.5" RAT_FUNC "%.4g" "%" COEFFS 0 1 0 0 0 12.5 /end COMPU_METHOD
/begin COMPU_METHOD CM_0127 "X*0.05" RAT_FUNC "%.4g" "s" COEFFS 0 1 0 0 0 0.05 /end COMPU_METHOD
/begin COMPU_METHOD CM_0128 "X*0.08" RAT_FUNC "%.4g" "A" COEFFS 0 1 0 0 0 0.08 /end COMPU_METHOD
/begin COMPU_METHOD CM_0129 "X*0.02" RAT_FUNC "%.4g" "A" COEFFS 0 1 0 0 0 0.02 /end COMPU_METHOD
/begin COMPU_METHOD CM_0130 "X*0.00625" RAT_FUNC "%.4g" "s" COEFFS 0 1 0 0 0 0.00625 /end COMPU_METHOD
/begin COMPU_METHOD CM_0131 "X*0.0196" RAT_FUNC "%.4g" "V" COEFFS 0 1 0 0 0 0.0196 /end COMPU_METHOD
/begin COMPU_METHOD CM_0132 "X*0.064+6.0" RAT_FUNC "%.4g" "V" COEFFS 0 1 -6 0 0 0.064 /end COMPU_METHOD
/begin COMPU_METHOD CM_0133 "X*5.12" RAT_FUNC "%.4g" "-" COEFFS 0 1 0 0 0 5.12 /end COMPU_METHOD
/begin COMPU_METHOD CM_0134 "X*0.04" RAT_FUNC "%.4g" "A" COEFFS 0 1 0 0 0 0.04 /end COMPU_METHOD
/begin COMPU_METHOD CM_0135 "X*256.0" RAT_FUNC "%.4g" "s" COEFFS 0 1 0 0 0 256 /end COMPU_METHOD
/begin COMPU_METHOD CM_0136 "X*0.0125" RAT_FUNC "%.4g" "s" COEFFS 0 1 0 0 0 0.0125 /end COMPU_METHOD
/begin COMPU_METHOD CM_0137 "X*0.002+0.01" RAT_FUNC "%.4g" "s" COEFFS 0 1 -0.01 0 0 0.002 /end COMPU_METHOD
/begin COMPU_METHOD CM_0138 "X*16.0" RAT_FUNC "%.4g" "s" COEFFS 0 1 0 0 0 16 /end COMPU_METHOD
/begin COMPU_METHOD CM_0139 "X*0.03125" RAT_FUNC "%.4g" "mg/ASP" COEFFS 0 1 0 0 0 0.03125 /end COMPU_METHOD
/begin COMPU_METHOD CM_0140 "X*0.015625" RAT_FUNC "%.4g" "mg" COEFFS 0 1 0 0 0 0.015625 /end COMPU_METHOD
/begin COMPU_METHOD CM_0141 "X*0.001" RAT_FUNC "%.4g" "ms" COEFFS 0 1 0 0 0 0.001 /end COMPU_METHOD
/begin COMPU_METHOD CM_0142 "X*0.001" RAT_FUNC "%.4g" "bar" COEFFS 0 1 0 0 0 0.001 /end COMPU_METHOD
/begin COMPU_METHOD CM_0143 "X*0.1" RAT_FUNC "%.4g" "m/s" COEFFS 0 1 0 0 0 0.1 /end COMPU_METHOD
/begin COMPU_METHOD CM_0144 "X*0.025" RAT_FUNC "%.4g" "m2/s2" COEFFS 0 1 0 0 0 0.025 /end COMPU_METHOD
/begin COMPU_METHOD CM_0145 "X*0.0009765625" RAT_FUNC "%.4g" "mg/ms" COEFFS 0 1 0 0 0 0.0009765625 /end COMPU_METHOD
/begin COMPU_METHOD CM_0146 "X*0.1" RAT_FUNC "%.4g" "mm2" COEFFS 0 1 0 0 0 0.1 /end COMPU_METHOD
/begin COMPU_METHOD CM_0147 "X*0.01" RAT_FUNC "%.4g" "kg/dm3" COEFFS 0 1 0 0 0 0.01 /end COMPU_METHOD
/begin COMPU_METHOD CM_0148 "X*0.0000610352" RAT_FUNC "%.4g" "m" COEFFS 0 1 0 0 0 6.10352e-05 /end COMPU_METHOD
/begin COMPU_METHOD CM_0149 "X*0.1" RAT_FUNC "%.4g" "mm" COEFFS 0 1 0 0 0 0.1 /end COMPU_METHOD
/begin COMPU_METHOD CM_0150 "X" RAT_FUNC "%.4g" "%" COEFFS 0 1 0 0 0 1 /end COMPU_METHOD
/begin COMPU_METHOD CM_0151 "X" RAT_FUNC "%.4g" "?C" COEFFS 0 1 0 0 0 1 /end COMPU_METHOD
/begin COMPU_METHOD CM_0152 "X*100.0" RAT_FUNC "%.4g" "ms" COEFFS 0 1 0 0 0 100 /end COMPU_METHOD
/begin COMPU_METHOD CM_0153 "X*3.125" RAT_FUNC "%.4g" "bar/s" COEFFS 0 1 0 0 0 3.125 /end COMPU_METHOD
/begin COMPU_METHOD CM_0154 "X*0.0625" RAT_FUNC "%.4g" "mbar/s" COEFFS 0 1 0 0 0 0.0625 /end COMPU_METHOD
/begin COMPU_METHOD CM_0155 "X*0.0000305176" RAT_FUNC "%.4g" "%" COEFFS 0 1 0 0 0 3.05176e-05 /end COMPU_METHOD
/begin COMPU_METHOD CM_0156 "X*0.01" RAT_FUNC "%.4g" "?C" COEFFS 0 1 0 0 0 0.01 /end COMPU_METHOD
/begin COMPU_METHOD CM_0157 "X*10.0" RAT_FUNC "%.4g" "km" COEFFS 0 1 0 0 0 10 /end COMPU_METHOD
/begin COMPU_METHOD CM_0158 "X*0.390625" RAT_FUNC "%.4g" "%" COEFFS 0 1 0 0 0 0.390625 /end COMPU_METHOD
/begin COMPU_METHOD CM_0159 "X*0.1" RAT_FUNC "%.4g" "?C" COEFFS 0 1 0 0 0 0.1 /end COMPU_METHOD
/begin COMPU_METHOD CM_0160 "X*0.0156250000" RAT_FUNC "%.4g" "-" COEFFS 0 1 0 0 0 0.015625 /end COMPU_METHOD
/begin COMPU_METHOD CM_0161 "X*0.125" RAT_FUNC "%.4g" "l/h" COEFFS 0 1 0 0 0 0.125 /end COMPU_METHOD
/begin COMPU_METHOD CM_0162 "X*0.0125" RAT_FUNC "%.4g" "10exp-3 -/mV" COEFFS 0 1 0 0 0 0.0125 /end COMPU_METHOD
/begin COMPU_METHOD CM_0163 "X*4.8828125" RAT_FUNC "%.4g" "mV" COEFFS 0 1 0 0 0 4.8828125 /end COMPU_METHOD
/begin COMPU_METHOD CM_0165 "X*0.001953125" RAT_FUNC "%.4g" "-" COEFFS 0 1 0 0 0 0.001953125 /end COMPU_METHOD
/begin COMPU_METHOD CM_0166 "X*0.032" RAT_FUNC "%.4g" "ms" COEFFS 0 1 0 0 0 0.032 /end COMPU_METHOD
/begin COMPU_METHOD CM_0167 "X*0.0003051758" RAT_FUNC "%.4g" "mA" COEFFS 0 1 0 0 0 0.0003051758 /end COMPU_METHOD
/begin COMPU_METHOD CM_0168 "X" RAT_FUNC "%.4g" "mg" COEFFS 0 1 0 0 0 1 /end COMPU_METHOD
/begin COMPU_METHOD CM_0169 "X" RAT_FUNC "%.4g" "ms" COEFFS 0 1 0 0 0 1 /end COMPU_METHOD
/begin COMPU_METHOD CM_0170 "X*0.015625" RAT_FUNC "%.4g" "mg/ASP" COEFFS 0 1 0 0 0 0.015625 /end COMPU_METHOD
/begin COMPU_METHOD CM_0171 "X*5.15+5.15" RAT_FUNC "%.4g" "uA" COEFFS 0 1 -5.15 0 0 5.15 /end COMPU_METHOD
/begin COMPU_METHOD CM_0172 "X*0.1+0.8" RAT_FUNC "%.4g" "ms" COEFFS 0 1 -0.8 0 0 0.1 /end COMPU_METHOD
/begin COMPU_METHOD CM_0173 "X*0.122+1.9531" RAT_FUNC "%.4g" "kHz" COEFFS 0 1 -1.9531 0 0 0.122 /end COMPU_METHOD
/begin COMPU_METHOD CM_0174 "X*0.1" RAT_FUNC "%.4g" "Ohm" COEFFS 0 1 0 0 0 0.1 /end COMPU_METHOD
/begin COMPU_METHOD CM_0175 "X*0.0122070312" RAT_FUNC "%.4g" "%" COEFFS 0 1 0 0 0 0.0122070312 /end COMPU_METHOD
/begin COMPU_METHOD CM_0177 "X" RAT_FUNC "%.4g" "sec" COEFFS 0 1 0 0 0 1 /end COMPU_METHOD
/begin COMPU_METHOD CM_0178 "X*100.0" RAT_FUNC "%.4g" "-" COEFFS 0 1 0 0 0 100 /end COMPU_METHOD
/begin COMPU_METHOD CM_0179 "X*0.0009765625" RAT_FUNC "%.4g" "(kg/h)/mbar" COEFFS 0 1 0 0 0 0.0009765625 /end COMPU_METHOD
/begin COMPU_METHOD CM_0180 "X*50.0" RAT_FUNC "%.4g" "bar/s" COEFFS 0 1 0 0 0 50 /end COMPU_METHOD
/begin COMPU_METHOD CM_0181 "X*0.001953125" RAT_FUNC "%.4g" "kg/h" COEFFS 0 1 0 0 0 0.001953125 /end COMPU_METHOD
/begin COMPU_METHOD CM_0182 "X*0.0625" RAT_FUNC "%.4g" "1/2^20" COEFFS 0 1 0 0 0 0.0625 /end COMPU_METHOD
/begin COMPU_METHOD CM_0183 "X*0.0125" RAT_FUNC "%.4g" "kg/h" COEFFS 0 1 0 0 0 0.0125 /end COMPU_METHOD
/begin COMPU_METHOD CM_0184 "X*0.0125" RAT_FUNC "%.4g" "mbar/V" COEFFS 0 1 0 0 0 0.0125 /end COMPU_METHOD
/begin COMPU_METHOD CM_0185 "X*0.1" RAT_FUNC "%.4g" "ccm" COEFFS 0 1 0 0 0 0.1 /end COMPU_METHOD
/begin COMPU_METHOD CM_0186 "X*0.125" RAT_FUNC "%.4g" "A" COEFFS 0 1 0 0 0 0.125 /end COMPU_METHOD
/begin COMPU_METHOD CM_0187 "X*0.146484375" RAT_FUNC "%.4g" "mm" COEFFS 0 1 0 0 0 0.146484375 /end COMPU_METHOD
/begin COMPU_METHOD CM_0188 "X*0.1000000000" RAT_FUNC "%.4g" "Liter" COEFFS 0 1 0 0 0 0.1 /end COMPU_METHOD
/begin COMPU_METHOD CM_0189 "X*0.0001525879" RAT_FUNC "%.4g" "%" COEFFS 0 1 0 0 0 0.0001525879 /end COMPU_METHOD
/begin COMPU_METHOD CM_0190 "X*0.0000915527" RAT_FUNC "%.4g" "-" COEFFS 0 1 0 0 0 9.15527e-05 /end COMPU_METHOD
/begin COMPU_METHOD CM_0191 "X*0.0942" RAT_FUNC "%.4g" "V" COEFFS 0 1 0 0 0 0.0942 /end COMPU_METHOD
/begin COMPU_METHOD CM_0192 "X*0.5" RAT_FUNC "%.4g" "l" COEFFS 0 1 0 0 0 0.5 /end COMPU_METHOD
/begin COMPU_METHOD CM_0193 "X*0.0002" RAT_FUNC "%.4g" "bar/V" COEFFS 0 1 0 0 0 0.0002 /end COMPU_METHOD
/begin COMPU_METHOD CM_0194 "X*0.0182002022" RAT_FUNC "%.4g" "Ah" COEFFS 0 1 0 0 0 0.0182002022 /end COMPU_METHOD
/begin COMPU_METHOD CM_0195 "X*0.00025+6.0" RAT_FUNC "%.4g" "-" COEFFS 0 1 -6 0 0 0.00025 /end COMPU_METHOD
/begin COMPU_METHOD CM_0196 "X*0.25" RAT_FUNC "%.4g" "-" COEFFS 0 1 0 0 0 0.25 /end COMPU_METHOD
/begin COMPU_METHOD CM_0197 "X*0.0078125" RAT_FUNC "%.4g" "%" COEFFS 0 1 0 0 0 0.0078125 /end COMPU_METHOD
/begin COMPU_METHOD CM_0198 "X*0.0030517578" RAT_FUNC "%.4g" "-" COEFFS 0 1 0 0 0 0.0030517578 /end COMPU_METHOD
/begin COMPU_METHOD CM_0199 "X*0.0015258789" RAT_FUNC "%.4g" "%" COEFFS 0 1 0 0 0 0.0015258789 /end COMPU_METHOD
/begin COMPU_METHOD CM_0200 "X*3.9062500000" RAT_FUNC "%.4g" "A" COEFFS 0 1 0 0 0 3.90625 /end COMPU_METHOD
/begin COMPU_METHOD CM_0201 "X*0.5" RAT_FUNC "%.4g" "%" COEFFS 0 1 0 0 0 0.5 /end COMPU_METHOD
/begin COMPU_METHOD CM_0202 "X*14.0" RAT_FUNC "%.4g" "s" COEFFS 0 1 0 0 0 14 /end COMPU_METHOD
/begin COMPU_METHOD CM_0203 "X*56.0" RAT_FUNC "%.4g" "s" COEFFS 0 1 0 0 0 56 /end COMPU_METHOD
/begin COMPU_METHOD CM_0204 "X*0.0015258789" RAT_FUNC "%.4g" "-" COEFFS 0 1 0 0 0 0.0015258789 /end COMPU_METHOD
/begin COMPU_METHOD CM_0205 "X*0.125" RAT_FUNC "%.4g" "-" COEFFS 0 1 0 0 0 0.125 /end COMPU_METHOD
/begin COMPU_METHOD CM_0206 "X*0.001" RAT_FUNC "%.4g" "qcm" COEFFS 0 1 0 0 0 0.001 /end COMPU_METHOD
/begin COMPU_METHOD CM_0207 "X" RAT_FUNC "%.4g" "kHz" COEFFS 0 1 0 0 0 1 /end COMPU_METHOD
/begin COMPU_METHOD CM_0208 "X" RAT_FUNC "%.4g" "y-Koordinate" COEFFS 0 1 0 0 0 1 /end COMPU_METHOD
/begin COMPU_METHOD CM_0209 "X*0.0625" RAT_FUNC "%.4g" "-" COEFFS 0 1 0 0 0 0.0625 /end COMPU_METHOD
/begin COMPU_METHOD CM_0210 "X*0.0015625" RAT_FUNC "%.4g" "V" COEFFS 0 1 0 0 0 0.0015625 /end COMPU_METHOD
/begin COMPU_METHOD CM_0211 "X*0.00225" RAT_FUNC "%.4g" "mA" COEFFS 0 1 0 0 0 0.00225 /end COMPU_METHOD
/begin COMPU_METHOD CM_0212 "X*0.1706666" RAT_FUNC "%.4g" "min" COEFFS 0 1 0 0 0 0.1706666 /end COMPU_METHOD
/begin COMPU_METHOD CM_0213 "X*0.5" RAT_FUNC "%.4g" "ms" COEFFS 0 1 0 0 0 0.5 /end COMPU_METHOD
/begin COMPU_METHOD CM_0214 "X*0.01" RAT_FUNC "%.4g" "ms" COEFFS 0 1 0 0 0 0.01 /end COMPU_METHOD
/begin COMPU_METHOD CM_0215 "X*0.1" RAT_FUNC "%.4g" "Hz" COEFFS 0 1 0 0 0 0.1 /end COMPU_METHOD
/begin COMPU_METHOD CM_0216 "X*0.009765625" RAT_FUNC "%.4g" "1/s" COEFFS 0 1 0 0 0 0.009765625 /end COMPU_METHOD
/begin COMPU_METHOD CM_0217 "X*3.0" RAT_FUNC "%.4g" "kg/(m2*s)" COEFFS 0 1 0 0 0 3 /end COMPU_METHOD
/begin COMPU_METHOD CM_0218 "X*9.0" RAT_FUNC "%.4g" "(kg/(m2*s))2" COEFFS 0 1 0 0 0 9 /end COMPU_METHOD
/begin COMPU_METHOD CM_0219 "X*0.09765625" RAT_FUNC "%.4g" "%/100ms" COEFFS 0 1 0 0 0 0.09765625 /end COMPU_METHOD
/end MODULE
/end PROJECT
