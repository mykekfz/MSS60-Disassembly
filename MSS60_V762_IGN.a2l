ASAP2_VERSION 1 60
/begin PROJECT MSS60_V762_IGN "MSS60 (S65) V762 IGN CPU - production calibration 7848136 (V762.01-B500.02)"
/begin HEADER "Calibration description. Measurements: V530 RAM names transferred to V762 addresses (confidence in each long identifier). Status tag in every long identifier: verified (checked against the code) / A2L-ref (placed from the V530 A2L) / EST (estimated) / unassigned (unidentified)." VERSION "V762-RE-04112026" /end HEADER
/begin MODULE IGN "MSS60 V762 IGN"
/begin MOD_COMMON "" BYTE_ORDER MSB_FIRST ALIGNMENT_BYTE 1 ALIGNMENT_WORD 2 ALIGNMENT_LONG 4 /end MOD_COMMON
/begin CHARACTERISTIC K_ED_THERMOSTAT.DEC_VOR_EINTRAG "Fault code THERMOSTAT - debounce filter decrement before fault-memory entry [verified]" VALUE 0x714DF RL_VAL_UB 0 CM_0000 0 255 /end CHARACTERISTIC
/begin CHARACTERISTIC K_ED_THERMOSTAT.FEHLERSCHWELLE "Fault code THERMOSTAT - debounce filter threshold for setting the fault [verified]" VALUE 0x714DC RL_VAL_UB 0 CM_0000 0 255 /end CHARACTERISTIC
/begin CHARACTERISTIC K_ED_THERMOSTAT.INC_NACH_EINTRAG "Fault code THERMOSTAT - debounce filter increment after fault-memory entry [verified]" VALUE 0x714E0 RL_VAL_UB 0 CM_0000 0 255 /end CHARACTERISTIC
/begin CHARACTERISTIC K_ED_THERMOSTAT.INC_VOR_EINTRAG "Fault code THERMOSTAT - debounce filter increment before fault-memory entry [verified]" VALUE 0x714DE RL_VAL_UB 0 CM_0000 0 255 /end CHARACTERISTIC
/begin CHARACTERISTIC K_ED_THERMOSTAT.KLASSENINDEX "Fault code THERMOSTAT - fault class selection (lamp / warning behaviour) [verified]" VALUE 0x714E2 RL_VAL_UB 0 CM_0000 0 255 /end CHARACTERISTIC
/begin CHARACTERISTIC K_ED_THERMOSTAT.OK_SCHWELLE "Fault code THERMOSTAT - debounce filter threshold for clearing (healing) the fault [verified]" VALUE 0x714DD RL_VAL_UB 0 CM_0000 0 255 /end CHARACTERISTIC
/begin CHARACTERISTIC K_ED_THERMOSTAT.P_CODE_OPENLOAD "Fault code THERMOSTAT - OBD P-code reported for open circuit [verified]" VALUE 0x714D8 RL_VAL_UW 0 CM_0000 0 65535 /end CHARACTERISTIC
/begin CHARACTERISTIC K_ED_THERMOSTAT.P_CODE_SH_TO_GND "Fault code THERMOSTAT - OBD P-code reported for short to ground [verified]" VALUE 0x714D6 RL_VAL_UW 0 CM_0000 0 65535 /end CHARACTERISTIC
/begin CHARACTERISTIC K_ED_THERMOSTAT.P_CODE_SH_TO_UB "Fault code THERMOSTAT - OBD P-code reported for short to battery voltage [verified]" VALUE 0x714D4 RL_VAL_UW 0 CM_0000 0 65535 /end CHARACTERISTIC
/begin CHARACTERISTIC K_ED_THERMOSTAT.P_CODE_UNPLAUSIBEL "Fault code THERMOSTAT - OBD P-code reported for implausible signal [verified]" VALUE 0x714DA RL_VAL_UW 0 CM_0000 0 65535 /end CHARACTERISTIC
/begin CHARACTERISTIC K_ED_TIME_REL_OBD.DEC_NACH_EINTRAG "Fault code TIME_REL_OBD - debounce filter decrement after fault-memory entry [verified]" VALUE 0x70B89 RL_VAL_UB 0 CM_0000 0 255 /end CHARACTERISTIC
/begin CHARACTERISTIC K_ED_TIME_REL_OBD.DEC_VOR_EINTRAG "Fault code TIME_REL_OBD - debounce filter decrement before fault-memory entry [verified]" VALUE 0x70B87 RL_VAL_UB 0 CM_0000 0 255 /end CHARACTERISTIC
/begin CHARACTERISTIC K_ED_TIME_REL_OBD.FEHLERSCHWELLE "Fault code TIME_REL_OBD - debounce filter threshold for setting the fault [verified]" VALUE 0x70B84 RL_VAL_UB 0 CM_0000 0 255 /end CHARACTERISTIC
/begin CHARACTERISTIC K_ED_TIME_REL_OBD.INC_NACH_EINTRAG "Fault code TIME_REL_OBD - debounce filter increment after fault-memory entry [verified]" VALUE 0x70B88 RL_VAL_UB 0 CM_0000 0 255 /end CHARACTERISTIC
/begin CHARACTERISTIC K_ED_TIME_REL_OBD.INC_VOR_EINTRAG "Fault code TIME_REL_OBD - debounce filter increment before fault-memory entry [verified]" VALUE 0x70B86 RL_VAL_UB 0 CM_0000 0 255 /end CHARACTERISTIC
/begin CHARACTERISTIC K_ED_TIME_REL_OBD.KLASSENINDEX "Fault code TIME_REL_OBD - fault class selection (lamp / warning behaviour) [verified]" VALUE 0x70B8A RL_VAL_UB 0 CM_0000 0 255 /end CHARACTERISTIC
/begin CHARACTERISTIC K_ED_TIME_REL_OBD.OK_SCHWELLE "Fault code TIME_REL_OBD - debounce filter threshold for clearing (healing) the fault [verified]" VALUE 0x70B85 RL_VAL_UB 0 CM_0000 0 255 /end CHARACTERISTIC
/begin CHARACTERISTIC K_ED_TIME_REL_OBD.P_CODE_OPENLOAD "Fault code TIME_REL_OBD - OBD P-code reported for open circuit [verified]" VALUE 0x70B80 RL_VAL_UW 0 CM_0000 0 65535 /end CHARACTERISTIC
/begin CHARACTERISTIC K_ED_TIME_REL_OBD.P_CODE_SH_TO_GND "Fault code TIME_REL_OBD - OBD P-code reported for short to ground [verified]" VALUE 0x70B7E RL_VAL_UW 0 CM_0000 0 65535 /end CHARACTERISTIC
/begin CHARACTERISTIC K_ED_TIME_REL_OBD.P_CODE_SH_TO_UB "Fault code TIME_REL_OBD - OBD P-code reported for short to battery voltage [verified]" VALUE 0x70B7C RL_VAL_UW 0 CM_0000 0 65535 /end CHARACTERISTIC
/begin CHARACTERISTIC K_ED_TIME_REL_OBD.P_CODE_UNPLAUSIBEL "Fault code TIME_REL_OBD - OBD P-code reported for implausible signal [verified]" VALUE 0x70B82 RL_VAL_UW 0 CM_0000 0 65535 /end CHARACTERISTIC
/begin CHARACTERISTIC K_ED_TKA.DEC_NACH_EINTRAG "Fault code TKA - debounce filter decrement after fault-memory entry [verified]" VALUE 0x70BBD RL_VAL_UB 0 CM_0000 0 255 /end CHARACTERISTIC
/begin CHARACTERISTIC K_ED_TKA.DEC_VOR_EINTRAG "Fault code TKA - debounce filter decrement before fault-memory entry [verified]" VALUE 0x70BBB RL_VAL_UB 0 CM_0000 0 255 /end CHARACTERISTIC
/begin CHARACTERISTIC K_ED_TKA.FEHLERSCHWELLE "Fault code TKA - debounce filter threshold for setting the fault [verified]" VALUE 0x70BB8 RL_VAL_UB 0 CM_0000 0 255 /end CHARACTERISTIC
/begin CHARACTERISTIC K_ED_TKA.INC_NACH_EINTRAG "Fault code TKA - debounce filter increment after fault-memory entry [verified]" VALUE 0x70BBC RL_VAL_UB 0 CM_0000 0 255 /end CHARACTERISTIC
/begin CHARACTERISTIC K_ED_TKA.INC_VOR_EINTRAG "Fault code TKA - debounce filter increment before fault-memory entry [verified]" VALUE 0x70BBA RL_VAL_UB 0 CM_0000 0 255 /end CHARACTERISTIC
/begin CHARACTERISTIC K_ED_TKA.KLASSENINDEX "Fault code TKA - fault class selection (lamp / warning behaviour) [verified]" VALUE 0x70BBE RL_VAL_UB 0 CM_0000 0 255 /end CHARACTERISTIC
/begin CHARACTERISTIC K_ED_TKA.OK_SCHWELLE "Fault code TKA - debounce filter threshold for clearing (healing) the fault [verified]" VALUE 0x70BB9 RL_VAL_UB 0 CM_0000 0 255 /end CHARACTERISTIC
/begin CHARACTERISTIC K_ED_TKA.P_CODE_OPENLOAD "Fault code TKA - OBD P-code reported for open circuit [verified]" VALUE 0x70BB4 RL_VAL_UW 0 CM_0000 0 65535 /end CHARACTERISTIC
/begin CHARACTERISTIC K_ED_TKA.P_CODE_SH_TO_GND "Fault code TKA - OBD P-code reported for short to ground [verified]" VALUE 0x70BB2 RL_VAL_UW 0 CM_0000 0 65535 /end CHARACTERISTIC
/begin CHARACTERISTIC K_ED_TKA.P_CODE_SH_TO_UB "Fault code TKA - OBD P-code reported for short to battery voltage [verified]" VALUE 0x70BB0 RL_VAL_UW 0 CM_0000 0 65535 /end CHARACTERISTIC
/begin CHARACTERISTIC K_ED_TKA.P_CODE_UNPLAUSIBEL "Fault code TKA - OBD P-code reported for implausible signal [verified]" VALUE 0x70BB6 RL_VAL_UW 0 CM_0000 0 65535 /end CHARACTERISTIC
/begin CHARACTERISTIC K_ED_TKA_OBD.DEC_NACH_EINTRAG "Fault code TKA_OBD - debounce filter decrement after fault-memory entry [verified]" VALUE 0x70C3F RL_VAL_UB 0 CM_0000 0 255 /end CHARACTERISTIC
/begin CHARACTERISTIC K_ED_TKA_OBD.DEC_VOR_EINTRAG "Fault code TKA_OBD - debounce filter decrement before fault-memory entry [verified]" VALUE 0x70C3D RL_VAL_UB 0 CM_0000 0 255 /end CHARACTERISTIC
/begin CHARACTERISTIC K_ED_TKA_OBD.FEHLERSCHWELLE "Fault code TKA_OBD - debounce filter threshold for setting the fault [verified]" VALUE 0x70C3A RL_VAL_UB 0 CM_0000 0 255 /end CHARACTERISTIC
/begin CHARACTERISTIC K_ED_TKA_OBD.INC_NACH_EINTRAG "Fault code TKA_OBD - debounce filter increment after fault-memory entry [verified]" VALUE 0x70C3E RL_VAL_UB 0 CM_0000 0 255 /end CHARACTERISTIC
/begin CHARACTERISTIC K_ED_TKA_OBD.INC_VOR_EINTRAG "Fault code TKA_OBD - debounce filter increment before fault-memory entry [verified]" VALUE 0x70C3C RL_VAL_UB 0 CM_0000 0 255 /end CHARACTERISTIC
/begin CHARACTERISTIC K_ED_TKA_OBD.KLASSENINDEX "Fault code TKA_OBD - fault class selection (lamp / warning behaviour) [verified]" VALUE 0x70C40 RL_VAL_UB 0 CM_0000 0 255 /end CHARACTERISTIC
/begin CHARACTERISTIC K_ED_TKA_OBD.OK_SCHWELLE "Fault code TKA_OBD - debounce filter threshold for clearing (healing) the fault [verified]" VALUE 0x70C3B RL_VAL_UB 0 CM_0000 0 255 /end CHARACTERISTIC
/begin CHARACTERISTIC K_ED_TKA_OBD.P_CODE_OPENLOAD "Fault code TKA_OBD - OBD P-code reported for open circuit [verified]" VALUE 0x70C36 RL_VAL_UW 0 CM_0000 0 65535 /end CHARACTERISTIC
/begin CHARACTERISTIC K_ED_TKA_OBD.P_CODE_SH_TO_GND "Fault code TKA_OBD - OBD P-code reported for short to ground [verified]" VALUE 0x70C34 RL_VAL_UW 0 CM_0000 0 65535 /end CHARACTERISTIC
/begin CHARACTERISTIC K_ED_TKA_OBD.P_CODE_SH_TO_UB "Fault code TKA_OBD - OBD P-code reported for short to battery voltage [verified]" VALUE 0x70C32 RL_VAL_UW 0 CM_0000 0 65535 /end CHARACTERISTIC
/begin CHARACTERISTIC K_ED_TKA_OBD.P_CODE_UNPLAUSIBEL "Fault code TKA_OBD - OBD P-code reported for implausible signal [verified]" VALUE 0x70C38 RL_VAL_UW 0 CM_0000 0 65535 /end CHARACTERISTIC
/begin CHARACTERISTIC K_ED_TMOT.DEC_NACH_EINTRAG "Fault code TMOT - debounce filter decrement after fault-memory entry [verified]" VALUE 0x70B21 RL_VAL_UB 0 CM_0000 0 255 /end CHARACTERISTIC
/begin CHARACTERISTIC K_ED_TMOT.DEC_VOR_EINTRAG "Fault code TMOT - debounce filter decrement before fault-memory entry [verified]" VALUE 0x70B1F RL_VAL_UB 0 CM_0000 0 255 /end CHARACTERISTIC
/begin CHARACTERISTIC K_ED_TMOT.FEHLERSCHWELLE "Fault code TMOT - debounce filter threshold for setting the fault [verified]" VALUE 0x70B1C RL_VAL_UB 0 CM_0000 0 255 /end CHARACTERISTIC
/begin CHARACTERISTIC K_ED_TMOT.INC_NACH_EINTRAG "Fault code TMOT - debounce filter increment after fault-memory entry [verified]" VALUE 0x70B20 RL_VAL_UB 0 CM_0000 0 255 /end CHARACTERISTIC
/begin CHARACTERISTIC K_ED_TMOT.INC_VOR_EINTRAG "Fault code TMOT - debounce filter increment before fault-memory entry [verified]" VALUE 0x70B1E RL_VAL_UB 0 CM_0000 0 255 /end CHARACTERISTIC
/begin CHARACTERISTIC K_ED_TMOT.KLASSENINDEX "Fault code TMOT - fault class selection (lamp / warning behaviour) [verified]" VALUE 0x70B22 RL_VAL_UB 0 CM_0000 0 255 /end CHARACTERISTIC
/begin CHARACTERISTIC K_ED_TMOT.OK_SCHWELLE "Fault code TMOT - debounce filter threshold for clearing (healing) the fault [verified]" VALUE 0x70B1D RL_VAL_UB 0 CM_0000 0 255 /end CHARACTERISTIC
/begin CHARACTERISTIC K_ED_TMOT.P_CODE_OPENLOAD "Fault code TMOT - OBD P-code reported for open circuit [verified]" VALUE 0x70B18 RL_VAL_UW 0 CM_0000 0 65535 /end CHARACTERISTIC
/begin CHARACTERISTIC K_ED_TMOT.P_CODE_SH_TO_GND "Fault code TMOT - OBD P-code reported for short to ground [verified]" VALUE 0x70B16 RL_VAL_UW 0 CM_0000 0 65535 /end CHARACTERISTIC
/begin CHARACTERISTIC K_ED_TMOT.P_CODE_SH_TO_UB "Fault code TMOT - OBD P-code reported for short to battery voltage [verified]" VALUE 0x70B14 RL_VAL_UW 0 CM_0000 0 65535 /end CHARACTERISTIC
/begin CHARACTERISTIC K_ED_TMOT.P_CODE_UNPLAUSIBEL "Fault code TMOT - OBD P-code reported for implausible signal [verified]" VALUE 0x70B1A RL_VAL_UW 0 CM_0000 0 65535 /end CHARACTERISTIC
/begin CHARACTERISTIC K_ED_TMOT_OBD.DEC_NACH_EINTRAG "Fault code TMOT_OBD - debounce filter decrement after fault-memory entry [verified]" VALUE 0x70B3B RL_VAL_UB 0 CM_0000 0 255 /end CHARACTERISTIC
/begin CHARACTERISTIC K_ED_TMOT_OBD.DEC_VOR_EINTRAG "Fault code TMOT_OBD - debounce filter decrement before fault-memory entry [verified]" VALUE 0x70B39 RL_VAL_UB 0 CM_0000 0 255 /end CHARACTERISTIC
/begin CHARACTERISTIC K_ED_TMOT_OBD.FEHLERSCHWELLE "Fault code TMOT_OBD - debounce filter threshold for setting the fault [verified]" VALUE 0x70B36 RL_VAL_UB 0 CM_0000 0 255 /end CHARACTERISTIC
/begin CHARACTERISTIC K_ED_TMOT_OBD.INC_NACH_EINTRAG "Fault code TMOT_OBD - debounce filter increment after fault-memory entry [verified]" VALUE 0x70B3A RL_VAL_UB 0 CM_0000 0 255 /end CHARACTERISTIC
/begin CHARACTERISTIC K_ED_TMOT_OBD.INC_VOR_EINTRAG "Fault code TMOT_OBD - debounce filter increment before fault-memory entry [verified]" VALUE 0x70B38 RL_VAL_UB 0 CM_0000 0 255 /end CHARACTERISTIC
/begin CHARACTERISTIC K_ED_TMOT_OBD.KLASSENINDEX "Fault code TMOT_OBD - fault class selection (lamp / warning behaviour) [verified]" VALUE 0x70B3C RL_VAL_UB 0 CM_0000 0 255 /end CHARACTERISTIC
/begin CHARACTERISTIC K_ED_TMOT_OBD.OK_SCHWELLE "Fault code TMOT_OBD - debounce filter threshold for clearing (healing) the fault [verified]" VALUE 0x70B37 RL_VAL_UB 0 CM_0000 0 255 /end CHARACTERISTIC
/begin CHARACTERISTIC K_ED_TMOT_OBD.P_CODE_OPENLOAD "Fault code TMOT_OBD - OBD P-code reported for open circuit [verified]" VALUE 0x70B32 RL_VAL_UW 0 CM_0000 0 65535 /end CHARACTERISTIC
/begin CHARACTERISTIC K_ED_TMOT_OBD.P_CODE_SH_TO_GND "Fault code TMOT_OBD - OBD P-code reported for short to ground [verified]" VALUE 0x70B30 RL_VAL_UW 0 CM_0000 0 65535 /end CHARACTERISTIC
/begin CHARACTERISTIC K_ED_TMOT_OBD.P_CODE_SH_TO_UB "Fault code TMOT_OBD - OBD P-code reported for short to battery voltage [verified]" VALUE 0x70B2E RL_VAL_UW 0 CM_0000 0 65535 /end CHARACTERISTIC
/begin CHARACTERISTIC K_ED_TMOT_OBD.P_CODE_UNPLAUSIBEL "Fault code TMOT_OBD - OBD P-code reported for implausible signal [verified]" VALUE 0x70B34 RL_VAL_UW 0 CM_0000 0 65535 /end CHARACTERISTIC
/begin CHARACTERISTIC K_ED_TMOT_OBD_HIGH.DEC_NACH_EINTRAG "Fault code TMOT_OBD_HIGH - debounce filter decrement after fault-memory entry [verified]" VALUE 0x71633 RL_VAL_UB 0 CM_0000 0 255 /end CHARACTERISTIC
/begin CHARACTERISTIC K_ED_TMOT_OBD_HIGH.DEC_VOR_EINTRAG "Fault code TMOT_OBD_HIGH - debounce filter decrement before fault-memory entry [verified]" VALUE 0x71631 RL_VAL_UB 0 CM_0000 0 255 /end CHARACTERISTIC
/begin CHARACTERISTIC K_ED_TMOT_OBD_HIGH.FEHLERSCHWELLE "Fault code TMOT_OBD_HIGH - debounce filter threshold for setting the fault [verified]" VALUE 0x7162E RL_VAL_UB 0 CM_0000 0 255 /end CHARACTERISTIC
/begin CHARACTERISTIC K_ED_TMOT_OBD_HIGH.INC_NACH_EINTRAG "Fault code TMOT_OBD_HIGH - debounce filter increment after fault-memory entry [verified]" VALUE 0x71632 RL_VAL_UB 0 CM_0000 0 255 /end CHARACTERISTIC
/begin CHARACTERISTIC K_ED_TMOT_OBD_HIGH.INC_VOR_EINTRAG "Fault code TMOT_OBD_HIGH - debounce filter increment before fault-memory entry [verified]" VALUE 0x71630 RL_VAL_UB 0 CM_0000 0 255 /end CHARACTERISTIC
/begin CHARACTERISTIC K_ED_TMOT_OBD_HIGH.KLASSENINDEX "Fault code TMOT_OBD_HIGH - fault class selection (lamp / warning behaviour) [verified]" VALUE 0x71634 RL_VAL_UB 0 CM_0000 0 255 /end CHARACTERISTIC
/begin CHARACTERISTIC K_ED_TMOT_OBD_HIGH.OK_SCHWELLE "Fault code TMOT_OBD_HIGH - debounce filter threshold for clearing (healing) the fault [verified]" VALUE 0x7162F RL_VAL_UB 0 CM_0000 0 255 /end CHARACTERISTIC
/begin CHARACTERISTIC K_ED_TMOT_OBD_HIGH.P_CODE_OPENLOAD "Fault code TMOT_OBD_HIGH - OBD P-code reported for open circuit [verified]" VALUE 0x7162A RL_VAL_UW 0 CM_0000 0 65535 /end CHARACTERISTIC
/begin CHARACTERISTIC K_ED_TMOT_OBD_HIGH.P_CODE_SH_TO_GND "Fault code TMOT_OBD_HIGH - OBD P-code reported for short to ground [verified]" VALUE 0x71628 RL_VAL_UW 0 CM_0000 0 65535 /end CHARACTERISTIC
/begin CHARACTERISTIC K_ED_TMOT_OBD_HIGH.P_CODE_SH_TO_UB "Fault code TMOT_OBD_HIGH - OBD P-code reported for short to battery voltage [verified]" VALUE 0x71626 RL_VAL_UW 0 CM_0000 0 65535 /end CHARACTERISTIC
/begin CHARACTERISTIC K_ED_TMOT_OBD_HIGH.P_CODE_UNPLAUSIBEL "Fault code TMOT_OBD_HIGH - OBD P-code reported for implausible signal [verified]" VALUE 0x7162C RL_VAL_UW 0 CM_0000 0 65535 /end CHARACTERISTIC
/begin CHARACTERISTIC K_ED_TUMG.DEC_NACH_EINTRAG "Fault code TUMG - debounce filter decrement after fault-memory entry [verified]" VALUE 0x715FF RL_VAL_UB 0 CM_0000 0 255 /end CHARACTERISTIC
/begin CHARACTERISTIC K_ED_TUMG.DEC_VOR_EINTRAG "Fault code TUMG - debounce filter decrement before fault-memory entry [verified]" VALUE 0x715FD RL_VAL_UB 0 CM_0000 0 255 /end CHARACTERISTIC
/begin CHARACTERISTIC K_ED_TUMG.FEHLERSCHWELLE "Fault code TUMG - debounce filter threshold for setting the fault [verified]" VALUE 0x715FA RL_VAL_UB 0 CM_0000 0 255 /end CHARACTERISTIC
/begin CHARACTERISTIC K_ED_TUMG.INC_NACH_EINTRAG "Fault code TUMG - debounce filter increment after fault-memory entry [verified]" VALUE 0x715FE RL_VAL_UB 0 CM_0000 0 255 /end CHARACTERISTIC
/begin CHARACTERISTIC K_ED_TUMG.INC_VOR_EINTRAG "Fault code TUMG - debounce filter increment before fault-memory entry [verified]" VALUE 0x715FC RL_VAL_UB 0 CM_0000 0 255 /end CHARACTERISTIC
/begin CHARACTERISTIC K_ED_TUMG.KLASSENINDEX "Fault code TUMG - fault class selection (lamp / warning behaviour) [verified]" VALUE 0x71600 RL_VAL_UB 0 CM_0000 0 255 /end CHARACTERISTIC
/begin CHARACTERISTIC K_ED_TUMG.OK_SCHWELLE "Fault code TUMG - debounce filter threshold for clearing (healing) the fault [verified]" VALUE 0x715FB RL_VAL_UB 0 CM_0000 0 255 /end CHARACTERISTIC
/begin CHARACTERISTIC K_ED_TUMG.P_CODE_OPENLOAD "Fault code TUMG - OBD P-code reported for open circuit [verified]" VALUE 0x715F6 RL_VAL_UW 0 CM_0000 0 65535 /end CHARACTERISTIC
/begin CHARACTERISTIC K_ED_TUMG.P_CODE_SH_TO_GND "Fault code TUMG - OBD P-code reported for short to ground [verified]" VALUE 0x715F4 RL_VAL_UW 0 CM_0000 0 65535 /end CHARACTERISTIC
/begin CHARACTERISTIC K_ED_TUMG.P_CODE_SH_TO_UB "Fault code TUMG - OBD P-code reported for short to battery voltage [verified]" VALUE 0x715F2 RL_VAL_UW 0 CM_0000 0 65535 /end CHARACTERISTIC
/begin CHARACTERISTIC K_ED_TUMG.P_CODE_UNPLAUSIBEL "Fault code TUMG - OBD P-code reported for implausible signal [verified]" VALUE 0x715F8 RL_VAL_UW 0 CM_0000 0 65535 /end CHARACTERISTIC
/begin CHARACTERISTIC K_ED_TUMG_OBD.DEC_NACH_EINTRAG "Fault code TUMG_OBD - debounce filter decrement after fault-memory entry [verified]" VALUE 0x70DAB RL_VAL_UB 0 CM_0000 0 255 /end CHARACTERISTIC
/begin CHARACTERISTIC K_ED_TUMG_OBD.DEC_VOR_EINTRAG "Fault code TUMG_OBD - debounce filter decrement before fault-memory entry [verified]" VALUE 0x70DA9 RL_VAL_UB 0 CM_0000 0 255 /end CHARACTERISTIC
/begin CHARACTERISTIC K_ED_TUMG_OBD.FEHLERSCHWELLE "Fault code TUMG_OBD - debounce filter threshold for setting the fault [verified]" VALUE 0x70DA6 RL_VAL_UB 0 CM_0000 0 255 /end CHARACTERISTIC
/begin CHARACTERISTIC K_ED_TUMG_OBD.INC_NACH_EINTRAG "Fault code TUMG_OBD - debounce filter increment after fault-memory entry [verified]" VALUE 0x70DAA RL_VAL_UB 0 CM_0000 0 255 /end CHARACTERISTIC
/begin CHARACTERISTIC K_ED_TUMG_OBD.INC_VOR_EINTRAG "Fault code TUMG_OBD - debounce filter increment before fault-memory entry [verified]" VALUE 0x70DA8 RL_VAL_UB 0 CM_0000 0 255 /end CHARACTERISTIC
/begin CHARACTERISTIC K_ED_TUMG_OBD.KLASSENINDEX "Fault code TUMG_OBD - fault class selection (lamp / warning behaviour) [verified]" VALUE 0x70DAC RL_VAL_UB 0 CM_0000 0 255 /end CHARACTERISTIC
/begin CHARACTERISTIC K_ED_TUMG_OBD.OK_SCHWELLE "Fault code TUMG_OBD - debounce filter threshold for clearing (healing) the fault [verified]" VALUE 0x70DA7 RL_VAL_UB 0 CM_0000 0 255 /end CHARACTERISTIC
/begin CHARACTERISTIC K_ED_TUMG_OBD.P_CODE_OPENLOAD "Fault code TUMG_OBD - OBD P-code reported for open circuit [verified]" VALUE 0x70DA2 RL_VAL_UW 0 CM_0000 0 65535 /end CHARACTERISTIC
/begin CHARACTERISTIC K_ED_TUMG_OBD.P_CODE_SH_TO_GND "Fault code TUMG_OBD - OBD P-code reported for short to ground [verified]" VALUE 0x70DA0 RL_VAL_UW 0 CM_0000 0 65535 /end CHARACTERISTIC
/begin CHARACTERISTIC K_ED_TUMG_OBD.P_CODE_SH_TO_UB "Fault code TUMG_OBD - OBD P-code reported for short to battery voltage [verified]" VALUE 0x70D9E RL_VAL_UW 0 CM_0000 0 65535 /end CHARACTERISTIC
/begin CHARACTERISTIC K_ED_TUMG_OBD.P_CODE_UNPLAUSIBEL "Fault code TUMG_OBD - OBD P-code reported for implausible signal [verified]" VALUE 0x70DA4 RL_VAL_UW 0 CM_0000 0 65535 /end CHARACTERISTIC
/begin CHARACTERISTIC K_ED_UB.DEC_NACH_EINTRAG "Fault code UB - debounce filter decrement after fault-memory entry [verified]" VALUE 0x70BA3 RL_VAL_UB 0 CM_0000 0 255 /end CHARACTERISTIC
/begin CHARACTERISTIC K_ED_UB.DEC_VOR_EINTRAG "Fault code UB - debounce filter decrement before fault-memory entry [verified]" VALUE 0x70BA1 RL_VAL_UB 0 CM_0000 0 255 /end CHARACTERISTIC
/begin CHARACTERISTIC K_ED_UB.FEHLERSCHWELLE "Fault code UB - debounce filter threshold for setting the fault [verified]" VALUE 0x70B9E RL_VAL_UB 0 CM_0000 0 255 /end CHARACTERISTIC
/begin CHARACTERISTIC K_ED_UB.INC_NACH_EINTRAG "Fault code UB - debounce filter increment after fault-memory entry [verified]" VALUE 0x70BA2 RL_VAL_UB 0 CM_0000 0 255 /end CHARACTERISTIC
/begin CHARACTERISTIC K_ED_UB.INC_VOR_EINTRAG "Fault code UB - debounce filter increment before fault-memory entry [verified]" VALUE 0x70BA0 RL_VAL_UB 0 CM_0000 0 255 /end CHARACTERISTIC
/begin CHARACTERISTIC K_ED_UB.KLASSENINDEX "Fault code UB - fault class selection (lamp / warning behaviour) [verified]" VALUE 0x70BA4 RL_VAL_UB 0 CM_0000 0 255 /end CHARACTERISTIC
/begin CHARACTERISTIC K_ED_UB.OK_SCHWELLE "Fault code UB - debounce filter threshold for clearing (healing) the fault [verified]" VALUE 0x70B9F RL_VAL_UB 0 CM_0000 0 255 /end CHARACTERISTIC
/begin CHARACTERISTIC K_ED_UB.P_CODE_OPENLOAD "Fault code UB - OBD P-code reported for open circuit [verified]" VALUE 0x70B9A RL_VAL_UW 0 CM_0000 0 65535 /end CHARACTERISTIC
/begin CHARACTERISTIC K_ED_UB.P_CODE_SH_TO_GND "Fault code UB - OBD P-code reported for short to ground [verified]" VALUE 0x70B98 RL_VAL_UW 0 CM_0000 0 65535 /end CHARACTERISTIC
/begin CHARACTERISTIC K_ED_UB.P_CODE_SH_TO_UB "Fault code UB - OBD P-code reported for short to battery voltage [verified]" VALUE 0x70B96 RL_VAL_UW 0 CM_0000 0 65535 /end CHARACTERISTIC
/begin CHARACTERISTIC K_ED_UB.P_CODE_UNPLAUSIBEL "Fault code UB - OBD P-code reported for implausible signal [verified]" VALUE 0x70B9C RL_VAL_UW 0 CM_0000 0 65535 /end CHARACTERISTIC
/begin CHARACTERISTIC K_ED_UEXT_111219514.DEC_NACH_EINTRAG "Fault code UEXT_111219514 - debounce filter decrement after fault-memory entry [verified]" VALUE 0x70BF1 RL_VAL_UB 0 CM_0000 0 255 /end CHARACTERISTIC
/begin CHARACTERISTIC K_ED_UEXT_111219514.DEC_VOR_EINTRAG "Fault code UEXT_111219514 - debounce filter decrement before fault-memory entry [verified]" VALUE 0x70BEF RL_VAL_UB 0 CM_0000 0 255 /end CHARACTERISTIC
/begin CHARACTERISTIC K_ED_UEXT_111219514.FEHLERSCHWELLE "Fault code UEXT_111219514 - debounce filter threshold for setting the fault [verified]" VALUE 0x70BEC RL_VAL_UB 0 CM_0000 0 255 /end CHARACTERISTIC
/begin CHARACTERISTIC K_ED_UEXT_111219514.INC_NACH_EINTRAG "Fault code UEXT_111219514 - debounce filter increment after fault-memory entry [verified]" VALUE 0x70BF0 RL_VAL_UB 0 CM_0000 0 255 /end CHARACTERISTIC
/begin CHARACTERISTIC K_ED_UEXT_111219514.INC_VOR_EINTRAG "Fault code UEXT_111219514 - debounce filter increment before fault-memory entry [verified]" VALUE 0x70BEE RL_VAL_UB 0 CM_0000 0 255 /end CHARACTERISTIC
/begin CHARACTERISTIC K_ED_UEXT_111219514.KLASSENINDEX "Fault code UEXT_111219514 - fault class selection (lamp / warning behaviour) [verified]" VALUE 0x70BF2 RL_VAL_UB 0 CM_0000 0 255 /end CHARACTERISTIC
/begin CHARACTERISTIC K_ED_UEXT_111219514.OK_SCHWELLE "Fault code UEXT_111219514 - debounce filter threshold for clearing (healing) the fault [verified]" VALUE 0x70BED RL_VAL_UB 0 CM_0000 0 255 /end CHARACTERISTIC
/begin CHARACTERISTIC K_ED_UEXT_111219514.P_CODE_OPENLOAD "Fault code UEXT_111219514 - OBD P-code reported for open circuit [verified]" VALUE 0x70BE8 RL_VAL_UW 0 CM_0000 0 65535 /end CHARACTERISTIC
/begin CHARACTERISTIC K_ED_UEXT_111219514.P_CODE_SH_TO_GND "Fault code UEXT_111219514 - OBD P-code reported for short to ground [verified]" VALUE 0x70BE6 RL_VAL_UW 0 CM_0000 0 65535 /end CHARACTERISTIC
/begin CHARACTERISTIC K_ED_UEXT_111219514.P_CODE_SH_TO_UB "Fault code UEXT_111219514 - OBD P-code reported for short to battery voltage [verified]" VALUE 0x70BE4 RL_VAL_UW 0 CM_0000 0 65535 /end CHARACTERISTIC
/begin CHARACTERISTIC K_ED_UEXT_111219514.P_CODE_UNPLAUSIBEL "Fault code UEXT_111219514 - OBD P-code reported for implausible signal [verified]" VALUE 0x70BEA RL_VAL_UW 0 CM_0000 0 65535 /end CHARACTERISTIC
/begin CHARACTERISTIC K_ED_UEXT_124_512.DEC_NACH_EINTRAG "Fault code UEXT_124_512 - debounce filter decrement after fault-memory entry [verified]" VALUE 0x70C0B RL_VAL_UB 0 CM_0000 0 255 /end CHARACTERISTIC
/begin CHARACTERISTIC K_ED_UEXT_124_512.DEC_VOR_EINTRAG "Fault code UEXT_124_512 - debounce filter decrement before fault-memory entry [verified]" VALUE 0x70C09 RL_VAL_UB 0 CM_0000 0 255 /end CHARACTERISTIC
/begin CHARACTERISTIC K_ED_UEXT_124_512.FEHLERSCHWELLE "Fault code UEXT_124_512 - debounce filter threshold for setting the fault [verified]" VALUE 0x70C06 RL_VAL_UB 0 CM_0000 0 255 /end CHARACTERISTIC
/begin CHARACTERISTIC K_ED_UEXT_124_512.INC_NACH_EINTRAG "Fault code UEXT_124_512 - debounce filter increment after fault-memory entry [verified]" VALUE 0x70C0A RL_VAL_UB 0 CM_0000 0 255 /end CHARACTERISTIC
/begin CHARACTERISTIC K_ED_UEXT_124_512.INC_VOR_EINTRAG "Fault code UEXT_124_512 - debounce filter increment before fault-memory entry [verified]" VALUE 0x70C08 RL_VAL_UB 0 CM_0000 0 255 /end CHARACTERISTIC
/begin CHARACTERISTIC K_ED_UEXT_124_512.KLASSENINDEX "Fault code UEXT_124_512 - fault class selection (lamp / warning behaviour) [verified]" VALUE 0x70C0C RL_VAL_UB 0 CM_0000 0 255 /end CHARACTERISTIC
/begin CHARACTERISTIC K_ED_UEXT_124_512.OK_SCHWELLE "Fault code UEXT_124_512 - debounce filter threshold for clearing (healing) the fault [verified]" VALUE 0x70C07 RL_VAL_UB 0 CM_0000 0 255 /end CHARACTERISTIC
/begin CHARACTERISTIC K_ED_UEXT_124_512.P_CODE_OPENLOAD "Fault code UEXT_124_512 - OBD P-code reported for open circuit [verified]" VALUE 0x70C02 RL_VAL_UW 0 CM_0000 0 65535 /end CHARACTERISTIC
/begin CHARACTERISTIC K_ED_UEXT_124_512.P_CODE_SH_TO_GND "Fault code UEXT_124_512 - OBD P-code reported for short to ground [verified]" VALUE 0x70C00 RL_VAL_UW 0 CM_0000 0 65535 /end CHARACTERISTIC
/begin CHARACTERISTIC K_ED_UEXT_124_512.P_CODE_SH_TO_UB "Fault code UEXT_124_512 - OBD P-code reported for short to battery voltage [verified]" VALUE 0x70BFE RL_VAL_UW 0 CM_0000 0 65535 /end CHARACTERISTIC
/begin CHARACTERISTIC K_ED_UEXT_124_512.P_CODE_UNPLAUSIBEL "Fault code UEXT_124_512 - OBD P-code reported for implausible signal [verified]" VALUE 0x70C04 RL_VAL_UW 0 CM_0000 0 65535 /end CHARACTERISTIC
/begin CHARACTERISTIC K_ED_V_DIREKT.DEC_NACH_EINTRAG "Fault code V_DIREKT - debounce filter decrement after fault-memory entry [verified]" VALUE 0x70DC5 RL_VAL_UB 0 CM_0000 0 255 /end CHARACTERISTIC
/begin CHARACTERISTIC K_ED_V_DIREKT.DEC_VOR_EINTRAG "Fault code V_DIREKT - debounce filter decrement before fault-memory entry [verified]" VALUE 0x70DC3 RL_VAL_UB 0 CM_0000 0 255 /end CHARACTERISTIC
/begin CHARACTERISTIC K_ED_V_DIREKT.FEHLERSCHWELLE "Fault code V_DIREKT - debounce filter threshold for setting the fault [verified]" VALUE 0x70DC0 RL_VAL_UB 0 CM_0000 0 255 /end CHARACTERISTIC
/begin CHARACTERISTIC K_ED_V_DIREKT.INC_NACH_EINTRAG "Fault code V_DIREKT - debounce filter increment after fault-memory entry [verified]" VALUE 0x70DC4 RL_VAL_UB 0 CM_0000 0 255 /end CHARACTERISTIC
/begin CHARACTERISTIC K_ED_V_DIREKT.INC_VOR_EINTRAG "Fault code V_DIREKT - debounce filter increment before fault-memory entry [verified]" VALUE 0x70DC2 RL_VAL_UB 0 CM_0000 0 255 /end CHARACTERISTIC
/begin CHARACTERISTIC K_ED_V_DIREKT.KLASSENINDEX "Fault code V_DIREKT - fault class selection (lamp / warning behaviour) [verified]" VALUE 0x70DC6 RL_VAL_UB 0 CM_0000 0 255 /end CHARACTERISTIC
/begin CHARACTERISTIC K_ED_V_DIREKT.OK_SCHWELLE "Fault code V_DIREKT - debounce filter threshold for clearing (healing) the fault [verified]" VALUE 0x70DC1 RL_VAL_UB 0 CM_0000 0 255 /end CHARACTERISTIC
/begin CHARACTERISTIC K_ED_V_DIREKT.P_CODE_OPENLOAD "Fault code V_DIREKT - OBD P-code reported for open circuit [verified]" VALUE 0x70DBC RL_VAL_UW 0 CM_0000 0 65535 /end CHARACTERISTIC
/begin CHARACTERISTIC K_ED_V_DIREKT.P_CODE_SH_TO_GND "Fault code V_DIREKT - OBD P-code reported for short to ground [verified]" VALUE 0x70DBA RL_VAL_UW 0 CM_0000 0 65535 /end CHARACTERISTIC
/begin CHARACTERISTIC K_ED_V_DIREKT.P_CODE_SH_TO_UB "Fault code V_DIREKT - OBD P-code reported for short to battery voltage [verified]" VALUE 0x70DB8 RL_VAL_UW 0 CM_0000 0 65535 /end CHARACTERISTIC
/begin CHARACTERISTIC K_ED_V_DIREKT.P_CODE_UNPLAUSIBEL "Fault code V_DIREKT - OBD P-code reported for implausible signal [verified]" VALUE 0x70DBE RL_VAL_UW 0 CM_0000 0 65535 /end CHARACTERISTIC
/begin CHARACTERISTIC K_ED_WUC_DELTA_TMOT__IGN_ "Minimum temperature rise for an OBD warm-up cycle [verified]" VALUE 0x717FE RL_VAL_SW 0 CM_0024 -3276.8 3276.7 /end CHARACTERISTIC
/begin CHARACTERISTIC K_ED_WUC_TMOT_MIN__IGN_ "Minimum temperature for an OBD warm-up cycle [verified]" VALUE 0x717FC RL_VAL_SW 0 CM_0006 -3550 3003.5 /end CHARACTERISTIC
/begin CHARACTERISTIC K_ED_ZOELP1.DEC_NACH_EINTRAG "Fault code ZOELP1 - debounce filter decrement after fault-memory entry [verified]" VALUE 0x7142B RL_VAL_UB 0 CM_0000 0 255 /end CHARACTERISTIC
/begin CHARACTERISTIC K_ED_ZOELP1.DEC_VOR_EINTRAG "Fault code ZOELP1 - debounce filter decrement before fault-memory entry [verified]" VALUE 0x71429 RL_VAL_UB 0 CM_0000 0 255 /end CHARACTERISTIC
/begin CHARACTERISTIC K_ED_ZOELP1.FEHLERSCHWELLE "Fault code ZOELP1 - debounce filter threshold for setting the fault [verified]" VALUE 0x71426 RL_VAL_UB 0 CM_0000 0 255 /end CHARACTERISTIC
/begin CHARACTERISTIC K_ED_ZOELP1.INC_NACH_EINTRAG "Fault code ZOELP1 - debounce filter increment after fault-memory entry [verified]" VALUE 0x7142A RL_VAL_UB 0 CM_0000 0 255 /end CHARACTERISTIC
/begin CHARACTERISTIC K_ED_ZOELP1.INC_VOR_EINTRAG "Fault code ZOELP1 - debounce filter increment before fault-memory entry [verified]" VALUE 0x71428 RL_VAL_UB 0 CM_0000 0 255 /end CHARACTERISTIC
/begin CHARACTERISTIC K_ED_ZOELP1.KLASSENINDEX "Fault code ZOELP1 - fault class selection (lamp / warning behaviour) [verified]" VALUE 0x7142C RL_VAL_UB 0 CM_0000 0 255 /end CHARACTERISTIC
/begin CHARACTERISTIC K_ED_ZOELP1.OK_SCHWELLE "Fault code ZOELP1 - debounce filter threshold for clearing (healing) the fault [verified]" VALUE 0x71427 RL_VAL_UB 0 CM_0000 0 255 /end CHARACTERISTIC
/begin CHARACTERISTIC K_ED_ZOELP1.P_CODE_OPENLOAD "Fault code ZOELP1 - OBD P-code reported for open circuit [verified]" VALUE 0x71422 RL_VAL_UW 0 CM_0000 0 65535 /end CHARACTERISTIC
/begin CHARACTERISTIC K_ED_ZOELP1.P_CODE_SH_TO_GND "Fault code ZOELP1 - OBD P-code reported for short to ground [verified]" VALUE 0x71420 RL_VAL_UW 0 CM_0000 0 65535 /end CHARACTERISTIC
/begin CHARACTERISTIC K_ED_ZOELP1.P_CODE_SH_TO_UB "Fault code ZOELP1 - OBD P-code reported for short to battery voltage [verified]" VALUE 0x7141E RL_VAL_UW 0 CM_0000 0 65535 /end CHARACTERISTIC
/begin CHARACTERISTIC K_ED_ZOELP1.P_CODE_UNPLAUSIBEL "Fault code ZOELP1 - OBD P-code reported for implausible signal [verified]" VALUE 0x71424 RL_VAL_UW 0 CM_0000 0 65535 /end CHARACTERISTIC
/begin CHARACTERISTIC K_ED_ZOELP2.DEC_NACH_EINTRAG "Fault code ZOELP2 - debounce filter decrement after fault-memory entry [verified]" VALUE 0x71445 RL_VAL_UB 0 CM_0000 0 255 /end CHARACTERISTIC
/begin CHARACTERISTIC K_ED_ZOELP2.DEC_VOR_EINTRAG "Fault code ZOELP2 - debounce filter decrement before fault-memory entry [verified]" VALUE 0x71443 RL_VAL_UB 0 CM_0000 0 255 /end CHARACTERISTIC
/begin CHARACTERISTIC K_ED_ZOELP2.FEHLERSCHWELLE "Fault code ZOELP2 - debounce filter threshold for setting the fault [verified]" VALUE 0x71440 RL_VAL_UB 0 CM_0000 0 255 /end CHARACTERISTIC
/begin CHARACTERISTIC K_ED_ZOELP2.INC_NACH_EINTRAG "Fault code ZOELP2 - debounce filter increment after fault-memory entry [verified]" VALUE 0x71444 RL_VAL_UB 0 CM_0000 0 255 /end CHARACTERISTIC
/begin CHARACTERISTIC K_ED_ZOELP2.INC_VOR_EINTRAG "Fault code ZOELP2 - debounce filter increment before fault-memory entry [verified]" VALUE 0x71442 RL_VAL_UB 0 CM_0000 0 255 /end CHARACTERISTIC
/begin CHARACTERISTIC K_ED_ZOELP2.KLASSENINDEX "Fault code ZOELP2 - fault class selection (lamp / warning behaviour) [verified]" VALUE 0x71446 RL_VAL_UB 0 CM_0000 0 255 /end CHARACTERISTIC
/begin CHARACTERISTIC K_ED_ZOELP2.OK_SCHWELLE "Fault code ZOELP2 - debounce filter threshold for clearing (healing) the fault [verified]" VALUE 0x71441 RL_VAL_UB 0 CM_0000 0 255 /end CHARACTERISTIC
/begin CHARACTERISTIC K_ED_ZOELP2.P_CODE_OPENLOAD "Fault code ZOELP2 - OBD P-code reported for open circuit [verified]" VALUE 0x7143C RL_VAL_UW 0 CM_0000 0 65535 /end CHARACTERISTIC
/begin CHARACTERISTIC K_ED_ZOELP2.P_CODE_SH_TO_GND "Fault code ZOELP2 - OBD P-code reported for short to ground [verified]" VALUE 0x7143A RL_VAL_UW 0 CM_0000 0 65535 /end CHARACTERISTIC
/begin CHARACTERISTIC K_ED_ZOELP2.P_CODE_SH_TO_UB "Fault code ZOELP2 - OBD P-code reported for short to battery voltage [verified]" VALUE 0x71438 RL_VAL_UW 0 CM_0000 0 65535 /end CHARACTERISTIC
/begin CHARACTERISTIC K_ED_ZOELP2.P_CODE_UNPLAUSIBEL "Fault code ZOELP2 - OBD P-code reported for implausible signal [verified]" VALUE 0x7143E RL_VAL_UW 0 CM_0000 0 65535 /end CHARACTERISTIC
/begin CHARACTERISTIC UNK_KL_16CE0_MD "X: Exhaust VANOS target deviation (van_kh_diff_a) [?KW] | Value: Ignition angle (tz) [?KW] [unassigned]" CURVE 0x76CE0 RL_CUR_SW_SW 0 CM_0028 -3276.8 3276.7 /begin AXIS_DESCR STD_AXIS NO_INPUT_QUANTITY CM_0028 3 -3276.8 3276.7 /end AXIS_DESCR /end CHARACTERISTIC
/begin CHARACTERISTIC UNK_TZ_1DBDF "Unassigned constant read by IGN [unassigned]" VALUE 0x7DBDF RL_VAL_UB 0 CM_0000 0 255 /end CHARACTERISTIC
/begin CHARACTERISTIC UNK_KR_139EC "Unassigned constant read by IGN 3FDF4 [unassigned]" VALUE 0x739EC RL_VAL_UB 0 CM_0000 0 255 /end CHARACTERISTIC
/begin CHARACTERISTIC UNK_KR_139F6 "Unassigned constant read by IGN 3FDF4 [unassigned]" VALUE 0x739F6 RL_VAL_SW 0 CM_0000 -32768 32767 /end CHARACTERISTIC
/begin CHARACTERISTIC UNK_KR_14E7E "Unassigned constant read by IGN 4514C [unassigned]" VALUE 0x74E7E RL_VAL_UB 0 CM_0000 0 255 /end CHARACTERISTIC
/begin CHARACTERISTIC UNK_KR_14ED8 "Unassigned constant read by IGN 44DB4 [unassigned]" VALUE 0x74ED8 RL_VAL_UB 0 CM_0000 0 255 /end CHARACTERISTIC
/begin CHARACTERISTIC UNK_KR_14EDA "Unassigned constant read by IGN 44DB4 [unassigned]" VALUE 0x74EDA RL_VAL_SW 0 CM_0000 -32768 32767 /end CHARACTERISTIC
/begin CHARACTERISTIC UNK_KR_14EDC "Unassigned constant read by IGN 44DB4 [unassigned]" VALUE 0x74EDC RL_VAL_SW 0 CM_0000 -32768 32767 /end CHARACTERISTIC
/begin CHARACTERISTIC UNK_KR_14EF2 "Unassigned constant read by IGN 44DB4 [unassigned]" VALUE 0x74EF2 RL_VAL_UB 0 CM_0000 0 255 /end CHARACTERISTIC
/begin CHARACTERISTIC UNK_KR_14EF3 "Unassigned constant read by IGN 44DB4 [unassigned]" VALUE 0x74EF3 RL_VAL_UB 0 CM_0000 0 255 /end CHARACTERISTIC
/begin CHARACTERISTIC UNK_KR_14EF4 "Unassigned constant read by IGN 44DB4 [unassigned]" VALUE 0x74EF4 RL_VAL_UB 0 CM_0000 0 255 /end CHARACTERISTIC
/begin CHARACTERISTIC UNK_KL_KH_ALT_OFFSET_KM_4 "Fourth mileage-dependent cat-aging offset curve (negative values) [unassigned]" CURVE 0x74190 RL_CUR_UW_SW 0 CM_0272 -3276.8 3276.7 /begin AXIS_DESCR STD_AXIS NO_INPUT_QUANTITY CM_0238 4 0 131070 /end AXIS_DESCR /end CHARACTERISTIC
/begin CHARACTERISTIC UNK_KH_140E0 "Unassigned constant read by IGN 42BB0 [unassigned]" VALUE 0x740E0 RL_VAL_UL 0 CM_0247 0 42949672.95 /end CHARACTERISTIC
/begin CHARACTERISTIC UNK_EGAS_1184F "Unassigned constant read by IGN 33180 [unassigned]" VALUE 0x7184F RL_VAL_UB 0 CM_0000 0 255 /end CHARACTERISTIC
/begin CHARACTERISTIC UNK_KF_EGASAQSO_1042A "Unidentified map (chapter by calling function: EGAS_AQ_SOLL). Raw values. [unassigned]" MAP 0x7042A RL_MAP_SW_SW_UW 0 CM_0000 0 65535 /begin AXIS_DESCR STD_AXIS NO_INPUT_QUANTITY CM_0000 5 -32768 32767 /end AXIS_DESCR /begin AXIS_DESCR STD_AXIS NO_INPUT_QUANTITY CM_0000 5 -32768 32767 /end AXIS_DESCR /end CHARACTERISTIC
/begin CHARACTERISTIC UNK_KF_MISC_107C4 "Unidentified map (chapter by calling function: unknown). Raw values. [unassigned]" MAP 0x707C4 RL_MAP_SW_SW_SW 0 CM_0000 -32768 32767 /begin AXIS_DESCR STD_AXIS NO_INPUT_QUANTITY CM_0000 4 -32768 32767 /end AXIS_DESCR /begin AXIS_DESCR STD_AXIS NO_INPUT_QUANTITY CM_0000 4 -32768 32767 /end AXIS_DESCR /end CHARACTERISTIC
/begin CHARACTERISTIC UNK_KF_MISC_1096C "Unidentified map (chapter by calling function: unknown). Raw values. [unassigned]" MAP 0x7096C RL_MAP_SW_SW_SW 0 CM_0000 -32768 32767 /begin AXIS_DESCR STD_AXIS NO_INPUT_QUANTITY CM_0000 6 -32768 32767 /end AXIS_DESCR /begin AXIS_DESCR STD_AXIS NO_INPUT_QUANTITY CM_0000 3 -32768 32767 /end AXIS_DESCR /end CHARACTERISTIC
/begin CHARACTERISTIC UNK_KF_MISC_109A4 "Unidentified map (chapter by calling function: unknown). Raw values. [unassigned]" MAP 0x709A4 RL_MAP_SW_SW_SW 0 CM_0000 -32768 32767 /begin AXIS_DESCR STD_AXIS NO_INPUT_QUANTITY CM_0000 6 -32768 32767 /end AXIS_DESCR /begin AXIS_DESCR STD_AXIS NO_INPUT_QUANTITY CM_0000 3 -32768 32767 /end AXIS_DESCR /end CHARACTERISTIC
/begin CHARACTERISTIC UNK_KF_MISC_10A14 "Unidentified map (chapter by calling function: unknown). Raw values. [unassigned]" MAP 0x70A14 RL_MAP_SW_SW_SW 0 CM_0000 -32768 32767 /begin AXIS_DESCR STD_AXIS NO_INPUT_QUANTITY CM_0000 6 -32768 32767 /end AXIS_DESCR /begin AXIS_DESCR STD_AXIS NO_INPUT_QUANTITY CM_0000 3 -32768 32767 /end AXIS_DESCR /end CHARACTERISTIC
/begin CHARACTERISTIC UNK_KL_EGAS_118FC "Unidentified curve (chapter by calling function: Egas). Raw values. [unassigned]" CURVE 0x718FC RL_CUR_SW_SW 0 CM_0000 -32768 32767 /begin AXIS_DESCR STD_AXIS NO_INPUT_QUANTITY CM_0000 10 -32768 32767 /end AXIS_DESCR /end CHARACTERISTIC
/begin CHARACTERISTIC UNK_KL_FAHRGESC_126DE "Unidentified curve (chapter by calling function: Fahrgeschwindigkeitsregler). Raw values. [unassigned]" CURVE 0x726DE RL_CUR_SW_SW 0 CM_0000 -32768 32767 /begin AXIS_DESCR STD_AXIS NO_INPUT_QUANTITY CM_0000 10 -32768 32767 /end AXIS_DESCR /end CHARACTERISTIC
/begin CHARACTERISTIC UNK_KL_FAHRGESC_12708 "Unidentified curve (chapter by calling function: Fahrgeschwindigkeitsregler). Raw values. [unassigned]" CURVE 0x72708 RL_CUR_SW_SW 0 CM_0000 -32768 32767 /begin AXIS_DESCR STD_AXIS NO_INPUT_QUANTITY CM_0000 10 -32768 32767 /end AXIS_DESCR /end CHARACTERISTIC
/begin CHARACTERISTIC UNK_KL_FAHRGESC_12732 "Unidentified curve (chapter by calling function: Fahrgeschwindigkeitsregler). Raw values. [unassigned]" CURVE 0x72732 RL_CUR_SW_SW 0 CM_0000 -32768 32767 /begin AXIS_DESCR STD_AXIS NO_INPUT_QUANTITY CM_0000 10 -32768 32767 /end AXIS_DESCR /end CHARACTERISTIC
/begin CHARACTERISTIC UNK_KL_FAHRGESC_1275C "Unidentified curve (chapter by calling function: Fahrgeschwindigkeitsregler). Raw values. [unassigned]" CURVE 0x7275C RL_CUR_SW_SW 0 CM_0000 -32768 32767 /begin AXIS_DESCR STD_AXIS NO_INPUT_QUANTITY CM_0000 8 -32768 32767 /end AXIS_DESCR /end CHARACTERISTIC
/begin CHARACTERISTIC UNK_KL_FAHRGESC_1277E "Unidentified curve (chapter by calling function: Fahrgeschwindigkeitsregler). Raw values. [unassigned]" CURVE 0x7277E RL_CUR_SW_SW 0 CM_0000 -32768 32767 /begin AXIS_DESCR STD_AXIS NO_INPUT_QUANTITY CM_0000 10 -32768 32767 /end AXIS_DESCR /end CHARACTERISTIC
/begin CHARACTERISTIC UNK_KL_FAHRGESC_127CA "Unidentified curve (chapter by calling function: Fahrgeschwindigkeitsregler). Raw values. [unassigned]" CURVE 0x727CA RL_CUR_SW_SW 0 CM_0000 -32768 32767 /begin AXIS_DESCR STD_AXIS NO_INPUT_QUANTITY CM_0000 8 -32768 32767 /end AXIS_DESCR /end CHARACTERISTIC
/begin CHARACTERISTIC UNK_KL_FAHRGESC_127EC "Unidentified curve (chapter by calling function: Fahrgeschwindigkeitsregler). Raw values. [unassigned]" CURVE 0x727EC RL_CUR_SW_SW 0 CM_0000 -32768 32767 /begin AXIS_DESCR STD_AXIS NO_INPUT_QUANTITY CM_0000 10 -32768 32767 /end AXIS_DESCR /end CHARACTERISTIC
/begin CHARACTERISTIC UNK_KL_FAHRGESC_12816 "Unidentified curve (chapter by calling function: Fahrgeschwindigkeitsregler). Raw values. [unassigned]" CURVE 0x72816 RL_CUR_SW_SW 0 CM_0000 -32768 32767 /begin AXIS_DESCR STD_AXIS NO_INPUT_QUANTITY CM_0000 10 -32768 32767 /end AXIS_DESCR /end CHARACTERISTIC
/begin CHARACTERISTIC UNK_KL_FAHRGESC_12840 "Unidentified curve (chapter by calling function: Fahrgeschwindigkeitsregler). Raw values. [unassigned]" CURVE 0x72840 RL_CUR_SW_SW 0 CM_0000 -32768 32767 /begin AXIS_DESCR STD_AXIS NO_INPUT_QUANTITY CM_0000 8 -32768 32767 /end AXIS_DESCR /end CHARACTERISTIC
/begin CHARACTERISTIC UNK_KF_FAHRGESC_13074 "Unidentified map (chapter by calling function: Fahrgeschwindigkeitsregler). Raw values. [unassigned]" MAP 0x73074 RL_MAP_SW_SW_SW 0 CM_0000 -32768 32767 /begin AXIS_DESCR STD_AXIS NO_INPUT_QUANTITY CM_0000 6 -32768 32767 /end AXIS_DESCR /begin AXIS_DESCR STD_AXIS NO_INPUT_QUANTITY CM_0000 6 -32768 32767 /end AXIS_DESCR /end CHARACTERISTIC
/begin CHARACTERISTIC UNK_KF_FAHRGESC_130D6 "Unidentified map (chapter by calling function: Fahrgeschwindigkeitsregler). Raw values. [unassigned]" MAP 0x730D6 RL_MAP_SW_SW_SW 0 CM_0000 -32768 32767 /begin AXIS_DESCR STD_AXIS NO_INPUT_QUANTITY CM_0000 5 -32768 32767 /end AXIS_DESCR /begin AXIS_DESCR STD_AXIS NO_INPUT_QUANTITY CM_0000 5 -32768 32767 /end AXIS_DESCR /end CHARACTERISTIC
/begin CHARACTERISTIC UNK_KL_MOMENTEN_16CBA "Unidentified curve (chapter by calling function: Momentenmanager). Raw values. [unassigned]" CURVE 0x76CBA RL_CUR_SW_UB 0 CM_0000 0 255 /begin AXIS_DESCR STD_AXIS NO_INPUT_QUANTITY CM_0000 3 -32768 32767 /end AXIS_DESCR /end CHARACTERISTIC
/begin CHARACTERISTIC UNK_KL_MOMENTEN_16CC6 "Unidentified curve (chapter by calling function: Momentenmanager). Raw values. [unassigned]" CURVE 0x76CC6 RL_CUR_SW_UB 0 CM_0000 0 255 /begin AXIS_DESCR STD_AXIS NO_INPUT_QUANTITY CM_0000 3 -32768 32767 /end AXIS_DESCR /end CHARACTERISTIC
/begin CHARACTERISTIC UNK_KL_MOMENTEN_16CD2 "Unidentified curve (chapter by calling function: Momentenmanager). Raw values. [unassigned]" CURVE 0x76CD2 RL_CUR_SW_UB 0 CM_0000 0 255 /begin AXIS_DESCR STD_AXIS NO_INPUT_QUANTITY CM_0000 4 -32768 32767 /end AXIS_DESCR /end CHARACTERISTIC
/begin CHARACTERISTIC UNK_KF_MOMENTEN_16CFC "Unidentified map (chapter by calling function: Momentenmanager). Raw values. [unassigned]" MAP 0x76CFC RL_MAP_SW_SW_SW 0 CM_0000 -32768 32767 /begin AXIS_DESCR STD_AXIS NO_INPUT_QUANTITY CM_0000 4 -32768 32767 /end AXIS_DESCR /begin AXIS_DESCR STD_AXIS NO_INPUT_QUANTITY CM_0000 4 -32768 32767 /end AXIS_DESCR /end CHARACTERISTIC
/begin CHARACTERISTIC UNK_KF_MOMENTEN_16D2E "ZW-Offset ueber n und rf [unassigned]" MAP 0x76D2E RL_MAP_SW_SW_SW 0 CM_0280 -3276.8 3276.7 /begin AXIS_DESCR STD_AXIS NO_INPUT_QUANTITY CM_0002 3 -32768 32767 /end AXIS_DESCR /begin AXIS_DESCR STD_AXIS NO_INPUT_QUANTITY CM_0282 3 -3.2768 3.2767 /end AXIS_DESCR /end CHARACTERISTIC
/begin CHARACTERISTIC UNK_KF_MOMENTEN_179B4 "Unidentified map (chapter by calling function: Momentenmanager). Raw values. [unassigned]" MAP 0x779B4 RL_MAP_SW_SW_SW 0 CM_0000 -32768 32767 /begin AXIS_DESCR STD_AXIS NO_INPUT_QUANTITY CM_0000 3 -32768 32767 /end AXIS_DESCR /begin AXIS_DESCR STD_AXIS NO_INPUT_QUANTITY CM_0000 2 -32768 32767 /end AXIS_DESCR /end CHARACTERISTIC
/begin CHARACTERISTIC UNK_KL_MISC_1AAB2 "Unidentified curve (chapter by calling function: unknown). Raw values. [unassigned]" CURVE 0x7AAB2 RL_CUR_SW_UB 0 CM_0000 0 255 /begin AXIS_DESCR STD_AXIS NO_INPUT_QUANTITY CM_0000 4 -32768 32767 /end AXIS_DESCR /end CHARACTERISTIC
/begin CHARACTERISTIC UNK_KL_MISC_1AD4C "Unidentified curve (chapter by calling function: unknown). Raw values. [unassigned]" CURVE 0x7AD4C RL_CUR_SW_UW 0 CM_0000 0 65535 /begin AXIS_DESCR STD_AXIS NO_INPUT_QUANTITY CM_0000 4 -32768 32767 /end AXIS_DESCR /end CHARACTERISTIC
/begin CHARACTERISTIC UNK_KL_MISC_1BAE8 "Unidentified curve (chapter by calling function: unknown). Raw values. [unassigned]" CURVE 0x7BAE8 RL_CUR_SW_UW 0 CM_0000 0 65535 /begin AXIS_DESCR STD_AXIS NO_INPUT_QUANTITY CM_0000 2 -32768 32767 /end AXIS_DESCR /end CHARACTERISTIC
/begin CHARACTERISTIC UNK_KL_MISC_1C5F2 "Unidentified curve (chapter by calling function: unknown). Raw values. [unassigned]" CURVE 0x7C5F2 RL_CUR_SW_UB 0 CM_0000 0 255 /begin AXIS_DESCR STD_AXIS NO_INPUT_QUANTITY CM_0000 6 -32768 32767 /end AXIS_DESCR /end CHARACTERISTIC
/begin CHARACTERISTIC UNK_KL_MISC_1C6EA "Unidentified curve (chapter by calling function: unknown). Raw values. [unassigned]" CURVE 0x7C6EA RL_CUR_SW_UW 0 CM_0000 0 65535 /begin AXIS_DESCR STD_AXIS NO_INPUT_QUANTITY CM_0000 4 -32768 32767 /end AXIS_DESCR /end CHARACTERISTIC
/begin CHARACTERISTIC UNK_KF_MISC_1CC5E "Unidentified map (chapter by calling function: unknown). Raw values. [unassigned]" MAP 0x7CC5E RL_MAP_SW_SW_UB 0 CM_0000 0 255 /begin AXIS_DESCR STD_AXIS NO_INPUT_QUANTITY CM_0000 6 -32768 32767 /end AXIS_DESCR /begin AXIS_DESCR STD_AXIS NO_INPUT_QUANTITY CM_0000 6 -32768 32767 /end AXIS_DESCR /end CHARACTERISTIC
/begin CHARACTERISTIC UNK_KL_MISC_1E728 "Unidentified curve (chapter by calling function: unknown). Raw values. [unassigned]" CURVE 0x7E728 RL_CUR_SW_SW 0 CM_0000 -32768 32767 /begin AXIS_DESCR STD_AXIS NO_INPUT_QUANTITY CM_0000 3 -32768 32767 /end AXIS_DESCR /end CHARACTERISTIC
/begin CHARACTERISTIC UNK_KL_ANTITRAM_10566 "Unidentified curve (chapter by calling function: Anti-Trampel-Funktion). Raw values. [unassigned]" CURVE 0x70566 RL_CUR_SW_SW 0 CM_0000 -32768 32767 /begin AXIS_DESCR STD_AXIS NO_INPUT_QUANTITY CM_0000 4 -32768 32767 /end AXIS_DESCR /end CHARACTERISTIC
/begin CHARACTERISTIC UNK_KL_ANTITRAM_10578 "Unidentified curve (chapter by calling function: Anti-Trampel-Funktion). Raw values. [unassigned]" CURVE 0x70578 RL_CUR_SW_SW 0 CM_0000 -32768 32767 /begin AXIS_DESCR STD_AXIS NO_INPUT_QUANTITY CM_0000 4 -32768 32767 /end AXIS_DESCR /end CHARACTERISTIC
/begin CHARACTERISTIC UNK_KL_MISC_1058A "Unidentified curve (chapter by calling function: unknown). Raw values. [unassigned]" CURVE 0x7058A RL_CUR_SW_UW 0 CM_0000 0 65535 /begin AXIS_DESCR STD_AXIS NO_INPUT_QUANTITY CM_0000 5 -32768 32767 /end AXIS_DESCR /end CHARACTERISTIC
/begin CHARACTERISTIC UNK_KL_MISC_10688 "Unidentified curve (chapter by calling function: unknown). Raw values. [unassigned]" CURVE 0x70688 RL_CUR_SW_SW 0 CM_0000 -32768 32767 /begin AXIS_DESCR STD_AXIS NO_INPUT_QUANTITY CM_0000 5 -32768 32767 /end AXIS_DESCR /end CHARACTERISTIC
/begin CHARACTERISTIC UNK_KL_MISC_1069E "Unidentified curve (chapter by calling function: unknown). Raw values. [unassigned]" CURVE 0x7069E RL_CUR_SW_SW 0 CM_0000 -32768 32767 /begin AXIS_DESCR STD_AXIS NO_INPUT_QUANTITY CM_0000 5 -32768 32767 /end AXIS_DESCR /end CHARACTERISTIC
/begin CHARACTERISTIC UNK_KL_MISC_13750 "Unidentified curve (chapter by calling function: unknown). Raw values. [unassigned]" CURVE 0x73750 RL_CUR_SW_SW 0 CM_0000 -32768 32767 /begin AXIS_DESCR STD_AXIS NO_INPUT_QUANTITY CM_0000 8 -32768 32767 /end AXIS_DESCR /end CHARACTERISTIC
/begin CHARACTERISTIC UNK_KL_KLOPFREG_14E30 "Unidentified curve (chapter by calling function: Klopfregelung). Raw values. [unassigned]" CURVE 0x74E30 RL_CUR_SW_SW 0 CM_0000 -32768 32767 /begin AXIS_DESCR STD_AXIS NO_INPUT_QUANTITY CM_0000 6 -32768 32767 /end AXIS_DESCR /end CHARACTERISTIC
/begin CHARACTERISTIC UNK_KL_MISC_14E4A "Unidentified curve (chapter by calling function: unknown). Raw values. [unassigned]" CURVE 0x74E4A RL_CUR_SW_SW 0 CM_0000 -32768 32767 /begin AXIS_DESCR STD_AXIS NO_INPUT_QUANTITY CM_0000 6 -32768 32767 /end AXIS_DESCR /end CHARACTERISTIC
/begin CHARACTERISTIC UNK_KL_LEERLAUF_16304 "Unidentified curve (chapter by calling function: Leerlaufregelung). Raw values. [unassigned]" CURVE 0x76304 RL_CUR_SW_SW 0 CM_0000 -32768 32767 /begin AXIS_DESCR STD_AXIS NO_INPUT_QUANTITY CM_0000 2 -32768 32767 /end AXIS_DESCR /end CHARACTERISTIC
/begin CHARACTERISTIC UNK_KL_LEERLAUF_1636C "Unidentified curve (chapter by calling function: Leerlaufregelung). Raw values. [unassigned]" CURVE 0x7636C RL_CUR_SW_SW 0 CM_0000 -32768 32767 /begin AXIS_DESCR STD_AXIS NO_INPUT_QUANTITY CM_0000 3 -32768 32767 /end AXIS_DESCR /end CHARACTERISTIC
/begin CHARACTERISTIC UNK_KF_MISC_1A5FC "Unidentified map (chapter by calling function: unknown). Raw values. [unassigned]" MAP 0x7A5FC RL_MAP_SW_SW_SW 0 CM_0000 -32768 32767 /begin AXIS_DESCR STD_AXIS NO_INPUT_QUANTITY CM_0000 4 -32768 32767 /end AXIS_DESCR /begin AXIS_DESCR STD_AXIS NO_INPUT_QUANTITY CM_0000 6 -32768 32767 /end AXIS_DESCR /end CHARACTERISTIC
/begin CHARACTERISTIC UNK_KL_MISC_1AC36 "Unidentified curve (chapter by calling function: unknown). Raw values. [unassigned]" CURVE 0x7AC36 RL_CUR_SW_UW 0 CM_0000 0 65535 /begin AXIS_DESCR STD_AXIS NO_INPUT_QUANTITY CM_0000 6 -32768 32767 /end AXIS_DESCR /end CHARACTERISTIC
/begin CHARACTERISTIC UNK_KF_MISC_1D076 "Unidentified map (chapter by calling function: unknown). Raw values. [unassigned]" MAP 0x7D076 RL_MAP_SW_SW_SW 0 CM_0000 -32768 32767 /begin AXIS_DESCR STD_AXIS NO_INPUT_QUANTITY CM_0000 6 -32768 32767 /end AXIS_DESCR /begin AXIS_DESCR STD_AXIS NO_INPUT_QUANTITY CM_0000 4 -32768 32767 /end AXIS_DESCR /end CHARACTERISTIC
/begin CHARACTERISTIC UNK_KF_MISC_1D0BC "Unidentified map (chapter by calling function: unknown). Raw values. [unassigned]" MAP 0x7D0BC RL_MAP_SW_SW_SW 0 CM_0000 -32768 32767 /begin AXIS_DESCR STD_AXIS NO_INPUT_QUANTITY CM_0000 6 -32768 32767 /end AXIS_DESCR /begin AXIS_DESCR STD_AXIS NO_INPUT_QUANTITY CM_0000 4 -32768 32767 /end AXIS_DESCR /end CHARACTERISTIC
/begin CHARACTERISTIC UNK_KL_ANSAUGLU_1D666 "Unidentified curve (chapter by calling function: Ansauglufttemperatur). Raw values. [unassigned]" CURVE 0x7D666 RL_CUR_SW_UW 0 CM_0000 0 65535 /begin AXIS_DESCR STD_AXIS NO_INPUT_QUANTITY CM_0000 6 -32768 32767 /end AXIS_DESCR /end CHARACTERISTIC
/begin CHARACTERISTIC UNK_KL_ANSAUGLU_1D680 "Unidentified curve (chapter by calling function: Ansauglufttemperatur). Raw values. [unassigned]" CURVE 0x7D680 RL_CUR_SW_SW 0 CM_0000 -32768 32767 /begin AXIS_DESCR STD_AXIS NO_INPUT_QUANTITY CM_0000 6 -32768 32767 /end AXIS_DESCR /end CHARACTERISTIC
/begin CHARACTERISTIC UNK_KL_ANSAUGLU_1D69A "Unidentified curve (chapter by calling function: Ansauglufttemperatur). Raw values. [unassigned]" CURVE 0x7D69A RL_CUR_SW_UW 0 CM_0000 0 65535 /begin AXIS_DESCR STD_AXIS NO_INPUT_QUANTITY CM_0000 6 -32768 32767 /end AXIS_DESCR /end CHARACTERISTIC
/begin CHARACTERISTIC UNK_KL_ANSAUGLU_1D6B4 "Unidentified curve (chapter by calling function: Ansauglufttemperatur). Raw values. [unassigned]" CURVE 0x7D6B4 RL_CUR_SW_SW 0 CM_0000 -32768 32767 /begin AXIS_DESCR STD_AXIS NO_INPUT_QUANTITY CM_0000 5 -32768 32767 /end AXIS_DESCR /end CHARACTERISTIC
/begin CHARACTERISTIC UNK_KL_ANSAUGLU_1D6CA "Unidentified curve (chapter by calling function: Ansauglufttemperatur). Raw values. [unassigned]" CURVE 0x7D6CA RL_CUR_SW_SW 0 CM_0000 -32768 32767 /begin AXIS_DESCR STD_AXIS NO_INPUT_QUANTITY CM_0000 5 -32768 32767 /end AXIS_DESCR /end CHARACTERISTIC
/begin CHARACTERISTIC UNK_KL_ZNDUNG_1D992 "Unidentified curve (chapter by calling function: Z?ndung). Raw values. [unassigned]" CURVE 0x7D992 RL_CUR_SW_SW 0 CM_0000 -32768 32767 /begin AXIS_DESCR STD_AXIS NO_INPUT_QUANTITY CM_0000 6 -32768 32767 /end AXIS_DESCR /end CHARACTERISTIC
/begin CHARACTERISTIC K_ED_AUSS_ABG_MULT.FEHLERSCHWELLE "Filterschwelle fuer Fehlereintrag [A2L-ref]" VALUE 0x71373 RL_VAL_UB 0 CM_0000 0 255 /end CHARACTERISTIC
/begin CHARACTERISTIC K_ED_AUSS_ABG_MULT.INC_VOR_EINTRAG "Filtererhoehung vorm Fehlerspeichereintrag [A2L-ref]" VALUE 0x71375 RL_VAL_UB 0 CM_0000 0 255 /end CHARACTERISTIC
/begin CHARACTERISTIC K_ED_AUSS_ABG_MULT.OK_SCHWELLE "Filterschwelle fuer Fehleraustrag [A2L-ref]" VALUE 0x71374 RL_VAL_UB 0 CM_0000 0 255 /end CHARACTERISTIC
/begin CHARACTERISTIC K_ED_INDEX_84_IGN.P_CODE_OPENLOAD "P-Code fuer die Art OPENLOAD [A2L-ref]" VALUE 0x71352 RL_VAL_UW 0 CM_0000 0 65535 /end CHARACTERISTIC
/begin CHARACTERISTIC K_ED_INDEX_84_IGN.P_CODE_SH_TO_GND "P-Code fuer die Art SH_TO_GND [A2L-ref]" VALUE 0x71350 RL_VAL_UW 0 CM_0000 0 65535 /end CHARACTERISTIC
/begin CHARACTERISTIC K_ED_INDEX_84_IGN.P_CODE_SH_TO_UB "P-Code fuer die Art SH_TO_UB [A2L-ref]" VALUE 0x7134E RL_VAL_UW 0 CM_0000 0 65535 /end CHARACTERISTIC
/begin CHARACTERISTIC K_ED_INDEX_84_IGN.P_CODE_UNPLAUSIBEL "P-Code fuer die Art UNPLAUSIBEL [A2L-ref]" VALUE 0x71354 RL_VAL_UW 0 CM_0000 0 65535 /end CHARACTERISTIC
/begin CHARACTERISTIC K_ED_INDEX_85_IGN.P_CODE_OPENLOAD "P-Code fuer die Art OPENLOAD [A2L-ref]" VALUE 0x7136C RL_VAL_UW 0 CM_0000 0 65535 /end CHARACTERISTIC
/begin CHARACTERISTIC K_ED_INDEX_85_IGN.P_CODE_SH_TO_GND "P-Code fuer die Art SH_TO_GND [A2L-ref]" VALUE 0x7136A RL_VAL_UW 0 CM_0000 0 65535 /end CHARACTERISTIC
/begin CHARACTERISTIC K_ED_INDEX_85_IGN.P_CODE_SH_TO_UB "P-Code fuer die Art SH_TO_UB [A2L-ref]" VALUE 0x71368 RL_VAL_UW 0 CM_0000 0 65535 /end CHARACTERISTIC
/begin CHARACTERISTIC K_ED_INDEX_85_IGN.P_CODE_UNPLAUSIBEL "P-Code fuer die Art UNPLAUSIBEL [A2L-ref]" VALUE 0x7136E RL_VAL_UW 0 CM_0000 0 65535 /end CHARACTERISTIC
/begin CHARACTERISTIC K_ED_INDEX_88_IGN.DEC_NACH_EINTRAG "Filterverringerung nach Fehlerspeichereintrag [A2L-ref]" VALUE 0x713A9 RL_VAL_UB 0 CM_0000 0 255 /end CHARACTERISTIC
/begin CHARACTERISTIC K_ED_INDEX_88_IGN.DEC_VOR_EINTRAG "Filterverringerung vorm Fehlerspeichereintrag [A2L-ref]" VALUE 0x713A7 RL_VAL_UB 0 CM_0000 0 255 /end CHARACTERISTIC
/begin CHARACTERISTIC K_ED_INDEX_88_IGN.FEHLERSCHWELLE "Filterschwelle fuer Fehlereintrag [A2L-ref]" VALUE 0x713A4 RL_VAL_UB 0 CM_0000 0 255 /end CHARACTERISTIC
/begin CHARACTERISTIC K_ED_INDEX_88_IGN.INC_NACH_EINTRAG "Filtererhoehung nach Fehlerspeichereintrag [A2L-ref]" VALUE 0x713A8 RL_VAL_UB 0 CM_0000 0 255 /end CHARACTERISTIC
/begin CHARACTERISTIC K_ED_INDEX_88_IGN.INC_VOR_EINTRAG "Filtererhoehung vorm Fehlerspeichereintrag [A2L-ref]" VALUE 0x713A6 RL_VAL_UB 0 CM_0000 0 255 /end CHARACTERISTIC
/begin CHARACTERISTIC K_ED_INDEX_88_IGN.KLASSENINDEX "Auswahl der Fehlerklasse [A2L-ref]" VALUE 0x713AA RL_VAL_UB 0 CM_0000 0 255 /end CHARACTERISTIC
/begin CHARACTERISTIC K_ED_INDEX_88_IGN.OK_SCHWELLE "Filterschwelle fuer Fehleraustrag [A2L-ref]" VALUE 0x713A5 RL_VAL_UB 0 CM_0000 0 255 /end CHARACTERISTIC
/begin CHARACTERISTIC K_ED_INDEX_88_IGN.P_CODE_OPENLOAD "P-Code fuer die Art OPENLOAD [A2L-ref]" VALUE 0x713A0 RL_VAL_UW 0 CM_0000 0 65535 /end CHARACTERISTIC
/begin CHARACTERISTIC K_ED_INDEX_88_IGN.P_CODE_SH_TO_GND "P-Code fuer die Art SH_TO_GND [A2L-ref]" VALUE 0x7139E RL_VAL_UW 0 CM_0000 0 65535 /end CHARACTERISTIC
/begin CHARACTERISTIC K_ED_INDEX_88_IGN.P_CODE_SH_TO_UB "P-Code fuer die Art SH_TO_UB [A2L-ref]" VALUE 0x7139C RL_VAL_UW 0 CM_0000 0 65535 /end CHARACTERISTIC
/begin CHARACTERISTIC K_ED_INDEX_88_IGN.P_CODE_UNPLAUSIBEL "P-Code fuer die Art UNPLAUSIBEL [A2L-ref]" VALUE 0x713A2 RL_VAL_UW 0 CM_0000 0 65535 /end CHARACTERISTIC
/begin CHARACTERISTIC K_ED_RBM_EVAP_MAX "Maximaltemperatur EVAP [A2L-ref]" VALUE 0x7180E RL_VAL_SW 0 CM_0006 -3550 3003.5 /end CHARACTERISTIC
/begin CHARACTERISTIC K_ED_RBM_EVAP_MIN "Mindesttemperatur EVAP [A2L-ref]" VALUE 0x7180C RL_VAL_SW 0 CM_0006 -3550 3003.5 /end CHARACTERISTIC
/begin CHARACTERISTIC K_ED_SK_TR_IGN.DEC_NACH_EINTRAG "Filterverringerung nach Fehlerspeichereintrag [A2L-ref]" VALUE 0x70B07 RL_VAL_UB 0 CM_0000 0 255 /end CHARACTERISTIC
/begin CHARACTERISTIC K_ED_SK_TR_IGN.DEC_VOR_EINTRAG "Filterverringerung vorm Fehlerspeichereintrag [A2L-ref]" VALUE 0x70B05 RL_VAL_UB 0 CM_0000 0 255 /end CHARACTERISTIC
/begin CHARACTERISTIC K_ED_SK_TR_IGN.FEHLERSCHWELLE "Filterschwelle fuer Fehlereintrag [A2L-ref]" VALUE 0x70B02 RL_VAL_UB 0 CM_0000 0 255 /end CHARACTERISTIC
/begin CHARACTERISTIC K_ED_SK_TR_IGN.INC_NACH_EINTRAG "Filtererhoehung nach Fehlerspeichereintrag [A2L-ref]" VALUE 0x70B06 RL_VAL_UB 0 CM_0000 0 255 /end CHARACTERISTIC
/begin CHARACTERISTIC K_ED_SK_TR_IGN.INC_VOR_EINTRAG "Filtererhoehung vorm Fehlerspeichereintrag [A2L-ref]" VALUE 0x70B04 RL_VAL_UB 0 CM_0000 0 255 /end CHARACTERISTIC
/begin CHARACTERISTIC K_ED_SK_TR_IGN.OK_SCHWELLE "Filterschwelle fuer Fehleraustrag [A2L-ref]" VALUE 0x70B03 RL_VAL_UB 0 CM_0000 0 255 /end CHARACTERISTIC
/begin CHARACTERISTIC K_ED_SK_TR_IGN.P_CODE_OPENLOAD "P-Code fuer die Art OPENLOAD [A2L-ref]" VALUE 0x70AFE RL_VAL_UW 0 CM_0000 0 65535 /end CHARACTERISTIC
/begin CHARACTERISTIC K_ED_SK_TR_IGN.P_CODE_SH_TO_GND "P-Code fuer die Art SH_TO_GND [A2L-ref]" VALUE 0x70AFC RL_VAL_UW 0 CM_0000 0 65535 /end CHARACTERISTIC
/begin CHARACTERISTIC K_ED_SK_TR_IGN.P_CODE_SH_TO_UB "P-Code fuer die Art SH_TO_UB [A2L-ref]" VALUE 0x70AFA RL_VAL_UW 0 CM_0000 0 65535 /end CHARACTERISTIC
/begin CHARACTERISTIC K_ED_SK_TR_IGN.P_CODE_UNPLAUSIBEL "P-Code fuer die Art UNPLAUSIBEL [A2L-ref]" VALUE 0x70B00 RL_VAL_UW 0 CM_0000 0 65535 /end CHARACTERISTIC
/begin CHARACTERISTIC UNK_RD_IGN_10000 "Unidentified constant read directly by IGN 0x4fc,0x1dc8,0x10580 (chapter unknown) [unassigned]" VALUE 0x70000 RL_VAL_UL 0 CM_0000 0 4294967295 /end CHARACTERISTIC
/begin CHARACTERISTIC UNK_RD_IGN_10004 "Unidentified constant read directly by IGN 0x14820 (chapter unknown) [unassigned]" VALUE 0x70004 RL_VAL_UL 0 CM_0000 0 4294967295 /end CHARACTERISTIC
/begin CHARACTERISTIC UNK_RD_IGN_10008 "Unidentified constant read directly by IGN 0x4fc,0x1356c,0x14820 (chapter unknown) [unassigned]" VALUE 0x70008 RL_VAL_UL 0 CM_0000 0 4294967295 /end CHARACTERISTIC
/begin CHARACTERISTIC UNK_RD_IGN_1000C "Unidentified constant read directly by IGN 0x14efc (chapter unknown) [unassigned]" VALUE 0x7000C RL_VAL_UL 0 CM_0000 0 4294967295 /end CHARACTERISTIC
/begin CHARACTERISTIC UNK_RD_IGN_10010 "Unidentified constant read directly by IGN 0x14efc (chapter unknown) [unassigned]" VALUE 0x70010 RL_VAL_UL 0 CM_0000 0 4294967295 /end CHARACTERISTIC
/begin CHARACTERISTIC UNK_RD_IGN_10014 "Unidentified constant read directly by IGN 0x1356c,0x1e71c (chapter unknown) [unassigned]" VALUE 0x70014 RL_VAL_UL 0 CM_0000 0 4294967295 /end CHARACTERISTIC
/begin CHARACTERISTIC UNK_RD_IGN_10018 "Unidentified constant read directly by IGN 0x14820,0x154bc (chapter unknown) [unassigned]" VALUE 0x70018 RL_VAL_UL 0 CM_0000 0 4294967295 /end CHARACTERISTIC
/begin CHARACTERISTIC UNK_RD_IGN_1001C "Unidentified constant read directly by IGN 0x14820,0x14e3c,0x15328 (chapter unknown) [unassigned]" VALUE 0x7001C RL_VAL_UL 0 CM_0000 0 4294967295 /end CHARACTERISTIC
/begin CHARACTERISTIC UNK_RD_IGN_10030 "Unidentified constant read directly by IGN 0x14e3c (chapter unknown) [unassigned]" VALUE 0x70030 RL_VAL_UL 0 CM_0000 0 4294967295 /end CHARACTERISTIC
/begin CHARACTERISTIC UNK_RD_IGN_10080 "Unidentified constant read directly by IGN 0x1356c,0x1e410,0x1e71c (chapter unknown) [unassigned]" VALUE 0x70080 RL_VAL_UL 0 CM_0000 0 4294967295 /end CHARACTERISTIC
/begin CHARACTERISTIC UNK_RD_IGN_101C0 "Unidentified constant read directly by IGN 0x1356c,0x1e71c,0x2fa60 (chapter unknown) [unassigned]" VALUE 0x701C0 RL_VAL_UL 0 CM_0000 0 4294967295 /end CHARACTERISTIC
/begin CHARACTERISTIC UNK_RD_IGN_101C4 "Unidentified constant read directly by IGN 0x1356c,0x2fb1c (SK-Manager) [unassigned]" VALUE 0x701C4 RL_VAL_UL 0 CM_0000 0 4294967295 /end CHARACTERISTIC
/begin CHARACTERISTIC UNK_RD_IGN_101C8 "Unidentified constant read directly by IGN 0x1356c,0x2fb1c (SK-Manager) [unassigned]" VALUE 0x701C8 RL_VAL_UL 0 CM_0000 0 4294967295 /end CHARACTERISTIC
/begin CHARACTERISTIC UNK_RD_IGN_10204 "Unidentified constant read directly by IGN 0x1356c,0x1e71c (chapter unknown) [unassigned]" VALUE 0x70204 RL_VAL_UL 0 CM_0000 0 4294967295 /end CHARACTERISTIC
/begin CHARACTERISTIC UNK_RD_IGN_10208 "Unidentified constant read directly by IGN 0x1356c (chapter unknown) [unassigned]" VALUE 0x70208 RL_VAL_UL 0 CM_0000 0 4294967295 /end CHARACTERISTIC
/begin CHARACTERISTIC UNK_RD_IGN_1020C "Unidentified constant read directly by IGN 0x1356c (chapter unknown) [unassigned]" VALUE 0x7020C RL_VAL_UL 0 CM_0000 0 4294967295 /end CHARACTERISTIC
/begin CHARACTERISTIC UNK_RD_IGN_10253 "Unidentified constant read directly by IGN 0x11865c (chapter unknown) [unassigned]" VALUE 0x70253 RL_VAL_UB 0 CM_0000 0 255 /end CHARACTERISTIC
/begin CHARACTERISTIC UNK_RD_IGN_1028B "Unidentified constant read directly by IGN 0xed198 (Momentenmanager) [unassigned]" VALUE 0x7028B RL_VAL_UL 0 CM_0000 0 4294967295 /end CHARACTERISTIC
/begin CHARACTERISTIC UNK_RD_IGN_10290 "Unidentified constant read directly by IGN 0x66100 (chapter unknown) [unassigned]" VALUE 0x70290 RL_VAL_UB 0 CM_0000 0 255 /end CHARACTERISTIC
/begin CHARACTERISTIC UNK_RD_IGN_10294 "Unidentified constant read directly by IGN 0x29984 (chapter unknown) [unassigned]" VALUE 0x70294 RL_VAL_UB 0 CM_0000 0 255 /end CHARACTERISTIC
/begin CHARACTERISTIC UNK_RD_IGN_10295 "Unidentified constant read directly by IGN 0x29984 (chapter unknown) [unassigned]" VALUE 0x70295 RL_VAL_UB 0 CM_0000 0 255 /end CHARACTERISTIC
/begin CHARACTERISTIC UNK_RD_IGN_10296 "Unidentified constant read directly by IGN 0x29984 (chapter unknown) [unassigned]" VALUE 0x70296 RL_VAL_UB 0 CM_0000 0 255 /end CHARACTERISTIC
/begin CHARACTERISTIC UNK_RD_IGN_10297 "Unidentified constant read directly by IGN 0x29984 (chapter unknown) [unassigned]" VALUE 0x70297 RL_VAL_UB 0 CM_0000 0 255 /end CHARACTERISTIC
/begin CHARACTERISTIC UNK_RD_IGN_10550 "Unidentified constant read directly by IGN 0x2ad44 (Anti-Trampel-Funktion) [unassigned]" VALUE 0x70550 RL_VAL_UB 0 CM_0000 0 255 /end CHARACTERISTIC
/begin CHARACTERISTIC UNK_RD_IGN_10551 "Unidentified constant read directly by IGN 0xd0b08 (Anti-Trampel-Funktion) [unassigned]" VALUE 0x70551 RL_VAL_UB 0 CM_0000 0 255 /end CHARACTERISTIC
/begin CHARACTERISTIC UNK_RD_IGN_10554 "Unidentified constant read directly by IGN 0x2ad44 (Anti-Trampel-Funktion) [unassigned]" VALUE 0x70554 RL_VAL_UW 0 CM_0000 0 65535 /end CHARACTERISTIC
/begin CHARACTERISTIC UNK_RD_IGN_10556 "Unidentified constant read directly by IGN 0x2ad44 (Anti-Trampel-Funktion) [unassigned]" VALUE 0x70556 RL_VAL_UW 0 CM_0000 0 65535 /end CHARACTERISTIC
/begin CHARACTERISTIC UNK_RD_IGN_10558 "Unidentified constant read directly by IGN 0x2ad44 (Anti-Trampel-Funktion) [unassigned]" VALUE 0x70558 RL_VAL_UW 0 CM_0000 0 65535 /end CHARACTERISTIC
/begin CHARACTERISTIC UNK_RD_IGN_1055A "Unidentified constant read directly by IGN 0x2ad44 (Anti-Trampel-Funktion) [unassigned]" VALUE 0x7055A RL_VAL_UW 0 CM_0000 0 65535 /end CHARACTERISTIC
/begin CHARACTERISTIC UNK_RD_IGN_1055C "Unidentified constant read directly by IGN 0x2ad44 (Anti-Trampel-Funktion) [unassigned]" VALUE 0x7055C RL_VAL_UB 0 CM_0000 0 255 /end CHARACTERISTIC
/begin CHARACTERISTIC UNK_RD_IGN_1055E "Unidentified constant read directly by IGN 0x2ad44 (Anti-Trampel-Funktion) [unassigned]" VALUE 0x7055E RL_VAL_UW 0 CM_0000 0 65535 /end CHARACTERISTIC
/begin CHARACTERISTIC UNK_RD_IGN_10565 "Unidentified constant read directly by IGN 0xd0b08 (Anti-Trampel-Funktion) [unassigned]" VALUE 0x70565 RL_VAL_UB 0 CM_0000 0 255 /end CHARACTERISTIC
/begin CHARACTERISTIC UNK_RD_IGN_105A0 "Unidentified constant read directly by IGN 0x2cdac (chapter unknown) [unassigned]" VALUE 0x705A0 RL_VAL_SW 0 CM_0000 -32768 32767 /end CHARACTERISTIC
/begin CHARACTERISTIC UNK_RD_IGN_105A2 "Unidentified constant read directly by IGN 0x2d10c,0x641fc (chapter unknown) [unassigned]" VALUE 0x705A2 RL_VAL_SW 0 CM_0000 -32768 32767 /end CHARACTERISTIC
/begin CHARACTERISTIC UNK_RD_IGN_105AB "Unidentified constant read directly by IGN 0x3157c (Klopfregelung) [unassigned]" VALUE 0x705AB RL_VAL_UB 0 CM_0000 0 255 /end CHARACTERISTIC
/begin CHARACTERISTIC UNK_RD_IGN_105AC "Unidentified constant read directly by IGN 0x3157c,0xd3204 (Klopfregelung) [unassigned]" VALUE 0x705AC RL_VAL_UB 0 CM_0000 0 255 /end CHARACTERISTIC
/begin CHARACTERISTIC UNK_RD_IGN_105AD "Unidentified constant read directly by IGN 0x3157c,0xd3204 (Klopfregelung) [unassigned]" VALUE 0x705AD RL_VAL_UB 0 CM_0000 0 255 /end CHARACTERISTIC
/begin CHARACTERISTIC UNK_RD_IGN_105AE "Unidentified constant read directly by IGN 0x3157c,0xd3204 (Klopfregelung) [unassigned]" VALUE 0x705AE RL_VAL_SW 0 CM_0000 -32768 32767 /end CHARACTERISTIC
/begin CHARACTERISTIC UNK_RD_IGN_105B0 "Unidentified constant read directly by IGN 0x3157c,0xd3204 (Klopfregelung) [unassigned]" VALUE 0x705B0 RL_VAL_SW 0 CM_0000 -32768 32767 /end CHARACTERISTIC
/begin CHARACTERISTIC UNK_RD_IGN_105B4 "Unidentified constant read directly by IGN 0x3157c,0xd3204 (Klopfregelung) [unassigned]" VALUE 0x705B4 RL_VAL_UW 0 CM_0000 0 65535 /end CHARACTERISTIC
/begin CHARACTERISTIC UNK_RD_IGN_105B6 "Unidentified constant read directly by IGN 0x3157c,0xd3204 (Klopfregelung) [unassigned]" VALUE 0x705B6 RL_VAL_UW 0 CM_0000 0 65535 /end CHARACTERISTIC
/begin CHARACTERISTIC UNK_RD_IGN_105C2 "Unidentified constant read directly by IGN 0x2d10c (chapter unknown) [unassigned]" VALUE 0x705C2 RL_VAL_UW 0 CM_0000 0 65535 /end CHARACTERISTIC
/begin CHARACTERISTIC UNK_RD_IGN_105EE "Unidentified constant read directly by IGN 0x2d10c (chapter unknown) [unassigned]" VALUE 0x705EE RL_VAL_UW 0 CM_0000 0 65535 /end CHARACTERISTIC
/begin CHARACTERISTIC UNK_RD_IGN_105F0 "Unidentified constant read directly by IGN 0x2cb5c,0x2d10c (chapter unknown) [unassigned]" VALUE 0x705F0 RL_VAL_SW 0 CM_0000 -32768 32767 /end CHARACTERISTIC
/begin CHARACTERISTIC UNK_RD_IGN_105F2 "Unidentified constant read directly by IGN 0x2cb5c (chapter unknown) [unassigned]" VALUE 0x705F2 RL_VAL_UB 0 CM_0000 0 255 /end CHARACTERISTIC
/begin CHARACTERISTIC UNK_RD_IGN_10604 "Unidentified constant read directly by IGN 0x2ba1c,0x2cdac (chapter unknown) [unassigned]" VALUE 0x70604 RL_VAL_UB 0 CM_0000 0 255 /end CHARACTERISTIC
/begin CHARACTERISTIC UNK_RD_IGN_10A4C "Unidentified constant read directly by IGN 0xd2b10 (chapter unknown) [unassigned]" VALUE 0x70A4C RL_VAL_UB 0 CM_0000 0 255 /end CHARACTERISTIC
/begin CHARACTERISTIC UNK_RD_IGN_10A4D "Unidentified constant read directly by IGN 0xd2b10 (chapter unknown) [unassigned]" VALUE 0x70A4D RL_VAL_UB 0 CM_0000 0 255 /end CHARACTERISTIC
/begin CHARACTERISTIC UNK_RD_IGN_10A4E "Unidentified constant read directly by IGN 0xd2b10 (chapter unknown) [unassigned]" VALUE 0x70A4E RL_VAL_UB 0 CM_0000 0 255 /end CHARACTERISTIC
/begin CHARACTERISTIC UNK_RD_IGN_10A50 "Unidentified constant read directly by IGN 0xd2b10 (chapter unknown) [unassigned]" VALUE 0x70A50 RL_VAL_UW 0 CM_0000 0 65535 /end CHARACTERISTIC
/begin CHARACTERISTIC UNK_RD_IGN_10A52 "Unidentified constant read directly by IGN 0xd2b10 (chapter unknown) [unassigned]" VALUE 0x70A52 RL_VAL_UW 0 CM_0000 0 65535 /end CHARACTERISTIC
/begin CHARACTERISTIC UNK_RD_IGN_10A7A "Unidentified constant read directly by IGN 0x51230 (chapter unknown) [unassigned]" VALUE 0x70A7A RL_VAL_SW 0 CM_0000 -32768 32767 /end CHARACTERISTIC
/begin CHARACTERISTIC UNK_RD_IGN_10A7C "Unidentified constant read directly by IGN 0x30608 (chapter unknown) [unassigned]" VALUE 0x70A7C RL_VAL_SW 0 CM_0000 -32768 32767 /end CHARACTERISTIC
/begin CHARACTERISTIC UNK_RD_IGN_11810 "Unidentified constant read directly by IGN 0x31bdc (chapter unknown) [unassigned]" VALUE 0x71810 RL_VAL_UB 0 CM_0000 0 255 /end CHARACTERISTIC
/begin CHARACTERISTIC UNK_RD_IGN_136AE "Unidentified constant read directly by IGN 0x3e924 (chapter unknown) [unassigned]" VALUE 0x736AE RL_VAL_UB 0 CM_0000 0 255 /end CHARACTERISTIC
/begin CHARACTERISTIC UNK_RD_IGN_136C0 "Unidentified constant read directly by IGN 0x3e924 (chapter unknown) [unassigned]" VALUE 0x736C0 RL_VAL_UB 0 CM_0000 0 255 /end CHARACTERISTIC
/begin CHARACTERISTIC UNK_RD_IGN_13712 "Unidentified constant read directly by IGN 0x3e924,0x4481c (Klopfregelung) [unassigned]" VALUE 0x73712 RL_VAL_UB 0 CM_0000 0 255 /end CHARACTERISTIC
/begin CHARACTERISTIC UNK_RD_IGN_13720 "Unidentified constant read directly by IGN 0x3e9fc,0x44db4,0x64070 (chapter unknown) [unassigned]" VALUE 0x73720 RL_VAL_UB 0 CM_0000 0 255 /end CHARACTERISTIC
/begin CHARACTERISTIC UNK_RD_IGN_13742 "Unidentified constant read directly by IGN 0xf4258,0xf42f8,0xf4424 (chapter unknown) [unassigned]" VALUE 0x73742 RL_VAL_UB 0 CM_0000 0 255 /end CHARACTERISTIC
/begin CHARACTERISTIC UNK_RD_IGN_13744 "Unidentified constant read directly by IGN 0xf4424 (chapter unknown) [unassigned]" VALUE 0x73744 RL_VAL_SW 0 CM_0000 -32768 32767 /end CHARACTERISTIC
/begin CHARACTERISTIC UNK_RD_IGN_13746 "Unidentified constant read directly by IGN 0xf4424 (chapter unknown) [unassigned]" VALUE 0x73746 RL_VAL_SW 0 CM_0000 -32768 32767 /end CHARACTERISTIC
/begin CHARACTERISTIC UNK_RD_IGN_13748 "Unidentified constant read directly by IGN 0xf4424 (chapter unknown) [unassigned]" VALUE 0x73748 RL_VAL_SW 0 CM_0000 -32768 32767 /end CHARACTERISTIC
/begin CHARACTERISTIC UNK_RD_IGN_1374A "Unidentified constant read directly by IGN 0xf4424 (chapter unknown) [unassigned]" VALUE 0x7374A RL_VAL_SW 0 CM_0000 -32768 32767 /end CHARACTERISTIC
/begin CHARACTERISTIC UNK_RD_IGN_1374C "Unidentified constant read directly by IGN 0xf4424 (chapter unknown) [unassigned]" VALUE 0x7374C RL_VAL_SW 0 CM_0000 -32768 32767 /end CHARACTERISTIC
/begin CHARACTERISTIC UNK_RD_IGN_1374E "Unidentified constant read directly by IGN 0xf42f8 (chapter unknown) [unassigned]" VALUE 0x7374E RL_VAL_UB 0 CM_0000 0 255 /end CHARACTERISTIC
/begin CHARACTERISTIC UNK_RD_IGN_13774 "Unidentified constant read directly by IGN 0xf463c (chapter unknown) [unassigned]" VALUE 0x73774 RL_VAL_UL 0 CM_0000 0 4294967295 /end CHARACTERISTIC
/begin CHARACTERISTIC UNK_RD_IGN_13778 "Unidentified constant read directly by IGN 0xf463c (chapter unknown) [unassigned]" VALUE 0x73778 RL_VAL_UL 0 CM_0000 0 4294967295 /end CHARACTERISTIC
/begin CHARACTERISTIC UNK_RD_IGN_1377C "Unidentified constant read directly by IGN 0xf463c (chapter unknown) [unassigned]" VALUE 0x7377C RL_VAL_UL 0 CM_0000 0 4294967295 /end CHARACTERISTIC
/begin CHARACTERISTIC UNK_RD_IGN_13780 "Unidentified constant read directly by IGN 0xf463c (chapter unknown) [unassigned]" VALUE 0x73780 RL_VAL_UL 0 CM_0000 0 4294967295 /end CHARACTERISTIC
/begin CHARACTERISTIC UNK_RD_IGN_13784 "Unidentified constant read directly by IGN 0xf463c (chapter unknown) [unassigned]" VALUE 0x73784 RL_VAL_UL 0 CM_0000 0 4294967295 /end CHARACTERISTIC
/begin CHARACTERISTIC UNK_RD_IGN_13788 "Unidentified constant read directly by IGN 0xf463c (chapter unknown) [unassigned]" VALUE 0x73788 RL_VAL_UL 0 CM_0000 0 4294967295 /end CHARACTERISTIC
/begin CHARACTERISTIC UNK_RD_IGN_1378C "Unidentified constant read directly by IGN 0xf463c (chapter unknown) [unassigned]" VALUE 0x7378C RL_VAL_UL 0 CM_0000 0 4294967295 /end CHARACTERISTIC
/begin CHARACTERISTIC UNK_RD_IGN_13790 "Unidentified constant read directly by IGN 0xf463c (chapter unknown) [unassigned]" VALUE 0x73790 RL_VAL_UL 0 CM_0000 0 4294967295 /end CHARACTERISTIC
/begin CHARACTERISTIC UNK_RD_IGN_13794 "Unidentified constant read directly by IGN 0xf463c (chapter unknown) [unassigned]" VALUE 0x73794 RL_VAL_UL 0 CM_0000 0 4294967295 /end CHARACTERISTIC
/begin CHARACTERISTIC UNK_RD_IGN_13798 "Unidentified constant read directly by IGN 0xf463c (chapter unknown) [unassigned]" VALUE 0x73798 RL_VAL_UL 0 CM_0000 0 4294967295 /end CHARACTERISTIC
/begin CHARACTERISTIC UNK_RD_IGN_1379C "Unidentified constant read directly by IGN 0xf463c (chapter unknown) [unassigned]" VALUE 0x7379C RL_VAL_UL 0 CM_0000 0 4294967295 /end CHARACTERISTIC
/begin CHARACTERISTIC UNK_RD_IGN_137A0 "Unidentified constant read directly by IGN 0xf463c (chapter unknown) [unassigned]" VALUE 0x737A0 RL_VAL_UL 0 CM_0000 0 4294967295 /end CHARACTERISTIC
/begin CHARACTERISTIC UNK_RD_IGN_137A4 "Unidentified constant read directly by IGN 0xf463c (chapter unknown) [unassigned]" VALUE 0x737A4 RL_VAL_UL 0 CM_0000 0 4294967295 /end CHARACTERISTIC
/begin CHARACTERISTIC UNK_RD_IGN_137A8 "Unidentified constant read directly by IGN 0xf463c (chapter unknown) [unassigned]" VALUE 0x737A8 RL_VAL_UL 0 CM_0000 0 4294967295 /end CHARACTERISTIC
/begin CHARACTERISTIC UNK_RD_IGN_137AC "Unidentified constant read directly by IGN 0xf463c (chapter unknown) [unassigned]" VALUE 0x737AC RL_VAL_UL 0 CM_0000 0 4294967295 /end CHARACTERISTIC
/begin CHARACTERISTIC UNK_RD_IGN_137B0 "Unidentified constant read directly by IGN 0xf463c (chapter unknown) [unassigned]" VALUE 0x737B0 RL_VAL_UL 0 CM_0000 0 4294967295 /end CHARACTERISTIC
/begin CHARACTERISTIC UNK_RD_IGN_137B4 "Unidentified constant read directly by IGN 0xf463c (chapter unknown) [unassigned]" VALUE 0x737B4 RL_VAL_UL 0 CM_0000 0 4294967295 /end CHARACTERISTIC
/begin CHARACTERISTIC UNK_RD_IGN_137B8 "Unidentified constant read directly by IGN 0xf463c (chapter unknown) [unassigned]" VALUE 0x737B8 RL_VAL_UL 0 CM_0000 0 4294967295 /end CHARACTERISTIC
/begin CHARACTERISTIC UNK_RD_IGN_137BC "Unidentified constant read directly by IGN 0xf463c (chapter unknown) [unassigned]" VALUE 0x737BC RL_VAL_UL 0 CM_0000 0 4294967295 /end CHARACTERISTIC
/begin CHARACTERISTIC UNK_RD_IGN_137C0 "Unidentified constant read directly by IGN 0xf463c (chapter unknown) [unassigned]" VALUE 0x737C0 RL_VAL_UL 0 CM_0000 0 4294967295 /end CHARACTERISTIC
/begin CHARACTERISTIC UNK_RD_IGN_137C4 "Unidentified constant read directly by IGN 0xf463c (chapter unknown) [unassigned]" VALUE 0x737C4 RL_VAL_UL 0 CM_0000 0 4294967295 /end CHARACTERISTIC
/begin CHARACTERISTIC UNK_RD_IGN_137C8 "Unidentified constant read directly by IGN 0xf463c (chapter unknown) [unassigned]" VALUE 0x737C8 RL_VAL_UL 0 CM_0000 0 4294967295 /end CHARACTERISTIC
/begin CHARACTERISTIC UNK_RD_IGN_137CC "Unidentified constant read directly by IGN 0xf463c (chapter unknown) [unassigned]" VALUE 0x737CC RL_VAL_UL 0 CM_0000 0 4294967295 /end CHARACTERISTIC
/begin CHARACTERISTIC UNK_RD_IGN_137D0 "Unidentified constant read directly by IGN 0xf463c (chapter unknown) [unassigned]" VALUE 0x737D0 RL_VAL_UL 0 CM_0000 0 4294967295 /end CHARACTERISTIC
/begin CHARACTERISTIC UNK_RD_IGN_137D4 "Unidentified constant read directly by IGN 0xf463c (chapter unknown) [unassigned]" VALUE 0x737D4 RL_VAL_UL 0 CM_0000 0 4294967295 /end CHARACTERISTIC
/begin CHARACTERISTIC UNK_RD_IGN_137D8 "Unidentified constant read directly by IGN 0xf463c (chapter unknown) [unassigned]" VALUE 0x737D8 RL_VAL_UL 0 CM_0000 0 4294967295 /end CHARACTERISTIC
/begin CHARACTERISTIC UNK_RD_IGN_137DC "Unidentified constant read directly by IGN 0xf463c (chapter unknown) [unassigned]" VALUE 0x737DC RL_VAL_UL 0 CM_0000 0 4294967295 /end CHARACTERISTIC
/begin CHARACTERISTIC UNK_RD_IGN_137E0 "Unidentified constant read directly by IGN 0xf463c (chapter unknown) [unassigned]" VALUE 0x737E0 RL_VAL_UL 0 CM_0000 0 4294967295 /end CHARACTERISTIC
/begin CHARACTERISTIC UNK_RD_IGN_137E4 "Unidentified constant read directly by IGN 0xf463c (chapter unknown) [unassigned]" VALUE 0x737E4 RL_VAL_UL 0 CM_0000 0 4294967295 /end CHARACTERISTIC
/begin CHARACTERISTIC UNK_RD_IGN_137E8 "Unidentified constant read directly by IGN 0xf463c (chapter unknown) [unassigned]" VALUE 0x737E8 RL_VAL_UL 0 CM_0000 0 4294967295 /end CHARACTERISTIC
/begin CHARACTERISTIC UNK_RD_IGN_137EC "Unidentified constant read directly by IGN 0xf463c (chapter unknown) [unassigned]" VALUE 0x737EC RL_VAL_UL 0 CM_0000 0 4294967295 /end CHARACTERISTIC
/begin CHARACTERISTIC UNK_RD_IGN_137F0 "Unidentified constant read directly by IGN 0xf463c (chapter unknown) [unassigned]" VALUE 0x737F0 RL_VAL_UL 0 CM_0000 0 4294967295 /end CHARACTERISTIC
/begin CHARACTERISTIC UNK_RD_IGN_137F4 "Unidentified constant read directly by IGN 0xf463c (chapter unknown) [unassigned]" VALUE 0x737F4 RL_VAL_UL 0 CM_0000 0 4294967295 /end CHARACTERISTIC
/begin CHARACTERISTIC UNK_RD_IGN_137F8 "Unidentified constant read directly by IGN 0xf463c (chapter unknown) [unassigned]" VALUE 0x737F8 RL_VAL_UL 0 CM_0000 0 4294967295 /end CHARACTERISTIC
/begin CHARACTERISTIC UNK_RD_IGN_137FC "Unidentified constant read directly by IGN 0xf463c (chapter unknown) [unassigned]" VALUE 0x737FC RL_VAL_UL 0 CM_0000 0 4294967295 /end CHARACTERISTIC
/begin CHARACTERISTIC UNK_RD_IGN_13800 "Unidentified constant read directly by IGN 0xf463c (chapter unknown) [unassigned]" VALUE 0x73800 RL_VAL_UL 0 CM_0000 0 4294967295 /end CHARACTERISTIC
/begin CHARACTERISTIC UNK_RD_IGN_13804 "Unidentified constant read directly by IGN 0xf463c (chapter unknown) [unassigned]" VALUE 0x73804 RL_VAL_UL 0 CM_0000 0 4294967295 /end CHARACTERISTIC
/begin CHARACTERISTIC UNK_RD_IGN_13808 "Unidentified constant read directly by IGN 0xf463c (chapter unknown) [unassigned]" VALUE 0x73808 RL_VAL_UL 0 CM_0000 0 4294967295 /end CHARACTERISTIC
/begin CHARACTERISTIC UNK_RD_IGN_1380C "Unidentified constant read directly by IGN 0xf463c (chapter unknown) [unassigned]" VALUE 0x7380C RL_VAL_UL 0 CM_0000 0 4294967295 /end CHARACTERISTIC
/begin CHARACTERISTIC UNK_RD_IGN_13810 "Unidentified constant read directly by IGN 0xf463c (chapter unknown) [unassigned]" VALUE 0x73810 RL_VAL_UL 0 CM_0000 0 4294967295 /end CHARACTERISTIC
/begin CHARACTERISTIC UNK_RD_IGN_13814 "Unidentified constant read directly by IGN 0xf463c (chapter unknown) [unassigned]" VALUE 0x73814 RL_VAL_UL 0 CM_0000 0 4294967295 /end CHARACTERISTIC
/begin CHARACTERISTIC UNK_RD_IGN_13818 "Unidentified constant read directly by IGN 0xf463c (chapter unknown) [unassigned]" VALUE 0x73818 RL_VAL_UL 0 CM_0000 0 4294967295 /end CHARACTERISTIC
/begin CHARACTERISTIC UNK_RD_IGN_1381C "Unidentified constant read directly by IGN 0xf463c (chapter unknown) [unassigned]" VALUE 0x7381C RL_VAL_UL 0 CM_0000 0 4294967295 /end CHARACTERISTIC
/begin CHARACTERISTIC UNK_RD_IGN_13820 "Unidentified constant read directly by IGN 0xf463c (chapter unknown) [unassigned]" VALUE 0x73820 RL_VAL_UL 0 CM_0000 0 4294967295 /end CHARACTERISTIC
/begin CHARACTERISTIC UNK_RD_IGN_13824 "Unidentified constant read directly by IGN 0xf463c (chapter unknown) [unassigned]" VALUE 0x73824 RL_VAL_UL 0 CM_0000 0 4294967295 /end CHARACTERISTIC
/begin CHARACTERISTIC UNK_RD_IGN_13828 "Unidentified constant read directly by IGN 0xf463c (chapter unknown) [unassigned]" VALUE 0x73828 RL_VAL_UL 0 CM_0000 0 4294967295 /end CHARACTERISTIC
/begin CHARACTERISTIC UNK_RD_IGN_1382C "Unidentified constant read directly by IGN 0xf463c (chapter unknown) [unassigned]" VALUE 0x7382C RL_VAL_UL 0 CM_0000 0 4294967295 /end CHARACTERISTIC
/begin CHARACTERISTIC UNK_RD_IGN_13830 "Unidentified constant read directly by IGN 0xf463c (chapter unknown) [unassigned]" VALUE 0x73830 RL_VAL_UL 0 CM_0000 0 4294967295 /end CHARACTERISTIC
/begin CHARACTERISTIC UNK_RD_IGN_13834 "Unidentified constant read directly by IGN 0xf463c (chapter unknown) [unassigned]" VALUE 0x73834 RL_VAL_SW 0 CM_0000 -32768 32767 /end CHARACTERISTIC
/begin CHARACTERISTIC UNK_RD_IGN_13836 "Unidentified constant read directly by IGN 0xf463c (chapter unknown) [unassigned]" VALUE 0x73836 RL_VAL_SW 0 CM_0000 -32768 32767 /end CHARACTERISTIC
/begin CHARACTERISTIC UNK_RD_IGN_13838 "Unidentified constant read directly by IGN 0xf463c (chapter unknown) [unassigned]" VALUE 0x73838 RL_VAL_UW 0 CM_0000 0 65535 /end CHARACTERISTIC
/begin CHARACTERISTIC UNK_RD_IGN_1383A "Unidentified constant read directly by IGN 0xf463c (chapter unknown) [unassigned]" VALUE 0x7383A RL_VAL_UW 0 CM_0000 0 65535 /end CHARACTERISTIC
/begin CHARACTERISTIC UNK_RD_IGN_1383C "Unidentified constant read directly by IGN 0xf463c (chapter unknown) [unassigned]" VALUE 0x7383C RL_VAL_UW 0 CM_0000 0 65535 /end CHARACTERISTIC
/begin CHARACTERISTIC UNK_RD_IGN_1383E "Unidentified constant read directly by IGN 0xf463c (chapter unknown) [unassigned]" VALUE 0x7383E RL_VAL_UW 0 CM_0000 0 65535 /end CHARACTERISTIC
/begin CHARACTERISTIC UNK_RD_IGN_13840 "Unidentified constant read directly by IGN 0xf463c (chapter unknown) [unassigned]" VALUE 0x73840 RL_VAL_UW 0 CM_0000 0 65535 /end CHARACTERISTIC
/begin CHARACTERISTIC UNK_RD_IGN_13842 "Unidentified constant read directly by IGN 0xf463c (chapter unknown) [unassigned]" VALUE 0x73842 RL_VAL_UW 0 CM_0000 0 65535 /end CHARACTERISTIC
/begin CHARACTERISTIC UNK_RD_IGN_13844 "Unidentified constant read directly by IGN 0xf463c (chapter unknown) [unassigned]" VALUE 0x73844 RL_VAL_UW 0 CM_0000 0 65535 /end CHARACTERISTIC
/begin CHARACTERISTIC UNK_RD_IGN_13846 "Unidentified constant read directly by IGN 0xf463c (chapter unknown) [unassigned]" VALUE 0x73846 RL_VAL_UW 0 CM_0000 0 65535 /end CHARACTERISTIC
/begin CHARACTERISTIC UNK_RD_IGN_13848 "Unidentified constant read directly by IGN 0xf463c (chapter unknown) [unassigned]" VALUE 0x73848 RL_VAL_UB 0 CM_0000 0 255 /end CHARACTERISTIC
/begin CHARACTERISTIC UNK_RD_IGN_13849 "Unidentified constant read directly by IGN 0xf463c (chapter unknown) [unassigned]" VALUE 0x73849 RL_VAL_UB 0 CM_0000 0 255 /end CHARACTERISTIC
/begin CHARACTERISTIC UNK_RD_IGN_1384A "Unidentified constant read directly by IGN 0xf463c (chapter unknown) [unassigned]" VALUE 0x7384A RL_VAL_UB 0 CM_0000 0 255 /end CHARACTERISTIC
/begin CHARACTERISTIC UNK_RD_IGN_1384B "Unidentified constant read directly by IGN 0xf463c (chapter unknown) [unassigned]" VALUE 0x7384B RL_VAL_UB 0 CM_0000 0 255 /end CHARACTERISTIC
/begin CHARACTERISTIC UNK_RD_IGN_1384C "Unidentified constant read directly by IGN 0xf463c (chapter unknown) [unassigned]" VALUE 0x7384C RL_VAL_UB 0 CM_0000 0 255 /end CHARACTERISTIC
/begin CHARACTERISTIC UNK_RD_IGN_1384D "Unidentified constant read directly by IGN 0xf463c (chapter unknown) [unassigned]" VALUE 0x7384D RL_VAL_UB 0 CM_0000 0 255 /end CHARACTERISTIC
/begin CHARACTERISTIC UNK_RD_IGN_1384E "Unidentified constant read directly by IGN 0xf463c (chapter unknown) [unassigned]" VALUE 0x7384E RL_VAL_UB 0 CM_0000 0 255 /end CHARACTERISTIC
/begin CHARACTERISTIC UNK_RD_IGN_1384F "Unidentified constant read directly by IGN 0xf463c (chapter unknown) [unassigned]" VALUE 0x7384F RL_VAL_UB 0 CM_0000 0 255 /end CHARACTERISTIC
/begin CHARACTERISTIC UNK_RD_IGN_13850 "Unidentified constant read directly by IGN 0xf463c (chapter unknown) [unassigned]" VALUE 0x73850 RL_VAL_UB 0 CM_0000 0 255 /end CHARACTERISTIC
/begin CHARACTERISTIC UNK_RD_IGN_13851 "Unidentified constant read directly by IGN 0xf463c (chapter unknown) [unassigned]" VALUE 0x73851 RL_VAL_UB 0 CM_0000 0 255 /end CHARACTERISTIC
/begin CHARACTERISTIC UNK_RD_IGN_13852 "Unidentified constant read directly by IGN 0xf463c (chapter unknown) [unassigned]" VALUE 0x73852 RL_VAL_UB 0 CM_0000 0 255 /end CHARACTERISTIC
/begin CHARACTERISTIC UNK_RD_IGN_13853 "Unidentified constant read directly by IGN 0xf463c (chapter unknown) [unassigned]" VALUE 0x73853 RL_VAL_UB 0 CM_0000 0 255 /end CHARACTERISTIC
/begin CHARACTERISTIC UNK_RD_IGN_13854 "Unidentified constant read directly by IGN 0xf463c (chapter unknown) [unassigned]" VALUE 0x73854 RL_VAL_UB 0 CM_0000 0 255 /end CHARACTERISTIC
/begin CHARACTERISTIC UNK_RD_IGN_13855 "Unidentified constant read directly by IGN 0xf463c (chapter unknown) [unassigned]" VALUE 0x73855 RL_VAL_UB 0 CM_0000 0 255 /end CHARACTERISTIC
/begin CHARACTERISTIC UNK_RD_IGN_13856 "Unidentified constant read directly by IGN 0xf463c (chapter unknown) [unassigned]" VALUE 0x73856 RL_VAL_UB 0 CM_0000 0 255 /end CHARACTERISTIC
/begin CHARACTERISTIC UNK_RD_IGN_13857 "Unidentified constant read directly by IGN 0xf463c (chapter unknown) [unassigned]" VALUE 0x73857 RL_VAL_UB 0 CM_0000 0 255 /end CHARACTERISTIC
/begin CHARACTERISTIC UNK_RD_IGN_13858 "Unidentified constant read directly by IGN 0xf463c (chapter unknown) [unassigned]" VALUE 0x73858 RL_VAL_UB 0 CM_0000 0 255 /end CHARACTERISTIC
/begin CHARACTERISTIC UNK_RD_IGN_13859 "Unidentified constant read directly by IGN 0xf463c (chapter unknown) [unassigned]" VALUE 0x73859 RL_VAL_UB 0 CM_0000 0 255 /end CHARACTERISTIC
/begin CHARACTERISTIC UNK_RD_IGN_1385A "Unidentified constant read directly by IGN 0xf463c (chapter unknown) [unassigned]" VALUE 0x7385A RL_VAL_UB 0 CM_0000 0 255 /end CHARACTERISTIC
/begin CHARACTERISTIC UNK_RD_IGN_1385B "Unidentified constant read directly by IGN 0xf463c (chapter unknown) [unassigned]" VALUE 0x7385B RL_VAL_UB 0 CM_0000 0 255 /end CHARACTERISTIC
/begin CHARACTERISTIC UNK_RD_IGN_1385C "Unidentified constant read directly by IGN 0xf463c (chapter unknown) [unassigned]" VALUE 0x7385C RL_VAL_UB 0 CM_0000 0 255 /end CHARACTERISTIC
/begin CHARACTERISTIC UNK_RD_IGN_1385D "Unidentified constant read directly by IGN 0xf463c (chapter unknown) [unassigned]" VALUE 0x7385D RL_VAL_UB 0 CM_0000 0 255 /end CHARACTERISTIC
/begin CHARACTERISTIC UNK_RD_IGN_1385E "Unidentified constant read directly by IGN 0xf463c (chapter unknown) [unassigned]" VALUE 0x7385E RL_VAL_UB 0 CM_0000 0 255 /end CHARACTERISTIC
/begin CHARACTERISTIC UNK_RD_IGN_1385F "Unidentified constant read directly by IGN 0xf463c (chapter unknown) [unassigned]" VALUE 0x7385F RL_VAL_UB 0 CM_0000 0 255 /end CHARACTERISTIC
/begin CHARACTERISTIC UNK_RD_IGN_13860 "Unidentified constant read directly by IGN 0xf463c (chapter unknown) [unassigned]" VALUE 0x73860 RL_VAL_UB 0 CM_0000 0 255 /end CHARACTERISTIC
/begin CHARACTERISTIC UNK_RD_IGN_13861 "Unidentified constant read directly by IGN 0xf463c (chapter unknown) [unassigned]" VALUE 0x73861 RL_VAL_UB 0 CM_0000 0 255 /end CHARACTERISTIC
/begin CHARACTERISTIC UNK_RD_IGN_13862 "Unidentified constant read directly by IGN 0xf463c (chapter unknown) [unassigned]" VALUE 0x73862 RL_VAL_UB 0 CM_0000 0 255 /end CHARACTERISTIC
/begin CHARACTERISTIC UNK_RD_IGN_13863 "Unidentified constant read directly by IGN 0xf463c (chapter unknown) [unassigned]" VALUE 0x73863 RL_VAL_UB 0 CM_0000 0 255 /end CHARACTERISTIC
/begin CHARACTERISTIC UNK_RD_IGN_13864 "Unidentified constant read directly by IGN 0xf463c (chapter unknown) [unassigned]" VALUE 0x73864 RL_VAL_UB 0 CM_0000 0 255 /end CHARACTERISTIC
/begin CHARACTERISTIC UNK_RD_IGN_13865 "Unidentified constant read directly by IGN 0xf463c (chapter unknown) [unassigned]" VALUE 0x73865 RL_VAL_UB 0 CM_0000 0 255 /end CHARACTERISTIC
/begin CHARACTERISTIC UNK_RD_IGN_13866 "Unidentified constant read directly by IGN 0xf463c (chapter unknown) [unassigned]" VALUE 0x73866 RL_VAL_UB 0 CM_0000 0 255 /end CHARACTERISTIC
/begin CHARACTERISTIC UNK_RD_IGN_13867 "Unidentified constant read directly by IGN 0xf463c (chapter unknown) [unassigned]" VALUE 0x73867 RL_VAL_UB 0 CM_0000 0 255 /end CHARACTERISTIC
/begin CHARACTERISTIC UNK_RD_IGN_13868 "Unidentified constant read directly by IGN 0xf463c (chapter unknown) [unassigned]" VALUE 0x73868 RL_VAL_UB 0 CM_0000 0 255 /end CHARACTERISTIC
/begin CHARACTERISTIC UNK_RD_IGN_13869 "Unidentified constant read directly by IGN 0xf463c (chapter unknown) [unassigned]" VALUE 0x73869 RL_VAL_UB 0 CM_0000 0 255 /end CHARACTERISTIC
/begin CHARACTERISTIC UNK_RD_IGN_1386A "Unidentified constant read directly by IGN 0xf463c (chapter unknown) [unassigned]" VALUE 0x7386A RL_VAL_UB 0 CM_0000 0 255 /end CHARACTERISTIC
/begin CHARACTERISTIC UNK_RD_IGN_1386B "Unidentified constant read directly by IGN 0xf463c (chapter unknown) [unassigned]" VALUE 0x7386B RL_VAL_UB 0 CM_0000 0 255 /end CHARACTERISTIC
/begin CHARACTERISTIC UNK_RD_IGN_1386C "Unidentified constant read directly by IGN 0xf463c (chapter unknown) [unassigned]" VALUE 0x7386C RL_VAL_UB 0 CM_0000 0 255 /end CHARACTERISTIC
/begin CHARACTERISTIC UNK_RD_IGN_1386D "Unidentified constant read directly by IGN 0xf463c (chapter unknown) [unassigned]" VALUE 0x7386D RL_VAL_UB 0 CM_0000 0 255 /end CHARACTERISTIC
/begin CHARACTERISTIC UNK_RD_IGN_1386E "Unidentified constant read directly by IGN 0xf463c (chapter unknown) [unassigned]" VALUE 0x7386E RL_VAL_UB 0 CM_0000 0 255 /end CHARACTERISTIC
/begin CHARACTERISTIC UNK_RD_IGN_1386F "Unidentified constant read directly by IGN 0xf463c (chapter unknown) [unassigned]" VALUE 0x7386F RL_VAL_UB 0 CM_0000 0 255 /end CHARACTERISTIC
/begin CHARACTERISTIC UNK_RD_IGN_13870 "Unidentified constant read directly by IGN 0xf463c (chapter unknown) [unassigned]" VALUE 0x73870 RL_VAL_UB 0 CM_0000 0 255 /end CHARACTERISTIC
/begin CHARACTERISTIC UNK_RD_IGN_13871 "Unidentified constant read directly by IGN 0xf463c (chapter unknown) [unassigned]" VALUE 0x73871 RL_VAL_UB 0 CM_0000 0 255 /end CHARACTERISTIC
/begin CHARACTERISTIC UNK_RD_IGN_13872 "Unidentified constant read directly by IGN 0xf463c (chapter unknown) [unassigned]" VALUE 0x73872 RL_VAL_UB 0 CM_0000 0 255 /end CHARACTERISTIC
/begin CHARACTERISTIC UNK_RD_IGN_13873 "Unidentified constant read directly by IGN 0xf463c (chapter unknown) [unassigned]" VALUE 0x73873 RL_VAL_UB 0 CM_0000 0 255 /end CHARACTERISTIC
/begin CHARACTERISTIC UNK_RD_IGN_13874 "Unidentified constant read directly by IGN 0xf463c (chapter unknown) [unassigned]" VALUE 0x73874 RL_VAL_UB 0 CM_0000 0 255 /end CHARACTERISTIC
/begin CHARACTERISTIC UNK_RD_IGN_13875 "Unidentified constant read directly by IGN 0xf463c (chapter unknown) [unassigned]" VALUE 0x73875 RL_VAL_UB 0 CM_0000 0 255 /end CHARACTERISTIC
/begin CHARACTERISTIC UNK_RD_IGN_13876 "Unidentified constant read directly by IGN 0xf463c (chapter unknown) [unassigned]" VALUE 0x73876 RL_VAL_UB 0 CM_0000 0 255 /end CHARACTERISTIC
/begin CHARACTERISTIC UNK_RD_IGN_13877 "Unidentified constant read directly by IGN 0xf463c (chapter unknown) [unassigned]" VALUE 0x73877 RL_VAL_UB 0 CM_0000 0 255 /end CHARACTERISTIC
/begin CHARACTERISTIC UNK_RD_IGN_13878 "Unidentified constant read directly by IGN 0xf463c (chapter unknown) [unassigned]" VALUE 0x73878 RL_VAL_UB 0 CM_0000 0 255 /end CHARACTERISTIC
/begin CHARACTERISTIC UNK_RD_IGN_13879 "Unidentified constant read directly by IGN 0xf463c (chapter unknown) [unassigned]" VALUE 0x73879 RL_VAL_UB 0 CM_0000 0 255 /end CHARACTERISTIC
/begin CHARACTERISTIC UNK_RD_IGN_1387A "Unidentified constant read directly by IGN 0xf463c (chapter unknown) [unassigned]" VALUE 0x7387A RL_VAL_UB 0 CM_0000 0 255 /end CHARACTERISTIC
/begin CHARACTERISTIC UNK_RD_IGN_1387B "Unidentified constant read directly by IGN 0xf463c (chapter unknown) [unassigned]" VALUE 0x7387B RL_VAL_UB 0 CM_0000 0 255 /end CHARACTERISTIC
/begin CHARACTERISTIC UNK_RD_IGN_1387C "Unidentified constant read directly by IGN 0xf463c (chapter unknown) [unassigned]" VALUE 0x7387C RL_VAL_UB 0 CM_0000 0 255 /end CHARACTERISTIC
/begin CHARACTERISTIC UNK_RD_IGN_1387D "Unidentified constant read directly by IGN 0xf463c (chapter unknown) [unassigned]" VALUE 0x7387D RL_VAL_UB 0 CM_0000 0 255 /end CHARACTERISTIC
/begin CHARACTERISTIC UNK_RD_IGN_1387E "Unidentified constant read directly by IGN 0xf463c (chapter unknown) [unassigned]" VALUE 0x7387E RL_VAL_UB 0 CM_0000 0 255 /end CHARACTERISTIC
/begin CHARACTERISTIC UNK_RD_IGN_1387F "Unidentified constant read directly by IGN 0xf463c (chapter unknown) [unassigned]" VALUE 0x7387F RL_VAL_UB 0 CM_0000 0 255 /end CHARACTERISTIC
/begin CHARACTERISTIC UNK_RD_IGN_13880 "Unidentified constant read directly by IGN 0xf463c (chapter unknown) [unassigned]" VALUE 0x73880 RL_VAL_UB 0 CM_0000 0 255 /end CHARACTERISTIC
/begin CHARACTERISTIC UNK_RD_IGN_13881 "Unidentified constant read directly by IGN 0xf463c (chapter unknown) [unassigned]" VALUE 0x73881 RL_VAL_UB 0 CM_0000 0 255 /end CHARACTERISTIC
/begin CHARACTERISTIC UNK_RD_IGN_13882 "Unidentified constant read directly by IGN 0xf463c (chapter unknown) [unassigned]" VALUE 0x73882 RL_VAL_UB 0 CM_0000 0 255 /end CHARACTERISTIC
/begin CHARACTERISTIC UNK_RD_IGN_13883 "Unidentified constant read directly by IGN 0xf463c (chapter unknown) [unassigned]" VALUE 0x73883 RL_VAL_UB 0 CM_0000 0 255 /end CHARACTERISTIC
/begin CHARACTERISTIC UNK_RD_IGN_13884 "Unidentified constant read directly by IGN 0xf463c (chapter unknown) [unassigned]" VALUE 0x73884 RL_VAL_UB 0 CM_0000 0 255 /end CHARACTERISTIC
/begin CHARACTERISTIC UNK_RD_IGN_13885 "Unidentified constant read directly by IGN 0xf463c (chapter unknown) [unassigned]" VALUE 0x73885 RL_VAL_UB 0 CM_0000 0 255 /end CHARACTERISTIC
/begin CHARACTERISTIC UNK_RD_IGN_13886 "Unidentified constant read directly by IGN 0xf463c (chapter unknown) [unassigned]" VALUE 0x73886 RL_VAL_UB 0 CM_0000 0 255 /end CHARACTERISTIC
/begin CHARACTERISTIC UNK_RD_IGN_13887 "Unidentified constant read directly by IGN 0xf463c (chapter unknown) [unassigned]" VALUE 0x73887 RL_VAL_UB 0 CM_0000 0 255 /end CHARACTERISTIC
/begin CHARACTERISTIC UNK_RD_IGN_13888 "Unidentified constant read directly by IGN 0xf463c (chapter unknown) [unassigned]" VALUE 0x73888 RL_VAL_UB 0 CM_0000 0 255 /end CHARACTERISTIC
/begin CHARACTERISTIC UNK_RD_IGN_13889 "Unidentified constant read directly by IGN 0xf463c (chapter unknown) [unassigned]" VALUE 0x73889 RL_VAL_UB 0 CM_0000 0 255 /end CHARACTERISTIC
/begin CHARACTERISTIC UNK_RD_IGN_1388B "Unidentified constant read directly by IGN 0xf463c (chapter unknown) [unassigned]" VALUE 0x7388B RL_VAL_UB 0 CM_0000 0 255 /end CHARACTERISTIC
/begin CHARACTERISTIC UNK_RD_IGN_15084 "Unidentified constant read directly by IGN 0xe2a8c (Momentenmanager) [unassigned]" VALUE 0x75084 RL_VAL_UL 0 CM_0000 0 4294967295 /end CHARACTERISTIC
/begin CHARACTERISTIC UNK_RD_IGN_150C0 "Unidentified constant read directly by IGN 0xe2a8c (Momentenmanager) [unassigned]" VALUE 0x750C0 RL_VAL_SW 0 CM_0000 -32768 32767 /end CHARACTERISTIC
/begin CHARACTERISTIC UNK_RD_IGN_169E6 "Unidentified constant read directly by IGN 0xfa668 (Leerlaufregelung) [unassigned]" VALUE 0x769E6 RL_VAL_UB 0 CM_0000 0 255 /end CHARACTERISTIC
/begin CHARACTERISTIC UNK_RD_IGN_191DC "Unidentified constant read directly by IGN 0xfbec4 (chapter unknown) [unassigned]" VALUE 0x791DC RL_VAL_SW 0 CM_0000 -32768 32767 /end CHARACTERISTIC
/begin CHARACTERISTIC UNK_RD_IGN_191DE "Unidentified constant read directly by IGN 0xfbec4 (chapter unknown) [unassigned]" VALUE 0x791DE RL_VAL_SW 0 CM_0000 -32768 32767 /end CHARACTERISTIC
/begin CHARACTERISTIC UNK_RD_IGN_191E0 "Unidentified constant read directly by IGN 0xfbec4 (chapter unknown) [unassigned]" VALUE 0x791E0 RL_VAL_SW 0 CM_0000 -32768 32767 /end CHARACTERISTIC
/begin CHARACTERISTIC UNK_RD_IGN_191E2 "Unidentified constant read directly by IGN 0xfbec4 (chapter unknown) [unassigned]" VALUE 0x791E2 RL_VAL_SW 0 CM_0000 -32768 32767 /end CHARACTERISTIC
/begin CHARACTERISTIC UNK_RD_IGN_191E4 "Unidentified constant read directly by IGN 0xfbec4 (chapter unknown) [unassigned]" VALUE 0x791E4 RL_VAL_UW 0 CM_0000 0 65535 /end CHARACTERISTIC
/begin CHARACTERISTIC UNK_RD_IGN_191E6 "Unidentified constant read directly by IGN 0xfbec4 (chapter unknown) [unassigned]" VALUE 0x791E6 RL_VAL_UW 0 CM_0000 0 65535 /end CHARACTERISTIC
/begin CHARACTERISTIC UNK_RD_IGN_1A644 "Unidentified constant read directly by IGN 0xfc278 (chapter unknown) [unassigned]" VALUE 0x7A644 RL_VAL_UL 0 CM_0000 0 4294967295 /end CHARACTERISTIC
/begin CHARACTERISTIC UNK_RD_IGN_1A648 "Unidentified constant read directly by IGN 0xfc278 (chapter unknown) [unassigned]" VALUE 0x7A648 RL_VAL_UL 0 CM_0000 0 4294967295 /end CHARACTERISTIC
/begin CHARACTERISTIC UNK_RD_IGN_1A64C "Unidentified constant read directly by IGN 0xfc278 (chapter unknown) [unassigned]" VALUE 0x7A64C RL_VAL_UL 0 CM_0000 0 4294967295 /end CHARACTERISTIC
/begin CHARACTERISTIC UNK_RD_IGN_1A650 "Unidentified constant read directly by IGN 0xfc278 (chapter unknown) [unassigned]" VALUE 0x7A650 RL_VAL_UL 0 CM_0000 0 4294967295 /end CHARACTERISTIC
/begin CHARACTERISTIC UNK_RD_IGN_1A654 "Unidentified constant read directly by IGN 0xfc278 (chapter unknown) [unassigned]" VALUE 0x7A654 RL_VAL_UL 0 CM_0000 0 4294967295 /end CHARACTERISTIC
/begin CHARACTERISTIC UNK_RD_IGN_1A658 "Unidentified constant read directly by IGN 0xfc278 (chapter unknown) [unassigned]" VALUE 0x7A658 RL_VAL_UL 0 CM_0000 0 4294967295 /end CHARACTERISTIC
/begin CHARACTERISTIC UNK_RD_IGN_1A65C "Unidentified constant read directly by IGN 0xfc278 (chapter unknown) [unassigned]" VALUE 0x7A65C RL_VAL_UL 0 CM_0000 0 4294967295 /end CHARACTERISTIC
/begin CHARACTERISTIC UNK_RD_IGN_1A660 "Unidentified constant read directly by IGN 0xfc278 (chapter unknown) [unassigned]" VALUE 0x7A660 RL_VAL_SW 0 CM_0000 -32768 32767 /end CHARACTERISTIC
/begin CHARACTERISTIC UNK_RD_IGN_1A662 "Unidentified constant read directly by IGN 0xfc278 (chapter unknown) [unassigned]" VALUE 0x7A662 RL_VAL_SW 0 CM_0000 -32768 32767 /end CHARACTERISTIC
/begin CHARACTERISTIC UNK_RD_IGN_1A664 "Unidentified constant read directly by IGN 0xfc278 (chapter unknown) [unassigned]" VALUE 0x7A664 RL_VAL_SW 0 CM_0000 -32768 32767 /end CHARACTERISTIC
/begin CHARACTERISTIC UNK_RD_IGN_1A666 "Unidentified constant read directly by IGN 0xfc278 (chapter unknown) [unassigned]" VALUE 0x7A666 RL_VAL_SW 0 CM_0000 -32768 32767 /end CHARACTERISTIC
/begin CHARACTERISTIC UNK_RD_IGN_1A668 "Unidentified constant read directly by IGN 0xfc278 (chapter unknown) [unassigned]" VALUE 0x7A668 RL_VAL_SW 0 CM_0000 -32768 32767 /end CHARACTERISTIC
/begin CHARACTERISTIC UNK_RD_IGN_1A66A "Unidentified constant read directly by IGN 0xfc278 (chapter unknown) [unassigned]" VALUE 0x7A66A RL_VAL_SW 0 CM_0000 -32768 32767 /end CHARACTERISTIC
/begin CHARACTERISTIC UNK_RD_IGN_1A66C "Unidentified constant read directly by IGN 0xfc278 (chapter unknown) [unassigned]" VALUE 0x7A66C RL_VAL_SW 0 CM_0000 -32768 32767 /end CHARACTERISTIC
/begin CHARACTERISTIC UNK_RD_IGN_1A66E "Unidentified constant read directly by IGN 0xfc278 (chapter unknown) [unassigned]" VALUE 0x7A66E RL_VAL_SW 0 CM_0000 -32768 32767 /end CHARACTERISTIC
/begin CHARACTERISTIC UNK_RD_IGN_1A670 "Unidentified constant read directly by IGN 0xfc278 (chapter unknown) [unassigned]" VALUE 0x7A670 RL_VAL_SW 0 CM_0000 -32768 32767 /end CHARACTERISTIC
/begin CHARACTERISTIC UNK_RD_IGN_1A672 "Unidentified constant read directly by IGN 0xfc278 (chapter unknown) [unassigned]" VALUE 0x7A672 RL_VAL_SW 0 CM_0000 -32768 32767 /end CHARACTERISTIC
/begin CHARACTERISTIC UNK_RD_IGN_1A674 "Unidentified constant read directly by IGN 0xfc278 (chapter unknown) [unassigned]" VALUE 0x7A674 RL_VAL_UW 0 CM_0000 0 65535 /end CHARACTERISTIC
/begin CHARACTERISTIC UNK_RD_IGN_1A676 "Unidentified constant read directly by IGN 0xfc278 (chapter unknown) [unassigned]" VALUE 0x7A676 RL_VAL_UW 0 CM_0000 0 65535 /end CHARACTERISTIC
/begin CHARACTERISTIC UNK_RD_IGN_1A678 "Unidentified constant read directly by IGN 0xfc278 (chapter unknown) [unassigned]" VALUE 0x7A678 RL_VAL_UW 0 CM_0000 0 65535 /end CHARACTERISTIC
/begin CHARACTERISTIC UNK_RD_IGN_1A67A "Unidentified constant read directly by IGN 0xfc278 (chapter unknown) [unassigned]" VALUE 0x7A67A RL_VAL_UW 0 CM_0000 0 65535 /end CHARACTERISTIC
/begin CHARACTERISTIC UNK_RD_IGN_1A67C "Unidentified constant read directly by IGN 0xfc278 (chapter unknown) [unassigned]" VALUE 0x7A67C RL_VAL_UW 0 CM_0000 0 65535 /end CHARACTERISTIC
/begin CHARACTERISTIC UNK_RD_IGN_1A67E "Unidentified constant read directly by IGN 0xfc278 (chapter unknown) [unassigned]" VALUE 0x7A67E RL_VAL_UW 0 CM_0000 0 65535 /end CHARACTERISTIC
/begin CHARACTERISTIC UNK_RD_IGN_1A680 "Unidentified constant read directly by IGN 0xfc278,0xfd530 (chapter unknown) [unassigned]" VALUE 0x7A680 RL_VAL_UW 0 CM_0000 0 65535 /end CHARACTERISTIC
/begin CHARACTERISTIC UNK_RD_IGN_1A682 "Unidentified constant read directly by IGN 0xfc278,0xfd530 (chapter unknown) [unassigned]" VALUE 0x7A682 RL_VAL_UW 0 CM_0000 0 65535 /end CHARACTERISTIC
/begin CHARACTERISTIC UNK_RD_IGN_1A684 "Unidentified constant read directly by IGN 0xfc278 (chapter unknown) [unassigned]" VALUE 0x7A684 RL_VAL_UW 0 CM_0000 0 65535 /end CHARACTERISTIC
/begin CHARACTERISTIC UNK_RD_IGN_1A686 "Unidentified constant read directly by IGN 0xfc278 (chapter unknown) [unassigned]" VALUE 0x7A686 RL_VAL_UW 0 CM_0000 0 65535 /end CHARACTERISTIC
/begin CHARACTERISTIC UNK_RD_IGN_1A688 "Unidentified constant read directly by IGN 0xfc278,0xfd530 (chapter unknown) [unassigned]" VALUE 0x7A688 RL_VAL_UB 0 CM_0000 0 255 /end CHARACTERISTIC
/begin CHARACTERISTIC UNK_RD_IGN_1A689 "Unidentified constant read directly by IGN 0xfc278,0xfd530 (chapter unknown) [unassigned]" VALUE 0x7A689 RL_VAL_UB 0 CM_0000 0 255 /end CHARACTERISTIC
/begin CHARACTERISTIC UNK_RD_IGN_1A68A "Unidentified constant read directly by IGN 0xfc278 (chapter unknown) [unassigned]" VALUE 0x7A68A RL_VAL_UB 0 CM_0000 0 255 /end CHARACTERISTIC
/begin CHARACTERISTIC UNK_RD_IGN_1A68B "Unidentified constant read directly by IGN 0xfc278,0xfd530 (chapter unknown) [unassigned]" VALUE 0x7A68B RL_VAL_UB 0 CM_0000 0 255 /end CHARACTERISTIC
/begin CHARACTERISTIC UNK_RD_IGN_1A68C "Unidentified constant read directly by IGN 0xfc278 (chapter unknown) [unassigned]" VALUE 0x7A68C RL_VAL_UB 0 CM_0000 0 255 /end CHARACTERISTIC
/begin CHARACTERISTIC UNK_RD_IGN_1A68E "Unidentified constant read directly by IGN 0xfc278 (chapter unknown) [unassigned]" VALUE 0x7A68E RL_VAL_UW 0 CM_0000 0 65535 /end CHARACTERISTIC
/begin CHARACTERISTIC UNK_RD_IGN_1A690 "Unidentified constant read directly by IGN 0xfc278 (chapter unknown) [unassigned]" VALUE 0x7A690 RL_VAL_UW 0 CM_0000 0 65535 /end CHARACTERISTIC
/begin CHARACTERISTIC UNK_RD_IGN_1A692 "Unidentified constant read directly by IGN 0xfc278 (chapter unknown) [unassigned]" VALUE 0x7A692 RL_VAL_UW 0 CM_0000 0 65535 /end CHARACTERISTIC
/begin CHARACTERISTIC UNK_RD_IGN_1A694 "Unidentified constant read directly by IGN 0xfc278 (chapter unknown) [unassigned]" VALUE 0x7A694 RL_VAL_UB 0 CM_0000 0 255 /end CHARACTERISTIC
/begin CHARACTERISTIC UNK_RD_IGN_1A695 "Unidentified constant read directly by IGN 0xfc278 (chapter unknown) [unassigned]" VALUE 0x7A695 RL_VAL_UB 0 CM_0000 0 255 /end CHARACTERISTIC
/begin CHARACTERISTIC UNK_RD_IGN_1A696 "Unidentified constant read directly by IGN 0x53450,0xfc278 (chapter unknown) [unassigned]" VALUE 0x7A696 RL_VAL_UB 0 CM_0000 0 255 /end CHARACTERISTIC
/begin CHARACTERISTIC UNK_RD_IGN_1A697 "Unidentified constant read directly by IGN 0x53450,0xfc278 (chapter unknown) [unassigned]" VALUE 0x7A697 RL_VAL_UB 0 CM_0000 0 255 /end CHARACTERISTIC
/begin CHARACTERISTIC UNK_RD_IGN_1A698 "Unidentified constant read directly by IGN 0xfc278 (chapter unknown) [unassigned]" VALUE 0x7A698 RL_VAL_UB 0 CM_0000 0 255 /end CHARACTERISTIC
/begin CHARACTERISTIC UNK_RD_IGN_1A699 "Unidentified constant read directly by IGN 0xfc278 (chapter unknown) [unassigned]" VALUE 0x7A699 RL_VAL_UB 0 CM_0000 0 255 /end CHARACTERISTIC
/begin CHARACTERISTIC UNK_RD_IGN_1A69A "Unidentified constant read directly by IGN 0xfc278 (chapter unknown) [unassigned]" VALUE 0x7A69A RL_VAL_UB 0 CM_0000 0 255 /end CHARACTERISTIC
/begin CHARACTERISTIC UNK_RD_IGN_1A69B "Unidentified constant read directly by IGN 0xfc278,0xfd530 (chapter unknown) [unassigned]" VALUE 0x7A69B RL_VAL_UB 0 CM_0000 0 255 /end CHARACTERISTIC
/begin CHARACTERISTIC UNK_RD_IGN_1A69C "Unidentified constant read directly by IGN 0xfc278,0xfd530 (chapter unknown) [unassigned]" VALUE 0x7A69C RL_VAL_UB 0 CM_0000 0 255 /end CHARACTERISTIC
/begin CHARACTERISTIC UNK_RD_IGN_1A69D "Unidentified constant read directly by IGN 0xfc278 (chapter unknown) [unassigned]" VALUE 0x7A69D RL_VAL_UB 0 CM_0000 0 255 /end CHARACTERISTIC
/begin CHARACTERISTIC UNK_RD_IGN_1A69E "Unidentified constant read directly by IGN 0xfc278 (chapter unknown) [unassigned]" VALUE 0x7A69E RL_VAL_UB 0 CM_0000 0 255 /end CHARACTERISTIC
/begin CHARACTERISTIC UNK_RD_IGN_1A6A4 "Unidentified constant read directly by IGN 0xfd6c8 (chapter unknown) [unassigned]" VALUE 0x7A6A4 RL_VAL_UL 0 CM_0000 0 4294967295 /end CHARACTERISTIC
/begin CHARACTERISTIC UNK_RD_IGN_1A6A8 "Unidentified constant read directly by IGN 0xfd6c8 (chapter unknown) [unassigned]" VALUE 0x7A6A8 RL_VAL_UL 0 CM_0000 0 4294967295 /end CHARACTERISTIC
/begin CHARACTERISTIC UNK_RD_IGN_1A6AC "Unidentified constant read directly by IGN 0xfd6c8 (chapter unknown) [unassigned]" VALUE 0x7A6AC RL_VAL_UL 0 CM_0000 0 4294967295 /end CHARACTERISTIC
/begin CHARACTERISTIC UNK_RD_IGN_1A6B0 "Unidentified constant read directly by IGN 0xfd6c8 (chapter unknown) [unassigned]" VALUE 0x7A6B0 RL_VAL_UL 0 CM_0000 0 4294967295 /end CHARACTERISTIC
/begin CHARACTERISTIC UNK_RD_IGN_1A6B4 "Unidentified constant read directly by IGN 0xfd6c8 (chapter unknown) [unassigned]" VALUE 0x7A6B4 RL_VAL_UL 0 CM_0000 0 4294967295 /end CHARACTERISTIC
/begin CHARACTERISTIC UNK_RD_IGN_1A6B8 "Unidentified constant read directly by IGN 0xfd6c8 (chapter unknown) [unassigned]" VALUE 0x7A6B8 RL_VAL_UL 0 CM_0000 0 4294967295 /end CHARACTERISTIC
/begin CHARACTERISTIC UNK_RD_IGN_1A6BC "Unidentified constant read directly by IGN 0xfd6c8 (chapter unknown) [unassigned]" VALUE 0x7A6BC RL_VAL_SW 0 CM_0000 -32768 32767 /end CHARACTERISTIC
/begin CHARACTERISTIC UNK_RD_IGN_1A6BE "Unidentified constant read directly by IGN 0xfd6c8 (chapter unknown) [unassigned]" VALUE 0x7A6BE RL_VAL_SW 0 CM_0000 -32768 32767 /end CHARACTERISTIC
/begin CHARACTERISTIC UNK_RD_IGN_1A6C0 "Unidentified constant read directly by IGN 0xfd6c8 (chapter unknown) [unassigned]" VALUE 0x7A6C0 RL_VAL_UW 0 CM_0000 0 65535 /end CHARACTERISTIC
/begin CHARACTERISTIC UNK_RD_IGN_1A6C2 "Unidentified constant read directly by IGN 0xfd6c8 (chapter unknown) [unassigned]" VALUE 0x7A6C2 RL_VAL_UB 0 CM_0000 0 255 /end CHARACTERISTIC
/begin CHARACTERISTIC UNK_RD_IGN_1A6C3 "Unidentified constant read directly by IGN 0xfd6c8 (chapter unknown) [unassigned]" VALUE 0x7A6C3 RL_VAL_UB 0 CM_0000 0 255 /end CHARACTERISTIC
/begin CHARACTERISTIC UNK_RD_IGN_1A6C4 "Unidentified constant read directly by IGN 0xfd6c8 (chapter unknown) [unassigned]" VALUE 0x7A6C4 RL_VAL_UB 0 CM_0000 0 255 /end CHARACTERISTIC
/begin CHARACTERISTIC UNK_RD_IGN_1A6C5 "Unidentified constant read directly by IGN 0xfd6c8 (chapter unknown) [unassigned]" VALUE 0x7A6C5 RL_VAL_UB 0 CM_0000 0 255 /end CHARACTERISTIC
/begin CHARACTERISTIC UNK_RD_IGN_1A6C6 "Unidentified constant read directly by IGN 0xfd6c8 (chapter unknown) [unassigned]" VALUE 0x7A6C6 RL_VAL_UB 0 CM_0000 0 255 /end CHARACTERISTIC
/begin CHARACTERISTIC UNK_RD_IGN_1A6C7 "Unidentified constant read directly by IGN 0xfd6c8 (chapter unknown) [unassigned]" VALUE 0x7A6C7 RL_VAL_UB 0 CM_0000 0 255 /end CHARACTERISTIC
/begin CHARACTERISTIC UNK_RD_IGN_1A6C8 "Unidentified constant read directly by IGN 0xfd6c8 (chapter unknown) [unassigned]" VALUE 0x7A6C8 RL_VAL_UB 0 CM_0000 0 255 /end CHARACTERISTIC
/begin CHARACTERISTIC UNK_RD_IGN_1A6C9 "Unidentified constant read directly by IGN 0xfd6c8 (chapter unknown) [unassigned]" VALUE 0x7A6C9 RL_VAL_UB 0 CM_0000 0 255 /end CHARACTERISTIC
/begin CHARACTERISTIC UNK_RD_IGN_1A6CA "Unidentified constant read directly by IGN 0xfd6c8 (chapter unknown) [unassigned]" VALUE 0x7A6CA RL_VAL_UB 0 CM_0000 0 255 /end CHARACTERISTIC
/begin CHARACTERISTIC UNK_RD_IGN_1A6CB "Unidentified constant read directly by IGN 0xfd6c8 (chapter unknown) [unassigned]" VALUE 0x7A6CB RL_VAL_UB 0 CM_0000 0 255 /end CHARACTERISTIC
/begin CHARACTERISTIC UNK_RD_IGN_1A6CC "Unidentified constant read directly by IGN 0xfd6c8 (chapter unknown) [unassigned]" VALUE 0x7A6CC RL_VAL_UB 0 CM_0000 0 255 /end CHARACTERISTIC
/begin CHARACTERISTIC UNK_RD_IGN_1A6CD "Unidentified constant read directly by IGN 0xfd6c8 (chapter unknown) [unassigned]" VALUE 0x7A6CD RL_VAL_UB 0 CM_0000 0 255 /end CHARACTERISTIC
/begin CHARACTERISTIC UNK_RD_IGN_1A6CE "Unidentified constant read directly by IGN 0xfd6c8 (chapter unknown) [unassigned]" VALUE 0x7A6CE RL_VAL_UB 0 CM_0000 0 255 /end CHARACTERISTIC
/begin CHARACTERISTIC UNK_RD_IGN_1A6CF "Unidentified constant read directly by IGN 0xfd6c8 (chapter unknown) [unassigned]" VALUE 0x7A6CF RL_VAL_UB 0 CM_0000 0 255 /end CHARACTERISTIC
/begin CHARACTERISTIC UNK_RD_IGN_1A6D0 "Unidentified constant read directly by IGN 0xfd6c8 (chapter unknown) [unassigned]" VALUE 0x7A6D0 RL_VAL_UB 0 CM_0000 0 255 /end CHARACTERISTIC
/begin CHARACTERISTIC UNK_RD_IGN_1A6D1 "Unidentified constant read directly by IGN 0xfd6c8 (chapter unknown) [unassigned]" VALUE 0x7A6D1 RL_VAL_UB 0 CM_0000 0 255 /end CHARACTERISTIC
/begin CHARACTERISTIC UNK_RD_IGN_1A6D2 "Unidentified constant read directly by IGN 0xfd6c8 (chapter unknown) [unassigned]" VALUE 0x7A6D2 RL_VAL_UB 0 CM_0000 0 255 /end CHARACTERISTIC
/begin CHARACTERISTIC UNK_RD_IGN_1A6D3 "Unidentified constant read directly by IGN 0xfd6c8 (chapter unknown) [unassigned]" VALUE 0x7A6D3 RL_VAL_UB 0 CM_0000 0 255 /end CHARACTERISTIC
/begin CHARACTERISTIC UNK_RD_IGN_1A6D4 "Unidentified constant read directly by IGN 0xfd6c8 (chapter unknown) [unassigned]" VALUE 0x7A6D4 RL_VAL_UB 0 CM_0000 0 255 /end CHARACTERISTIC
/begin CHARACTERISTIC UNK_RD_IGN_1A758 "Unidentified constant read directly by IGN 0xfd6c8 (chapter unknown) [unassigned]" VALUE 0x7A758 RL_VAL_UB 0 CM_0000 0 255 /end CHARACTERISTIC
/begin CHARACTERISTIC UNK_RD_IGN_1A759 "Unidentified constant read directly by IGN 0xfd6c8 (chapter unknown) [unassigned]" VALUE 0x7A759 RL_VAL_UB 0 CM_0000 0 255 /end CHARACTERISTIC
/begin CHARACTERISTIC UNK_RD_IGN_1A75A "Unidentified constant read directly by IGN 0xfd6c8 (chapter unknown) [unassigned]" VALUE 0x7A75A RL_VAL_UB 0 CM_0000 0 255 /end CHARACTERISTIC
/begin CHARACTERISTIC UNK_RD_IGN_1A75B "Unidentified constant read directly by IGN 0xfd6c8 (chapter unknown) [unassigned]" VALUE 0x7A75B RL_VAL_UB 0 CM_0000 0 255 /end CHARACTERISTIC
/begin CHARACTERISTIC UNK_RD_IGN_1A75C "Unidentified constant read directly by IGN 0xfd6c8 (chapter unknown) [unassigned]" VALUE 0x7A75C RL_VAL_UB 0 CM_0000 0 255 /end CHARACTERISTIC
/begin CHARACTERISTIC UNK_RD_IGN_1A75D "Unidentified constant read directly by IGN 0xfd6c8 (chapter unknown) [unassigned]" VALUE 0x7A75D RL_VAL_UB 0 CM_0000 0 255 /end CHARACTERISTIC
/begin CHARACTERISTIC UNK_RD_IGN_1A760 "Unidentified constant read directly by IGN 0xfe9ac (chapter unknown) [unassigned]" VALUE 0x7A760 RL_VAL_UL 0 CM_0000 0 4294967295 /end CHARACTERISTIC
/begin CHARACTERISTIC UNK_RD_IGN_1A764 "Unidentified constant read directly by IGN 0xfe9ac (chapter unknown) [unassigned]" VALUE 0x7A764 RL_VAL_UL 0 CM_0000 0 4294967295 /end CHARACTERISTIC
/begin CHARACTERISTIC UNK_RD_IGN_1A768 "Unidentified constant read directly by IGN 0xfe9ac (chapter unknown) [unassigned]" VALUE 0x7A768 RL_VAL_UL 0 CM_0000 0 4294967295 /end CHARACTERISTIC
/begin CHARACTERISTIC UNK_RD_IGN_1A76C "Unidentified constant read directly by IGN 0xfe9ac (chapter unknown) [unassigned]" VALUE 0x7A76C RL_VAL_UL 0 CM_0000 0 4294967295 /end CHARACTERISTIC
/begin CHARACTERISTIC UNK_RD_IGN_1A770 "Unidentified constant read directly by IGN 0xfe9ac (chapter unknown) [unassigned]" VALUE 0x7A770 RL_VAL_UL 0 CM_0000 0 4294967295 /end CHARACTERISTIC
/begin CHARACTERISTIC UNK_RD_IGN_1A774 "Unidentified constant read directly by IGN 0xfe9ac (chapter unknown) [unassigned]" VALUE 0x7A774 RL_VAL_SW 0 CM_0000 -32768 32767 /end CHARACTERISTIC
/begin CHARACTERISTIC UNK_RD_IGN_1A776 "Unidentified constant read directly by IGN 0x51f54 (chapter unknown) [unassigned]" VALUE 0x7A776 RL_VAL_SW 0 CM_0000 -32768 32767 /end CHARACTERISTIC
/begin CHARACTERISTIC UNK_RD_IGN_1A778 "Unidentified constant read directly by IGN 0x51f54 (chapter unknown) [unassigned]" VALUE 0x7A778 RL_VAL_SW 0 CM_0000 -32768 32767 /end CHARACTERISTIC
/begin CHARACTERISTIC UNK_RD_IGN_1A77A "Unidentified constant read directly by IGN 0x51f54 (chapter unknown) [unassigned]" VALUE 0x7A77A RL_VAL_UW 0 CM_0000 0 65535 /end CHARACTERISTIC
/begin CHARACTERISTIC UNK_RD_IGN_1A77C "Unidentified constant read directly by IGN 0x51f54 (chapter unknown) [unassigned]" VALUE 0x7A77C RL_VAL_UW 0 CM_0000 0 65535 /end CHARACTERISTIC
/begin CHARACTERISTIC UNK_RD_IGN_1A77E "Unidentified constant read directly by IGN 0x51f54 (chapter unknown) [unassigned]" VALUE 0x7A77E RL_VAL_UW 0 CM_0000 0 65535 /end CHARACTERISTIC
/begin CHARACTERISTIC UNK_RD_IGN_1A780 "Unidentified constant read directly by IGN 0x51f54,0xfe9ac (chapter unknown) [unassigned]" VALUE 0x7A780 RL_VAL_UW 0 CM_0000 0 65535 /end CHARACTERISTIC
/begin CHARACTERISTIC UNK_RD_IGN_1A782 "Unidentified constant read directly by IGN 0x51f54,0xfe9ac (chapter unknown) [unassigned]" VALUE 0x7A782 RL_VAL_UW 0 CM_0000 0 65535 /end CHARACTERISTIC
/begin CHARACTERISTIC UNK_RD_IGN_1A784 "Unidentified constant read directly by IGN 0x51f54 (chapter unknown) [unassigned]" VALUE 0x7A784 RL_VAL_UW 0 CM_0000 0 65535 /end CHARACTERISTIC
/begin CHARACTERISTIC UNK_RD_IGN_1A786 "Unidentified constant read directly by IGN 0x51f54 (chapter unknown) [unassigned]" VALUE 0x7A786 RL_VAL_UW 0 CM_0000 0 65535 /end CHARACTERISTIC
/begin CHARACTERISTIC UNK_RD_IGN_1A788 "Unidentified constant read directly by IGN 0x51f54,0xfc278 (chapter unknown) [unassigned]" VALUE 0x7A788 RL_VAL_UW 0 CM_0000 0 65535 /end CHARACTERISTIC
/begin CHARACTERISTIC UNK_RD_IGN_1A78A "Unidentified constant read directly by IGN 0xfe9ac (chapter unknown) [unassigned]" VALUE 0x7A78A RL_VAL_UB 0 CM_0000 0 255 /end CHARACTERISTIC
/begin CHARACTERISTIC UNK_RD_IGN_1A78B "Unidentified constant read directly by IGN 0x51f54 (chapter unknown) [unassigned]" VALUE 0x7A78B RL_VAL_UB 0 CM_0000 0 255 /end CHARACTERISTIC
/begin CHARACTERISTIC UNK_RD_IGN_1A78C "Unidentified constant read directly by IGN 0xfe9ac (chapter unknown) [unassigned]" VALUE 0x7A78C RL_VAL_UB 0 CM_0000 0 255 /end CHARACTERISTIC
/begin CHARACTERISTIC UNK_RD_IGN_1A78D "Unidentified constant read directly by IGN 0x51f54,0xfe9ac (chapter unknown) [unassigned]" VALUE 0x7A78D RL_VAL_UB 0 CM_0000 0 255 /end CHARACTERISTIC
/begin CHARACTERISTIC UNK_RD_IGN_1A78E "Unidentified constant read directly by IGN 0x51f54,0xfe9ac (chapter unknown) [unassigned]" VALUE 0x7A78E RL_VAL_UB 0 CM_0000 0 255 /end CHARACTERISTIC
/begin CHARACTERISTIC UNK_RD_IGN_1A78F "Unidentified constant read directly by IGN 0x51f54,0xfe9ac (chapter unknown) [unassigned]" VALUE 0x7A78F RL_VAL_UB 0 CM_0000 0 255 /end CHARACTERISTIC
/begin CHARACTERISTIC UNK_RD_IGN_1A790 "Unidentified constant read directly by IGN 0x51f54 (chapter unknown) [unassigned]" VALUE 0x7A790 RL_VAL_UB 0 CM_0000 0 255 /end CHARACTERISTIC
/begin CHARACTERISTIC UNK_RD_IGN_1A791 "Unidentified constant read directly by IGN 0xfe9ac (chapter unknown) [unassigned]" VALUE 0x7A791 RL_VAL_UB 0 CM_0000 0 255 /end CHARACTERISTIC
/begin CHARACTERISTIC UNK_RD_IGN_1A792 "Unidentified constant read directly by IGN 0x51f54,0xfe9ac (chapter unknown) [unassigned]" VALUE 0x7A792 RL_VAL_UB 0 CM_0000 0 255 /end CHARACTERISTIC
/begin CHARACTERISTIC UNK_RD_IGN_1A793 "Unidentified constant read directly by IGN 0xfe9ac (chapter unknown) [unassigned]" VALUE 0x7A793 RL_VAL_UB 0 CM_0000 0 255 /end CHARACTERISTIC
/begin CHARACTERISTIC UNK_RD_IGN_1A794 "Unidentified constant read directly by IGN 0xfe9ac (chapter unknown) [unassigned]" VALUE 0x7A794 RL_VAL_UB 0 CM_0000 0 255 /end CHARACTERISTIC
/begin CHARACTERISTIC UNK_RD_IGN_1A795 "Unidentified constant read directly by IGN 0xfe9ac (chapter unknown) [unassigned]" VALUE 0x7A795 RL_VAL_UB 0 CM_0000 0 255 /end CHARACTERISTIC
/begin CHARACTERISTIC UNK_RD_IGN_1A796 "Unidentified constant read directly by IGN 0xfe9ac (chapter unknown) [unassigned]" VALUE 0x7A796 RL_VAL_UB 0 CM_0000 0 255 /end CHARACTERISTIC
/begin CHARACTERISTIC UNK_RD_IGN_1A797 "Unidentified constant read directly by IGN 0xfe9ac (chapter unknown) [unassigned]" VALUE 0x7A797 RL_VAL_UB 0 CM_0000 0 255 /end CHARACTERISTIC
/begin CHARACTERISTIC UNK_RD_IGN_1A798 "Unidentified constant read directly by IGN 0xfe9ac (chapter unknown) [unassigned]" VALUE 0x7A798 RL_VAL_UB 0 CM_0000 0 255 /end CHARACTERISTIC
/begin CHARACTERISTIC UNK_RD_IGN_1A799 "Unidentified constant read directly by IGN 0xfe9ac (chapter unknown) [unassigned]" VALUE 0x7A799 RL_VAL_UB 0 CM_0000 0 255 /end CHARACTERISTIC
/begin CHARACTERISTIC UNK_RD_IGN_1A79A "Unidentified constant read directly by IGN 0x51f54 (chapter unknown) [unassigned]" VALUE 0x7A79A RL_VAL_UB 0 CM_0000 0 255 /end CHARACTERISTIC
/begin CHARACTERISTIC UNK_RD_IGN_1A79B "Unidentified constant read directly by IGN 0xfe9ac (chapter unknown) [unassigned]" VALUE 0x7A79B RL_VAL_UB 0 CM_0000 0 255 /end CHARACTERISTIC
/begin CHARACTERISTIC UNK_RD_IGN_1A79C "Unidentified constant read directly by IGN 0xfd6c8,0xff2d8 (chapter unknown) [unassigned]" VALUE 0x7A79C RL_VAL_UW 0 CM_0000 0 65535 /end CHARACTERISTIC
/begin CHARACTERISTIC UNK_RD_IGN_1A79E "Unidentified constant read directly by IGN 0x525fc (chapter unknown) [unassigned]" VALUE 0x7A79E RL_VAL_UB 0 CM_0000 0 255 /end CHARACTERISTIC
/begin CHARACTERISTIC UNK_RD_IGN_1A7A0 "Unidentified constant read directly by IGN 0xff2d8 (chapter unknown) [unassigned]" VALUE 0x7A7A0 RL_VAL_UL 0 CM_0000 0 4294967295 /end CHARACTERISTIC
/begin CHARACTERISTIC UNK_RD_IGN_1A7A4 "Unidentified constant read directly by IGN 0xff2d8 (chapter unknown) [unassigned]" VALUE 0x7A7A4 RL_VAL_UL 0 CM_0000 0 4294967295 /end CHARACTERISTIC
/begin CHARACTERISTIC UNK_RD_IGN_1A7A8 "Unidentified constant read directly by IGN 0xff2d8 (chapter unknown) [unassigned]" VALUE 0x7A7A8 RL_VAL_UL 0 CM_0000 0 4294967295 /end CHARACTERISTIC
/begin CHARACTERISTIC UNK_RD_IGN_1A7AC "Unidentified constant read directly by IGN 0xff2d8 (chapter unknown) [unassigned]" VALUE 0x7A7AC RL_VAL_UL 0 CM_0000 0 4294967295 /end CHARACTERISTIC
/begin CHARACTERISTIC UNK_RD_IGN_1A7B0 "Unidentified constant read directly by IGN 0xff2d8 (chapter unknown) [unassigned]" VALUE 0x7A7B0 RL_VAL_UL 0 CM_0000 0 4294967295 /end CHARACTERISTIC
/begin CHARACTERISTIC UNK_RD_IGN_1A7B4 "Unidentified constant read directly by IGN 0xff2d8 (chapter unknown) [unassigned]" VALUE 0x7A7B4 RL_VAL_UL 0 CM_0000 0 4294967295 /end CHARACTERISTIC
/begin CHARACTERISTIC UNK_RD_IGN_1A7B8 "Unidentified constant read directly by IGN 0xff2d8 (chapter unknown) [unassigned]" VALUE 0x7A7B8 RL_VAL_UL 0 CM_0000 0 4294967295 /end CHARACTERISTIC
/begin CHARACTERISTIC UNK_RD_IGN_1A7BC "Unidentified constant read directly by IGN 0xff2d8 (chapter unknown) [unassigned]" VALUE 0x7A7BC RL_VAL_UL 0 CM_0000 0 4294967295 /end CHARACTERISTIC
/begin CHARACTERISTIC UNK_RD_IGN_1A7C0 "Unidentified constant read directly by IGN 0xff2d8 (chapter unknown) [unassigned]" VALUE 0x7A7C0 RL_VAL_UL 0 CM_0000 0 4294967295 /end CHARACTERISTIC
/begin CHARACTERISTIC UNK_RD_IGN_1A7C4 "Unidentified constant read directly by IGN 0xff2d8 (chapter unknown) [unassigned]" VALUE 0x7A7C4 RL_VAL_UL 0 CM_0000 0 4294967295 /end CHARACTERISTIC
/begin CHARACTERISTIC UNK_RD_IGN_1A7C8 "Unidentified constant read directly by IGN 0xff2d8 (chapter unknown) [unassigned]" VALUE 0x7A7C8 RL_VAL_UL 0 CM_0000 0 4294967295 /end CHARACTERISTIC
/begin CHARACTERISTIC UNK_RD_IGN_1A7CC "Unidentified constant read directly by IGN 0xff2d8 (chapter unknown) [unassigned]" VALUE 0x7A7CC RL_VAL_SW 0 CM_0000 -32768 32767 /end CHARACTERISTIC
/begin CHARACTERISTIC UNK_RD_IGN_1A7CE "Unidentified constant read directly by IGN 0xff2d8 (chapter unknown) [unassigned]" VALUE 0x7A7CE RL_VAL_SW 0 CM_0000 -32768 32767 /end CHARACTERISTIC
/begin CHARACTERISTIC UNK_RD_IGN_1A7D0 "Unidentified constant read directly by IGN 0x525fc (chapter unknown) [unassigned]" VALUE 0x7A7D0 RL_VAL_SW 0 CM_0000 -32768 32767 /end CHARACTERISTIC
/begin CHARACTERISTIC UNK_RD_IGN_1A7D2 "Unidentified constant read directly by IGN 0xff2d8 (chapter unknown) [unassigned]" VALUE 0x7A7D2 RL_VAL_SW 0 CM_0000 -32768 32767 /end CHARACTERISTIC
/begin CHARACTERISTIC UNK_RD_IGN_1A7D4 "Unidentified constant read directly by IGN 0x525fc (chapter unknown) [unassigned]" VALUE 0x7A7D4 RL_VAL_UW 0 CM_0000 0 65535 /end CHARACTERISTIC
/begin CHARACTERISTIC UNK_RD_IGN_1A7D6 "Unidentified constant read directly by IGN 0x525fc (chapter unknown) [unassigned]" VALUE 0x7A7D6 RL_VAL_UW 0 CM_0000 0 65535 /end CHARACTERISTIC
/begin CHARACTERISTIC UNK_RD_IGN_1A7D8 "Unidentified constant read directly by IGN 0xff2d8 (chapter unknown) [unassigned]" VALUE 0x7A7D8 RL_VAL_UW 0 CM_0000 0 65535 /end CHARACTERISTIC
/begin CHARACTERISTIC UNK_RD_IGN_1A7DA "Unidentified constant read directly by IGN 0xff2d8 (chapter unknown) [unassigned]" VALUE 0x7A7DA RL_VAL_UW 0 CM_0000 0 65535 /end CHARACTERISTIC
/begin CHARACTERISTIC UNK_RD_IGN_1A7DC "Unidentified constant read directly by IGN 0xff2d8 (chapter unknown) [unassigned]" VALUE 0x7A7DC RL_VAL_UW 0 CM_0000 0 65535 /end CHARACTERISTIC
/begin CHARACTERISTIC UNK_RD_IGN_1A7DE "Unidentified constant read directly by IGN 0xff2d8 (chapter unknown) [unassigned]" VALUE 0x7A7DE RL_VAL_UW 0 CM_0000 0 65535 /end CHARACTERISTIC
/begin CHARACTERISTIC UNK_RD_IGN_1A7E0 "Unidentified constant read directly by IGN 0x525fc (chapter unknown) [unassigned]" VALUE 0x7A7E0 RL_VAL_UW 0 CM_0000 0 65535 /end CHARACTERISTIC
/begin CHARACTERISTIC UNK_RD_IGN_1A7E2 "Unidentified constant read directly by IGN 0x525fc (chapter unknown) [unassigned]" VALUE 0x7A7E2 RL_VAL_UW 0 CM_0000 0 65535 /end CHARACTERISTIC
/begin CHARACTERISTIC UNK_RD_IGN_1A7E4 "Unidentified constant read directly by IGN 0x525fc (chapter unknown) [unassigned]" VALUE 0x7A7E4 RL_VAL_UW 0 CM_0000 0 65535 /end CHARACTERISTIC
/begin CHARACTERISTIC UNK_RD_IGN_1A7E6 "Unidentified constant read directly by IGN 0xff2d8 (chapter unknown) [unassigned]" VALUE 0x7A7E6 RL_VAL_UW 0 CM_0000 0 65535 /end CHARACTERISTIC
/begin CHARACTERISTIC UNK_RD_IGN_1A7E8 "Unidentified constant read directly by IGN 0x525fc (chapter unknown) [unassigned]" VALUE 0x7A7E8 RL_VAL_UW 0 CM_0000 0 65535 /end CHARACTERISTIC
/begin CHARACTERISTIC UNK_RD_IGN_1A7EA "Unidentified constant read directly by IGN 0xff2d8 (chapter unknown) [unassigned]" VALUE 0x7A7EA RL_VAL_UW 0 CM_0000 0 65535 /end CHARACTERISTIC
/begin CHARACTERISTIC UNK_RD_IGN_1A7EC "Unidentified constant read directly by IGN 0xff2d8 (chapter unknown) [unassigned]" VALUE 0x7A7EC RL_VAL_UW 0 CM_0000 0 65535 /end CHARACTERISTIC
/begin CHARACTERISTIC UNK_RD_IGN_1A7EE "Unidentified constant read directly by IGN 0x525fc (chapter unknown) [unassigned]" VALUE 0x7A7EE RL_VAL_UB 0 CM_0000 0 255 /end CHARACTERISTIC
/begin CHARACTERISTIC UNK_RD_IGN_1A7EF "Unidentified constant read directly by IGN 0x525fc (chapter unknown) [unassigned]" VALUE 0x7A7EF RL_VAL_UB 0 CM_0000 0 255 /end CHARACTERISTIC
/begin CHARACTERISTIC UNK_RD_IGN_1A7F0 "Unidentified constant read directly by IGN 0xff2d8 (chapter unknown) [unassigned]" VALUE 0x7A7F0 RL_VAL_UB 0 CM_0000 0 255 /end CHARACTERISTIC
/begin CHARACTERISTIC UNK_RD_IGN_1A7F1 "Unidentified constant read directly by IGN 0x525fc,0xff2d8 (chapter unknown) [unassigned]" VALUE 0x7A7F1 RL_VAL_UB 0 CM_0000 0 255 /end CHARACTERISTIC
/begin CHARACTERISTIC UNK_RD_IGN_1A7F2 "Unidentified constant read directly by IGN 0x525fc (chapter unknown) [unassigned]" VALUE 0x7A7F2 RL_VAL_UB 0 CM_0000 0 255 /end CHARACTERISTIC
/begin CHARACTERISTIC UNK_RD_IGN_1A7F3 "Unidentified constant read directly by IGN 0x525fc (chapter unknown) [unassigned]" VALUE 0x7A7F3 RL_VAL_UB 0 CM_0000 0 255 /end CHARACTERISTIC
/begin CHARACTERISTIC UNK_RD_IGN_1A7F4 "Unidentified constant read directly by IGN 0xff2d8 (chapter unknown) [unassigned]" VALUE 0x7A7F4 RL_VAL_UB 0 CM_0000 0 255 /end CHARACTERISTIC
/begin CHARACTERISTIC UNK_RD_IGN_1A7F5 "Unidentified constant read directly by IGN 0xff2d8 (chapter unknown) [unassigned]" VALUE 0x7A7F5 RL_VAL_UB 0 CM_0000 0 255 /end CHARACTERISTIC
/begin CHARACTERISTIC UNK_RD_IGN_1A7F6 "Unidentified constant read directly by IGN 0xff2d8 (chapter unknown) [unassigned]" VALUE 0x7A7F6 RL_VAL_UB 0 CM_0000 0 255 /end CHARACTERISTIC
/begin CHARACTERISTIC UNK_RD_IGN_1A7F7 "Unidentified constant read directly by IGN 0xff2d8 (chapter unknown) [unassigned]" VALUE 0x7A7F7 RL_VAL_UB 0 CM_0000 0 255 /end CHARACTERISTIC
/begin CHARACTERISTIC UNK_RD_IGN_1A7F8 "Unidentified constant read directly by IGN 0xff2d8 (chapter unknown) [unassigned]" VALUE 0x7A7F8 RL_VAL_UB 0 CM_0000 0 255 /end CHARACTERISTIC
/begin CHARACTERISTIC UNK_RD_IGN_1A7F9 "Unidentified constant read directly by IGN 0xff2d8 (chapter unknown) [unassigned]" VALUE 0x7A7F9 RL_VAL_UB 0 CM_0000 0 255 /end CHARACTERISTIC
/begin CHARACTERISTIC UNK_RD_IGN_1A7FA "Unidentified constant read directly by IGN 0xff2d8 (chapter unknown) [unassigned]" VALUE 0x7A7FA RL_VAL_UB 0 CM_0000 0 255 /end CHARACTERISTIC
/begin CHARACTERISTIC UNK_RD_IGN_1A7FC "Unidentified constant read directly by IGN 0x1005a0 (chapter unknown) [unassigned]" VALUE 0x7A7FC RL_VAL_UL 0 CM_0000 0 4294967295 /end CHARACTERISTIC
/begin CHARACTERISTIC UNK_RD_IGN_1A800 "Unidentified constant read directly by IGN 0x1005a0 (chapter unknown) [unassigned]" VALUE 0x7A800 RL_VAL_UL 0 CM_0000 0 4294967295 /end CHARACTERISTIC
/begin CHARACTERISTIC UNK_RD_IGN_1A804 "Unidentified constant read directly by IGN 0x1005a0 (chapter unknown) [unassigned]" VALUE 0x7A804 RL_VAL_UL 0 CM_0000 0 4294967295 /end CHARACTERISTIC
/begin CHARACTERISTIC UNK_RD_IGN_1A808 "Unidentified constant read directly by IGN 0x1005a0 (chapter unknown) [unassigned]" VALUE 0x7A808 RL_VAL_UL 0 CM_0000 0 4294967295 /end CHARACTERISTIC
/begin CHARACTERISTIC UNK_RD_IGN_1A80C "Unidentified constant read directly by IGN 0x1005a0 (chapter unknown) [unassigned]" VALUE 0x7A80C RL_VAL_UB 0 CM_0000 0 255 /end CHARACTERISTIC
/begin CHARACTERISTIC UNK_RD_IGN_1A80D "Unidentified constant read directly by IGN 0x1005a0 (chapter unknown) [unassigned]" VALUE 0x7A80D RL_VAL_UB 0 CM_0000 0 255 /end CHARACTERISTIC
/begin CHARACTERISTIC UNK_RD_IGN_1A80E "Unidentified constant read directly by IGN 0x1005a0 (chapter unknown) [unassigned]" VALUE 0x7A80E RL_VAL_UB 0 CM_0000 0 255 /end CHARACTERISTIC
/begin CHARACTERISTIC UNK_RD_IGN_1A80F "Unidentified constant read directly by IGN 0x1005a0 (chapter unknown) [unassigned]" VALUE 0x7A80F RL_VAL_UB 0 CM_0000 0 255 /end CHARACTERISTIC
/begin CHARACTERISTIC UNK_RD_IGN_1A810 "Unidentified constant read directly by IGN 0x1005a0 (chapter unknown) [unassigned]" VALUE 0x7A810 RL_VAL_UB 0 CM_0000 0 255 /end CHARACTERISTIC
/begin CHARACTERISTIC UNK_RD_IGN_1A811 "Unidentified constant read directly by IGN 0x1005a0 (chapter unknown) [unassigned]" VALUE 0x7A811 RL_VAL_UB 0 CM_0000 0 255 /end CHARACTERISTIC
/begin CHARACTERISTIC UNK_RD_IGN_1A812 "Unidentified constant read directly by IGN 0x1005a0 (chapter unknown) [unassigned]" VALUE 0x7A812 RL_VAL_UB 0 CM_0000 0 255 /end CHARACTERISTIC
/begin CHARACTERISTIC UNK_RD_IGN_1A813 "Unidentified constant read directly by IGN 0x1005a0 (chapter unknown) [unassigned]" VALUE 0x7A813 RL_VAL_UB 0 CM_0000 0 255 /end CHARACTERISTIC
/begin CHARACTERISTIC UNK_RD_IGN_1A814 "Unidentified constant read directly by IGN 0x1005a0 (chapter unknown) [unassigned]" VALUE 0x7A814 RL_VAL_UB 0 CM_0000 0 255 /end CHARACTERISTIC
/begin CHARACTERISTIC UNK_RD_IGN_1A815 "Unidentified constant read directly by IGN 0x1005a0 (chapter unknown) [unassigned]" VALUE 0x7A815 RL_VAL_UB 0 CM_0000 0 255 /end CHARACTERISTIC
/begin CHARACTERISTIC UNK_RD_IGN_1A9A8 "Unidentified constant read directly by IGN 0x53450 (chapter unknown) [unassigned]" VALUE 0x7A9A8 RL_VAL_SW 0 CM_0000 -32768 32767 /end CHARACTERISTIC
/begin CHARACTERISTIC UNK_RD_IGN_1A9AA "Unidentified constant read directly by IGN 0x53450 (chapter unknown) [unassigned]" VALUE 0x7A9AA RL_VAL_SW 0 CM_0000 -32768 32767 /end CHARACTERISTIC
/begin CHARACTERISTIC UNK_RD_IGN_1A9AC "Unidentified constant read directly by IGN 0x52b38 (chapter unknown) [unassigned]" VALUE 0x7A9AC RL_VAL_UW 0 CM_0000 0 65535 /end CHARACTERISTIC
/begin CHARACTERISTIC UNK_RD_IGN_1A9B0 "Unidentified constant read directly by IGN 0x53450 (chapter unknown) [unassigned]" VALUE 0x7A9B0 RL_VAL_UL 0 CM_0000 0 4294967295 /end CHARACTERISTIC
/begin CHARACTERISTIC UNK_RD_IGN_1A9B4 "Unidentified constant read directly by IGN 0x53450 (chapter unknown) [unassigned]" VALUE 0x7A9B4 RL_VAL_UL 0 CM_0000 0 4294967295 /end CHARACTERISTIC
/begin CHARACTERISTIC UNK_RD_IGN_1A9B8 "Unidentified constant read directly by IGN 0x53450 (chapter unknown) [unassigned]" VALUE 0x7A9B8 RL_VAL_UL 0 CM_0000 0 4294967295 /end CHARACTERISTIC
/begin CHARACTERISTIC UNK_RD_IGN_1A9BC "Unidentified constant read directly by IGN 0x53450 (chapter unknown) [unassigned]" VALUE 0x7A9BC RL_VAL_UL 0 CM_0000 0 4294967295 /end CHARACTERISTIC
/begin CHARACTERISTIC UNK_RD_IGN_1A9C0 "Unidentified constant read directly by IGN 0x52b38 (chapter unknown) [unassigned]" VALUE 0x7A9C0 RL_VAL_SW 0 CM_0000 -32768 32767 /end CHARACTERISTIC
/begin CHARACTERISTIC UNK_RD_IGN_1A9C2 "Unidentified constant read directly by IGN 0x53450 (chapter unknown) [unassigned]" VALUE 0x7A9C2 RL_VAL_SW 0 CM_0000 -32768 32767 /end CHARACTERISTIC
/begin CHARACTERISTIC UNK_RD_IGN_1A9C4 "Unidentified constant read directly by IGN 0x53450 (chapter unknown) [unassigned]" VALUE 0x7A9C4 RL_VAL_SW 0 CM_0000 -32768 32767 /end CHARACTERISTIC
/begin CHARACTERISTIC UNK_RD_IGN_1A9C6 "Unidentified constant read directly by IGN 0x53450 (chapter unknown) [unassigned]" VALUE 0x7A9C6 RL_VAL_SW 0 CM_0000 -32768 32767 /end CHARACTERISTIC
/begin CHARACTERISTIC UNK_RD_IGN_1A9C8 "Unidentified constant read directly by IGN 0x52b38 (chapter unknown) [unassigned]" VALUE 0x7A9C8 RL_VAL_UW 0 CM_0000 0 65535 /end CHARACTERISTIC
/begin CHARACTERISTIC UNK_RD_IGN_1A9CA "Unidentified constant read directly by IGN 0x53450 (chapter unknown) [unassigned]" VALUE 0x7A9CA RL_VAL_UW 0 CM_0000 0 65535 /end CHARACTERISTIC
/begin CHARACTERISTIC UNK_RD_IGN_1A9CC "Unidentified constant read directly by IGN 0x53450 (chapter unknown) [unassigned]" VALUE 0x7A9CC RL_VAL_UW 0 CM_0000 0 65535 /end CHARACTERISTIC
/begin CHARACTERISTIC UNK_RD_IGN_1A9CE "Unidentified constant read directly by IGN 0x53450 (chapter unknown) [unassigned]" VALUE 0x7A9CE RL_VAL_UW 0 CM_0000 0 65535 /end CHARACTERISTIC
/begin CHARACTERISTIC UNK_RD_IGN_1A9D0 "Unidentified constant read directly by IGN 0x52b38 (chapter unknown) [unassigned]" VALUE 0x7A9D0 RL_VAL_UW 0 CM_0000 0 65535 /end CHARACTERISTIC
/begin CHARACTERISTIC UNK_RD_IGN_1A9D2 "Unidentified constant read directly by IGN 0x52b38 (chapter unknown) [unassigned]" VALUE 0x7A9D2 RL_VAL_UB 0 CM_0000 0 255 /end CHARACTERISTIC
/begin CHARACTERISTIC UNK_RD_IGN_1A9D3 "Unidentified constant read directly by IGN 0x52b38 (chapter unknown) [unassigned]" VALUE 0x7A9D3 RL_VAL_UB 0 CM_0000 0 255 /end CHARACTERISTIC
/begin CHARACTERISTIC UNK_RD_IGN_1A9D4 "Unidentified constant read directly by IGN 0x53450 (chapter unknown) [unassigned]" VALUE 0x7A9D4 RL_VAL_UB 0 CM_0000 0 255 /end CHARACTERISTIC
/begin CHARACTERISTIC UNK_RD_IGN_1A9D5 "Unidentified constant read directly by IGN 0x52b38 (chapter unknown) [unassigned]" VALUE 0x7A9D5 RL_VAL_UB 0 CM_0000 0 255 /end CHARACTERISTIC
/begin CHARACTERISTIC UNK_RD_IGN_1A9D6 "Unidentified constant read directly by IGN 0x52b38 (chapter unknown) [unassigned]" VALUE 0x7A9D6 RL_VAL_UB 0 CM_0000 0 255 /end CHARACTERISTIC
/begin CHARACTERISTIC UNK_RD_IGN_1A9D8 "Unidentified constant read directly by IGN 0x52b38,0x53450 (chapter unknown) [unassigned]" VALUE 0x7A9D8 RL_VAL_UW 0 CM_0000 0 65535 /end CHARACTERISTIC
/begin CHARACTERISTIC UNK_RD_IGN_1A9DA "Unidentified constant read directly by IGN 0x52b38 (chapter unknown) [unassigned]" VALUE 0x7A9DA RL_VAL_UW 0 CM_0000 0 65535 /end CHARACTERISTIC
/begin CHARACTERISTIC UNK_RD_IGN_1A9DC "Unidentified constant read directly by IGN 0x52b38 (chapter unknown) [unassigned]" VALUE 0x7A9DC RL_VAL_UW 0 CM_0000 0 65535 /end CHARACTERISTIC
/begin CHARACTERISTIC UNK_RD_IGN_1A9DE "Unidentified constant read directly by IGN 0x53450 (chapter unknown) [unassigned]" VALUE 0x7A9DE RL_VAL_SW 0 CM_0000 -32768 32767 /end CHARACTERISTIC
/begin CHARACTERISTIC UNK_RD_IGN_1A9E0 "Unidentified constant read directly by IGN 0x53450 (chapter unknown) [unassigned]" VALUE 0x7A9E0 RL_VAL_SW 0 CM_0000 -32768 32767 /end CHARACTERISTIC
/begin CHARACTERISTIC UNK_RD_IGN_1A9E2 "Unidentified constant read directly by IGN 0x53450 (chapter unknown) [unassigned]" VALUE 0x7A9E2 RL_VAL_SW 0 CM_0000 -32768 32767 /end CHARACTERISTIC
/begin CHARACTERISTIC UNK_RD_IGN_1A9E4 "Unidentified constant read directly by IGN 0x53450 (chapter unknown) [unassigned]" VALUE 0x7A9E4 RL_VAL_SW 0 CM_0000 -32768 32767 /end CHARACTERISTIC
/begin CHARACTERISTIC UNK_RD_IGN_1A9E6 "Unidentified constant read directly by IGN 0x53450 (chapter unknown) [unassigned]" VALUE 0x7A9E6 RL_VAL_SW 0 CM_0000 -32768 32767 /end CHARACTERISTIC
/begin CHARACTERISTIC UNK_RD_IGN_1A9E8 "Unidentified constant read directly by IGN 0x53450 (chapter unknown) [unassigned]" VALUE 0x7A9E8 RL_VAL_SW 0 CM_0000 -32768 32767 /end CHARACTERISTIC
/begin CHARACTERISTIC UNK_RD_IGN_1A9EA "Unidentified constant read directly by IGN 0x52b38 (chapter unknown) [unassigned]" VALUE 0x7A9EA RL_VAL_UW 0 CM_0000 0 65535 /end CHARACTERISTIC
/begin CHARACTERISTIC UNK_RD_IGN_1A9EC "Unidentified constant read directly by IGN 0x52b38 (chapter unknown) [unassigned]" VALUE 0x7A9EC RL_VAL_UB 0 CM_0000 0 255 /end CHARACTERISTIC
/begin CHARACTERISTIC UNK_RD_IGN_1A9EE "Unidentified constant read directly by IGN 0x53450 (chapter unknown) [unassigned]" VALUE 0x7A9EE RL_VAL_UW 0 CM_0000 0 65535 /end CHARACTERISTIC
/begin CHARACTERISTIC UNK_RD_IGN_1A9F0 "Unidentified constant read directly by IGN 0x52b38,0x53450 (chapter unknown) [unassigned]" VALUE 0x7A9F0 RL_VAL_UB 0 CM_0000 0 255 /end CHARACTERISTIC
/begin CHARACTERISTIC UNK_RD_IGN_1A9F1 "Unidentified constant read directly by IGN 0x53450 (chapter unknown) [unassigned]" VALUE 0x7A9F1 RL_VAL_UB 0 CM_0000 0 255 /end CHARACTERISTIC
/begin CHARACTERISTIC UNK_RD_IGN_1A9F2 "Unidentified constant read directly by IGN 0x52b38,0x53450 (chapter unknown) [unassigned]" VALUE 0x7A9F2 RL_VAL_UB 0 CM_0000 0 255 /end CHARACTERISTIC
/begin CHARACTERISTIC UNK_RD_IGN_1A9F3 "Unidentified constant read directly by IGN 0x52b38,0x53450 (chapter unknown) [unassigned]" VALUE 0x7A9F3 RL_VAL_UB 0 CM_0000 0 255 /end CHARACTERISTIC
/begin CHARACTERISTIC UNK_RD_IGN_1A9F4 "Unidentified constant read directly by IGN 0x53450 (chapter unknown) [unassigned]" VALUE 0x7A9F4 RL_VAL_UB 0 CM_0000 0 255 /end CHARACTERISTIC
/begin CHARACTERISTIC UNK_RD_IGN_1A9F5 "Unidentified constant read directly by IGN 0x53450 (chapter unknown) [unassigned]" VALUE 0x7A9F5 RL_VAL_UB 0 CM_0000 0 255 /end CHARACTERISTIC
/begin CHARACTERISTIC UNK_RD_IGN_1A9F6 "Unidentified constant read directly by IGN 0x53450 (chapter unknown) [unassigned]" VALUE 0x7A9F6 RL_VAL_UB 0 CM_0000 0 255 /end CHARACTERISTIC
/begin CHARACTERISTIC UNK_RD_IGN_1A9F7 "Unidentified constant read directly by IGN 0x53450 (chapter unknown) [unassigned]" VALUE 0x7A9F7 RL_VAL_UB 0 CM_0000 0 255 /end CHARACTERISTIC
/begin CHARACTERISTIC UNK_RD_IGN_1A9F8 "Unidentified constant read directly by IGN 0x53450 (chapter unknown) [unassigned]" VALUE 0x7A9F8 RL_VAL_UB 0 CM_0000 0 255 /end CHARACTERISTIC
/begin CHARACTERISTIC UNK_RD_IGN_1A9F9 "Unidentified constant read directly by IGN 0x53450 (chapter unknown) [unassigned]" VALUE 0x7A9F9 RL_VAL_UB 0 CM_0000 0 255 /end CHARACTERISTIC
/begin CHARACTERISTIC UNK_RD_IGN_1A9FA "Unidentified constant read directly by IGN 0x53450 (chapter unknown) [unassigned]" VALUE 0x7A9FA RL_VAL_UB 0 CM_0000 0 255 /end CHARACTERISTIC
/begin CHARACTERISTIC UNK_RD_IGN_1A9FB "Unidentified constant read directly by IGN 0x52b38 (chapter unknown) [unassigned]" VALUE 0x7A9FB RL_VAL_UB 0 CM_0000 0 255 /end CHARACTERISTIC
/begin CHARACTERISTIC UNK_RD_IGN_1A9FC "Unidentified constant read directly by IGN 0x52b38,0x53450 (chapter unknown) [unassigned]" VALUE 0x7A9FC RL_VAL_UB 0 CM_0000 0 255 /end CHARACTERISTIC
/begin CHARACTERISTIC UNK_RD_IGN_1A9FE "Unidentified constant read directly by IGN 0x53450 (chapter unknown) [unassigned]" VALUE 0x7A9FE RL_VAL_SW 0 CM_0000 -32768 32767 /end CHARACTERISTIC
/begin CHARACTERISTIC UNK_RD_IGN_1AA08 "Unidentified constant read directly by IGN 0x53450 (chapter unknown) [unassigned]" VALUE 0x7AA08 RL_VAL_UB 0 CM_0000 0 255 /end CHARACTERISTIC
/begin CHARACTERISTIC UNK_RD_IGN_1AA0C "Unidentified constant read directly by IGN 0x51f54,0x53450,0x54628 (chapter unknown) [unassigned]" VALUE 0x7AA0C RL_VAL_UB 0 CM_0000 0 255 /end CHARACTERISTIC
/begin CHARACTERISTIC UNK_RD_IGN_1AA0E "Unidentified constant read directly by IGN 0x5443c (chapter unknown) [unassigned]" VALUE 0x7AA0E RL_VAL_SW 0 CM_0000 -32768 32767 /end CHARACTERISTIC
/begin CHARACTERISTIC UNK_RD_IGN_1AA10 "Unidentified constant read directly by IGN 0x5443c (chapter unknown) [unassigned]" VALUE 0x7AA10 RL_VAL_SW 0 CM_0000 -32768 32767 /end CHARACTERISTIC
/begin CHARACTERISTIC UNK_RD_IGN_1AA12 "Unidentified constant read directly by IGN 0x54628,0xfc278 (chapter unknown) [unassigned]" VALUE 0x7AA12 RL_VAL_UW 0 CM_0000 0 65535 /end CHARACTERISTIC
/begin CHARACTERISTIC UNK_RD_IGN_1AA14 "Unidentified constant read directly by IGN 0x1005a0 (chapter unknown) [unassigned]" VALUE 0x7AA14 RL_VAL_UB 0 CM_0000 0 255 /end CHARACTERISTIC
/begin CHARACTERISTIC UNK_RD_IGN_1AA15 "Unidentified constant read directly by IGN 0x54628 (chapter unknown) [unassigned]" VALUE 0x7AA15 RL_VAL_UB 0 CM_0000 0 255 /end CHARACTERISTIC
/begin CHARACTERISTIC UNK_RD_IGN_1AA16 "Unidentified constant read directly by IGN 0x54628 (chapter unknown) [unassigned]" VALUE 0x7AA16 RL_VAL_UB 0 CM_0000 0 255 /end CHARACTERISTIC
/begin CHARACTERISTIC UNK_RD_IGN_1AA17 "Unidentified constant read directly by IGN 0x54628 (chapter unknown) [unassigned]" VALUE 0x7AA17 RL_VAL_UB 0 CM_0000 0 255 /end CHARACTERISTIC
/begin CHARACTERISTIC UNK_RD_IGN_1AA18 "Unidentified constant read directly by IGN 0x54628 (chapter unknown) [unassigned]" VALUE 0x7AA18 RL_VAL_UB 0 CM_0000 0 255 /end CHARACTERISTIC
/begin CHARACTERISTIC UNK_RD_IGN_1AA19 "Unidentified constant read directly by IGN 0x5443c (chapter unknown) [unassigned]" VALUE 0x7AA19 RL_VAL_UB 0 CM_0000 0 255 /end CHARACTERISTIC
/begin CHARACTERISTIC UNK_RD_IGN_1AA1A "Unidentified constant read directly by IGN 0x54628 (chapter unknown) [unassigned]" VALUE 0x7AA1A RL_VAL_UB 0 CM_0000 0 255 /end CHARACTERISTIC
/begin CHARACTERISTIC UNK_RD_IGN_1AA1B "Unidentified constant read directly by IGN 0x54628,0xfc278 (chapter unknown) [unassigned]" VALUE 0x7AA1B RL_VAL_UB 0 CM_0000 0 255 /end CHARACTERISTIC
/begin CHARACTERISTIC UNK_RD_IGN_1AA1C "Unidentified constant read directly by IGN 0x54628,0x1005a0 (chapter unknown) [unassigned]" VALUE 0x7AA1C RL_VAL_UW 0 CM_0000 0 65535 /end CHARACTERISTIC
/begin CHARACTERISTIC UNK_RD_IGN_1AA1E "Unidentified constant read directly by IGN 0x54628,0x1005a0 (chapter unknown) [unassigned]" VALUE 0x7AA1E RL_VAL_UW 0 CM_0000 0 65535 /end CHARACTERISTIC
/begin CHARACTERISTIC UNK_RD_IGN_1AA20 "Unidentified constant read directly by IGN 0x54628 (chapter unknown) [unassigned]" VALUE 0x7AA20 RL_VAL_UB 0 CM_0000 0 255 /end CHARACTERISTIC
/begin CHARACTERISTIC UNK_RD_IGN_1AA21 "Unidentified constant read directly by IGN 0x54628 (chapter unknown) [unassigned]" VALUE 0x7AA21 RL_VAL_UB 0 CM_0000 0 255 /end CHARACTERISTIC
/begin CHARACTERISTIC UNK_RD_IGN_1AA22 "Unidentified constant read directly by IGN 0x5443c (chapter unknown) [unassigned]" VALUE 0x7AA22 RL_VAL_UB 0 CM_0000 0 255 /end CHARACTERISTIC
/begin CHARACTERISTIC UNK_RD_IGN_1AA30 "Unidentified constant read directly by IGN 0x5601c (chapter unknown) [unassigned]" VALUE 0x7AA30 RL_VAL_SW 0 CM_0000 -32768 32767 /end CHARACTERISTIC
/begin CHARACTERISTIC UNK_RD_IGN_1AA32 "Unidentified constant read directly by IGN 0x5601c (chapter unknown) [unassigned]" VALUE 0x7AA32 RL_VAL_UW 0 CM_0000 0 65535 /end CHARACTERISTIC
/begin CHARACTERISTIC UNK_RD_IGN_1AA34 "Unidentified constant read directly by IGN 0x5601c (chapter unknown) [unassigned]" VALUE 0x7AA34 RL_VAL_UW 0 CM_0000 0 65535 /end CHARACTERISTIC
/begin CHARACTERISTIC UNK_RD_IGN_1AA36 "Unidentified constant read directly by IGN 0x5601c (chapter unknown) [unassigned]" VALUE 0x7AA36 RL_VAL_UB 0 CM_0000 0 255 /end CHARACTERISTIC
/begin CHARACTERISTIC UNK_RD_IGN_1AA37 "Unidentified constant read directly by IGN 0x5601c (chapter unknown) [unassigned]" VALUE 0x7AA37 RL_VAL_UB 0 CM_0000 0 255 /end CHARACTERISTIC
/begin CHARACTERISTIC UNK_RD_IGN_1AA38 "Unidentified constant read directly by IGN 0x5601c (chapter unknown) [unassigned]" VALUE 0x7AA38 RL_VAL_UW 0 CM_0000 0 65535 /end CHARACTERISTIC
/begin CHARACTERISTIC UNK_RD_IGN_1AA3A "Unidentified constant read directly by IGN 0x5601c (chapter unknown) [unassigned]" VALUE 0x7AA3A RL_VAL_SW 0 CM_0000 -32768 32767 /end CHARACTERISTIC
/begin CHARACTERISTIC UNK_RD_IGN_1AA3C "Unidentified constant read directly by IGN 0x5601c (chapter unknown) [unassigned]" VALUE 0x7AA3C RL_VAL_SW 0 CM_0000 -32768 32767 /end CHARACTERISTIC
/begin CHARACTERISTIC UNK_RD_IGN_1AA3E "Unidentified constant read directly by IGN 0x5601c (chapter unknown) [unassigned]" VALUE 0x7AA3E RL_VAL_SW 0 CM_0000 -32768 32767 /end CHARACTERISTIC
/begin CHARACTERISTIC UNK_RD_IGN_1AA40 "Unidentified constant read directly by IGN 0x552c8 (chapter unknown) [unassigned]" VALUE 0x7AA40 RL_VAL_UW 0 CM_0000 0 65535 /end CHARACTERISTIC
/begin CHARACTERISTIC UNK_RD_IGN_1AA42 "Unidentified constant read directly by IGN 0x5601c (chapter unknown) [unassigned]" VALUE 0x7AA42 RL_VAL_UB 0 CM_0000 0 255 /end CHARACTERISTIC
/begin CHARACTERISTIC UNK_RD_IGN_1AA43 "Unidentified constant read directly by IGN 0x54628,0x557a0,0x5601c (chapter unknown) [unassigned]" VALUE 0x7AA43 RL_VAL_UB 0 CM_0000 0 255 /end CHARACTERISTIC
/begin CHARACTERISTIC UNK_RD_IGN_1AA44 "Unidentified constant read directly by IGN 0x101404 (chapter unknown) [unassigned]" VALUE 0x7AA44 RL_VAL_SW 0 CM_0000 -32768 32767 /end CHARACTERISTIC
/begin CHARACTERISTIC UNK_RD_IGN_1AA46 "Unidentified constant read directly by IGN 0x101404 (chapter unknown) [unassigned]" VALUE 0x7AA46 RL_VAL_UW 0 CM_0000 0 65535 /end CHARACTERISTIC
/begin CHARACTERISTIC UNK_RD_IGN_1AA48 "Unidentified constant read directly by IGN 0x101404 (chapter unknown) [unassigned]" VALUE 0x7AA48 RL_VAL_SW 0 CM_0000 -32768 32767 /end CHARACTERISTIC
/begin CHARACTERISTIC UNK_RD_IGN_1AA4A "Unidentified constant read directly by IGN 0x101404 (chapter unknown) [unassigned]" VALUE 0x7AA4A RL_VAL_SW 0 CM_0000 -32768 32767 /end CHARACTERISTIC
/begin CHARACTERISTIC UNK_RD_IGN_1AA4E "Unidentified constant read directly by IGN 0x1005a0,0x101404 (chapter unknown) [unassigned]" VALUE 0x7AA4E RL_VAL_UB 0 CM_0000 0 255 /end CHARACTERISTIC
/begin CHARACTERISTIC UNK_RD_IGN_1AA4F "Unidentified constant read directly by IGN 0x1005a0,0x101404 (chapter unknown) [unassigned]" VALUE 0x7AA4F RL_VAL_UB 0 CM_0000 0 255 /end CHARACTERISTIC
/begin CHARACTERISTIC UNK_RD_IGN_1AA50 "Unidentified constant read directly by IGN 0x101404 (chapter unknown) [unassigned]" VALUE 0x7AA50 RL_VAL_UB 0 CM_0000 0 255 /end CHARACTERISTIC
/begin CHARACTERISTIC UNK_RD_IGN_1AA51 "Unidentified constant read directly by IGN 0x1005a0,0x101404 (chapter unknown) [unassigned]" VALUE 0x7AA51 RL_VAL_UB 0 CM_0000 0 255 /end CHARACTERISTIC
/begin CHARACTERISTIC UNK_RD_IGN_1AA52 "Unidentified constant read directly by IGN 0x101404 (chapter unknown) [unassigned]" VALUE 0x7AA52 RL_VAL_UW 0 CM_0000 0 65535 /end CHARACTERISTIC
/begin CHARACTERISTIC UNK_RD_IGN_1AA54 "Unidentified constant read directly by IGN 0x55ae8 (chapter unknown) [unassigned]" VALUE 0x7AA54 RL_VAL_UB 0 CM_0000 0 255 /end CHARACTERISTIC
/begin CHARACTERISTIC UNK_RD_IGN_1AA57 "Unidentified constant read directly by IGN 0x101404 (chapter unknown) [unassigned]" VALUE 0x7AA57 RL_VAL_UB 0 CM_0000 0 255 /end CHARACTERISTIC
/begin CHARACTERISTIC UNK_RD_IGN_1AA58 "Unidentified constant read directly by IGN 0x101404 (chapter unknown) [unassigned]" VALUE 0x7AA58 RL_VAL_UB 0 CM_0000 0 255 /end CHARACTERISTIC
/begin CHARACTERISTIC UNK_RD_IGN_1AA5A "Unidentified constant read directly by IGN 0x2ad44,0x55ae8,0xd0218 (Anti-Trampel-Funktion) [unassigned]" VALUE 0x7AA5A RL_VAL_UW 0 CM_0000 0 65535 /end CHARACTERISTIC
/begin CHARACTERISTIC UNK_RD_IGN_1AA5C "Unidentified constant read directly by IGN 0x2ad44,0x55ae8,0xd0218 (Anti-Trampel-Funktion) [unassigned]" VALUE 0x7AA5C RL_VAL_UW 0 CM_0000 0 65535 /end CHARACTERISTIC
/begin CHARACTERISTIC UNK_RD_IGN_1AA5E "Unidentified constant read directly by IGN 0x54628 (chapter unknown) [unassigned]" VALUE 0x7AA5E RL_VAL_UB 0 CM_0000 0 255 /end CHARACTERISTIC
/begin CHARACTERISTIC UNK_RD_IGN_1AA60 "Unidentified constant read directly by IGN 0x552c8 (chapter unknown) [unassigned]" VALUE 0x7AA60 RL_VAL_UW 0 CM_0000 0 65535 /end CHARACTERISTIC
/begin CHARACTERISTIC UNK_RD_IGN_1AA62 "Unidentified constant read directly by IGN 0x55430,0x1005a0 (chapter unknown) [unassigned]" VALUE 0x7AA62 RL_VAL_UB 0 CM_0000 0 255 /end CHARACTERISTIC
/begin CHARACTERISTIC UNK_RD_IGN_1AA64 "Unidentified constant read directly by IGN 0x55c60 (chapter unknown) [unassigned]" VALUE 0x7AA64 RL_VAL_UW 0 CM_0000 0 65535 /end CHARACTERISTIC
/begin CHARACTERISTIC UNK_RD_IGN_1AA66 "Unidentified constant read directly by IGN 0x55c60 (chapter unknown) [unassigned]" VALUE 0x7AA66 RL_VAL_UW 0 CM_0000 0 65535 /end CHARACTERISTIC
/begin CHARACTERISTIC UNK_RD_IGN_1AA6E "Unidentified constant read directly by IGN 0x2ad44,0x5601c (Anti-Trampel-Funktion) [unassigned]" VALUE 0x7AA6E RL_VAL_UW 0 CM_0000 0 65535 /end CHARACTERISTIC
/begin CHARACTERISTIC UNK_RD_IGN_1AA72 "Unidentified constant read directly by IGN 0x55430 (chapter unknown) [unassigned]" VALUE 0x7AA72 RL_VAL_UW 0 CM_0000 0 65535 /end CHARACTERISTIC
/begin CHARACTERISTIC UNK_RD_IGN_1AA74 "Unidentified constant read directly by IGN 0x557a0 (chapter unknown) [unassigned]" VALUE 0x7AA74 RL_VAL_SW 0 CM_0000 -32768 32767 /end CHARACTERISTIC
/begin CHARACTERISTIC UNK_RD_IGN_1AA76 "Unidentified constant read directly by IGN 0x557a0 (chapter unknown) [unassigned]" VALUE 0x7AA76 RL_VAL_SW 0 CM_0000 -32768 32767 /end CHARACTERISTIC
/begin CHARACTERISTIC UNK_RD_IGN_1AA78 "Unidentified constant read directly by IGN 0x557a0 (chapter unknown) [unassigned]" VALUE 0x7AA78 RL_VAL_SW 0 CM_0000 -32768 32767 /end CHARACTERISTIC
/begin CHARACTERISTIC UNK_RD_IGN_1AA7A "Unidentified constant read directly by IGN 0x55ae8 (chapter unknown) [unassigned]" VALUE 0x7AA7A RL_VAL_SW 0 CM_0000 -32768 32767 /end CHARACTERISTIC
/begin CHARACTERISTIC UNK_RD_IGN_1AA7C "Unidentified constant read directly by IGN 0x55ae8 (chapter unknown) [unassigned]" VALUE 0x7AA7C RL_VAL_SW 0 CM_0000 -32768 32767 /end CHARACTERISTIC
/begin CHARACTERISTIC UNK_RD_IGN_1AA7E "Unidentified constant read directly by IGN 0x55430 (chapter unknown) [unassigned]" VALUE 0x7AA7E RL_VAL_UB 0 CM_0000 0 255 /end CHARACTERISTIC
/begin CHARACTERISTIC UNK_RD_IGN_1AA7F "Unidentified constant read directly by IGN 0x55430 (chapter unknown) [unassigned]" VALUE 0x7AA7F RL_VAL_UB 0 CM_0000 0 255 /end CHARACTERISTIC
/begin CHARACTERISTIC UNK_RD_IGN_1AA80 "Unidentified constant read directly by IGN 0x55430 (chapter unknown) [unassigned]" VALUE 0x7AA80 RL_VAL_UW 0 CM_0000 0 65535 /end CHARACTERISTIC
/begin CHARACTERISTIC UNK_RD_IGN_1AA88 "Unidentified constant read directly by IGN 0x557a0 (chapter unknown) [unassigned]" VALUE 0x7AA88 RL_VAL_UB 0 CM_0000 0 255 /end CHARACTERISTIC
/begin CHARACTERISTIC UNK_RD_IGN_1AA8B "Unidentified constant read directly by IGN 0x55430 (chapter unknown) [unassigned]" VALUE 0x7AA8B RL_VAL_UB 0 CM_0000 0 255 /end CHARACTERISTIC
/begin CHARACTERISTIC UNK_RD_IGN_1AA8C "Unidentified constant read directly by IGN 0x55430 (chapter unknown) [unassigned]" VALUE 0x7AA8C RL_VAL_UB 0 CM_0000 0 255 /end CHARACTERISTIC
/begin CHARACTERISTIC UNK_RD_IGN_1AA8D "Unidentified constant read directly by IGN 0x55430 (chapter unknown) [unassigned]" VALUE 0x7AA8D RL_VAL_UB 0 CM_0000 0 255 /end CHARACTERISTIC
/begin CHARACTERISTIC UNK_RD_IGN_1AA8E "Unidentified constant read directly by IGN 0x5601c (chapter unknown) [unassigned]" VALUE 0x7AA8E RL_VAL_UB 0 CM_0000 0 255 /end CHARACTERISTIC
/begin CHARACTERISTIC UNK_RD_IGN_1AA8F "Unidentified constant read directly by IGN 0x5601c (chapter unknown) [unassigned]" VALUE 0x7AA8F RL_VAL_UB 0 CM_0000 0 255 /end CHARACTERISTIC
/begin CHARACTERISTIC UNK_RD_IGN_1AA90 "Unidentified constant read directly by IGN 0x5601c (chapter unknown) [unassigned]" VALUE 0x7AA90 RL_VAL_UB 0 CM_0000 0 255 /end CHARACTERISTIC
/begin CHARACTERISTIC UNK_RD_IGN_1AA91 "Unidentified constant read directly by IGN 0x55430 (chapter unknown) [unassigned]" VALUE 0x7AA91 RL_VAL_UB 0 CM_0000 0 255 /end CHARACTERISTIC
/begin CHARACTERISTIC UNK_RD_IGN_1AA92 "Unidentified constant read directly by IGN 0x55430 (chapter unknown) [unassigned]" VALUE 0x7AA92 RL_VAL_UB 0 CM_0000 0 255 /end CHARACTERISTIC
/begin CHARACTERISTIC UNK_RD_IGN_1AA93 "Unidentified constant read directly by IGN 0x55430 (chapter unknown) [unassigned]" VALUE 0x7AA93 RL_VAL_UB 0 CM_0000 0 255 /end CHARACTERISTIC
/begin CHARACTERISTIC UNK_RD_IGN_1AA94 "Unidentified constant read directly by IGN 0x557a0 (chapter unknown) [unassigned]" VALUE 0x7AA94 RL_VAL_UB 0 CM_0000 0 255 /end CHARACTERISTIC
/begin CHARACTERISTIC UNK_RD_IGN_1AA95 "Unidentified constant read directly by IGN 0x557a0 (chapter unknown) [unassigned]" VALUE 0x7AA95 RL_VAL_UB 0 CM_0000 0 255 /end CHARACTERISTIC
/begin CHARACTERISTIC UNK_RD_IGN_1AA96 "Unidentified constant read directly by IGN 0x557a0 (chapter unknown) [unassigned]" VALUE 0x7AA96 RL_VAL_SW 0 CM_0000 -32768 32767 /end CHARACTERISTIC
/begin CHARACTERISTIC UNK_RD_IGN_1AA98 "Unidentified constant read directly by IGN 0x54628 (chapter unknown) [unassigned]" VALUE 0x7AA98 RL_VAL_UB 0 CM_0000 0 255 /end CHARACTERISTIC
/begin CHARACTERISTIC UNK_RD_IGN_1AA99 "Unidentified constant read directly by IGN 0x557a0 (chapter unknown) [unassigned]" VALUE 0x7AA99 RL_VAL_UB 0 CM_0000 0 255 /end CHARACTERISTIC
/begin CHARACTERISTIC UNK_RD_IGN_1AA9A "Unidentified constant read directly by IGN 0x55430 (chapter unknown) [unassigned]" VALUE 0x7AA9A RL_VAL_UB 0 CM_0000 0 255 /end CHARACTERISTIC
/begin CHARACTERISTIC UNK_RD_IGN_1AA9B "Unidentified constant read directly by IGN 0x55430 (chapter unknown) [unassigned]" VALUE 0x7AA9B RL_VAL_UB 0 CM_0000 0 255 /end CHARACTERISTIC
/begin CHARACTERISTIC UNK_RD_IGN_1AA9C "Unidentified constant read directly by IGN 0x55430 (chapter unknown) [unassigned]" VALUE 0x7AA9C RL_VAL_UW 0 CM_0000 0 65535 /end CHARACTERISTIC
/begin CHARACTERISTIC UNK_RD_IGN_1AA9E "Unidentified constant read directly by IGN 0x55c60 (chapter unknown) [unassigned]" VALUE 0x7AA9E RL_VAL_SW 0 CM_0000 -32768 32767 /end CHARACTERISTIC
/begin CHARACTERISTIC UNK_RD_IGN_1AAA0 "Unidentified constant read directly by IGN 0x54628 (chapter unknown) [unassigned]" VALUE 0x7AAA0 RL_VAL_UW 0 CM_0000 0 65535 /end CHARACTERISTIC
/begin CHARACTERISTIC UNK_RD_IGN_1AAA2 "Unidentified constant read directly by IGN 0x54628 (chapter unknown) [unassigned]" VALUE 0x7AAA2 RL_VAL_UW 0 CM_0000 0 65535 /end CHARACTERISTIC
/begin CHARACTERISTIC UNK_RD_IGN_1AAA4 "Unidentified constant read directly by IGN 0x54628 (chapter unknown) [unassigned]" VALUE 0x7AAA4 RL_VAL_UW 0 CM_0000 0 65535 /end CHARACTERISTIC
/begin CHARACTERISTIC UNK_RD_IGN_1AAA6 "Unidentified constant read directly by IGN 0x54628 (chapter unknown) [unassigned]" VALUE 0x7AAA6 RL_VAL_UW 0 CM_0000 0 65535 /end CHARACTERISTIC
/begin CHARACTERISTIC UNK_RD_IGN_1AAA8 "Unidentified constant read directly by IGN 0x5601c (chapter unknown) [unassigned]" VALUE 0x7AAA8 RL_VAL_UB 0 CM_0000 0 255 /end CHARACTERISTIC
/begin CHARACTERISTIC UNK_RD_IGN_1AAAA "Unidentified constant read directly by IGN 0x5601c (chapter unknown) [unassigned]" VALUE 0x7AAAA RL_VAL_UW 0 CM_0000 0 65535 /end CHARACTERISTIC
/begin CHARACTERISTIC UNK_RD_IGN_1AAAC "Unidentified constant read directly by IGN 0x5601c (chapter unknown) [unassigned]" VALUE 0x7AAAC RL_VAL_UB 0 CM_0000 0 255 /end CHARACTERISTIC
/begin CHARACTERISTIC UNK_RD_IGN_1AAAD "Unidentified constant read directly by IGN 0x5601c (chapter unknown) [unassigned]" VALUE 0x7AAAD RL_VAL_UB 0 CM_0000 0 255 /end CHARACTERISTIC
/begin CHARACTERISTIC UNK_RD_IGN_1AAAE "Unidentified constant read directly by IGN 0x55c60 (chapter unknown) [unassigned]" VALUE 0x7AAAE RL_VAL_UW 0 CM_0000 0 65535 /end CHARACTERISTIC
/begin CHARACTERISTIC UNK_RD_IGN_1AAB0 "Unidentified constant read directly by IGN 0x55c60 (chapter unknown) [unassigned]" VALUE 0x7AAB0 RL_VAL_UB 0 CM_0000 0 255 /end CHARACTERISTIC
/begin CHARACTERISTIC UNK_RD_IGN_1AADC "Unidentified constant read directly by IGN 0x57110 (chapter unknown) [unassigned]" VALUE 0x7AADC RL_VAL_SW 0 CM_0000 -32768 32767 /end CHARACTERISTIC
/begin CHARACTERISTIC UNK_RD_IGN_1AADE "Unidentified constant read directly by IGN 0x57110 (chapter unknown) [unassigned]" VALUE 0x7AADE RL_VAL_SW 0 CM_0000 -32768 32767 /end CHARACTERISTIC
/begin CHARACTERISTIC UNK_RD_IGN_1AAE0 "Unidentified constant read directly by IGN 0x56e90 (chapter unknown) [unassigned]" VALUE 0x7AAE0 RL_VAL_UB 0 CM_0000 0 255 /end CHARACTERISTIC
/begin CHARACTERISTIC UNK_RD_IGN_1AAE2 "Unidentified constant read directly by IGN 0x573dc (chapter unknown) [unassigned]" VALUE 0x7AAE2 RL_VAL_SW 0 CM_0000 -32768 32767 /end CHARACTERISTIC
/begin CHARACTERISTIC UNK_RD_IGN_1AAE4 "Unidentified constant read directly by IGN 0x573dc (chapter unknown) [unassigned]" VALUE 0x7AAE4 RL_VAL_SW 0 CM_0000 -32768 32767 /end CHARACTERISTIC
/begin CHARACTERISTIC UNK_RD_IGN_1AAF4 "Unidentified constant read directly by IGN 0x575fc (Ladungswechseldrehzahl) [unassigned]" VALUE 0x7AAF4 RL_VAL_UB 0 CM_0000 0 255 /end CHARACTERISTIC
/begin CHARACTERISTIC UNK_RD_IGN_1AB02 "Unidentified constant read directly by IGN 0x575fc (Ladungswechseldrehzahl) [unassigned]" VALUE 0x7AB02 RL_VAL_UB 0 CM_0000 0 255 /end CHARACTERISTIC
/begin CHARACTERISTIC UNK_RD_IGN_1AC06 "Unidentified constant read directly by IGN 0x101b78,0x118ae0,0x118f6c (chapter unknown) [unassigned]" VALUE 0x7AC06 RL_VAL_UB 0 CM_0000 0 255 /end CHARACTERISTIC
/begin CHARACTERISTIC UNK_RD_IGN_1AC08 "Unidentified constant read directly by IGN 0x101b78 (chapter unknown) [unassigned]" VALUE 0x7AC08 RL_VAL_SW 0 CM_0000 -32768 32767 /end CHARACTERISTIC
/begin CHARACTERISTIC UNK_RD_IGN_1AC0A "Unidentified constant read directly by IGN 0x101b78 (chapter unknown) [unassigned]" VALUE 0x7AC0A RL_VAL_SW 0 CM_0000 -32768 32767 /end CHARACTERISTIC
/begin CHARACTERISTIC UNK_RD_IGN_1AC0C "Unidentified constant read directly by IGN 0x101b78,0x10229c (chapter unknown) [unassigned]" VALUE 0x7AC0C RL_VAL_SW 0 CM_0000 -32768 32767 /end CHARACTERISTIC
/begin CHARACTERISTIC UNK_RD_IGN_1AC0E "Unidentified constant read directly by IGN 0x101b78 (chapter unknown) [unassigned]" VALUE 0x7AC0E RL_VAL_SW 0 CM_0000 -32768 32767 /end CHARACTERISTIC
/begin CHARACTERISTIC UNK_RD_IGN_1AC10 "Unidentified constant read directly by IGN 0x101b78 (chapter unknown) [unassigned]" VALUE 0x7AC10 RL_VAL_SW 0 CM_0000 -32768 32767 /end CHARACTERISTIC
/begin CHARACTERISTIC UNK_RD_IGN_1AC12 "Unidentified constant read directly by IGN 0x101b78 (chapter unknown) [unassigned]" VALUE 0x7AC12 RL_VAL_SW 0 CM_0000 -32768 32767 /end CHARACTERISTIC
/begin CHARACTERISTIC UNK_RD_IGN_1AC14 "Unidentified constant read directly by IGN 0x101b78 (chapter unknown) [unassigned]" VALUE 0x7AC14 RL_VAL_SW 0 CM_0000 -32768 32767 /end CHARACTERISTIC
/begin CHARACTERISTIC UNK_RD_IGN_1AC16 "Unidentified constant read directly by IGN 0x101b78 (chapter unknown) [unassigned]" VALUE 0x7AC16 RL_VAL_UW 0 CM_0000 0 65535 /end CHARACTERISTIC
/begin CHARACTERISTIC UNK_RD_IGN_1AC18 "Unidentified constant read directly by IGN 0x101b78 (chapter unknown) [unassigned]" VALUE 0x7AC18 RL_VAL_SW 0 CM_0000 -32768 32767 /end CHARACTERISTIC
/begin CHARACTERISTIC UNK_RD_IGN_1AC1A "Unidentified constant read directly by IGN 0x101b78 (chapter unknown) [unassigned]" VALUE 0x7AC1A RL_VAL_SW 0 CM_0000 -32768 32767 /end CHARACTERISTIC
/begin CHARACTERISTIC UNK_RD_IGN_1AC1C "Unidentified constant read directly by IGN 0x101b78 (chapter unknown) [unassigned]" VALUE 0x7AC1C RL_VAL_SW 0 CM_0000 -32768 32767 /end CHARACTERISTIC
/begin CHARACTERISTIC UNK_RD_IGN_1AC1E "Unidentified constant read directly by IGN 0x101b78 (chapter unknown) [unassigned]" VALUE 0x7AC1E RL_VAL_SW 0 CM_0000 -32768 32767 /end CHARACTERISTIC
/begin CHARACTERISTIC UNK_RD_IGN_1AC20 "Unidentified constant read directly by IGN 0x101b78 (chapter unknown) [unassigned]" VALUE 0x7AC20 RL_VAL_UW 0 CM_0000 0 65535 /end CHARACTERISTIC
/begin CHARACTERISTIC UNK_RD_IGN_1AC22 "Unidentified constant read directly by IGN 0x101b78 (chapter unknown) [unassigned]" VALUE 0x7AC22 RL_VAL_SW 0 CM_0000 -32768 32767 /end CHARACTERISTIC
/begin CHARACTERISTIC UNK_RD_IGN_1AC24 "Unidentified constant read directly by IGN 0x101fbc (chapter unknown) [unassigned]" VALUE 0x7AC24 RL_VAL_UB 0 CM_0000 0 255 /end CHARACTERISTIC
/begin CHARACTERISTIC UNK_RD_IGN_1AC25 "Unidentified constant read directly by IGN 0x101fbc (chapter unknown) [unassigned]" VALUE 0x7AC25 RL_VAL_UB 0 CM_0000 0 255 /end CHARACTERISTIC
/begin CHARACTERISTIC UNK_RD_IGN_1AC26 "Unidentified constant read directly by IGN 0x101fbc (chapter unknown) [unassigned]" VALUE 0x7AC26 RL_VAL_SW 0 CM_0000 -32768 32767 /end CHARACTERISTIC
/begin CHARACTERISTIC UNK_RD_IGN_1AC28 "Unidentified constant read directly by IGN 0x101fbc (chapter unknown) [unassigned]" VALUE 0x7AC28 RL_VAL_SW 0 CM_0000 -32768 32767 /end CHARACTERISTIC
/begin CHARACTERISTIC UNK_RD_IGN_1AC2A "Unidentified constant read directly by IGN 0x101fbc (chapter unknown) [unassigned]" VALUE 0x7AC2A RL_VAL_SW 0 CM_0000 -32768 32767 /end CHARACTERISTIC
/begin CHARACTERISTIC UNK_RD_IGN_1AC2C "Unidentified constant read directly by IGN 0x101ab4,0x10206c (chapter unknown) [unassigned]" VALUE 0x7AC2C RL_VAL_UW 0 CM_0000 0 65535 /end CHARACTERISTIC
/begin CHARACTERISTIC UNK_RD_IGN_1AC2E "Unidentified constant read directly by IGN 0x10206c (chapter unknown) [unassigned]" VALUE 0x7AC2E RL_VAL_UW 0 CM_0000 0 65535 /end CHARACTERISTIC
/begin CHARACTERISTIC UNK_RD_IGN_1AC30 "Unidentified constant read directly by IGN 0x10229c (chapter unknown) [unassigned]" VALUE 0x7AC30 RL_VAL_UW 0 CM_0000 0 65535 /end CHARACTERISTIC
/begin CHARACTERISTIC UNK_RD_IGN_1AC32 "Unidentified constant read directly by IGN 0x10229c (chapter unknown) [unassigned]" VALUE 0x7AC32 RL_VAL_UB 0 CM_0000 0 255 /end CHARACTERISTIC
/begin CHARACTERISTIC UNK_RD_IGN_1AC33 "Unidentified constant read directly by IGN 0x10229c (chapter unknown) [unassigned]" VALUE 0x7AC33 RL_VAL_UB 0 CM_0000 0 255 /end CHARACTERISTIC
/begin CHARACTERISTIC UNK_RD_IGN_1AC34 "Unidentified constant read directly by IGN 0x10229c (chapter unknown) [unassigned]" VALUE 0x7AC34 RL_VAL_UB 0 CM_0000 0 255 /end CHARACTERISTIC
/begin CHARACTERISTIC UNK_RD_IGN_1AC51 "Unidentified constant read directly by IGN 0x57ff4 (chapter unknown) [unassigned]" VALUE 0x7AC51 RL_VAL_UB 0 CM_0000 0 255 /end CHARACTERISTIC
/begin CHARACTERISTIC UNK_RD_IGN_1AC52 "Unidentified constant read directly by IGN 0x57ff4 (chapter unknown) [unassigned]" VALUE 0x7AC52 RL_VAL_UB 0 CM_0000 0 255 /end CHARACTERISTIC
/begin CHARACTERISTIC UNK_RD_IGN_1AC5C "Unidentified constant read directly by IGN 0x594f4 (chapter unknown) [unassigned]" VALUE 0x7AC5C RL_VAL_UW 0 CM_0000 0 65535 /end CHARACTERISTIC
/begin CHARACTERISTIC UNK_RD_IGN_1AC5E "Unidentified constant read directly by IGN 0x594f4 (chapter unknown) [unassigned]" VALUE 0x7AC5E RL_VAL_UW 0 CM_0000 0 65535 /end CHARACTERISTIC
/begin CHARACTERISTIC UNK_RD_IGN_1AC60 "Unidentified constant read directly by IGN 0x594f4 (chapter unknown) [unassigned]" VALUE 0x7AC60 RL_VAL_UW 0 CM_0000 0 65535 /end CHARACTERISTIC
/begin CHARACTERISTIC UNK_RD_IGN_1AC64 "Unidentified constant read directly by IGN 0x594f4 (chapter unknown) [unassigned]" VALUE 0x7AC64 RL_VAL_UL 0 CM_0000 0 4294967295 /end CHARACTERISTIC
/begin CHARACTERISTIC UNK_RD_IGN_1AD10 "Unidentified constant read directly by IGN 0x5aabc (chapter unknown) [unassigned]" VALUE 0x7AD10 RL_VAL_UB 0 CM_0000 0 255 /end CHARACTERISTIC
/begin CHARACTERISTIC UNK_RD_IGN_1AD1C "Unidentified constant read directly by IGN 0x5b0bc (chapter unknown) [unassigned]" VALUE 0x7AD1C RL_VAL_SW 0 CM_0000 -32768 32767 /end CHARACTERISTIC
/begin CHARACTERISTIC UNK_RD_IGN_1AD1E "Unidentified constant read directly by IGN 0x5b0bc (chapter unknown) [unassigned]" VALUE 0x7AD1E RL_VAL_SW 0 CM_0000 -32768 32767 /end CHARACTERISTIC
/begin CHARACTERISTIC UNK_RD_IGN_1AD20 "Unidentified constant read directly by IGN 0x5acd8 (chapter unknown) [unassigned]" VALUE 0x7AD20 RL_VAL_UB 0 CM_0000 0 255 /end CHARACTERISTIC
/begin CHARACTERISTIC UNK_RD_IGN_1AD3A "Unidentified constant read directly by IGN 0x5acd8,0x5ae68 (chapter unknown) [unassigned]" VALUE 0x7AD3A RL_VAL_UB 0 CM_0000 0 255 /end CHARACTERISTIC
/begin CHARACTERISTIC UNK_RD_IGN_1BAE4 "Unidentified constant read directly by IGN 0x5b4ec (chapter unknown) [unassigned]" VALUE 0x7BAE4 RL_VAL_SW 0 CM_0000 -32768 32767 /end CHARACTERISTIC
/begin CHARACTERISTIC UNK_RD_IGN_1BAE6 "Unidentified constant read directly by IGN 0x5b4ec (chapter unknown) [unassigned]" VALUE 0x7BAE6 RL_VAL_SW 0 CM_0000 -32768 32767 /end CHARACTERISTIC
/begin CHARACTERISTIC UNK_RD_IGN_1BC44 "Unidentified constant read directly by IGN 0x5c738 (chapter unknown) [unassigned]" VALUE 0x7BC44 RL_VAL_UB 0 CM_0000 0 255 /end CHARACTERISTIC
/begin CHARACTERISTIC UNK_RD_IGN_1C288 "Unidentified constant read directly by IGN 0xe2a8c (Momentenmanager) [unassigned]" VALUE 0x7C288 RL_VAL_UW 0 CM_0000 0 65535 /end CHARACTERISTIC
/begin CHARACTERISTIC UNK_RD_IGN_1E4CE "Unidentified constant read directly by IGN 0x63fbc (chapter unknown) [unassigned]" VALUE 0x7E4CE RL_VAL_SW 0 CM_0000 -32768 32767 /end CHARACTERISTIC
/begin CHARACTERISTIC UNK_RD_IGN_1E4D1 "Unidentified constant read directly by IGN 0x641fc (chapter unknown) [unassigned]" VALUE 0x7E4D1 RL_VAL_UB 0 CM_0000 0 255 /end CHARACTERISTIC
/begin CHARACTERISTIC UNK_RD_IGN_1E4D2 "Unidentified constant read directly by IGN 0x641fc (chapter unknown) [unassigned]" VALUE 0x7E4D2 RL_VAL_UB 0 CM_0000 0 255 /end CHARACTERISTIC
/begin CHARACTERISTIC UNK_RD_IGN_1E4D3 "Unidentified constant read directly by IGN 0x641fc (chapter unknown) [unassigned]" VALUE 0x7E4D3 RL_VAL_UB 0 CM_0000 0 255 /end CHARACTERISTIC
/begin CHARACTERISTIC UNK_RD_IGN_1E4E2 "Unidentified constant read directly by IGN 0x64724 (chapter unknown) [unassigned]" VALUE 0x7E4E2 RL_VAL_UW 0 CM_0000 0 65535 /end CHARACTERISTIC
/begin CHARACTERISTIC UNK_RD_IGN_1E6FA "Unidentified constant read directly by IGN 0x118ae0 (chapter unknown) [unassigned]" VALUE 0x7E6FA RL_VAL_UB 0 CM_0000 0 255 /end CHARACTERISTIC
/begin CHARACTERISTIC UNK_RD_IGN_1E6FC "Unidentified constant read directly by IGN 0x118ae0 (chapter unknown) [unassigned]" VALUE 0x7E6FC RL_VAL_SW 0 CM_0000 -32768 32767 /end CHARACTERISTIC
/begin CHARACTERISTIC UNK_RD_IGN_1E6FE "Unidentified constant read directly by IGN 0x118ae0 (chapter unknown) [unassigned]" VALUE 0x7E6FE RL_VAL_SW 0 CM_0000 -32768 32767 /end CHARACTERISTIC
/begin CHARACTERISTIC UNK_RD_IGN_1E700 "Unidentified constant read directly by IGN 0x118ae0 (chapter unknown) [unassigned]" VALUE 0x7E700 RL_VAL_SW 0 CM_0000 -32768 32767 /end CHARACTERISTIC
/begin CHARACTERISTIC UNK_RD_IGN_1E702 "Unidentified constant read directly by IGN 0x118ae0 (chapter unknown) [unassigned]" VALUE 0x7E702 RL_VAL_SW 0 CM_0000 -32768 32767 /end CHARACTERISTIC
/begin CHARACTERISTIC UNK_RD_IGN_1E71E "Unidentified constant read directly by IGN 0x271a8 (chapter unknown) [unassigned]" VALUE 0x7E71E RL_VAL_UW 0 CM_0000 0 65535 /end CHARACTERISTIC
/begin CHARACTERISTIC UNK_RD_IGN_1E720 "Unidentified constant read directly by IGN 0x27308 (chapter unknown) [unassigned]" VALUE 0x7E720 RL_VAL_SW 0 CM_0000 -32768 32767 /end CHARACTERISTIC
/begin CHARACTERISTIC UNK_RD_IGN_1E722 "Unidentified constant read directly by IGN 0x27308 (chapter unknown) [unassigned]" VALUE 0x7E722 RL_VAL_SW 0 CM_0000 -32768 32767 /end CHARACTERISTIC
/begin CHARACTERISTIC UNK_RD_IGN_1E724 "Unidentified constant read directly by IGN 0x27308 (chapter unknown) [unassigned]" VALUE 0x7E724 RL_VAL_SW 0 CM_0000 -32768 32767 /end CHARACTERISTIC
/begin CHARACTERISTIC UNK_RD_IGN_1E726 "Unidentified constant read directly by IGN 0x27308 (chapter unknown) [unassigned]" VALUE 0x7E726 RL_VAL_UW 0 CM_0000 0 65535 /end CHARACTERISTIC
/begin CHARACTERISTIC UNK_RD_IGN_1F2CB "Unidentified constant read directly by IGN 0xe2a8c (Momentenmanager) [unassigned]" VALUE 0x7F2CB RL_VAL_UL 0 CM_0000 0 4294967295 /end CHARACTERISTIC
/begin CHARACTERISTIC UNK_RD_IGN_1FFF8 "Unidentified constant read directly by IGN 0x14820,0x14f78,0x15328 (chapter unknown) [unassigned]" VALUE 0x7FFF8 RL_VAL_UL 0 CM_0000 0 4294967295 /end CHARACTERISTIC
/begin CHARACTERISTIC UNK_RD_IGN_1FFFC "Unidentified constant read directly by IGN 0x2fb1c (SK-Manager) [unassigned]" VALUE 0x7FFFC RL_VAL_UL 0 CM_0000 0 4294967295 /end CHARACTERISTIC
/begin CHARACTERISTIC UNK_EGASAQ_102A6 "Unassigned constant read by IGN 29E70 [unassigned]" VALUE 0x702A6 RL_VAL_UW 0 CM_0000 0 65535 /end CHARACTERISTIC
/begin CHARACTERISTIC UNK_MOMENTEN_16A78 "Unassigned constant read by IGN 4AAF0 [unassigned]" VALUE 0x76A78 RL_VAL_UW 0 CM_0000 0 65535 /end CHARACTERISTIC
/begin CHARACTERISTIC UNK_MOMENTEN_16A96 "Unassigned constant read by IGN 4D50C [unassigned]" VALUE 0x76A96 RL_VAL_SW 0 CM_0000 -32768 32767 /end CHARACTERISTIC
/begin CHARACTERISTIC UNK_MOMENTEN_16A98 "Unassigned constant read by IGN 4AFE0 [unassigned]" VALUE 0x76A98 RL_VAL_UB 0 CM_0000 0 255 /end CHARACTERISTIC
/begin CHARACTERISTIC UNK_MOMENTEN_16A9A "Unassigned constant read by IGN 4E288 [unassigned]" VALUE 0x76A9A RL_VAL_SW 0 CM_0256 -3550 3003.5 /end CHARACTERISTIC
/begin CHARACTERISTIC UNK_MOMENTEN_17C40 "Unassigned constant read by IGN 4C520 [unassigned]" VALUE 0x77C40 RL_VAL_SW 0 CM_0000 -32768 32767 /end CHARACTERISTIC
/begin CHARACTERISTIC UNK_MOMENTEN_190AE "Unassigned constant read by IGN 4F3D8 [unassigned]" VALUE 0x790AE RL_VAL_SW 0 CM_0002 -32768 32767 /end CHARACTERISTIC
/begin CHARACTERISTIC UNK_MOMENTEN_191D6 "Unassigned constant read by IGN 51AC8 [unassigned]" VALUE 0x791D6 RL_VAL_UW 0 CM_0000 0 65535 /end CHARACTERISTIC
/begin CHARACTERISTIC UNK_MOMENTEN_191DA "Unassigned constant read by IGN FBEC4 [unassigned]" VALUE 0x791DA RL_VAL_SW 0 CM_0000 -32768 32767 /end CHARACTERISTIC
/begin CHARACTERISTIC UNK_MOMENTEN_1A6A0 "Unassigned constant read by IGN FD6C8 [unassigned]" VALUE 0x7A6A0 RL_VAL_UL 0 CM_0000 0 4294967295 /end CHARACTERISTIC
/begin CHARACTERISTIC UNK_MOMENTEN_1AA84 "Unassigned constant read by IGN 101404 55AE8 [unassigned]" VALUE 0x7AA84 RL_VAL_SW 0 CM_0000 -32768 32767 /end CHARACTERISTIC
/begin CHARACTERISTIC UNK_MOMENTEN_1AA86 "Unassigned constant read by IGN 557A0 [unassigned]" VALUE 0x7AA86 RL_VAL_UB 0 CM_0000 0 255 /end CHARACTERISTIC
/begin CHARACTERISTIC UNK_MOMENTEN_1AA87 "Unassigned constant read by IGN 557A0 [unassigned]" VALUE 0x7AA87 RL_VAL_UB 0 CM_0000 0 255 /end CHARACTERISTIC
/begin CHARACTERISTIC UNK_MOMENTEN_1D106 "Unassigned constant read by IGN 29984 5BA78 [unassigned]" VALUE 0x7D106 RL_VAL_UB 0 CM_0000 0 255 /end CHARACTERISTIC
/begin CHARACTERISTIC UNK_MOMENTEN_1D10D "Unassigned constant read by IGN 10FD14 38AFC 3A76C [unassigned]" VALUE 0x7D10D RL_VAL_UB 0 CM_0000 0 255 /end CHARACTERISTIC
/begin CHARACTERISTIC UNK_MOMENTEN_1D10E "Unassigned constant read by IGN 2F020 2F840 58CAC [unassigned]" VALUE 0x7D10E RL_VAL_UB 0 CM_0000 0 255 /end CHARACTERISTIC
/begin CHARACTERISTIC UNK_MOMENTEN_1D114 "Unassigned constant read by IGN [unassigned]" VALUE 0x7D114 RL_VAL_UB 0 CM_0000 0 255 /end CHARACTERISTIC
/begin CHARACTERISTIC UNK_MOMENTEN_1D338 "Unassigned constant read by IGN 1104BC [unassigned]" VALUE 0x7D338 RL_VAL_UB 0 CM_0000 0 255 /end CHARACTERISTIC
/begin CHARACTERISTIC UNK_MOMENTEN_1D342 "Unassigned constant read by IGN 1104BC [unassigned]" VALUE 0x7D342 RL_VAL_UW 0 CM_0000 0 65535 /end CHARACTERISTIC
/begin CHARACTERISTIC UNK_MOMENTEN_1D344 "Unassigned constant read by IGN 1104BC [unassigned]" VALUE 0x7D344 RL_VAL_SW 0 CM_0000 -32768 32767 /end CHARACTERISTIC
/begin CHARACTERISTIC UNK_MOMENTEN_1D346 "Unassigned constant read by IGN 1104BC [unassigned]" VALUE 0x7D346 RL_VAL_SW 0 CM_0000 -32768 32767 /end CHARACTERISTIC
/begin CHARACTERISTIC UNK_MOMENTEN_1D356 "Unassigned constant read by IGN 1104BC [unassigned]" VALUE 0x7D356 RL_VAL_UW 0 CM_0247 0 655.35 /end CHARACTERISTIC
/begin CHARACTERISTIC UNK_MOMENTEN_1D358 "Unassigned constant read by IGN 1104BC [unassigned]" VALUE 0x7D358 RL_VAL_UW 0 CM_0000 0 65535 /end CHARACTERISTIC
/begin CHARACTERISTIC UNK_MOMENTEN_1D35A "Unassigned constant read by IGN 1104BC [unassigned]" VALUE 0x7D35A RL_VAL_SW 0 CM_0000 -32768 32767 /end CHARACTERISTIC
/begin CHARACTERISTIC UNK_MOMENTEN_1D35C "Unassigned constant read by IGN 1104BC [unassigned]" VALUE 0x7D35C RL_VAL_UL 0 CM_0000 0 4294967295 /end CHARACTERISTIC
/begin CHARACTERISTIC UNK_MOMENTEN_1D360 "Unassigned constant read by IGN 1104BC [unassigned]" VALUE 0x7D360 RL_VAL_SW 0 CM_0000 -32768 32767 /end CHARACTERISTIC
/begin CHARACTERISTIC UNK_MOMENTEN_1D362 "Unassigned constant read by IGN 1104BC [unassigned]" VALUE 0x7D362 RL_VAL_SW 0 CM_0000 -32768 32767 /end CHARACTERISTIC
/begin CHARACTERISTIC UNK_MOMENTEN_1E71A "Unassigned constant read by IGN 11A77C [unassigned]" VALUE 0x7E71A RL_VAL_SW 0 CM_0000 -32768 32767 /end CHARACTERISTIC
/begin CHARACTERISTIC UNK_MOMENTEN_1E71C "Unassigned constant read by IGN 271A8 [unassigned]" VALUE 0x7E71C RL_VAL_SW 0 CM_0000 -32768 32767 /end CHARACTERISTIC
/begin CHARACTERISTIC UNK_MOMENTEN_1E784 "Unassigned constant read by IGN 119D44 4D50C 59A6C [unassigned]" VALUE 0x7E784 RL_VAL_UB 0 CM_0000 0 255 /end CHARACTERISTIC
/begin CHARACTERISTIC UNK_MOMENTEN_1ECAA "Unassigned constant read by IGN 278C8 [unassigned]" VALUE 0x7ECAA RL_VAL_UW 0 CM_0000 0 65535 /end CHARACTERISTIC
/begin CHARACTERISTIC UNK_MOMENTEN_1ECAC "Unassigned constant read by IGN 278C8 [unassigned]" VALUE 0x7ECAC RL_VAL_UW 0 CM_0000 0 65535 /end CHARACTERISTIC
/begin CHARACTERISTIC UNK_MOMENTEN_1ECAE "Unassigned constant read by IGN 278C8 [unassigned]" VALUE 0x7ECAE RL_VAL_UB 0 CM_0000 0 255 /end CHARACTERISTIC
/begin CHARACTERISTIC UNK_MOMENTEN_1ECAF "Unassigned constant read by IGN 278C8 [unassigned]" VALUE 0x7ECAF RL_VAL_UB 0 CM_0000 0 255 /end CHARACTERISTIC
/begin CHARACTERISTIC UNK_MOMENTEN_1ECC0 "Unassigned constant read by IGN 278C8 [unassigned]" VALUE 0x7ECC0 RL_VAL_UW 0 CM_0000 0 65535 /end CHARACTERISTIC
/begin CHARACTERISTIC UNK_MOMENTEN_1ECC2 "Unassigned constant read by IGN 278C8 [unassigned]" VALUE 0x7ECC2 RL_VAL_UW 0 CM_0000 0 65535 /end CHARACTERISTIC
/begin CHARACTERISTIC UNK_MOMENTEN_1ECC4 "Unassigned constant read by IGN 11A3D0 278C8 [unassigned]" VALUE 0x7ECC4 RL_VAL_UW 0 CM_0000 0 65535 /end CHARACTERISTIC
/begin CHARACTERISTIC UNK_MOMENTEN_1ECC6 "Unassigned constant read by IGN 11A3D0 278C8 [unassigned]" VALUE 0x7ECC6 RL_VAL_UW 0 CM_0000 0 65535 /end CHARACTERISTIC
/begin CHARACTERISTIC UNK_MOMENTEN_1ECC8 "Unassigned constant read by IGN 278C8 [unassigned]" VALUE 0x7ECC8 RL_VAL_UW 0 CM_0000 0 65535 /end CHARACTERISTIC
/begin CHARACTERISTIC UNK_MOMENTEN_1ECCA "Unassigned constant read by IGN 278C8 [unassigned]" VALUE 0x7ECCA RL_VAL_SW 0 CM_0000 -32768 32767 /end CHARACTERISTIC
/begin CHARACTERISTIC UNK_MOMENTEN_1ECCC "Unassigned constant read by IGN 278C8 [unassigned]" VALUE 0x7ECCC RL_VAL_SW 0 CM_0000 -32768 32767 /end CHARACTERISTIC
/begin CHARACTERISTIC UNK_MOMENTEN_1ECCE "Unassigned constant read by IGN 278C8 [unassigned]" VALUE 0x7ECCE RL_VAL_SW 0 CM_0000 -32768 32767 /end CHARACTERISTIC
/begin CHARACTERISTIC UNK_MOMENTEN_1ECD0 "Unassigned constant read by IGN 278C8 [unassigned]" VALUE 0x7ECD0 RL_VAL_UB 0 CM_0000 0 255 /end CHARACTERISTIC
/begin CHARACTERISTIC UNK_MOMENTEN_1ECD1 "Unassigned constant read by IGN 278C8 [unassigned]" VALUE 0x7ECD1 RL_VAL_UB 0 CM_0000 0 255 /end CHARACTERISTIC
/begin CHARACTERISTIC UNK_MOMENTEN_1ECD2 "Unassigned constant read by IGN 278C8 [unassigned]" VALUE 0x7ECD2 RL_VAL_UB 0 CM_0000 0 255 /end CHARACTERISTIC
/begin CHARACTERISTIC UNK_MOMENTEN_1ECD4 "Unassigned constant read by IGN 278C8 [unassigned]" VALUE 0x7ECD4 RL_VAL_SW 0 CM_0000 -32768 32767 /end CHARACTERISTIC
/begin CHARACTERISTIC UNK_MOMENTEN_1ECD6 "Unassigned constant read by IGN 278C8 [unassigned]" VALUE 0x7ECD6 RL_VAL_UW 0 CM_0000 0 65535 /end CHARACTERISTIC
/begin CHARACTERISTIC UNK_MOMENTEN_1ECD8 "Unassigned constant read by IGN 278C8 [unassigned]" VALUE 0x7ECD8 RL_VAL_UW 0 CM_0000 0 65535 /end CHARACTERISTIC
/begin CHARACTERISTIC UNK_LEERLAUF_16208 "Unassigned constant read by IGN 49920 [unassigned]" VALUE 0x76208 RL_VAL_SW 0 CM_0000 -32768 32767 /end CHARACTERISTIC
/begin CHARACTERISTIC UNK_LEERLAUF_16210 "Unassigned constant read by IGN 42BB0 496C8 [unassigned]" VALUE 0x76210 RL_VAL_UW 0 CM_0247 0 655.35 /end CHARACTERISTIC
/begin CHARACTERISTIC UNK_LEERLAUF_16222 "Unassigned constant read by IGN 49DDC [unassigned]" VALUE 0x76222 RL_VAL_SW 0 CM_0000 -32768 32767 /end CHARACTERISTIC
/begin CHARACTERISTIC UNK_LEERLAUF_1626E "Unassigned constant read by IGN FA12C [unassigned]" VALUE 0x7626E RL_VAL_SW 0 CM_0000 -32768 32767 /end CHARACTERISTIC
/begin CHARACTERISTIC UNK_ANSAUGLU_1D4E5 "Unassigned constant read by IGN 1120B8 [unassigned]" VALUE 0x7D4E5 RL_VAL_UB 0 CM_0000 0 255 /end CHARACTERISTIC
/begin CHARACTERISTIC UNK_ANSAUGLU_1D4E8 "Unassigned constant read by IGN 1120B8 [unassigned]" VALUE 0x7D4E8 RL_VAL_UB 0 CM_0000 0 255 /end CHARACTERISTIC
/begin CHARACTERISTIC UNK_ANSAUGLU_1D4E9 "Unassigned constant read by IGN 1120B8 [unassigned]" VALUE 0x7D4E9 RL_VAL_UB 0 CM_0000 0 255 /end CHARACTERISTIC
/begin CHARACTERISTIC UNK_ANSAUGLU_1D58E "Unassigned constant read by IGN 1127E8 [unassigned]" VALUE 0x7D58E RL_VAL_SW 0 CM_0000 -32768 32767 /end CHARACTERISTIC
/begin CHARACTERISTIC UNK_ANSAUGLU_1D592 "Unassigned constant read by IGN 1127E8 [unassigned]" VALUE 0x7D592 RL_VAL_UW 0 CM_0000 0 65535 /end CHARACTERISTIC
/begin CHARACTERISTIC UNK_ANSAUGLU_1D5A0 "Unassigned constant read by IGN 1130D4 [unassigned]" VALUE 0x7D5A0 RL_VAL_SW 0 CM_0000 -32768 32767 /end CHARACTERISTIC
/begin CHARACTERISTIC UNK_ANSAUGLU_1D5A2 "Unassigned constant read by IGN 1130D4 [unassigned]" VALUE 0x7D5A2 RL_VAL_SW 0 CM_0000 -32768 32767 /end CHARACTERISTIC
/begin CHARACTERISTIC UNK_ANSAUGLU_1D5A4 "Unassigned constant read by IGN 1130D4 [unassigned]" VALUE 0x7D5A4 RL_VAL_UB 0 CM_0000 0 255 /end CHARACTERISTIC
/begin CHARACTERISTIC UNK_ANSAUGLU_1D5A8 "Unassigned constant read by IGN 1130D4 [unassigned]" VALUE 0x7D5A8 RL_VAL_UW 0 CM_0000 0 65535 /end CHARACTERISTIC
/begin CHARACTERISTIC UNK_ANSAUGLU_1D5B8 "Unassigned constant read by IGN 1127E8 [unassigned]" VALUE 0x7D5B8 RL_VAL_SW 0 CM_0256 -3550 3003.5 /end CHARACTERISTIC
/begin CHARACTERISTIC UNK_ANSAUGLU_1D5BA "Unassigned constant read by IGN 1127E8 [unassigned]" VALUE 0x7D5BA RL_VAL_SW 0 CM_0000 -32768 32767 /end CHARACTERISTIC
/begin CHARACTERISTIC UNK_ANSAUGLU_1D5CC "Unassigned constant read by IGN 1127E8 [unassigned]" VALUE 0x7D5CC RL_VAL_SW 0 CM_0000 -32768 32767 /end CHARACTERISTIC
/begin CHARACTERISTIC UNK_ANSAUGLU_1D5D0 "Unassigned constant read by IGN 1127E8 [unassigned]" VALUE 0x7D5D0 RL_VAL_UL 0 CM_0233 0 71582788.25 /end CHARACTERISTIC
/begin CHARACTERISTIC UNK_PEDALWER_1AC9E "Unassigned constant read by IGN 59A6C [unassigned]" VALUE 0x7AC9E RL_VAL_UW 0 CM_0000 0 65535 /end CHARACTERISTIC
/begin CHARACTERISTIC UNK_PEDALWER_1ACA0 "Unassigned constant read by IGN 59A6C [unassigned]" VALUE 0x7ACA0 RL_VAL_SW 0 CM_0000 -32768 32767 /end CHARACTERISTIC
/begin CHARACTERISTIC UNK_ABGASTEM_1918C "Unassigned constant read by IGN 50ECC [unassigned]" VALUE 0x7918C RL_VAL_UL 0 CM_0059 0 1.717986918e+10 /end CHARACTERISTIC
/begin CHARACTERISTIC UNK_GANGERKE_1363E "Unassigned constant read by IGN 3DD34 3E4D8 [unassigned]" VALUE 0x7363E RL_VAL_UB 0 CM_0000 0 255 /end CHARACTERISTIC
/begin CHARACTERISTIC UNK_GANGERKE_1CD24 "Unassigned constant read by IGN 10CABC [unassigned]" VALUE 0x7CD24 RL_VAL_UW 0 CM_0000 0 65535 /end CHARACTERISTIC
/begin CHARACTERISTIC UNK_GANGERKE_1CD68 "Unassigned constant read by IGN 10CE44 [unassigned]" VALUE 0x7CD68 RL_VAL_UW 0 CM_0000 0 65535 /end CHARACTERISTIC
/begin CHARACTERISTIC UNK_KLOPFREG_138FA "Unassigned constant read by IGN F57A0 [unassigned]" VALUE 0x738FA RL_VAL_SW 0 CM_0000 -32768 32767 /end CHARACTERISTIC
/begin CHARACTERISTIC UNK_FAHRGESC_12520 "Unassigned constant read by IGN 38AFC [unassigned]" VALUE 0x72520 RL_VAL_SW 0 CM_0000 -32768 32767 /end CHARACTERISTIC
/begin CHARACTERISTIC UNK_FAHRGESC_1255A "Unassigned constant read by IGN 38AFC [unassigned]" VALUE 0x7255A RL_VAL_UB 0 CM_0000 0 255 /end CHARACTERISTIC
/begin CHARACTERISTIC UNK_MD_RES_TMOT_19188 "Unassigned constant (role from code) [unassigned]" VALUE 0x79188 RL_VAL_UW 0 CM_0000 0 65535 /end CHARACTERISTIC
/begin CHARACTERISTIC UNK_KL_TMOT_MODELL_INIT_TUMG "Start-value cap of the coolant-temperature model over ambient temperature (role from code, documented name not identified) [unassigned]" CURVE 0x7D642 RL_CUR_SW_SW 0 CM_0006 -3550 3003.5 /begin AXIS_DESCR STD_AXIS NO_INPUT_QUANTITY CM_0006 4 -3550 3003.5 /end AXIS_DESCR /end CHARACTERISTIC
/begin MEASUREMENT cfg_boot_st "Bootstaus [RAM name from V530, voted 12]" ULONG M_FORMULA_0000 0 0 0 4294967295 ECU_ADDRESS 0x3F8010 /end MEASUREMENT
/begin MEASUREMENT sys_exc_lr "Linkregister nach Exception [RAM name from V530, voted 3]" ULONG M_FORMULA_0000 0 0 0 4294967295 ECU_ADDRESS 0x3F8018 /end MEASUREMENT
/begin MEASUREMENT tz_zyl_ti "Zylinder selektive Abschaltung der Einspritzung [RAM name from V530, voted 1]" UWORD M_FORMULA_0080 0 0 0 65535 ECU_ADDRESS 0x3F858C /end MEASUREMENT
/begin MEASUREMENT tz_grad_b1 "Zuendwinkelgradient pro Bank [RAM name from V530, voted 2]" SWORD M_FORMULA_0231 0 0 -3276.8 3276.7 ECU_ADDRESS 0x3F85AA /end MEASUREMENT
/begin MEASUREMENT md_kupp_ist_ve "Moment an der Kupplung vor Eingriff [RAM name from V530, voted 1]" SWORD M_FORMULA_0009 0 0 -3276.8 3276.7 ECU_ADDRESS 0x3F85AE /end MEASUREMENT
/begin MEASUREMENT md_kupp_ist "Moment an der Kupplung [RAM name from V530, voted 11]" SWORD M_FORMULA_0009 0 0 -3276.8 3276.7 ECU_ADDRESS 0x3F85B0 /end MEASUREMENT
/begin MEASUREMENT md_ind_ne "ind. Moment nach Eingriff [RAM name from V530, voted 3]" SWORD M_FORMULA_0009 0 0 -3276.8 3276.7 ECU_ADDRESS 0x3F85B2 /end MEASUREMENT
/begin MEASUREMENT md_tz_soll_mittel "mittlerer Soll-TZ [RAM name from V530, voted 2]" SWORD M_FORMULA_0102 0 0 -3276.8 3276.7 ECU_ADDRESS 0x3F85BA /end MEASUREMENT
/begin COMPU_METHOD M_FORMULA_0000 "V530 FORMULA_0000" RAT_FUNC "%.4g" "-" COEFFS 0 1 0 0 0 1 /end COMPU_METHOD
/begin COMPU_METHOD M_FORMULA_0009 "V530 FORMULA_0009" RAT_FUNC "%.4g" "Nm" COEFFS 0 10 0 0 0 1 /end COMPU_METHOD
/begin COMPU_METHOD M_FORMULA_0080 "V530 FORMULA_0080" RAT_FUNC "%.4g" "-" COEFFS 0 1 0 0 0 1 /end COMPU_METHOD
/begin COMPU_METHOD M_FORMULA_0102 "V530 FORMULA_0102" RAT_FUNC "%.4g" "???KW" COEFFS 0 10 0 0 0 1 /end COMPU_METHOD
/begin COMPU_METHOD M_FORMULA_0231 "V530 FORMULA_0231" RAT_FUNC "%.4g" "???KW/Segm" COEFFS 0 10 0 0 0 1 /end COMPU_METHOD
/begin COMPU_METHOD CM_0000 "X" RAT_FUNC "%.4g" "-" COEFFS 0 1 0 0 0 1 /end COMPU_METHOD
/begin COMPU_METHOD CM_0002 "X" RAT_FUNC "%.4g" "Upm" COEFFS 0 1 0 0 0 1 /end COMPU_METHOD
/begin COMPU_METHOD CM_0006 "X*0.1-273.2" RAT_FUNC "%.4g" "?C" COEFFS 0 1 273.2 0 0 0.1 /end COMPU_METHOD
/begin COMPU_METHOD CM_0024 "X*0.1" RAT_FUNC "%.4g" "Kelvin" COEFFS 0 1 0 0 0 0.1 /end COMPU_METHOD
/begin COMPU_METHOD CM_0028 "X*0.1" RAT_FUNC "%.4g" "?KW" COEFFS 0 1 0 0 0 0.1 /end COMPU_METHOD
/begin COMPU_METHOD CM_0059 "X*4" RAT_FUNC "%.4g" "km" COEFFS 0 1 0 0 0 4 /end COMPU_METHOD
/begin COMPU_METHOD CM_0123 "X*0.29296875" RAT_FUNC "%.4g" "mm" COEFFS 0 1 0 0 0 0.29296875 /end COMPU_METHOD
/begin COMPU_METHOD CM_0233 "X/60" RAT_FUNC "%.4g" "min" COEFFS 0 60 0 0 0 1 /end COMPU_METHOD
/begin COMPU_METHOD CM_0238 "X*2" RAT_FUNC "%.4g" "km" COEFFS 0 1 0 0 0 2 /end COMPU_METHOD
/begin COMPU_METHOD CM_0247 "X/100" RAT_FUNC "%.4g" "s" COEFFS 0 100 0 0 0 1 /end COMPU_METHOD
/begin COMPU_METHOD CM_0256 "(X-2732)/10" RAT_FUNC "%.4g" "?C" COEFFS 0 10 2732 0 0 1 /end COMPU_METHOD
/begin COMPU_METHOD CM_0272 "X*0.1" RAT_FUNC "%.4g" "K" COEFFS 0 1 0 0 0 0.1 /end COMPU_METHOD
/begin COMPU_METHOD CM_0280 "X/10" RAT_FUNC "%.4g" "?KW" COEFFS 0 10 0 0 0 1 /end COMPU_METHOD
/begin COMPU_METHOD CM_0282 "X/10000" RAT_FUNC "%.4g" "-" COEFFS 0 10000 0 0 0 1 /end COMPU_METHOD
/begin RECORD_LAYOUT RL_CUR_SW_SW FNC_VALUES 4 SWORD COLUMN_DIR DIRECT AXIS_PTS_X 3 SWORD INDEX_INCR DIRECT NO_AXIS_PTS_X 1 UBYTE RESERVED 2 BYTE /end RECORD_LAYOUT
/begin RECORD_LAYOUT RL_CUR_SW_UB FNC_VALUES 4 UBYTE COLUMN_DIR DIRECT AXIS_PTS_X 3 SWORD INDEX_INCR DIRECT NO_AXIS_PTS_X 1 UBYTE RESERVED 2 BYTE /end RECORD_LAYOUT
/begin RECORD_LAYOUT RL_CUR_SW_UW FNC_VALUES 4 UWORD COLUMN_DIR DIRECT AXIS_PTS_X 3 SWORD INDEX_INCR DIRECT NO_AXIS_PTS_X 1 UBYTE RESERVED 2 BYTE /end RECORD_LAYOUT
/begin RECORD_LAYOUT RL_CUR_UW_SW FNC_VALUES 4 SWORD COLUMN_DIR DIRECT AXIS_PTS_X 3 UWORD INDEX_INCR DIRECT NO_AXIS_PTS_X 1 UBYTE RESERVED 2 BYTE /end RECORD_LAYOUT
/begin RECORD_LAYOUT RL_MAP_SW_SW_SW FNC_VALUES 5 SWORD COLUMN_DIR DIRECT AXIS_PTS_X 3 SWORD INDEX_INCR DIRECT AXIS_PTS_Y 4 SWORD INDEX_INCR DIRECT NO_AXIS_PTS_X 1 UBYTE NO_AXIS_PTS_Y 2 UBYTE /end RECORD_LAYOUT
/begin RECORD_LAYOUT RL_MAP_SW_SW_UB FNC_VALUES 5 UBYTE COLUMN_DIR DIRECT AXIS_PTS_X 3 SWORD INDEX_INCR DIRECT AXIS_PTS_Y 4 SWORD INDEX_INCR DIRECT NO_AXIS_PTS_X 1 UBYTE NO_AXIS_PTS_Y 2 UBYTE /end RECORD_LAYOUT
/begin RECORD_LAYOUT RL_MAP_SW_SW_UW FNC_VALUES 5 UWORD COLUMN_DIR DIRECT AXIS_PTS_X 3 SWORD INDEX_INCR DIRECT AXIS_PTS_Y 4 SWORD INDEX_INCR DIRECT NO_AXIS_PTS_X 1 UBYTE NO_AXIS_PTS_Y 2 UBYTE /end RECORD_LAYOUT
/begin RECORD_LAYOUT RL_VAL_SW FNC_VALUES 1 SWORD COLUMN_DIR DIRECT /end RECORD_LAYOUT
/begin RECORD_LAYOUT RL_VAL_UB FNC_VALUES 1 UBYTE COLUMN_DIR DIRECT /end RECORD_LAYOUT
/begin RECORD_LAYOUT RL_VAL_UL FNC_VALUES 1 ULONG COLUMN_DIR DIRECT /end RECORD_LAYOUT
/begin RECORD_LAYOUT RL_VAL_UW FNC_VALUES 1 UWORD COLUMN_DIR DIRECT /end RECORD_LAYOUT
/begin GROUP G_y_Fault_paths__K_ED_ "y Fault paths (K_ED)" ROOT
 /begin REF_CHARACTERISTIC K_ED_THERMOSTAT.DEC_VOR_EINTRAG K_ED_THERMOSTAT.FEHLERSCHWELLE K_ED_THERMOSTAT.INC_NACH_EINTRAG K_ED_THERMOSTAT.INC_VOR_EINTRAG K_ED_THERMOSTAT.KLASSENINDEX K_ED_THERMOSTAT.OK_SCHWELLE K_ED_THERMOSTAT.P_CODE_OPENLOAD K_ED_THERMOSTAT.P_CODE_SH_TO_GND K_ED_THERMOSTAT.P_CODE_SH_TO_UB K_ED_THERMOSTAT.P_CODE_UNPLAUSIBEL K_ED_TIME_REL_OBD.DEC_NACH_EINTRAG K_ED_TIME_REL_OBD.DEC_VOR_EINTRAG K_ED_TIME_REL_OBD.FEHLERSCHWELLE K_ED_TIME_REL_OBD.INC_NACH_EINTRAG K_ED_TIME_REL_OBD.INC_VOR_EINTRAG K_ED_TIME_REL_OBD.KLASSENINDEX K_ED_TIME_REL_OBD.OK_SCHWELLE K_ED_TIME_REL_OBD.P_CODE_OPENLOAD K_ED_TIME_REL_OBD.P_CODE_SH_TO_GND K_ED_TIME_REL_OBD.P_CODE_SH_TO_UB K_ED_TIME_REL_OBD.P_CODE_UNPLAUSIBEL K_ED_TKA.DEC_NACH_EINTRAG K_ED_TKA.DEC_VOR_EINTRAG K_ED_TKA.FEHLERSCHWELLE K_ED_TKA.INC_NACH_EINTRAG K_ED_TKA.INC_VOR_EINTRAG K_ED_TKA.KLASSENINDEX K_ED_TKA.OK_SCHWELLE K_ED_TKA.P_CODE_OPENLOAD K_ED_TKA.P_CODE_SH_TO_GND K_ED_TKA.P_CODE_SH_TO_UB K_ED_TKA.P_CODE_UNPLAUSIBEL K_ED_TKA_OBD.DEC_NACH_EINTRAG K_ED_TKA_OBD.DEC_VOR_EINTRAG K_ED_TKA_OBD.FEHLERSCHWELLE K_ED_TKA_OBD.INC_NACH_EINTRAG K_ED_TKA_OBD.INC_VOR_EINTRAG K_ED_TKA_OBD.KLASSENINDEX K_ED_TKA_OBD.OK_SCHWELLE K_ED_TKA_OBD.P_CODE_OPENLOAD K_ED_TKA_OBD.P_CODE_SH_TO_GND K_ED_TKA_OBD.P_CODE_SH_TO_UB K_ED_TKA_OBD.P_CODE_UNPLAUSIBEL K_ED_TMOT.DEC_NACH_EINTRAG K_ED_TMOT.DEC_VOR_EINTRAG K_ED_TMOT.FEHLERSCHWELLE K_ED_TMOT.INC_NACH_EINTRAG K_ED_TMOT.INC_VOR_EINTRAG K_ED_TMOT.KLASSENINDEX K_ED_TMOT.OK_SCHWELLE K_ED_TMOT.P_CODE_OPENLOAD K_ED_TMOT.P_CODE_SH_TO_GND K_ED_TMOT.P_CODE_SH_TO_UB K_ED_TMOT.P_CODE_UNPLAUSIBEL K_ED_TMOT_OBD.DEC_NACH_EINTRAG K_ED_TMOT_OBD.DEC_VOR_EINTRAG K_ED_TMOT_OBD.FEHLERSCHWELLE K_ED_TMOT_OBD.INC_NACH_EINTRAG K_ED_TMOT_OBD.INC_VOR_EINTRAG K_ED_TMOT_OBD.KLASSENINDEX K_ED_TMOT_OBD.OK_SCHWELLE K_ED_TMOT_OBD.P_CODE_OPENLOAD K_ED_TMOT_OBD.P_CODE_SH_TO_GND K_ED_TMOT_OBD.P_CODE_SH_TO_UB K_ED_TMOT_OBD.P_CODE_UNPLAUSIBEL K_ED_TMOT_OBD_HIGH.DEC_NACH_EINTRAG K_ED_TMOT_OBD_HIGH.DEC_VOR_EINTRAG K_ED_TMOT_OBD_HIGH.FEHLERSCHWELLE K_ED_TMOT_OBD_HIGH.INC_NACH_EINTRAG K_ED_TMOT_OBD_HIGH.INC_VOR_EINTRAG K_ED_TMOT_OBD_HIGH.KLASSENINDEX K_ED_TMOT_OBD_HIGH.OK_SCHWELLE K_ED_TMOT_OBD_HIGH.P_CODE_OPENLOAD K_ED_TMOT_OBD_HIGH.P_CODE_SH_TO_GND K_ED_TMOT_OBD_HIGH.P_CODE_SH_TO_UB K_ED_TMOT_OBD_HIGH.P_CODE_UNPLAUSIBEL K_ED_TUMG.DEC_NACH_EINTRAG K_ED_TUMG.DEC_VOR_EINTRAG K_ED_TUMG.FEHLERSCHWELLE K_ED_TUMG.INC_NACH_EINTRAG K_ED_TUMG.INC_VOR_EINTRAG K_ED_TUMG.KLASSENINDEX K_ED_TUMG.OK_SCHWELLE K_ED_TUMG.P_CODE_OPENLOAD K_ED_TUMG.P_CODE_SH_TO_GND K_ED_TUMG.P_CODE_SH_TO_UB K_ED_TUMG.P_CODE_UNPLAUSIBEL K_ED_TUMG_OBD.DEC_NACH_EINTRAG K_ED_TUMG_OBD.DEC_VOR_EINTRAG K_ED_TUMG_OBD.FEHLERSCHWELLE K_ED_TUMG_OBD.INC_NACH_EINTRAG K_ED_TUMG_OBD.INC_VOR_EINTRAG K_ED_TUMG_OBD.KLASSENINDEX K_ED_TUMG_OBD.OK_SCHWELLE K_ED_TUMG_OBD.P_CODE_OPENLOAD K_ED_TUMG_OBD.P_CODE_SH_TO_GND K_ED_TUMG_OBD.P_CODE_SH_TO_UB K_ED_TUMG_OBD.P_CODE_UNPLAUSIBEL K_ED_UB.DEC_NACH_EINTRAG K_ED_UB.DEC_VOR_EINTRAG K_ED_UB.FEHLERSCHWELLE K_ED_UB.INC_NACH_EINTRAG K_ED_UB.INC_VOR_EINTRAG K_ED_UB.KLASSENINDEX K_ED_UB.OK_SCHWELLE K_ED_UB.P_CODE_OPENLOAD K_ED_UB.P_CODE_SH_TO_GND K_ED_UB.P_CODE_SH_TO_UB K_ED_UB.P_CODE_UNPLAUSIBEL K_ED_UEXT_111219514.DEC_NACH_EINTRAG K_ED_UEXT_111219514.DEC_VOR_EINTRAG K_ED_UEXT_111219514.FEHLERSCHWELLE K_ED_UEXT_111219514.INC_NACH_EINTRAG K_ED_UEXT_111219514.INC_VOR_EINTRAG K_ED_UEXT_111219514.KLASSENINDEX K_ED_UEXT_111219514.OK_SCHWELLE K_ED_UEXT_111219514.P_CODE_OPENLOAD K_ED_UEXT_111219514.P_CODE_SH_TO_GND K_ED_UEXT_111219514.P_CODE_SH_TO_UB K_ED_UEXT_111219514.P_CODE_UNPLAUSIBEL K_ED_UEXT_124_512.DEC_NACH_EINTRAG K_ED_UEXT_124_512.DEC_VOR_EINTRAG K_ED_UEXT_124_512.FEHLERSCHWELLE K_ED_UEXT_124_512.INC_NACH_EINTRAG K_ED_UEXT_124_512.INC_VOR_EINTRAG K_ED_UEXT_124_512.KLASSENINDEX K_ED_UEXT_124_512.OK_SCHWELLE K_ED_UEXT_124_512.P_CODE_OPENLOAD K_ED_UEXT_124_512.P_CODE_SH_TO_GND K_ED_UEXT_124_512.P_CODE_SH_TO_UB K_ED_UEXT_124_512.P_CODE_UNPLAUSIBEL K_ED_V_DIREKT.DEC_NACH_EINTRAG K_ED_V_DIREKT.DEC_VOR_EINTRAG K_ED_V_DIREKT.FEHLERSCHWELLE K_ED_V_DIREKT.INC_NACH_EINTRAG K_ED_V_DIREKT.INC_VOR_EINTRAG K_ED_V_DIREKT.KLASSENINDEX K_ED_V_DIREKT.OK_SCHWELLE K_ED_V_DIREKT.P_CODE_OPENLOAD K_ED_V_DIREKT.P_CODE_SH_TO_GND K_ED_V_DIREKT.P_CODE_SH_TO_UB K_ED_V_DIREKT.P_CODE_UNPLAUSIBEL K_ED_WUC_DELTA_TMOT__IGN_ K_ED_WUC_TMOT_MIN__IGN_ K_ED_ZOELP1.DEC_NACH_EINTRAG K_ED_ZOELP1.DEC_VOR_EINTRAG K_ED_ZOELP1.FEHLERSCHWELLE K_ED_ZOELP1.INC_NACH_EINTRAG K_ED_ZOELP1.INC_VOR_EINTRAG K_ED_ZOELP1.KLASSENINDEX K_ED_ZOELP1.OK_SCHWELLE K_ED_ZOELP1.P_CODE_OPENLOAD K_ED_ZOELP1.P_CODE_SH_TO_GND K_ED_ZOELP1.P_CODE_SH_TO_UB K_ED_ZOELP1.P_CODE_UNPLAUSIBEL K_ED_ZOELP2.DEC_NACH_EINTRAG K_ED_ZOELP2.DEC_VOR_EINTRAG K_ED_ZOELP2.FEHLERSCHWELLE K_ED_ZOELP2.INC_NACH_EINTRAG K_ED_ZOELP2.INC_VOR_EINTRAG K_ED_ZOELP2.KLASSENINDEX K_ED_ZOELP2.OK_SCHWELLE K_ED_ZOELP2.P_CODE_OPENLOAD K_ED_ZOELP2.P_CODE_SH_TO_GND K_ED_ZOELP2.P_CODE_SH_TO_UB K_ED_ZOELP2.P_CODE_UNPLAUSIBEL K_ED_AUSS_ABG_MULT.FEHLERSCHWELLE K_ED_AUSS_ABG_MULT.INC_VOR_EINTRAG K_ED_AUSS_ABG_MULT.OK_SCHWELLE K_ED_INDEX_84_IGN.P_CODE_OPENLOAD K_ED_INDEX_84_IGN.P_CODE_SH_TO_GND K_ED_INDEX_84_IGN.P_CODE_SH_TO_UB K_ED_INDEX_84_IGN.P_CODE_UNPLAUSIBEL K_ED_INDEX_85_IGN.P_CODE_OPENLOAD K_ED_INDEX_85_IGN.P_CODE_SH_TO_GND K_ED_INDEX_85_IGN.P_CODE_SH_TO_UB K_ED_INDEX_85_IGN.P_CODE_UNPLAUSIBEL K_ED_INDEX_88_IGN.DEC_NACH_EINTRAG K_ED_INDEX_88_IGN.DEC_VOR_EINTRAG K_ED_INDEX_88_IGN.FEHLERSCHWELLE K_ED_INDEX_88_IGN.INC_NACH_EINTRAG K_ED_INDEX_88_IGN.INC_VOR_EINTRAG K_ED_INDEX_88_IGN.KLASSENINDEX K_ED_INDEX_88_IGN.OK_SCHWELLE K_ED_INDEX_88_IGN.P_CODE_OPENLOAD K_ED_INDEX_88_IGN.P_CODE_SH_TO_GND K_ED_INDEX_88_IGN.P_CODE_SH_TO_UB K_ED_INDEX_88_IGN.P_CODE_UNPLAUSIBEL K_ED_RBM_EVAP_MAX K_ED_RBM_EVAP_MIN K_ED_SK_TR_IGN.DEC_NACH_EINTRAG K_ED_SK_TR_IGN.DEC_VOR_EINTRAG K_ED_SK_TR_IGN.FEHLERSCHWELLE K_ED_SK_TR_IGN.INC_NACH_EINTRAG K_ED_SK_TR_IGN.INC_VOR_EINTRAG K_ED_SK_TR_IGN.OK_SCHWELLE K_ED_SK_TR_IGN.P_CODE_OPENLOAD K_ED_SK_TR_IGN.P_CODE_SH_TO_GND K_ED_SK_TR_IGN.P_CODE_SH_TO_UB K_ED_SK_TR_IGN.P_CODE_UNPLAUSIBEL /end REF_CHARACTERISTIC
/end GROUP
/begin GROUP G_z_Unidentified___maps "z Unidentified - maps" ROOT
 /begin REF_CHARACTERISTIC UNK_KL_16CE0_MD UNK_KL_KH_ALT_OFFSET_KM_4 UNK_KF_EGASAQSO_1042A UNK_KF_MISC_107C4 UNK_KF_MISC_1096C UNK_KF_MISC_109A4 UNK_KF_MISC_10A14 UNK_KL_EGAS_118FC UNK_KL_FAHRGESC_126DE UNK_KL_FAHRGESC_12708 UNK_KL_FAHRGESC_12732 UNK_KL_FAHRGESC_1275C UNK_KL_FAHRGESC_1277E UNK_KL_FAHRGESC_127CA UNK_KL_FAHRGESC_127EC UNK_KL_FAHRGESC_12816 UNK_KL_FAHRGESC_12840 UNK_KF_FAHRGESC_13074 UNK_KF_FAHRGESC_130D6 UNK_KL_MOMENTEN_16CBA UNK_KL_MOMENTEN_16CC6 UNK_KL_MOMENTEN_16CD2 UNK_KF_MOMENTEN_16CFC UNK_KF_MOMENTEN_16D2E UNK_KF_MOMENTEN_179B4 UNK_KL_MISC_1AAB2 UNK_KL_MISC_1AD4C UNK_KL_MISC_1BAE8 UNK_KL_MISC_1C5F2 UNK_KL_MISC_1C6EA UNK_KF_MISC_1CC5E UNK_KL_MISC_1E728 UNK_KL_ANTITRAM_10566 UNK_KL_ANTITRAM_10578 UNK_KL_MISC_1058A UNK_KL_MISC_10688 UNK_KL_MISC_1069E UNK_KL_MISC_13750 UNK_KL_KLOPFREG_14E30 UNK_KL_MISC_14E4A UNK_KL_LEERLAUF_16304 UNK_KL_LEERLAUF_1636C UNK_KF_MISC_1A5FC UNK_KL_MISC_1AC36 UNK_KF_MISC_1D076 UNK_KF_MISC_1D0BC UNK_KL_ANSAUGLU_1D666 UNK_KL_ANSAUGLU_1D680 UNK_KL_ANSAUGLU_1D69A UNK_KL_ANSAUGLU_1D6B4 UNK_KL_ANSAUGLU_1D6CA UNK_KL_ZNDUNG_1D992 UNK_KL_TMOT_MODELL_INIT_TUMG /end REF_CHARACTERISTIC
/end GROUP
/begin GROUP G_z_Unidentified___values "z Unidentified - values" ROOT
 /begin REF_CHARACTERISTIC UNK_TZ_1DBDF UNK_KR_139EC UNK_KR_139F6 UNK_KR_14E7E UNK_KR_14ED8 UNK_KR_14EDA UNK_KR_14EDC UNK_KR_14EF2 UNK_KR_14EF3 UNK_KR_14EF4 UNK_KH_140E0 UNK_EGAS_1184F UNK_RD_IGN_10000 UNK_RD_IGN_10004 UNK_RD_IGN_10008 UNK_RD_IGN_1000C UNK_RD_IGN_10010 UNK_RD_IGN_10014 UNK_RD_IGN_10018 UNK_RD_IGN_1001C UNK_RD_IGN_10030 UNK_RD_IGN_10080 UNK_RD_IGN_101C0 UNK_RD_IGN_101C4 UNK_RD_IGN_101C8 UNK_RD_IGN_10204 UNK_RD_IGN_10208 UNK_RD_IGN_1020C UNK_RD_IGN_10253 UNK_RD_IGN_1028B UNK_RD_IGN_10290 UNK_RD_IGN_10294 UNK_RD_IGN_10295 UNK_RD_IGN_10296 UNK_RD_IGN_10297 UNK_RD_IGN_10550 UNK_RD_IGN_10551 UNK_RD_IGN_10554 UNK_RD_IGN_10556 UNK_RD_IGN_10558 UNK_RD_IGN_1055A UNK_RD_IGN_1055C UNK_RD_IGN_1055E UNK_RD_IGN_10565 UNK_RD_IGN_105A0 UNK_RD_IGN_105A2 UNK_RD_IGN_105AB UNK_RD_IGN_105AC UNK_RD_IGN_105AD UNK_RD_IGN_105AE UNK_RD_IGN_105B0 UNK_RD_IGN_105B4 UNK_RD_IGN_105B6 UNK_RD_IGN_105C2 UNK_RD_IGN_105EE UNK_RD_IGN_105F0 UNK_RD_IGN_105F2 UNK_RD_IGN_10604 UNK_RD_IGN_10A4C UNK_RD_IGN_10A4D UNK_RD_IGN_10A4E UNK_RD_IGN_10A50 UNK_RD_IGN_10A52 UNK_RD_IGN_10A7A UNK_RD_IGN_10A7C UNK_RD_IGN_11810 UNK_RD_IGN_136AE UNK_RD_IGN_136C0 UNK_RD_IGN_13712 UNK_RD_IGN_13720 UNK_RD_IGN_13742 UNK_RD_IGN_13744 UNK_RD_IGN_13746 UNK_RD_IGN_13748 UNK_RD_IGN_1374A UNK_RD_IGN_1374C UNK_RD_IGN_1374E UNK_RD_IGN_13774 UNK_RD_IGN_13778 UNK_RD_IGN_1377C UNK_RD_IGN_13780 UNK_RD_IGN_13784 UNK_RD_IGN_13788 UNK_RD_IGN_1378C UNK_RD_IGN_13790 UNK_RD_IGN_13794 UNK_RD_IGN_13798 UNK_RD_IGN_1379C UNK_RD_IGN_137A0 UNK_RD_IGN_137A4 UNK_RD_IGN_137A8 UNK_RD_IGN_137AC UNK_RD_IGN_137B0 UNK_RD_IGN_137B4 UNK_RD_IGN_137B8 UNK_RD_IGN_137BC UNK_RD_IGN_137C0 UNK_RD_IGN_137C4 UNK_RD_IGN_137C8 UNK_RD_IGN_137CC UNK_RD_IGN_137D0 UNK_RD_IGN_137D4 UNK_RD_IGN_137D8 UNK_RD_IGN_137DC UNK_RD_IGN_137E0 UNK_RD_IGN_137E4 UNK_RD_IGN_137E8 UNK_RD_IGN_137EC UNK_RD_IGN_137F0 UNK_RD_IGN_137F4 UNK_RD_IGN_137F8 UNK_RD_IGN_137FC UNK_RD_IGN_13800 UNK_RD_IGN_13804 UNK_RD_IGN_13808 UNK_RD_IGN_1380C UNK_RD_IGN_13810 UNK_RD_IGN_13814 UNK_RD_IGN_13818 UNK_RD_IGN_1381C UNK_RD_IGN_13820 UNK_RD_IGN_13824 UNK_RD_IGN_13828 UNK_RD_IGN_1382C UNK_RD_IGN_13830 UNK_RD_IGN_13834 UNK_RD_IGN_13836 UNK_RD_IGN_13838 UNK_RD_IGN_1383A UNK_RD_IGN_1383C UNK_RD_IGN_1383E UNK_RD_IGN_13840 UNK_RD_IGN_13842 UNK_RD_IGN_13844 UNK_RD_IGN_13846 UNK_RD_IGN_13848 UNK_RD_IGN_13849 UNK_RD_IGN_1384A UNK_RD_IGN_1384B UNK_RD_IGN_1384C UNK_RD_IGN_1384D UNK_RD_IGN_1384E UNK_RD_IGN_1384F UNK_RD_IGN_13850 UNK_RD_IGN_13851 UNK_RD_IGN_13852 UNK_RD_IGN_13853 UNK_RD_IGN_13854 UNK_RD_IGN_13855 UNK_RD_IGN_13856 UNK_RD_IGN_13857 UNK_RD_IGN_13858 UNK_RD_IGN_13859 UNK_RD_IGN_1385A UNK_RD_IGN_1385B UNK_RD_IGN_1385C UNK_RD_IGN_1385D UNK_RD_IGN_1385E UNK_RD_IGN_1385F UNK_RD_IGN_13860 UNK_RD_IGN_13861 UNK_RD_IGN_13862 UNK_RD_IGN_13863 UNK_RD_IGN_13864 UNK_RD_IGN_13865 UNK_RD_IGN_13866 UNK_RD_IGN_13867 UNK_RD_IGN_13868 UNK_RD_IGN_13869 UNK_RD_IGN_1386A UNK_RD_IGN_1386B UNK_RD_IGN_1386C UNK_RD_IGN_1386D UNK_RD_IGN_1386E UNK_RD_IGN_1386F UNK_RD_IGN_13870 UNK_RD_IGN_13871 UNK_RD_IGN_13872 UNK_RD_IGN_13873 UNK_RD_IGN_13874 UNK_RD_IGN_13875 UNK_RD_IGN_13876 UNK_RD_IGN_13877 UNK_RD_IGN_13878 UNK_RD_IGN_13879 UNK_RD_IGN_1387A UNK_RD_IGN_1387B UNK_RD_IGN_1387C UNK_RD_IGN_1387D UNK_RD_IGN_1387E UNK_RD_IGN_1387F UNK_RD_IGN_13880 UNK_RD_IGN_13881 UNK_RD_IGN_13882 UNK_RD_IGN_13883 UNK_RD_IGN_13884 UNK_RD_IGN_13885 UNK_RD_IGN_13886 UNK_RD_IGN_13887 UNK_RD_IGN_13888 UNK_RD_IGN_13889 UNK_RD_IGN_1388B UNK_RD_IGN_15084 UNK_RD_IGN_150C0 UNK_RD_IGN_169E6 UNK_RD_IGN_191DC UNK_RD_IGN_191DE UNK_RD_IGN_191E0 UNK_RD_IGN_191E2 UNK_RD_IGN_191E4 UNK_RD_IGN_191E6 UNK_RD_IGN_1A644 UNK_RD_IGN_1A648 UNK_RD_IGN_1A64C UNK_RD_IGN_1A650 UNK_RD_IGN_1A654 UNK_RD_IGN_1A658 UNK_RD_IGN_1A65C UNK_RD_IGN_1A660 UNK_RD_IGN_1A662 UNK_RD_IGN_1A664 UNK_RD_IGN_1A666 UNK_RD_IGN_1A668 UNK_RD_IGN_1A66A UNK_RD_IGN_1A66C UNK_RD_IGN_1A66E UNK_RD_IGN_1A670 UNK_RD_IGN_1A672 UNK_RD_IGN_1A674 UNK_RD_IGN_1A676 UNK_RD_IGN_1A678 UNK_RD_IGN_1A67A UNK_RD_IGN_1A67C UNK_RD_IGN_1A67E UNK_RD_IGN_1A680 UNK_RD_IGN_1A682 UNK_RD_IGN_1A684 UNK_RD_IGN_1A686 UNK_RD_IGN_1A688 UNK_RD_IGN_1A689 UNK_RD_IGN_1A68A UNK_RD_IGN_1A68B UNK_RD_IGN_1A68C UNK_RD_IGN_1A68E UNK_RD_IGN_1A690 UNK_RD_IGN_1A692 UNK_RD_IGN_1A694 UNK_RD_IGN_1A695 UNK_RD_IGN_1A696 UNK_RD_IGN_1A697 UNK_RD_IGN_1A698 UNK_RD_IGN_1A699 UNK_RD_IGN_1A69A UNK_RD_IGN_1A69B UNK_RD_IGN_1A69C UNK_RD_IGN_1A69D UNK_RD_IGN_1A69E UNK_RD_IGN_1A6A4 UNK_RD_IGN_1A6A8 UNK_RD_IGN_1A6AC UNK_RD_IGN_1A6B0 UNK_RD_IGN_1A6B4 UNK_RD_IGN_1A6B8 UNK_RD_IGN_1A6BC UNK_RD_IGN_1A6BE UNK_RD_IGN_1A6C0 UNK_RD_IGN_1A6C2 UNK_RD_IGN_1A6C3 UNK_RD_IGN_1A6C4 UNK_RD_IGN_1A6C5 UNK_RD_IGN_1A6C6 UNK_RD_IGN_1A6C7 UNK_RD_IGN_1A6C8 UNK_RD_IGN_1A6C9 UNK_RD_IGN_1A6CA UNK_RD_IGN_1A6CB UNK_RD_IGN_1A6CC UNK_RD_IGN_1A6CD UNK_RD_IGN_1A6CE UNK_RD_IGN_1A6CF UNK_RD_IGN_1A6D0 UNK_RD_IGN_1A6D1 UNK_RD_IGN_1A6D2 UNK_RD_IGN_1A6D3 UNK_RD_IGN_1A6D4 UNK_RD_IGN_1A758 UNK_RD_IGN_1A759 UNK_RD_IGN_1A75A UNK_RD_IGN_1A75B UNK_RD_IGN_1A75C UNK_RD_IGN_1A75D UNK_RD_IGN_1A760 UNK_RD_IGN_1A764 UNK_RD_IGN_1A768 UNK_RD_IGN_1A76C UNK_RD_IGN_1A770 UNK_RD_IGN_1A774 UNK_RD_IGN_1A776 UNK_RD_IGN_1A778 UNK_RD_IGN_1A77A UNK_RD_IGN_1A77C UNK_RD_IGN_1A77E UNK_RD_IGN_1A780 UNK_RD_IGN_1A782 UNK_RD_IGN_1A784 UNK_RD_IGN_1A786 UNK_RD_IGN_1A788 UNK_RD_IGN_1A78A UNK_RD_IGN_1A78B UNK_RD_IGN_1A78C UNK_RD_IGN_1A78D UNK_RD_IGN_1A78E UNK_RD_IGN_1A78F UNK_RD_IGN_1A790 UNK_RD_IGN_1A791 UNK_RD_IGN_1A792 UNK_RD_IGN_1A793 UNK_RD_IGN_1A794 UNK_RD_IGN_1A795 UNK_RD_IGN_1A796 UNK_RD_IGN_1A797 UNK_RD_IGN_1A798 UNK_RD_IGN_1A799 UNK_RD_IGN_1A79A UNK_RD_IGN_1A79B UNK_RD_IGN_1A79C UNK_RD_IGN_1A79E UNK_RD_IGN_1A7A0 UNK_RD_IGN_1A7A4 UNK_RD_IGN_1A7A8 UNK_RD_IGN_1A7AC UNK_RD_IGN_1A7B0 UNK_RD_IGN_1A7B4 UNK_RD_IGN_1A7B8 UNK_RD_IGN_1A7BC UNK_RD_IGN_1A7C0 UNK_RD_IGN_1A7C4 UNK_RD_IGN_1A7C8 UNK_RD_IGN_1A7CC UNK_RD_IGN_1A7CE UNK_RD_IGN_1A7D0 UNK_RD_IGN_1A7D2 UNK_RD_IGN_1A7D4 UNK_RD_IGN_1A7D6 UNK_RD_IGN_1A7D8 UNK_RD_IGN_1A7DA UNK_RD_IGN_1A7DC UNK_RD_IGN_1A7DE UNK_RD_IGN_1A7E0 UNK_RD_IGN_1A7E2 UNK_RD_IGN_1A7E4 UNK_RD_IGN_1A7E6 UNK_RD_IGN_1A7E8 UNK_RD_IGN_1A7EA UNK_RD_IGN_1A7EC UNK_RD_IGN_1A7EE UNK_RD_IGN_1A7EF UNK_RD_IGN_1A7F0 UNK_RD_IGN_1A7F1 UNK_RD_IGN_1A7F2 UNK_RD_IGN_1A7F3 UNK_RD_IGN_1A7F4 UNK_RD_IGN_1A7F5 UNK_RD_IGN_1A7F6 UNK_RD_IGN_1A7F7 UNK_RD_IGN_1A7F8 UNK_RD_IGN_1A7F9 UNK_RD_IGN_1A7FA UNK_RD_IGN_1A7FC UNK_RD_IGN_1A800 UNK_RD_IGN_1A804 UNK_RD_IGN_1A808 UNK_RD_IGN_1A80C UNK_RD_IGN_1A80D UNK_RD_IGN_1A80E UNK_RD_IGN_1A80F UNK_RD_IGN_1A810 UNK_RD_IGN_1A811 UNK_RD_IGN_1A812 UNK_RD_IGN_1A813 UNK_RD_IGN_1A814 UNK_RD_IGN_1A815 UNK_RD_IGN_1A9A8 UNK_RD_IGN_1A9AA UNK_RD_IGN_1A9AC UNK_RD_IGN_1A9B0 UNK_RD_IGN_1A9B4 UNK_RD_IGN_1A9B8 UNK_RD_IGN_1A9BC UNK_RD_IGN_1A9C0 UNK_RD_IGN_1A9C2 UNK_RD_IGN_1A9C4 UNK_RD_IGN_1A9C6 UNK_RD_IGN_1A9C8 UNK_RD_IGN_1A9CA UNK_RD_IGN_1A9CC UNK_RD_IGN_1A9CE UNK_RD_IGN_1A9D0 UNK_RD_IGN_1A9D2 UNK_RD_IGN_1A9D3 UNK_RD_IGN_1A9D4 UNK_RD_IGN_1A9D5 UNK_RD_IGN_1A9D6 UNK_RD_IGN_1A9D8 UNK_RD_IGN_1A9DA UNK_RD_IGN_1A9DC UNK_RD_IGN_1A9DE UNK_RD_IGN_1A9E0 UNK_RD_IGN_1A9E2 UNK_RD_IGN_1A9E4 UNK_RD_IGN_1A9E6 UNK_RD_IGN_1A9E8 UNK_RD_IGN_1A9EA UNK_RD_IGN_1A9EC UNK_RD_IGN_1A9EE UNK_RD_IGN_1A9F0 UNK_RD_IGN_1A9F1 UNK_RD_IGN_1A9F2 UNK_RD_IGN_1A9F3 UNK_RD_IGN_1A9F4 UNK_RD_IGN_1A9F5 UNK_RD_IGN_1A9F6 UNK_RD_IGN_1A9F7 UNK_RD_IGN_1A9F8 UNK_RD_IGN_1A9F9 UNK_RD_IGN_1A9FA UNK_RD_IGN_1A9FB UNK_RD_IGN_1A9FC UNK_RD_IGN_1A9FE UNK_RD_IGN_1AA08 UNK_RD_IGN_1AA0C UNK_RD_IGN_1AA0E UNK_RD_IGN_1AA10 UNK_RD_IGN_1AA12 UNK_RD_IGN_1AA14 UNK_RD_IGN_1AA15 UNK_RD_IGN_1AA16 UNK_RD_IGN_1AA17 UNK_RD_IGN_1AA18 UNK_RD_IGN_1AA19 UNK_RD_IGN_1AA1A UNK_RD_IGN_1AA1B UNK_RD_IGN_1AA1C UNK_RD_IGN_1AA1E UNK_RD_IGN_1AA20 UNK_RD_IGN_1AA21 UNK_RD_IGN_1AA22 UNK_RD_IGN_1AA30 UNK_RD_IGN_1AA32 UNK_RD_IGN_1AA34 UNK_RD_IGN_1AA36 UNK_RD_IGN_1AA37 UNK_RD_IGN_1AA38 UNK_RD_IGN_1AA3A UNK_RD_IGN_1AA3C UNK_RD_IGN_1AA3E UNK_RD_IGN_1AA40 UNK_RD_IGN_1AA42 UNK_RD_IGN_1AA43 UNK_RD_IGN_1AA44 UNK_RD_IGN_1AA46 UNK_RD_IGN_1AA48 UNK_RD_IGN_1AA4A UNK_RD_IGN_1AA4E UNK_RD_IGN_1AA4F UNK_RD_IGN_1AA50 UNK_RD_IGN_1AA51 UNK_RD_IGN_1AA52 UNK_RD_IGN_1AA54 UNK_RD_IGN_1AA57 UNK_RD_IGN_1AA58 UNK_RD_IGN_1AA5A UNK_RD_IGN_1AA5C UNK_RD_IGN_1AA5E UNK_RD_IGN_1AA60 UNK_RD_IGN_1AA62 UNK_RD_IGN_1AA64 UNK_RD_IGN_1AA66 UNK_RD_IGN_1AA6E UNK_RD_IGN_1AA72 UNK_RD_IGN_1AA74 UNK_RD_IGN_1AA76 UNK_RD_IGN_1AA78 UNK_RD_IGN_1AA7A UNK_RD_IGN_1AA7C UNK_RD_IGN_1AA7E UNK_RD_IGN_1AA7F UNK_RD_IGN_1AA80 UNK_RD_IGN_1AA88 UNK_RD_IGN_1AA8B UNK_RD_IGN_1AA8C UNK_RD_IGN_1AA8D UNK_RD_IGN_1AA8E UNK_RD_IGN_1AA8F UNK_RD_IGN_1AA90 UNK_RD_IGN_1AA91 UNK_RD_IGN_1AA92 UNK_RD_IGN_1AA93 UNK_RD_IGN_1AA94 UNK_RD_IGN_1AA95 UNK_RD_IGN_1AA96 UNK_RD_IGN_1AA98 UNK_RD_IGN_1AA99 UNK_RD_IGN_1AA9A UNK_RD_IGN_1AA9B UNK_RD_IGN_1AA9C UNK_RD_IGN_1AA9E UNK_RD_IGN_1AAA0 UNK_RD_IGN_1AAA2 UNK_RD_IGN_1AAA4 UNK_RD_IGN_1AAA6 UNK_RD_IGN_1AAA8 UNK_RD_IGN_1AAAA UNK_RD_IGN_1AAAC UNK_RD_IGN_1AAAD UNK_RD_IGN_1AAAE UNK_RD_IGN_1AAB0 UNK_RD_IGN_1AADC UNK_RD_IGN_1AADE UNK_RD_IGN_1AAE0 UNK_RD_IGN_1AAE2 UNK_RD_IGN_1AAE4 UNK_RD_IGN_1AAF4 UNK_RD_IGN_1AB02 UNK_RD_IGN_1AC06 UNK_RD_IGN_1AC08 UNK_RD_IGN_1AC0A UNK_RD_IGN_1AC0C UNK_RD_IGN_1AC0E UNK_RD_IGN_1AC10 UNK_RD_IGN_1AC12 UNK_RD_IGN_1AC14 UNK_RD_IGN_1AC16 UNK_RD_IGN_1AC18 UNK_RD_IGN_1AC1A UNK_RD_IGN_1AC1C UNK_RD_IGN_1AC1E UNK_RD_IGN_1AC20 UNK_RD_IGN_1AC22 UNK_RD_IGN_1AC24 UNK_RD_IGN_1AC25 UNK_RD_IGN_1AC26 UNK_RD_IGN_1AC28 UNK_RD_IGN_1AC2A UNK_RD_IGN_1AC2C UNK_RD_IGN_1AC2E UNK_RD_IGN_1AC30 UNK_RD_IGN_1AC32 UNK_RD_IGN_1AC33 UNK_RD_IGN_1AC34 UNK_RD_IGN_1AC51 UNK_RD_IGN_1AC52 UNK_RD_IGN_1AC5C UNK_RD_IGN_1AC5E UNK_RD_IGN_1AC60 UNK_RD_IGN_1AC64 UNK_RD_IGN_1AD10 UNK_RD_IGN_1AD1C UNK_RD_IGN_1AD1E UNK_RD_IGN_1AD20 UNK_RD_IGN_1AD3A UNK_RD_IGN_1BAE4 UNK_RD_IGN_1BAE6 UNK_RD_IGN_1BC44 UNK_RD_IGN_1C288 UNK_RD_IGN_1E4CE UNK_RD_IGN_1E4D1 UNK_RD_IGN_1E4D2 UNK_RD_IGN_1E4D3 UNK_RD_IGN_1E4E2 UNK_RD_IGN_1E6FA UNK_RD_IGN_1E6FC UNK_RD_IGN_1E6FE UNK_RD_IGN_1E700 UNK_RD_IGN_1E702 UNK_RD_IGN_1E71E UNK_RD_IGN_1E720 UNK_RD_IGN_1E722 UNK_RD_IGN_1E724 UNK_RD_IGN_1E726 UNK_RD_IGN_1F2CB UNK_RD_IGN_1FFF8 UNK_RD_IGN_1FFFC UNK_EGASAQ_102A6 UNK_MOMENTEN_16A78 UNK_MOMENTEN_16A96 UNK_MOMENTEN_16A98 UNK_MOMENTEN_16A9A UNK_MOMENTEN_17C40 UNK_MOMENTEN_190AE UNK_MOMENTEN_191D6 UNK_MOMENTEN_191DA UNK_MOMENTEN_1A6A0 UNK_MOMENTEN_1AA84 UNK_MOMENTEN_1AA86 UNK_MOMENTEN_1AA87 UNK_MOMENTEN_1D106 UNK_MOMENTEN_1D10D UNK_MOMENTEN_1D10E UNK_MOMENTEN_1D114 UNK_MOMENTEN_1D338 UNK_MOMENTEN_1D342 UNK_MOMENTEN_1D344 UNK_MOMENTEN_1D346 UNK_MOMENTEN_1D356 UNK_MOMENTEN_1D358 UNK_MOMENTEN_1D35A UNK_MOMENTEN_1D35C UNK_MOMENTEN_1D360 UNK_MOMENTEN_1D362 UNK_MOMENTEN_1E71A UNK_MOMENTEN_1E71C UNK_MOMENTEN_1E784 UNK_MOMENTEN_1ECAA UNK_MOMENTEN_1ECAC UNK_MOMENTEN_1ECAE UNK_MOMENTEN_1ECAF UNK_MOMENTEN_1ECC0 UNK_MOMENTEN_1ECC2 UNK_MOMENTEN_1ECC4 UNK_MOMENTEN_1ECC6 UNK_MOMENTEN_1ECC8 UNK_MOMENTEN_1ECCA UNK_MOMENTEN_1ECCC UNK_MOMENTEN_1ECCE UNK_MOMENTEN_1ECD0 UNK_MOMENTEN_1ECD1 UNK_MOMENTEN_1ECD2 UNK_MOMENTEN_1ECD4 UNK_MOMENTEN_1ECD6 UNK_MOMENTEN_1ECD8 UNK_LEERLAUF_16208 UNK_LEERLAUF_16210 UNK_LEERLAUF_16222 UNK_LEERLAUF_1626E UNK_ANSAUGLU_1D4E5 UNK_ANSAUGLU_1D4E8 UNK_ANSAUGLU_1D4E9 UNK_ANSAUGLU_1D58E UNK_ANSAUGLU_1D592 UNK_ANSAUGLU_1D5A0 UNK_ANSAUGLU_1D5A2 UNK_ANSAUGLU_1D5A4 UNK_ANSAUGLU_1D5A8 UNK_ANSAUGLU_1D5B8 UNK_ANSAUGLU_1D5BA UNK_ANSAUGLU_1D5CC UNK_ANSAUGLU_1D5D0 UNK_PEDALWER_1AC9E UNK_PEDALWER_1ACA0 UNK_ABGASTEM_1918C UNK_GANGERKE_1363E UNK_GANGERKE_1CD24 UNK_GANGERKE_1CD68 UNK_KLOPFREG_138FA UNK_FAHRGESC_12520 UNK_FAHRGESC_1255A UNK_MD_RES_TMOT_19188 /end REF_CHARACTERISTIC
/end GROUP
/end MODULE
/end PROJECT
