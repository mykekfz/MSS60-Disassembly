ASAP2_VERSION 1 60
/begin PROJECT MSS60_V762_IGN "MSS60 (S65) V762 IGN CPU - production calibration 7848136 (V762.01-B500.02)"
/begin HEADER "Calibration description. Measurements: V530 RAM names transferred to V762 addresses (confidence in each long identifier). Status tag in every long identifier: verified (checked against the code) / A2L-ref (placed from the V530 A2L) / EST (estimated) / unassigned (unidentified)." VERSION "V762-RE-04112026" /end HEADER
/begin MODULE IGN "MSS60 V762 IGN"
/begin MOD_COMMON "" BYTE_ORDER MSB_FIRST ALIGNMENT_BYTE 1 ALIGNMENT_WORD 2 ALIGNMENT_LONG 4 /end MOD_COMMON
/begin CHARACTERISTIC KL_E_FUNKTION__IGN_ "Approximation of the exponential function (lookup) [verified] (axes fixed/not stored)" VAL_BLK 0x76A44 RL_BLK_F32 0 CM_0000 -1e+30 1e+30 NUMBER 13 /end CHARACTERISTIC
/begin CHARACTERISTIC K_VERS_DATEN__IGN_ "Data version [verified]" VALUE 0x70254 RL_VAL_UW 0 CM_0000 0 65535 /end CHARACTERISTIC
/begin CHARACTERISTIC K_VERS_PROG__IGN_ "Program version [verified]" VALUE 0x70250 RL_VAL_UW 0 CM_0000 0 65535 /end CHARACTERISTIC
/begin CHARACTERISTIC K_VERS_PROZ__IGN_ "Processor ID [verified]" VALUE 0x70252 RL_VAL_UB 0 CM_0000 0 255 /end CHARACTERISTIC
/begin CHARACTERISTIC KF_AUSS_LP_INT_MIN "Minimum ion-current integral for misfire detection [verified]" MAP 0x707F6 RL_MAP_SW_SW_SW 0 CM_0001 -639.6988621 639.67934 /begin AXIS_DESCR STD_AXIS NO_INPUT_QUANTITY CM_0002 16 -32768 32767 /end AXIS_DESCR /begin AXIS_DESCR STD_AXIS NO_INPUT_QUANTITY CM_0003 10 -3.2768 3.2767 /end AXIS_DESCR /end CHARACTERISTIC
/begin CHARACTERISTIC KF_AUSS_SPARK_TIME_MAX "Maximum permitted spark burn duration [verified]" MAP 0x707A4 RL_MAP_SW_SW_SW 0 CM_0004 -4.681141453 4.680998596 /begin AXIS_DESCR STD_AXIS NO_INPUT_QUANTITY CM_0002 3 -32768 32767 /end AXIS_DESCR /begin AXIS_DESCR STD_AXIS NO_INPUT_QUANTITY CM_0003 3 -3.2768 3.2767 /end AXIS_DESCR /end CHARACTERISTIC
/begin CHARACTERISTIC KL_AUSS_INT_TMOT_FAKTOR "Correction factor over engine temperature [verified]" CURVE 0x70658 RL_CUR_SW_SW 0 CM_0005 -199.9999992 199.9938957 /begin AXIS_DESCR STD_AXIS NO_INPUT_QUANTITY CM_0006 8 -3550 3003.5 /end AXIS_DESCR /end CHARACTERISTIC
/begin CHARACTERISTIC KL_AUSS_START_FAKTOR "Correction factor during start phase for auss_lp_int_min [verified]" CURVE 0x70642 RL_CUR_SW_SW 0 CM_0005 -199.9999992 199.9938957 /begin AXIS_DESCR STD_AXIS NO_INPUT_QUANTITY CM_0006 5 -3550 3003.5 /end AXIS_DESCR /end CHARACTERISTIC
/begin CHARACTERISTIC K_AG_TZ_ANZ "Number of directly consecutive suppressions [verified]" VALUE 0x7029C RL_VAL_UW 0 CM_0000 0 65535 /end CHARACTERISTIC
/begin CHARACTERISTIC K_AG_TZ_CFG "Welcher Aussetzergenerator [verified]" VALUE 0x70298 RL_VAL_UB 0 CM_0000 0 255 /end CHARACTERISTIC
/begin CHARACTERISTIC K_AG_TZ_PAUSE "Number of working cycles between suppressions [verified]" VALUE 0x7029E RL_VAL_UW 0 CM_0000 0 65535 /end CHARACTERISTIC
/begin CHARACTERISTIC K_AG_TZ_V_MIN "Minimum vehicle speed threshold [km/h] [verified]" VALUE 0x702A0 RL_VAL_SW 0 CM_0010 -2048 2047.9375 /end CHARACTERISTIC
/begin CHARACTERISTIC K_AG_TZ_ZYL "Static suppression pattern [verified]" VALUE 0x7029A RL_VAL_UW 0 CM_0000 0 65535 /end CHARACTERISTIC
/begin CHARACTERISTIC K_DEBUG_READ_ADR__IGN_ "Debug read address [verified]" VALUE 0x70A54 RL_VAL_UL 0 CM_0000 0 4294967295 /end CHARACTERISTIC
/begin CHARACTERISTIC K_DEBUG_RW_LENGTH__IGN_ "Debug read/write length [verified]" VALUE 0x70A60 RL_VAL_UB 0 CM_0000 0 255 /end CHARACTERISTIC
/begin CHARACTERISTIC K_DEBUG_WRITE_ADR__IGN_ "Debug write address [verified]" VALUE 0x70A58 RL_VAL_UL 0 CM_0000 0 4294967295 /end CHARACTERISTIC
/begin CHARACTERISTIC K_DEBUG_WRITE_VALUE__IGN_ "Debug write value [verified]" VALUE 0x70A5C RL_VAL_UL 0 CM_0000 0 4294967295 /end CHARACTERISTIC
/begin CHARACTERISTIC KF_FGR_FAK_V_WA "Weighting factor, speed on resume [verified]" MAP 0x73036 RL_MAP_SW_SW_UB 0 CM_0009 0 0.999999993 /begin AXIS_DESCR STD_AXIS NO_INPUT_QUANTITY CM_0010 6 -2048 2047.9375 /end AXIS_DESCR /begin AXIS_DESCR STD_AXIS NO_INPUT_QUANTITY CM_0013 6 -3276.8 3276.7 /end AXIS_DESCR /end CHARACTERISTIC
/begin CHARACTERISTIC KF_FGR_KR "Controller gain [verified]" MAP 0x72ABA RL_MAP_SW_SW_UW 0 CM_0034 0 102.3984375 /begin AXIS_DESCR STD_AXIS NO_INPUT_QUANTITY CM_0010 12 -2048 2047.9375 /end AXIS_DESCR /begin AXIS_DESCR STD_AXIS NO_INPUT_QUANTITY CM_0015 8 -32768 32767 /end AXIS_DESCR /end CHARACTERISTIC
/begin CHARACTERISTIC KF_FGR_KR_CONST "Controller gain, steady cruising [verified]" MAP 0x72BA4 RL_MAP_SW_SW_UW 0 CM_0034 0 102.3984375 /begin AXIS_DESCR STD_AXIS NO_INPUT_QUANTITY CM_0010 12 -2048 2047.9375 /end AXIS_DESCR /begin AXIS_DESCR STD_AXIS NO_INPUT_QUANTITY CM_0015 8 -32768 32767 /end AXIS_DESCR /end CHARACTERISTIC
/begin CHARACTERISTIC KF_FGR_TN "Integral (reset) time [verified]" MAP 0x72C8E RL_MAP_SW_SW_UW 0 CM_0035 0 102.3984375 /begin AXIS_DESCR STD_AXIS NO_INPUT_QUANTITY CM_0010 12 -2048 2047.9375 /end AXIS_DESCR /begin AXIS_DESCR STD_AXIS NO_INPUT_QUANTITY CM_0015 8 -32768 32767 /end AXIS_DESCR /end CHARACTERISTIC
/begin CHARACTERISTIC KF_FGR_TN_CONST "Integral time, steady cruising [verified]" MAP 0x72D78 RL_MAP_SW_SW_UW 0 CM_0035 0 102.3984375 /begin AXIS_DESCR STD_AXIS NO_INPUT_QUANTITY CM_0010 12 -2048 2047.9375 /end AXIS_DESCR /begin AXIS_DESCR STD_AXIS NO_INPUT_QUANTITY CM_0015 8 -32768 32767 /end AXIS_DESCR /end CHARACTERISTIC
/begin CHARACTERISTIC KF_FGR_TV "Derivative time [verified]" MAP 0x72E62 RL_MAP_SW_SW_UW 0 CM_0035 0 102.3984375 /begin AXIS_DESCR STD_AXIS NO_INPUT_QUANTITY CM_0010 12 -2048 2047.9375 /end AXIS_DESCR /begin AXIS_DESCR STD_AXIS NO_INPUT_QUANTITY CM_0015 8 -32768 32767 /end AXIS_DESCR /end CHARACTERISTIC
/begin CHARACTERISTIC KF_FGR_TV_CONST "Derivative time, steady cruising [verified]" MAP 0x72F4C RL_MAP_SW_SW_UW 0 CM_0035 0 102.3984375 /begin AXIS_DESCR STD_AXIS NO_INPUT_QUANTITY CM_0010 12 -2048 2047.9375 /end AXIS_DESCR /begin AXIS_DESCR STD_AXIS NO_INPUT_QUANTITY CM_0015 8 -32768 32767 /end AXIS_DESCR /end CHARACTERISTIC
/begin CHARACTERISTIC KF_FGR_VORST "PID controller [verified]" MAP 0x728E6 RL_MAP_SW_SW_UW 0 CM_0036 0 102.3984375 /begin AXIS_DESCR STD_AXIS NO_INPUT_QUANTITY CM_0010 12 -2048 2047.9375 /end AXIS_DESCR /begin AXIS_DESCR STD_AXIS NO_INPUT_QUANTITY CM_0015 8 -32768 32767 /end AXIS_DESCR /end CHARACTERISTIC
/begin CHARACTERISTIC KF_FGR_VORST_UP "PID controller [verified]" MAP 0x729D0 RL_MAP_SW_SW_UW 0 CM_0036 0 102.3984375 /begin AXIS_DESCR STD_AXIS NO_INPUT_QUANTITY CM_0010 12 -2048 2047.9375 /end AXIS_DESCR /begin AXIS_DESCR STD_AXIS NO_INPUT_QUANTITY CM_0015 8 -32768 32767 /end AXIS_DESCR /end CHARACTERISTIC
/begin CHARACTERISTIC KL_FGR_FAK_T_BESCHL "Time-dependent weighting factors for acceleration [verified]" CURVE 0x725D2 RL_CUR_UB_UB 0 CM_0037 0 1.9921875 /begin AXIS_DESCR STD_AXIS NO_INPUT_QUANTITY CM_0038 6 0 1.9921875 /end AXIS_DESCR /end CHARACTERISTIC
/begin CHARACTERISTIC KL_FGR_FAK_T_VERZ "Time-dependent weighting factors for deceleration [verified]" CURVE 0x725E0 RL_CUR_UB_UB 0 CM_0037 0 1.9921875 /begin AXIS_DESCR STD_AXIS NO_INPUT_QUANTITY CM_0038 6 0 1.9921875 /end AXIS_DESCR /end CHARACTERISTIC
/begin CHARACTERISTIC KL_FGR_FAK_T_WA "Time-dependent weighting factors for resume [verified]" CURVE 0x725C4 RL_CUR_UB_UB 0 CM_0037 0 1.9921875 /begin AXIS_DESCR STD_AXIS NO_INPUT_QUANTITY CM_0038 6 0 1.9921875 /end AXIS_DESCR /end CHARACTERISTIC
/begin CHARACTERISTIC KL_FGR_FAK_V_TIP "Weighting factor, speed tip (+/-) [verified]" CURVE 0x725B0 RL_CUR_SW_UB 0 CM_0009 0 0.999999993 /begin AXIS_DESCR STD_AXIS NO_INPUT_QUANTITY CM_0010 6 -2048 2047.9375 /end AXIS_DESCR /end CHARACTERISTIC
/begin CHARACTERISTIC KL_FGR_KOEFF_WICHT "Controller coefficient weighting [verified]" CURVE 0x72698 RL_CUR_UW_UW 0 CM_0039 0 655.35 /begin AXIS_DESCR STD_AXIS NO_INPUT_QUANTITY CM_0025 4 0 655.35 /end AXIS_DESCR /end CHARACTERISTIC
/begin CHARACTERISTIC KL_FGR_KR_FAK "Weighting of controller gain [verified]" CURVE 0x725EE RL_CUR_SW_UB 0 CM_0040 0 25.5 /begin AXIS_DESCR STD_AXIS NO_INPUT_QUANTITY CM_0010 6 -2048 2047.9375 /end AXIS_DESCR /end CHARACTERISTIC
/begin CHARACTERISTIC KL_FGR_MD_FW_LL "Minimum threshold to avoid cruise switch-off [verified]" CURVE 0x7262A RL_CUR_SW_UB 0 CM_0013 0 25.5 /begin AXIS_DESCR STD_AXIS NO_INPUT_QUANTITY CM_0002 6 -32768 32767 /end AXIS_DESCR /end CHARACTERISTIC
/begin CHARACTERISTIC KL_FGR_MD_RAMPE_DELTA "Step size of the ramp-out [verified]" CURVE 0x72596 RL_CUR_SW_UW 0 CM_0041 0 6553.5 /begin AXIS_DESCR STD_AXIS NO_INPUT_QUANTITY CM_0002 6 -32768 32767 /end AXIS_DESCR /end CHARACTERISTIC
/begin CHARACTERISTIC KL_FGR_TN_FAK "Weighting of integral time [verified]" CURVE 0x72602 RL_CUR_SW_UB 0 CM_0040 0 25.5 /begin AXIS_DESCR STD_AXIS NO_INPUT_QUANTITY CM_0010 6 -2048 2047.9375 /end AXIS_DESCR /end CHARACTERISTIC
/begin CHARACTERISTIC KL_FGR_TV_FAK "Weighting of derivative time [verified]" CURVE 0x72616 RL_CUR_SW_UB 0 CM_0040 0 25.5 /begin AXIS_DESCR STD_AXIS NO_INPUT_QUANTITY CM_0010 6 -2048 2047.9375 /end AXIS_DESCR /end CHARACTERISTIC
/begin CHARACTERISTIC KL_FGR_VERZ_WA "Target deceleration on resume [verified]" CURVE 0x72584 RL_CUR_SW_SW 0 CM_0042 -819.2 819.175 /begin AXIS_DESCR STD_AXIS NO_INPUT_QUANTITY CM_0002 4 -32768 32767 /end AXIS_DESCR /end CHARACTERISTIC
/begin CHARACTERISTIC KL_FGR_V_FIL_A1 "Filter constant A1 for speed filter [verified]" CURVE 0x7263E RL_CUR_UW_SW 0 CM_0019 -2.000001434 1.999940398 /begin AXIS_DESCR STD_AXIS NO_INPUT_QUANTITY CM_0025 7 0 655.35 /end AXIS_DESCR /end CHARACTERISTIC
/begin CHARACTERISTIC KL_FGR_V_FIL_B1 "Filter constant B1 for speed filter [verified]" CURVE 0x7265C RL_CUR_UW_UW 0 CM_0043 0 0.2499963645 /begin AXIS_DESCR STD_AXIS NO_INPUT_QUANTITY CM_0025 7 0 655.35 /end AXIS_DESCR /end CHARACTERISTIC
/begin CHARACTERISTIC KL_FGR_V_FIL_B2 "Filter constant B2 for speed filter [verified]" CURVE 0x7267A RL_CUR_UW_UW 0 CM_0043 0 0.2499963645 /begin AXIS_DESCR STD_AXIS NO_INPUT_QUANTITY CM_0025 7 0 655.35 /end AXIS_DESCR /end CHARACTERISTIC
/begin CHARACTERISTIC KL_FGR_V_SA_SPERRE "Speed limit for cruise switch-off lock [verified]" CURVE 0x726BC RL_CUR_SW_SW 0 CM_0010 -2048 2047.9375 /begin AXIS_DESCR STD_AXIS NO_INPUT_QUANTITY CM_0015 8 -32768 32767 /end AXIS_DESCR /end CHARACTERISTIC
/begin CHARACTERISTIC K_FGR_A1 "Controller coefficient a1 [verified]" VALUE 0x7254C RL_VAL_UB 0 CM_0040 0 25.5 /end CHARACTERISTIC
/begin CHARACTERISTIC K_FGR_AX_TAU "Filter constant, acceleration [s] [verified]" VALUE 0x72545 RL_VAL_UB 0 CM_0027 0 255 /end CHARACTERISTIC
/begin CHARACTERISTIC K_FGR_BESCHL_KOMFORT "Target acceleration in Comfort mode [m/(s*s)] [verified]" VALUE 0x72534 RL_VAL_SW 0 CM_0042 -819.2 819.175 /end CHARACTERISTIC
/begin CHARACTERISTIC K_FGR_BESCHL_NORMAL "Target acceleration in Normal mode [m/(s*s)] [verified]" VALUE 0x72538 RL_VAL_SW 0 CM_0042 -819.2 819.175 /end CHARACTERISTIC
/begin CHARACTERISTIC K_FGR_BESCHL_SPORT "Target acceleration in Sport mode [m/(s*s)] [verified]" VALUE 0x72530 RL_VAL_SW 0 CM_0042 -819.2 819.175 /end CHARACTERISTIC
/begin CHARACTERISTIC K_FGR_BESCHL_TIP "Target acceleration on tip [m/(s*s)] [verified]" VALUE 0x7253A RL_VAL_SW 0 CM_0042 -819.2 819.175 /end CHARACTERISTIC
/begin CHARACTERISTIC K_FGR_BESCHL_WA_KOMFORT "Target acceleration on resume, Comfort mode [m/(s*s)] [verified]" VALUE 0x72532 RL_VAL_SW 0 CM_0042 -819.2 819.175 /end CHARACTERISTIC
/begin CHARACTERISTIC K_FGR_BESCHL_WA_NORMAL "Target acceleration on resume, Normal mode [m/(s*s)] [verified]" VALUE 0x72536 RL_VAL_SW 0 CM_0042 -819.2 819.175 /end CHARACTERISTIC
/begin CHARACTERISTIC K_FGR_BESCHL_WA_SPORT "Target acceleration on resume, Sport mode [m/(s*s)] [verified]" VALUE 0x7252E RL_VAL_SW 0 CM_0042 -819.2 819.175 /end CHARACTERISTIC
/begin CHARACTERISTIC K_FGR_CFG_V_IST "Auswahl V-Ist: Fahrzeuggeschw. oder Anzeigegeschw. [verified]" VALUE 0x72544 RL_VAL_UB 0 CM_0000 0 255 /end CHARACTERISTIC
/begin CHARACTERISTIC K_FGR_CFG_V_MAX "Konfig FGR bis Vmax [verified]" VALUE 0x724E5 RL_VAL_UB 0 CM_0000 0 255 /end CHARACTERISTIC
/begin CHARACTERISTIC K_FGR_DSC_BLS_T "Maximum duration of a combined DSC intervention [s] [verified]" VALUE 0x72502 RL_VAL_UW 0 CM_0025 0 655.35 /end CHARACTERISTIC
/begin CHARACTERISTIC K_FGR_DSC_MD_BLS_T "Maximum duration of a DSC brake intervention [s] [verified]" VALUE 0x72500 RL_VAL_UW 0 CM_0025 0 655.35 /end CHARACTERISTIC
/begin CHARACTERISTIC K_FGR_DSC_MD_T "Maximum duration of a DSC torque intervention [s] [verified]" VALUE 0x724FE RL_VAL_UW 0 CM_0025 0 655.35 /end CHARACTERISTIC
/begin CHARACTERISTIC K_FGR_EIN "FGR Einschalten 1: Ein, 0: Aus [verified]" VALUE 0x724DC RL_VAL_UB 0 CM_0000 0 255 /end CHARACTERISTIC
/begin CHARACTERISTIC K_FGR_FAK_V_MAX "Threshold, upper range [km/h] [verified]" VALUE 0x72514 RL_VAL_SW 0 CM_0010 -2048 2047.9375 /end CHARACTERISTIC
/begin CHARACTERISTIC K_FGR_MARKE_CFG "Konfig Markenanzeige w?hrend Beschleunigung [verified]" VALUE 0x724E4 RL_VAL_UB 0 CM_0000 0 255 /end CHARACTERISTIC
/begin CHARACTERISTIC K_FGR_MD_DELTA "Rate limit on controller intervention [%/sek] [verified]" VALUE 0x7254A RL_VAL_UW 0 CM_0041 0 6553.5 /end CHARACTERISTIC
/begin CHARACTERISTIC K_FGR_MD_FW_HYS "Hysteresis for overtaking detection [%] [verified]" VALUE 0x72548 RL_VAL_SW 0 CM_0044 -327.68 327.67 /end CHARACTERISTIC
/begin CHARACTERISTIC K_FGR_MD_FW_LL_HYS "Hysteresis, minimum threshold [%] [verified]" VALUE 0x72546 RL_VAL_SW 0 CM_0044 -327.68 327.67 /end CHARACTERISTIC
/begin CHARACTERISTIC K_FGR_N_MAX "Maximum engine-speed limit [Upm] [verified]" VALUE 0x7252C RL_VAL_SW 0 CM_0002 -32768 32767 /end CHARACTERISTIC
/begin CHARACTERISTIC K_FGR_STUFE_KMH "Step size in km/h [km/h] [verified]" VALUE 0x72554 RL_VAL_SW 0 CM_0010 -2048 2047.9375 /end CHARACTERISTIC
/begin CHARACTERISTIC K_FGR_STUFE_MPH "Step size in mph [mph] [verified]" VALUE 0x72552 RL_VAL_SW 0 CM_0045 -2048 2047.9375 /end CHARACTERISTIC
/begin CHARACTERISTIC K_FGR_T_AUS "Wait time until HUD-off is detected [s] [verified]" VALUE 0x724E9 RL_VAL_UB 0 CM_0025 0 2.55 /end CHARACTERISTIC
/begin CHARACTERISTIC K_FGR_T_CONSTF_RAMPE "Maximum time when driver overrides cruise control [s] [verified]" VALUE 0x724F2 RL_VAL_UW 0 CM_0025 0 655.35 /end CHARACTERISTIC
/begin CHARACTERISTIC K_FGR_T_MIN_SA "Minimum wait time before switch-off during steady cruising [sek] [verified]" VALUE 0x7254E RL_VAL_UW 0 CM_0046 0 655.35 /end CHARACTERISTIC
/begin CHARACTERISTIC K_FGR_T_STRICH "Time for HUD dash display [s] [verified]" VALUE 0x724F0 RL_VAL_UW 0 CM_0025 0 655.35 /end CHARACTERISTIC
/begin CHARACTERISTIC K_FGR_T_UEBERHOL_MAX "Maximum time when driver overrides cruise control [s] [verified]" VALUE 0x724EE RL_VAL_UW 0 CM_0025 0 655.35 /end CHARACTERISTIC
/begin CHARACTERISTIC K_FGR_VERZ "Target deceleration when decelerating [m/(s*s)] [verified]" VALUE 0x7253C RL_VAL_SW 0 CM_0042 -819.2 819.175 /end CHARACTERISTIC
/begin CHARACTERISTIC K_FGR_VERZ_TIP "Target deceleration on tip [m/(s*s)] [verified]" VALUE 0x7253E RL_VAL_SW 0 CM_0042 -819.2 819.175 /end CHARACTERISTIC
/begin CHARACTERISTIC K_FGR_V_DIF_MAX "Maximum threshold of setpoint/actual control error [km/h] [verified]" VALUE 0x724EA RL_VAL_SW 0 CM_0010 -2048 2047.9375 /end CHARACTERISTIC
/begin CHARACTERISTIC K_FGR_V_DIF_MIN "Minimum threshold of setpoint/actual control error [km/h] [verified]" VALUE 0x724EC RL_VAL_SW 0 CM_0010 -2048 2047.9375 /end CHARACTERISTIC
/begin CHARACTERISTIC K_FGR_V_DIF_MIN_UEBERHOL "Threshold for pull-away acceleration [km/h] [verified]" VALUE 0x72550 RL_VAL_SW 0 CM_0010 -2048 2047.9375 /end CHARACTERISTIC
/begin CHARACTERISTIC K_FGR_V_IST_MIN "Minimum vehicle speed [km/h] [verified]" VALUE 0x72504 RL_VAL_SW 0 CM_0010 -2048 2047.9375 /end CHARACTERISTIC
/begin CHARACTERISTIC K_FGR_V_IST_TAU "Filter constant for switching actual speed source [s] [verified]" VALUE 0x72542 RL_VAL_UW 0 CM_0025 0 655.35 /end CHARACTERISTIC
/begin CHARACTERISTIC K_FGR_V_MAX "Maximum speed limit [km/h] [verified]" VALUE 0x72510 RL_VAL_SW 0 CM_0010 -2048 2047.9375 /end CHARACTERISTIC
/begin CHARACTERISTIC K_FGR_V_SOLL_DIF_KONST "Constant deviation from target speed when overridden [km/h] [verified]" VALUE 0x724F8 RL_VAL_SW 0 CM_0010 -2048 2047.9375 /end CHARACTERISTIC
/begin CHARACTERISTIC K_FGR_V_SOLL_DIF_MAX "Maximum deviation from target speed when overridden [km/h] [verified]" VALUE 0x724F4 RL_VAL_SW 0 CM_0010 -2048 2047.9375 /end CHARACTERISTIC
/begin CHARACTERISTIC K_FGR_V_SOLL_DIF_MIN "Minimum deviation from target speed when overridden [km/h] [verified]" VALUE 0x724F6 RL_VAL_SW 0 CM_0010 -2048 2047.9375 /end CHARACTERISTIC
/begin CHARACTERISTIC K_FGR_V_SOLL_MAX_HYS "Maximum speed hysteresis [km/h] [verified]" VALUE 0x7252A RL_VAL_SW 0 CM_0010 -2048 2047.9375 /end CHARACTERISTIC
/begin CHARACTERISTIC K_FGR_V_SOLL_MAX_KMH "Maximum target/set speed in km/h [km/h] [verified]" VALUE 0x72508 RL_VAL_SW 0 CM_0010 -2048 2047.9375 /end CHARACTERISTIC
/begin CHARACTERISTIC K_FGR_V_SOLL_MAX_MPH "Maximum target/set speed in mph [mph] [verified]" VALUE 0x7250C RL_VAL_SW 0 CM_0045 -2048 2047.9375 /end CHARACTERISTIC
/begin CHARACTERISTIC K_FGR_V_SOLL_MAX_T "Maximum time above maximum set speed [s] [verified]" VALUE 0x724FC RL_VAL_UW 0 CM_0025 0 655.35 /end CHARACTERISTIC
/begin CHARACTERISTIC K_FGR_V_SOLL_MIN_KMH "Minimum target/set speed in km/h [km/h] [verified]" VALUE 0x7250A RL_VAL_SW 0 CM_0010 -2048 2047.9375 /end CHARACTERISTIC
/begin CHARACTERISTIC K_FGR_V_SOLL_MIN_MPH "Minimum target/set speed in mph [mph] [verified]" VALUE 0x7250E RL_VAL_SW 0 CM_0045 -2048 2047.9375 /end CHARACTERISTIC
/begin CHARACTERISTIC K_FGR_V_SOLL_OFFSET "Constant deviation from instrument cluster [km/h] [verified]" VALUE 0x724FA RL_VAL_SB 0 CM_0010 -8 7.9375 /end CHARACTERISTIC
/begin CHARACTERISTIC K_FGR_V_TIP_INC_DEC "Tip vehicle speed inc/dec [km/h] [verified]" VALUE 0x72506 RL_VAL_SW 0 CM_0010 -2048 2047.9375 /end CHARACTERISTIC
/begin CHARACTERISTIC KL_GANG_I_DKG "DKG gear from gearbox ratio [verified]" CURVE 0x73666 RL_CUR_SW_SW 0 CM_0016 -32 31.99902344 /begin AXIS_DESCR STD_AXIS NO_INPUT_QUANTITY CM_0016 9 -32 31.99902344 /end AXIS_DESCR /end CHARACTERISTIC
/begin CHARACTERISTIC KL_GANG_I_HS "Manual gearbox gear from gearbox ratio [verified]" CURVE 0x7368C RL_CUR_SW_SW 0 CM_0016 -32 31.99902344 /begin AXIS_DESCR STD_AXIS NO_INPUT_QUANTITY CM_0016 8 -32 31.99902344 /end AXIS_DESCR /end CHARACTERISTIC
/begin CHARACTERISTIC KL_GANG_I_SMG "SMG gear from gearbox ratio [verified]" CURVE 0x73640 RL_CUR_SW_SW 0 CM_0016 -32 31.99902344 /begin AXIS_DESCR STD_AXIS NO_INPUT_QUANTITY CM_0016 9 -32 31.99902344 /end AXIS_DESCR /end CHARACTERISTIC
/begin CHARACTERISTIC K_GANG_GLG_TIMER_MAX "Time until gearbox neutral is displayed [ms] [verified]" VALUE 0x7363A RL_VAL_SW 0 CM_0052 -327680 327670 /end CHARACTERISTIC
/begin CHARACTERISTIC K_GANG_I_RW_DKG "Reverse gear ratio, DKG [verified]" VALUE 0x7361C RL_VAL_SW 0 CM_0016 -32 31.99902344 /end CHARACTERISTIC
/begin CHARACTERISTIC K_GANG_I_RW_HS "Reverse gear ratio, manual gearbox [verified]" VALUE 0x7361E RL_VAL_SW 0 CM_0016 -32 31.99902344 /end CHARACTERISTIC
/begin CHARACTERISTIC K_GANG_I_RW_SMG "Reverse gear ratio, SMG [verified]" VALUE 0x7361A RL_VAL_SW 0 CM_0016 -32 31.99902344 /end CHARACTERISTIC
/begin CHARACTERISTIC K_GANG_N_VERH_MAX "Maximum gear ratio [verified]" VALUE 0x73618 RL_VAL_SW 0 CM_0016 -32 31.99902344 /end CHARACTERISTIC
/begin CHARACTERISTIC K_GANG_N_VERH_MIN "Minimum gear ratio [verified]" VALUE 0x73616 RL_VAL_SW 0 CM_0016 -32 31.99902344 /end CHARACTERISTIC
/begin CHARACTERISTIC KF_KH_SMG_T_DLY "Catalyst-heating delay time for SMG [verified]" MAP 0x74D48 RL_MAP_SW_SW_UW 0 CM_0020 0 327.675 /begin AXIS_DESCR STD_AXIS NO_INPUT_QUANTITY CM_0059 4 -131072 131068 /end AXIS_DESCR /begin AXIS_DESCR STD_AXIS NO_INPUT_QUANTITY CM_0006 4 -3550 3003.5 /end AXIS_DESCR /end CHARACTERISTIC
/begin CHARACTERISTIC KL_KH_ALT_OFFSET "Catalyst ageing offset [verified]" CURVE 0x7413C RL_CUR_UW_SW 0 CM_0024 -3276.8 3276.7 /begin AXIS_DESCR STD_AXIS NO_INPUT_QUANTITY CM_0019 7 0 3.999941832 /end AXIS_DESCR /end CHARACTERISTIC
/begin CHARACTERISTIC KL_KH_MD_ETA_F_LLOKS_KH3 "Factor map for efficiency (ETA) [verified]" CURVE 0x74258 RL_CUR_UW_UW 0 CM_0016 0 63.99902344 /begin AXIS_DESCR STD_AXIS NO_INPUT_QUANTITY CM_0020 6 0 327.675 /end AXIS_DESCR /end CHARACTERISTIC
/begin CHARACTERISTIC KL_KH_MD_ETA_F_PUMG "Correction factor, ambient pressure [verified]" CURVE 0x74212 RL_CUR_SW_UW 0 CM_0016 0 63.99902344 /begin AXIS_DESCR STD_AXIS NO_INPUT_QUANTITY CM_0022 5 -2048 2047.9375 /end AXIS_DESCR /end CHARACTERISTIC
/begin CHARACTERISTIC KL_KH_MD_ETA_START "Factor curve for efficiency (ETA) [verified]" CURVE 0x741DA RL_CUR_SW_UW 0 CM_0050 0 199.9969474 /begin AXIS_DESCR STD_AXIS NO_INPUT_QUANTITY CM_0006 8 -3550 3003.5 /end AXIS_DESCR /end CHARACTERISTIC
/begin CHARACTERISTIC KL_KH_MD_ETA_START_SL "Factor curve for efficiency (ETA) [verified]" CURVE 0x741B8 RL_CUR_SW_UW 0 CM_0050 0 199.9969474 /begin AXIS_DESCR STD_AXIS NO_INPUT_QUANTITY CM_0006 8 -3550 3003.5 /end AXIS_DESCR /end CHARACTERISTIC
/begin CHARACTERISTIC KL_KH_TKAT_ENDE_MSA "Temperature threshold for end of catalyst heating, auto start-stop [verified]" CURVE 0x74228 RL_CUR_UW_SW 0 CM_0006 -3550 3003.5 /begin AXIS_DESCR STD_AXIS NO_INPUT_QUANTITY CM_0060 6 0 1092.250002 /end AXIS_DESCR /end CHARACTERISTIC
/begin CHARACTERISTIC KL_KH_T_MAX "Maximum catalyst-heating time [verified]" CURVE 0x741A2 RL_CUR_SW_UW 0 CM_0020 0 327.675 /begin AXIS_DESCR STD_AXIS NO_INPUT_QUANTITY CM_0006 5 -3550 3003.5 /end AXIS_DESCR /end CHARACTERISTIC
/begin CHARACTERISTIC KL_KH_VAN_AUF_TMOT_A "Factor between KF_VAN_A and KF_VAN_KH_A (exhaust VANOS normal vs cat heating) [verified]" CURVE 0x74110 RL_CUR_SW_SW 0 CM_0027 -32768 32767 /begin AXIS_DESCR STD_AXIS NO_INPUT_QUANTITY CM_0006 4 -3550 3003.5 /end AXIS_DESCR /end CHARACTERISTIC
/begin CHARACTERISTIC KL_KH_VAN_AUF_TMOT_E "Factor between KF_VAN_E and KF_VAN_KH_E (intake VANOS normal vs cat heating) [verified]" CURVE 0x740FE RL_CUR_SW_SW 0 CM_0027 -32768 32767 /begin AXIS_DESCR STD_AXIS NO_INPUT_QUANTITY CM_0006 4 -3550 3003.5 /end AXIS_DESCR /end CHARACTERISTIC
/begin CHARACTERISTIC KL_KH_VAN_DELAY_TMOT "Catalyst-heating delay depending on engine temperature [verified]" CURVE 0x740E4 RL_CUR_SW_UW 0 CM_0025 0 655.35 /begin AXIS_DESCR STD_AXIS NO_INPUT_QUANTITY CM_0006 6 -3550 3003.5 /end AXIS_DESCR /end CHARACTERISTIC
/begin CHARACTERISTIC KL_KH_VAN_TMOT_F "Factor between KF_VAN_A and KF_VAN_KH_A (exhaust VANOS normal vs cat heating) [verified]" CURVE 0x74122 RL_CUR_SW_UW 0 CM_0019 0 3.999941832 /begin AXIS_DESCR STD_AXIS NO_INPUT_QUANTITY CM_0006 6 -3550 3003.5 /end AXIS_DESCR /end CHARACTERISTIC
/begin CHARACTERISTIC K_KH_PUMG_MIN "Minimum permitted ambient pressure for catalyst heating [mbar] [verified]" VALUE 0x740B2 RL_VAL_SW 0 CM_0022 -2048 2047.9375 /end CHARACTERISTIC
/begin CHARACTERISTIC K_KH_PUMG_MIN_HYS "Hysteresis for minimum permitted ambient pressure [mbar] [verified]" VALUE 0x740B4 RL_VAL_SW 0 CM_0022 -2048 2047.9375 /end CHARACTERISTIC
/begin CHARACTERISTIC K_KH_SLP_DAUER_MIN "Minimum secondary-air-pump run time for catalyst heating [s] [verified]" VALUE 0x740B6 RL_VAL_UW 0 CM_0023 0 6553.5 /end CHARACTERISTIC
/begin CHARACTERISTIC K_KH_TAN_MAX "Maximum permitted intake air temperature for catalyst heating [?C] [verified]" VALUE 0x740AE RL_VAL_SW 0 CM_0006 -3550 3003.5 /end CHARACTERISTIC
/begin CHARACTERISTIC K_KH_TAN_MAX_HYS "Hysteresis for maximum permitted intake air temperature [?C] [verified]" VALUE 0x740B0 RL_VAL_SW 0 CM_0006 -3550 3003.5 /end CHARACTERISTIC
/begin CHARACTERISTIC K_KH_VAN_AB_Einlass "Catalyst-heating ramp-down time [verified]" VALUE 0x740A4 RL_VAL_SW 0 CM_0027 -32768 32767 /end CHARACTERISTIC
/begin CHARACTERISTIC K_KIS_ACTIVE_PULSE "Active pulse configuration [verified]" VALUE 0x74D7D RL_VAL_UB 0 CM_0000 0 255 /end CHARACTERISTIC
/begin CHARACTERISTIC K_KIS_CFG "KIS configuration [verified]" VALUE 0x74D7C RL_VAL_UB 0 CM_0000 0 255 /end CHARACTERISTIC
/begin CHARACTERISTIC K_KIS_LEN "Pulse length [verified]" VALUE 0x74D80 RL_VAL_UW 0 CM_0061 0 719.989012 /end CHARACTERISTIC
/begin CHARACTERISTIC K_KIS_PERIOD "Pulse period [verified]" VALUE 0x74D82 RL_VAL_UW 0 CM_0061 0 719.989012 /end CHARACTERISTIC
/begin CHARACTERISTIC K_KIS_START "Pulse start [verified]" VALUE 0x74D7E RL_VAL_UW 0 CM_0061 0 719.989012 /end CHARACTERISTIC
/begin CHARACTERISTIC K_KIS_TIME_OUT "Maximum pulse time [verified]" VALUE 0x74D84 RL_VAL_UL 0 CM_0004 0 613566.5724 /end CHARACTERISTIC
/begin CHARACTERISTIC KF_KUS_N_MIN "Lower limit of maximum engine speed [verified]" MAP 0x7616A RL_MAP_SW_SW_SW 0 CM_0002 -32768 32767 /begin AXIS_DESCR STD_AXIS NO_INPUT_QUANTITY CM_0020 4 -163.84 163.835 /end AXIS_DESCR /begin AXIS_DESCR STD_AXIS NO_INPUT_QUANTITY CM_0002 4 -32768 32767 /end AXIS_DESCR /end CHARACTERISTIC
/begin CHARACTERISTIC KF_MD_KUS_TN "Control parameter TN (integral time) [verified]" MAP 0x78F92 RL_MAP_SW_SW_SW 0 CM_0064 -32.768 32.767 /begin AXIS_DESCR STD_AXIS NO_INPUT_QUANTITY CM_0016 7 -32 31.99902344 /end AXIS_DESCR /begin AXIS_DESCR STD_AXIS NO_INPUT_QUANTITY CM_0002 6 -32768 32767 /end AXIS_DESCR /end CHARACTERISTIC
/begin CHARACTERISTIC KL_KUS_GANG_FAK "Gear share depending on slip [verified]" CURVE 0x76146 RL_CUR_SW_SW 0 CM_0016 -32 31.99902344 /begin AXIS_DESCR STD_AXIS NO_INPUT_QUANTITY CM_0002 4 -32768 32767 /end AXIS_DESCR /end CHARACTERISTIC
/begin CHARACTERISTIC KL_KUS_N_MIN_AFZ "Lower engine speed depending on gradient (incline) [verified]" CURVE 0x76158 RL_CUR_SW_SW 0 CM_0002 -32768 32767 /begin AXIS_DESCR STD_AXIS NO_INPUT_QUANTITY CM_0042 4 -819.2 819.175 /end AXIS_DESCR /end CHARACTERISTIC
/begin CHARACTERISTIC KL_KUS_SCHLUPF_MAX "Permitted clutch slip [verified]" CURVE 0x76132 RL_CUR_UB_SW 0 CM_0002 -32768 32767 /begin AXIS_DESCR STD_AXIS NO_INPUT_QUANTITY CM_0000 6 0 255 /end AXIS_DESCR /end CHARACTERISTIC
/begin CHARACTERISTIC K_LLR_CFG_MIN "Konfiguration Begr Min-Moment [verified]" VALUE 0x76201 RL_VAL_UB 0 CM_0000 0 255 /end CHARACTERISTIC
/begin CHARACTERISTIC K_LLR_CFG_N_NACHF "Konfiguration nachgef. nSoll [verified]" VALUE 0x76200 RL_VAL_UB 0 CM_0000 0 255 /end CHARACTERISTIC
/begin CHARACTERISTIC K_LLR_D_GRAD "Activate derivative share [Upm/s] [verified]" VALUE 0x76238 RL_VAL_SW 0 CM_0067 -32768 32767 /end CHARACTERISTIC
/begin CHARACTERISTIC K_LLR_D_OFFSET "Activate derivative share [Upm] [verified]" VALUE 0x7623A RL_VAL_SW 0 CM_0002 -32768 32767 /end CHARACTERISTIC
/begin CHARACTERISTIC K_LLR_MD_D_MAX "Maximum derivative share, clutch open [Nm] [verified]" VALUE 0x76240 RL_VAL_SW 0 CM_0017 -3276.8 3276.7 /end CHARACTERISTIC
/begin CHARACTERISTIC K_LLR_MD_D_MIN "Minimum derivative share [Nm] [verified]" VALUE 0x7623E RL_VAL_SW 0 CM_0017 -3276.8 3276.7 /end CHARACTERISTIC
/begin CHARACTERISTIC K_N_MIN_FREEZE__IGN_ "Minimum entry speed for engine-speed freeze [Upm] [verified]" VALUE 0x7AAC4 RL_VAL_SW 0 CM_0002 -32768 32767 /end CHARACTERISTIC
/begin CHARACTERISTIC K_N_OBERGRENZE__IGN_ "Plausibility limit for engine-speed sensing [Upm] [verified]" VALUE 0x7AAC2 RL_VAL_SW 0 CM_0002 -32768 32767 /end CHARACTERISTIC
/begin CHARACTERISTIC K_N_ZEIT_STOERUNG__IGN_ "Freeze time of speed sensing after TPU fault [s] [verified]" VALUE 0x7AAC0 RL_VAL_SB 0 CM_0025 -1.28 1.27 /end CHARACTERISTIC
/begin CHARACTERISTIC K_N_GETR_CFG "Schalter Auswahl Getriebeeingangsdrehzahl [verified]" VALUE 0x7AAD0 RL_VAL_UB 0 CM_0000 0 255 /end CHARACTERISTIC
/begin CHARACTERISTIC K_N_GETR_F_HS "Factor for engine-speed calculation [verified]" VALUE 0x7AACC RL_VAL_UL 0 CM_0000 0 4294967295 /end CHARACTERISTIC
/begin CHARACTERISTIC K_N_GETR_MAX_PERIOD_HS "Maximum permitted tooth period (*6 us) [us] [verified]" VALUE 0x7AAC8 RL_VAL_UW 0 CM_0084 0 393210 /end CHARACTERISTIC
/begin CHARACTERISTIC KF_SMG_BW_NULL "Zero-crossing evaluation [verified]" MAP 0x7CAE6 RL_MAP_UB_UB_UB 0 CM_0000 0 255 /begin AXIS_DESCR STD_AXIS NO_INPUT_QUANTITY CM_0000 6 0 255 /end AXIS_DESCR /begin AXIS_DESCR STD_AXIS NO_INPUT_QUANTITY CM_0000 6 0 255 /end AXIS_DESCR /end CHARACTERISTIC
/begin CHARACTERISTIC KF_SMG_KI_AB_K "Ramp-down index, Comfort [verified]" MAP 0x7C6FC RL_MAP_SW_SW_UB 0 CM_0000 0 255 /begin AXIS_DESCR STD_AXIS NO_INPUT_QUANTITY CM_0013 8 -3276.8 3276.7 /end AXIS_DESCR /begin AXIS_DESCR STD_AXIS NO_INPUT_QUANTITY CM_0002 6 -32768 32767 /end AXIS_DESCR /end CHARACTERISTIC
/begin CHARACTERISTIC KF_SMG_KI_AB_S "Ramp-down index, Sport [verified]" MAP 0x7C74A RL_MAP_SW_SW_UB 0 CM_0000 0 255 /begin AXIS_DESCR STD_AXIS NO_INPUT_QUANTITY CM_0013 8 -3276.8 3276.7 /end AXIS_DESCR /begin AXIS_DESCR STD_AXIS NO_INPUT_QUANTITY CM_0002 6 -32768 32767 /end AXIS_DESCR /end CHARACTERISTIC
/begin CHARACTERISTIC KF_SMG_KI_AB_SCH_K "Ramp-down index, overrun, Comfort [verified]" MAP 0x7C8D0 RL_MAP_SW_SW_UB 0 CM_0000 0 255 /begin AXIS_DESCR STD_AXIS NO_INPUT_QUANTITY CM_0042 5 -819.2 819.175 /end AXIS_DESCR /begin AXIS_DESCR STD_AXIS NO_INPUT_QUANTITY CM_0002 6 -32768 32767 /end AXIS_DESCR /end CHARACTERISTIC
/begin CHARACTERISTIC KF_SMG_KI_AB_SCH_S "Ramp-down index, overrun, Sport [verified]" MAP 0x7C906 RL_MAP_SW_SW_UB 0 CM_0000 0 255 /begin AXIS_DESCR STD_AXIS NO_INPUT_QUANTITY CM_0042 5 -819.2 819.175 /end AXIS_DESCR /begin AXIS_DESCR STD_AXIS NO_INPUT_QUANTITY CM_0002 6 -32768 32767 /end AXIS_DESCR /end CHARACTERISTIC
/begin CHARACTERISTIC KF_SMG_KI_AUF_K "Ramp-up index, Comfort [verified]" MAP 0x7C834 RL_MAP_SW_SW_UB 0 CM_0000 0 255 /begin AXIS_DESCR STD_AXIS NO_INPUT_QUANTITY CM_0013 8 -3276.8 3276.7 /end AXIS_DESCR /begin AXIS_DESCR STD_AXIS NO_INPUT_QUANTITY CM_0002 6 -32768 32767 /end AXIS_DESCR /end CHARACTERISTIC
/begin CHARACTERISTIC KF_SMG_KI_AUF_S "Ramp-up index, Sport [verified]" MAP 0x7C882 RL_MAP_SW_SW_UB 0 CM_0000 0 255 /begin AXIS_DESCR STD_AXIS NO_INPUT_QUANTITY CM_0013 8 -3276.8 3276.7 /end AXIS_DESCR /begin AXIS_DESCR STD_AXIS NO_INPUT_QUANTITY CM_0002 6 -32768 32767 /end AXIS_DESCR /end CHARACTERISTIC
/begin CHARACTERISTIC KF_SMG_KI_AUF_SCH_K "Ramp-up index, overrun, Comfort [verified]" MAP 0x7C9A8 RL_MAP_SW_SW_UB 0 CM_0000 0 255 /begin AXIS_DESCR STD_AXIS NO_INPUT_QUANTITY CM_0042 5 -819.2 819.175 /end AXIS_DESCR /begin AXIS_DESCR STD_AXIS NO_INPUT_QUANTITY CM_0002 6 -32768 32767 /end AXIS_DESCR /end CHARACTERISTIC
/begin CHARACTERISTIC KF_SMG_KI_AUF_SCH_S "Ramp-up index, overrun, Sport [verified]" MAP 0x7C9DE RL_MAP_SW_SW_UB 0 CM_0000 0 255 /begin AXIS_DESCR STD_AXIS NO_INPUT_QUANTITY CM_0042 5 -819.2 819.175 /end AXIS_DESCR /begin AXIS_DESCR STD_AXIS NO_INPUT_QUANTITY CM_0002 6 -32768 32767 /end AXIS_DESCR /end CHARACTERISTIC
/begin CHARACTERISTIC KF_SMG_KI_SCHA_K "Shift index, Comfort [verified]" MAP 0x7C798 RL_MAP_SW_SW_UB 0 CM_0000 0 255 /begin AXIS_DESCR STD_AXIS NO_INPUT_QUANTITY CM_0013 8 -3276.8 3276.7 /end AXIS_DESCR /begin AXIS_DESCR STD_AXIS NO_INPUT_QUANTITY CM_0002 6 -32768 32767 /end AXIS_DESCR /end CHARACTERISTIC
/begin CHARACTERISTIC KF_SMG_KI_SCHA_S "Shift index, Sport [verified]" MAP 0x7C7E6 RL_MAP_SW_SW_UB 0 CM_0000 0 255 /begin AXIS_DESCR STD_AXIS NO_INPUT_QUANTITY CM_0013 8 -3276.8 3276.7 /end AXIS_DESCR /begin AXIS_DESCR STD_AXIS NO_INPUT_QUANTITY CM_0002 6 -32768 32767 /end AXIS_DESCR /end CHARACTERISTIC
/begin CHARACTERISTIC KF_SMG_KI_SCHA_SCH_K "Shift index, overrun, Comfort [verified]" MAP 0x7C93C RL_MAP_SW_SW_UB 0 CM_0000 0 255 /begin AXIS_DESCR STD_AXIS NO_INPUT_QUANTITY CM_0042 5 -819.2 819.175 /end AXIS_DESCR /begin AXIS_DESCR STD_AXIS NO_INPUT_QUANTITY CM_0002 6 -32768 32767 /end AXIS_DESCR /end CHARACTERISTIC
/begin CHARACTERISTIC KF_SMG_KI_SCHA_SCH_S "Shift index, overrun, Sport [verified]" MAP 0x7C972 RL_MAP_SW_SW_UB 0 CM_0000 0 255 /begin AXIS_DESCR STD_AXIS NO_INPUT_QUANTITY CM_0042 5 -819.2 819.175 /end AXIS_DESCR /begin AXIS_DESCR STD_AXIS NO_INPUT_QUANTITY CM_0002 6 -32768 32767 /end AXIS_DESCR /end CHARACTERISTIC
/begin CHARACTERISTIC KF_SMG_KUPP_LW_RAMPE "Ramp on load change [verified]" MAP 0x7CCD4 RL_MAP_SW_SW_SW 0 CM_0088 -327680 327670 /begin AXIS_DESCR STD_AXIS NO_INPUT_QUANTITY CM_0013 4 -3276.8 3276.7 /end AXIS_DESCR /begin AXIS_DESCR STD_AXIS NO_INPUT_QUANTITY CM_0017 4 -3276.8 3276.7 /end AXIS_DESCR /end CHARACTERISTIC
/begin CHARACTERISTIC KF_SMG_KUPP_REG_I_SCH "Clutch controller for overrun [verified]" MAP 0x7CCB8 RL_MAP_SW_SW_UB 0 CM_0089 0 0.0255 /begin AXIS_DESCR STD_AXIS NO_INPUT_QUANTITY CM_0002 4 -32768 32767 /end AXIS_DESCR /begin AXIS_DESCR STD_AXIS NO_INPUT_QUANTITY CM_0067 3 -32768 32767 /end AXIS_DESCR /end CHARACTERISTIC
/begin CHARACTERISTIC KF_SMG_KUPP_REG_I_ZUG "Clutch controller for traction (drive) [verified]" MAP 0x7CC9C RL_MAP_SW_SW_UB 0 CM_0089 0 0.0255 /begin AXIS_DESCR STD_AXIS NO_INPUT_QUANTITY CM_0002 4 -32768 32767 /end AXIS_DESCR /begin AXIS_DESCR STD_AXIS NO_INPUT_QUANTITY CM_0067 3 -32768 32767 /end AXIS_DESCR /end CHARACTERISTIC
/begin CHARACTERISTIC KF_SMG_MOT_ANF_M_RAMPE_1R "Ramp for pull-away in 1st and reverse [verified]" MAP 0x7CBBC RL_MAP_SW_SW_SW 0 CM_0007 -655360 655340 /begin AXIS_DESCR STD_AXIS NO_INPUT_QUANTITY CM_0013 4 -3276.8 3276.7 /end AXIS_DESCR /begin AXIS_DESCR STD_AXIS NO_INPUT_QUANTITY CM_0042 4 -819.2 819.175 /end AXIS_DESCR /end CHARACTERISTIC
/begin CHARACTERISTIC KF_SMG_MOT_ANF_M_RAMPE_2 "Ramp for pull-away in 2nd [verified]" MAP 0x7CBEE RL_MAP_SW_SW_SW 0 CM_0007 -655360 655340 /begin AXIS_DESCR STD_AXIS NO_INPUT_QUANTITY CM_0013 4 -3276.8 3276.7 /end AXIS_DESCR /begin AXIS_DESCR STD_AXIS NO_INPUT_QUANTITY CM_0042 4 -819.2 819.175 /end AXIS_DESCR /end CHARACTERISTIC
/begin CHARACTERISTIC KF_SMG_MOT_N_REG_M_MAX "Maximum limit of speed controller [verified]" MAP 0x7CB74 RL_MAP_SW_SW_SW 0 CM_0017 -3276.8 3276.7 /begin AXIS_DESCR STD_AXIS NO_INPUT_QUANTITY CM_0013 5 -3276.8 3276.7 /end AXIS_DESCR /begin AXIS_DESCR STD_AXIS NO_INPUT_QUANTITY CM_0000 5 -32768 32767 /end AXIS_DESCR /end CHARACTERISTIC
/begin CHARACTERISTIC KF_SMG_MOT_N_REG_P_KO "P-factor correction [verified]" MAP 0x7CC20 RL_MAP_SW_SW_UB 0 CM_0090 1 2.9921875 /begin AXIS_DESCR STD_AXIS NO_INPUT_QUANTITY CM_0002 6 -32768 32767 /end AXIS_DESCR /begin AXIS_DESCR STD_AXIS NO_INPUT_QUANTITY CM_0067 6 -32768 32767 /end AXIS_DESCR /end CHARACTERISTIC
/begin CHARACTERISTIC KF_SMG_N_ZIEL_OFF_K "Offset factor on target speed, Comfort [verified]" MAP 0x7CB18 RL_MAP_SW_SW_UB 0 CM_0026 0 199.21875 /begin AXIS_DESCR STD_AXIS NO_INPUT_QUANTITY CM_0042 4 -819.2 819.175 /end AXIS_DESCR /begin AXIS_DESCR STD_AXIS NO_INPUT_QUANTITY CM_0002 6 -32768 32767 /end AXIS_DESCR /end CHARACTERISTIC
/begin CHARACTERISTIC KF_SMG_N_ZIEL_OFF_S "Offset factor on target speed, Sport [verified]" MAP 0x7CB46 RL_MAP_SW_SW_UB 0 CM_0026 0 199.21875 /begin AXIS_DESCR STD_AXIS NO_INPUT_QUANTITY CM_0042 4 -819.2 819.175 /end AXIS_DESCR /begin AXIS_DESCR STD_AXIS NO_INPUT_QUANTITY CM_0002 6 -32768 32767 /end AXIS_DESCR /end CHARACTERISTIC
/begin CHARACTERISTIC KF_SMG_T_ABREGEL "Ramp-down time [verified]" MAP 0x7CA14 RL_MAP_UB_UB_UB 0 CM_0025 0 2.55 /begin AXIS_DESCR STD_AXIS NO_INPUT_QUANTITY CM_0000 12 0 255 /end AXIS_DESCR /begin AXIS_DESCR STD_AXIS NO_INPUT_QUANTITY CM_0000 7 0 255 /end AXIS_DESCR /end CHARACTERISTIC
/begin CHARACTERISTIC KF_SMG_T_AUFREGEL "Ramp-up time [verified]" MAP 0x7CA7D RL_MAP_UB_UB_UB 0 CM_0025 0 2.55 /begin AXIS_DESCR STD_AXIS NO_INPUT_QUANTITY CM_0000 12 0 255 /end AXIS_DESCR /begin AXIS_DESCR STD_AXIS NO_INPUT_QUANTITY CM_0000 7 0 255 /end AXIS_DESCR /end CHARACTERISTIC
/begin CHARACTERISTIC KL_SMG_FW_REL_VIRT "Virtual driver demand [verified]" CURVE 0x7C464 RL_CUR_SW_UB 0 CM_0037 0 1.9921875 /begin AXIS_DESCR STD_AXIS NO_INPUT_QUANTITY CM_0091 4 -3200 3199.902344 /end AXIS_DESCR /end CHARACTERISTIC
/begin CHARACTERISTIC KL_SMG_KI_AKS_GANG "Maximum shift index over target gear [verified]" CURVE 0x7C47E RL_CUR_SB_UB 0 CM_0000 0 255 /begin AXIS_DESCR STD_AXIS NO_INPUT_QUANTITY CM_0000 7 -128 127 /end AXIS_DESCR /end CHARACTERISTIC
/begin CHARACTERISTIC KL_SMG_KI_DAY_MAX "Maximum increase of lateral acceleration [verified]" CURVE 0x7C472 RL_CUR_SW_UB 0 CM_0000 0 255 /begin AXIS_DESCR STD_AXIS NO_INPUT_QUANTITY CM_0042 3 -819.2 819.175 /end AXIS_DESCR /end CHARACTERISTIC
/begin CHARACTERISTIC KL_SMG_KUPP_M_AB_ANF "Ramp-down curve after pull-away [verified]" CURVE 0x7C4D6 RL_CUR_UB_UB 0 CM_0092 0 199.21875 /begin AXIS_DESCR STD_AXIS NO_INPUT_QUANTITY CM_0093 6 0 199.21875 /end AXIS_DESCR /end CHARACTERISTIC
/begin CHARACTERISTIC KL_SMG_KUPP_M_AB_OFF "Offset on driver demand during ramp-down [verified]" CURVE 0x7C532 RL_CUR_SW_SW 0 CM_0017 -3276.8 3276.7 /begin AXIS_DESCR STD_AXIS NO_INPUT_QUANTITY CM_0017 3 -3276.8 3276.7 /end AXIS_DESCR /end CHARACTERISTIC
/begin CHARACTERISTIC KL_SMG_KUPP_M_AB_SH "Ramp-down curve, overrun upshift [verified]" CURVE 0x7C4B2 RL_CUR_UB_UB 0 CM_0092 0 199.21875 /begin AXIS_DESCR STD_AXIS NO_INPUT_QUANTITY CM_0093 8 0 199.21875 /end AXIS_DESCR /end CHARACTERISTIC
/begin CHARACTERISTIC KL_SMG_KUPP_M_AB_SR "Ramp-down curve, overrun downshift [verified]" CURVE 0x7C4C4 RL_CUR_UB_UB 0 CM_0092 0 199.21875 /begin AXIS_DESCR STD_AXIS NO_INPUT_QUANTITY CM_0093 8 0 199.21875 /end AXIS_DESCR /end CHARACTERISTIC
/begin CHARACTERISTIC KL_SMG_KUPP_M_AB_ZH "Ramp-down curve, traction upshift [verified]" CURVE 0x7C48E RL_CUR_UB_UB 0 CM_0092 0 199.21875 /begin AXIS_DESCR STD_AXIS NO_INPUT_QUANTITY CM_0093 8 0 199.21875 /end AXIS_DESCR /end CHARACTERISTIC
/begin CHARACTERISTIC KL_SMG_KUPP_M_AB_ZR "Ramp-down curve, traction downshift [verified]" CURVE 0x7C4A0 RL_CUR_UB_UB 0 CM_0092 0 199.21875 /begin AXIS_DESCR STD_AXIS NO_INPUT_QUANTITY CM_0093 8 0 199.21875 /end AXIS_DESCR /end CHARACTERISTIC
/begin CHARACTERISTIC KL_SMG_KUPP_M_AUF_KI "Offset on ramp-up ramp [verified]" CURVE 0x7C508 RL_CUR_UB_UB 0 CM_0092 0 199.21875 /begin AXIS_DESCR STD_AXIS NO_INPUT_QUANTITY CM_0000 4 0 255 /end AXIS_DESCR /end CHARACTERISTIC
/begin CHARACTERISTIC KL_SMG_KUPP_M_AUF_OFF "Clutch offset during ramp-up [verified]" CURVE 0x7C512 RL_CUR_UB_UB 0 CM_0017 0 25.5 /begin AXIS_DESCR STD_AXIS NO_INPUT_QUANTITY CM_0093 8 0 199.21875 /end AXIS_DESCR /end CHARACTERISTIC
/begin CHARACTERISTIC KL_SMG_KUPP_M_AUF_S1 "Ramp-up curve, overrun [verified]" CURVE 0x7C4F6 RL_CUR_UB_UB 0 CM_0092 0 199.21875 /begin AXIS_DESCR STD_AXIS NO_INPUT_QUANTITY CM_0093 8 0 199.21875 /end AXIS_DESCR /end CHARACTERISTIC
/begin CHARACTERISTIC KL_SMG_KUPP_M_AUF_Z1 "Ramp-up curve, traction [verified]" CURVE 0x7C4E4 RL_CUR_UB_UB 0 CM_0092 0 199.21875 /begin AXIS_DESCR STD_AXIS NO_INPUT_QUANTITY CM_0093 8 0 199.21875 /end AXIS_DESCR /end CHARACTERISTIC
/begin CHARACTERISTIC KL_SMG_KUPP_REG_I_F "Factor for ramp and controller [verified]" CURVE 0x7C524 RL_CUR_SW_UW 0 CM_0094 0 511.9921875 /begin AXIS_DESCR STD_AXIS NO_INPUT_QUANTITY CM_0017 3 -3276.8 3276.7 /end AXIS_DESCR /end CHARACTERISTIC
/begin CHARACTERISTIC KL_SMG_KUPP_UL_DN_POS "Gradient threshold, overload protection [verified]" CURVE 0x7C540 RL_CUR_SW_SW 0 CM_0067 -32768 32767 /begin AXIS_DESCR STD_AXIS NO_INPUT_QUANTITY CM_0002 3 -32768 32767 /end AXIS_DESCR /end CHARACTERISTIC
/begin CHARACTERISTIC KL_SMG_MOT_DN_REG_P "P share of gradient controller [verified]" CURVE 0x7C648 RL_CUR_SW_UB 0 CM_0095 0 0.255 /begin AXIS_DESCR STD_AXIS NO_INPUT_QUANTITY CM_0002 4 -32768 32767 /end AXIS_DESCR /end CHARACTERISTIC
/begin CHARACTERISTIC KL_SMG_MOT_DN_SOLL "Magnitude of target gradient [verified]" CURVE 0x7C62E RL_CUR_SW_SW 0 CM_0067 -32768 32767 /begin AXIS_DESCR STD_AXIS NO_INPUT_QUANTITY CM_0002 6 -32768 32767 /end AXIS_DESCR /end CHARACTERISTIC
/begin CHARACTERISTIC KL_SMG_MOT_J_MOTOR "Factor for pre-control 2 [verified]" CURVE 0x7C656 RL_CUR_SW_UB 0 CM_0096 0 1.9921875 /begin AXIS_DESCR STD_AXIS NO_INPUT_QUANTITY CM_0002 3 -32768 32767 /end AXIS_DESCR /end CHARACTERISTIC
/begin CHARACTERISTIC KL_SMG_MOT_M_AB_SH "Ramp-down curve, overrun upshift [verified]" CURVE 0x7C572 RL_CUR_UB_UB 0 CM_0092 0 199.21875 /begin AXIS_DESCR STD_AXIS NO_INPUT_QUANTITY CM_0093 8 0 199.21875 /end AXIS_DESCR /end CHARACTERISTIC
/begin CHARACTERISTIC KL_SMG_MOT_M_AB_SR "Ramp-down curve, overrun downshift [verified]" CURVE 0x7C584 RL_CUR_UB_UB 0 CM_0092 0 199.21875 /begin AXIS_DESCR STD_AXIS NO_INPUT_QUANTITY CM_0093 8 0 199.21875 /end AXIS_DESCR /end CHARACTERISTIC
/begin CHARACTERISTIC KL_SMG_MOT_M_AB_ZH "Ramp-down curve, traction upshift [verified]" CURVE 0x7C54E RL_CUR_UB_UB 0 CM_0092 0 199.21875 /begin AXIS_DESCR STD_AXIS NO_INPUT_QUANTITY CM_0093 8 0 199.21875 /end AXIS_DESCR /end CHARACTERISTIC
/begin CHARACTERISTIC KL_SMG_MOT_M_AB_ZR "Ramp-down curve, traction downshift [verified]" CURVE 0x7C560 RL_CUR_UB_UB 0 CM_0092 0 199.21875 /begin AXIS_DESCR STD_AXIS NO_INPUT_QUANTITY CM_0093 8 0 199.21875 /end AXIS_DESCR /end CHARACTERISTIC
/begin CHARACTERISTIC KL_SMG_MOT_M_RES_AUF "Reserve during ramp-up [verified]" CURVE 0x7C690 RL_CUR_SW_SW 0 CM_0017 -3276.8 3276.7 /begin AXIS_DESCR STD_AXIS NO_INPUT_QUANTITY CM_0017 4 -3276.8 3276.7 /end AXIS_DESCR /end CHARACTERISTIC
/begin CHARACTERISTIC KL_SMG_MOT_M_VOR_AUF "Engine look-ahead [verified]" CURVE 0x7C662 RL_CUR_SW_UB 0 CM_0025 0 2.55 /begin AXIS_DESCR STD_AXIS NO_INPUT_QUANTITY CM_0002 4 -32768 32767 /end AXIS_DESCR /end CHARACTERISTIC
/begin CHARACTERISTIC KL_SMG_MOT_N_REG_D_DN "Derivative share DOWN [verified]" CURVE 0x7C61A RL_CUR_SW_UB 0 CM_0097 0 25.5 /begin AXIS_DESCR STD_AXIS NO_INPUT_QUANTITY CM_0002 6 -32768 32767 /end AXIS_DESCR /end CHARACTERISTIC
/begin CHARACTERISTIC KL_SMG_MOT_N_REG_D_UP "Derivative share UP [verified]" CURVE 0x7C606 RL_CUR_SW_UB 0 CM_0097 0 25.5 /begin AXIS_DESCR STD_AXIS NO_INPUT_QUANTITY CM_0002 6 -32768 32767 /end AXIS_DESCR /end CHARACTERISTIC
/begin CHARACTERISTIC KL_SMG_MOT_N_REG_M_LW "Maximum torque during load change [verified]" CURVE 0x7C6BE RL_CUR_SW_SW 0 CM_0017 -3276.8 3276.7 /begin AXIS_DESCR STD_AXIS NO_INPUT_QUANTITY CM_0017 4 -3276.8 3276.7 /end AXIS_DESCR /end CHARACTERISTIC
/begin CHARACTERISTIC KL_SMG_MOT_N_REG_P_DN "P share DOWN [verified]" CURVE 0x7C5DE RL_CUR_SW_UB 0 CM_0063 0 2.55 /begin AXIS_DESCR STD_AXIS NO_INPUT_QUANTITY CM_0002 6 -32768 32767 /end AXIS_DESCR /end CHARACTERISTIC
/begin CHARACTERISTIC KL_SMG_MOT_N_REG_P_UP "P share UP [verified]" CURVE 0x7C5CA RL_CUR_SW_UB 0 CM_0063 0 2.55 /begin AXIS_DESCR STD_AXIS NO_INPUT_QUANTITY CM_0002 6 -32768 32767 /end AXIS_DESCR /end CHARACTERISTIC
/begin CHARACTERISTIC KL_SMG_MOT_N_REG_SA_DIFF "Speed difference for cruise switch-off [verified]" CURVE 0x7C6D0 RL_CUR_SW_SW 0 CM_0002 -32768 32767 /begin AXIS_DESCR STD_AXIS NO_INPUT_QUANTITY CM_0015 6 -32768 32767 /end AXIS_DESCR /end CHARACTERISTIC
/begin CHARACTERISTIC KL_SMG_MOT_VOR_2_KI "Factor for pre-control 2 [verified]" CURVE 0x7C596 RL_CUR_UB_UB 0 CM_0037 0 1.9921875 /begin AXIS_DESCR STD_AXIS NO_INPUT_QUANTITY CM_0000 4 0 255 /end AXIS_DESCR /end CHARACTERISTIC
/begin CHARACTERISTIC KL_SMG_N_ABRISS_SCHW "Threshold for tear-off (wheel slip) [verified]" CURVE 0x7C452 RL_CUR_SW_SW 0 CM_0002 -32768 32767 /begin AXIS_DESCR STD_AXIS NO_INPUT_QUANTITY CM_0017 4 -3276.8 3276.7 /end AXIS_DESCR /end CHARACTERISTIC
/begin CHARACTERISTIC KL_SMG_N_ZIEL_OFF_ANF "Offset on pull-away speed [verified]" CURVE 0x7C5AE RL_CUR_SW_SW 0 CM_0002 -32768 32767 /begin AXIS_DESCR STD_AXIS NO_INPUT_QUANTITY CM_0013 3 -3276.8 3276.7 /end AXIS_DESCR /end CHARACTERISTIC
/begin CHARACTERISTIC KL_SMG_N_ZIEL_OFF_LL "Offset on idle speed [verified]" CURVE 0x7C5BC RL_CUR_SW_SW 0 CM_0002 -32768 32767 /begin AXIS_DESCR STD_AXIS NO_INPUT_QUANTITY CM_0013 3 -3276.8 3276.7 /end AXIS_DESCR /end CHARACTERISTIC
/begin CHARACTERISTIC KL_SMG_N_ZIEL_OFF_MAX "Maximum offset factor [verified]" CURVE 0x7C5A0 RL_CUR_SW_UB 0 CM_0026 0 199.21875 /begin AXIS_DESCR STD_AXIS NO_INPUT_QUANTITY CM_0006 4 -3550 3003.5 /end AXIS_DESCR /end CHARACTERISTIC
/begin CHARACTERISTIC KL_SMG_N_ZIEL_OFF_RAB "Speed offset on wheel tear-off [verified]" CURVE 0x7C67E RL_CUR_SW_SW 0 CM_0002 -32768 32767 /begin AXIS_DESCR STD_AXIS NO_INPUT_QUANTITY CM_0017 4 -3276.8 3276.7 /end AXIS_DESCR /end CHARACTERISTIC
/begin CHARACTERISTIC KL_SMG_N_ZIEL_OFF_ZR "Offset during traction downshift [verified]" CURVE 0x7C670 RL_CUR_UW_SW 0 CM_0002 -32768 32767 /begin AXIS_DESCR STD_AXIS NO_INPUT_QUANTITY CM_0000 3 0 65535 /end AXIS_DESCR /end CHARACTERISTIC
/begin CHARACTERISTIC KL_SMG_PROG_AUTOMAT "Automatic programs [verified]" CURVE 0x7C428 RL_CUR_UB_UB 0 CM_0000 0 255 /begin AXIS_DESCR STD_AXIS NO_INPUT_QUANTITY CM_0000 6 0 255 /end AXIS_DESCR /end CHARACTERISTIC
/begin CHARACTERISTIC KL_SMG_PROG_MANUELL "Manual programs [verified]" CURVE 0x7C41A RL_CUR_UB_UB 0 CM_0000 0 255 /begin AXIS_DESCR STD_AXIS NO_INPUT_QUANTITY CM_0000 6 0 255 /end AXIS_DESCR /end CHARACTERISTIC
/begin CHARACTERISTIC KL_SMG_PROG_MAX_TOEL "Maximum program over oil temperature [verified]" CURVE 0x7C6A2 RL_CUR_SW_UB 0 CM_0098 0 255 /begin AXIS_DESCR STD_AXIS NO_INPUT_QUANTITY CM_0006 4 -3550 3003.5 /end AXIS_DESCR /end CHARACTERISTIC
/begin CHARACTERISTIC KL_SMG_PROG_MIN_BERG "Minimum program on incline [verified]" CURVE 0x7C6B0 RL_CUR_SW_UB 0 CM_0098 0 255 /begin AXIS_DESCR STD_AXIS NO_INPUT_QUANTITY CM_0042 4 -819.2 819.175 /end AXIS_DESCR /end CHARACTERISTIC
/begin CHARACTERISTIC KL_SMG_T_KORR_AB "Correction factor [verified]" CURVE 0x7C444 RL_CUR_UB_UB 0 CM_0026 0 199.21875 /begin AXIS_DESCR STD_AXIS NO_INPUT_QUANTITY CM_0026 6 0 199.21875 /end AXIS_DESCR /end CHARACTERISTIC
/begin CHARACTERISTIC K_SMG_ADAPT_IHAR_CNT "Counter, rear-axle ratio adaptation [verified]" VALUE 0x7C412 RL_VAL_UB 0 CM_0000 0 255 /end CHARACTERISTIC
/begin CHARACTERISTIC K_SMG_ADAPT_IHAR_DFLT "Default rear-axle ratio [verified]" VALUE 0x7C418 RL_VAL_UW 0 CM_0016 0 63.99902344 /end CHARACTERISTIC
/begin CHARACTERISTIC K_SMG_ADAPT_IHAR_MAX "Maximum rear-axle ratio [verified]" VALUE 0x7C416 RL_VAL_UW 0 CM_0016 0 63.99902344 /end CHARACTERISTIC
/begin CHARACTERISTIC K_SMG_ADAPT_IHAR_MIN "Minimum rear-axle ratio [verified]" VALUE 0x7C414 RL_VAL_UW 0 CM_0016 0 63.99902344 /end CHARACTERISTIC
/begin CHARACTERISTIC K_SMG_ADAPT_SP_DMD_FW "Gradient lock for clutch adaptation [verified]" VALUE 0x7C3D0 RL_VAL_SW 0 CM_0007 -655360 655340 /end CHARACTERISTIC
/begin CHARACTERISTIC K_SMG_ADAPT_SP_DM_MAX "Permitted deviation for clutch adaptation [verified]" VALUE 0x7C3D2 RL_VAL_SW 0 CM_0017 -3276.8 3276.7 /end CHARACTERISTIC
/begin CHARACTERISTIC K_SMG_ADAPT_SP_N_MAX "Maximum engine speed for clutch adaptation [verified]" VALUE 0x7C3D6 RL_VAL_SW 0 CM_0002 -32768 32767 /end CHARACTERISTIC
/begin CHARACTERISTIC K_SMG_ADAPT_SP_N_MIN "Minimum engine speed for clutch adaptation [verified]" VALUE 0x7C3D4 RL_VAL_SW 0 CM_0002 -32768 32767 /end CHARACTERISTIC
/begin CHARACTERISTIC K_SMG_ADAPT_SP_TOEL "Oil-temperature lock for clutch adaptation [verified]" VALUE 0x7C3CE RL_VAL_SW 0 CM_0006 -3550 3003.5 /end CHARACTERISTIC
/begin CHARACTERISTIC K_SMG_BERG_MD_KW_SCHW "Torque threshold for hill detection [verified]" VALUE 0x7C3CC RL_VAL_SW 0 CM_0017 -3276.8 3276.7 /end CHARACTERISTIC
/begin CHARACTERISTIC K_SMG_BERG_V_MAX_SCHW "Maximum speed threshold for hill detection [verified]" VALUE 0x7C3CA RL_VAL_SW 0 CM_0010 -2048 2047.9375 /end CHARACTERISTIC
/begin CHARACTERISTIC K_SMG_BERG_V_MIN_SCHW "Minimum speed threshold for hill detection [verified]" VALUE 0x7C3C8 RL_VAL_SW 0 CM_0010 -2048 2047.9375 /end CHARACTERISTIC
/begin CHARACTERISTIC K_SMG_CAN_ED_TSPERR "Maximum time for CAN checksum [verified]" VALUE 0x7CD06 RL_VAL_UW 0 CM_0020 0 327.675 /end CHARACTERISTIC
/begin CHARACTERISTIC K_SMG_CAN_ED_UB_MIN "Minimum battery voltage for CAN diagnosis [verified]" VALUE 0x7CD08 RL_VAL_SW 0 CM_0021 -3276.8 3276.7 /end CHARACTERISTIC
/begin CHARACTERISTIC K_SMG_CAN_KL87_TMAX "Terminal 87 timeout [verified]" VALUE 0x7CD0E RL_VAL_UW 0 CM_0023 0 6553.5 /end CHARACTERISTIC
/begin CHARACTERISTIC K_SMG_I_GANG_1 "Gear ratio [verified]" VALUE 0x7C3DE RL_VAL_UW 0 CM_0016 0 63.99902344 /end CHARACTERISTIC
/begin CHARACTERISTIC K_SMG_I_GANG_2 "Gear ratio [verified]" VALUE 0x7C3E0 RL_VAL_UW 0 CM_0016 0 63.99902344 /end CHARACTERISTIC
/begin CHARACTERISTIC K_SMG_I_GANG_3 "Gear ratio [verified]" VALUE 0x7C3E2 RL_VAL_UW 0 CM_0016 0 63.99902344 /end CHARACTERISTIC
/begin CHARACTERISTIC K_SMG_I_GANG_4 "Gear ratio [verified]" VALUE 0x7C3E4 RL_VAL_UW 0 CM_0016 0 63.99902344 /end CHARACTERISTIC
/begin CHARACTERISTIC K_SMG_I_GANG_5 "Gear ratio [verified]" VALUE 0x7C3E6 RL_VAL_UW 0 CM_0016 0 63.99902344 /end CHARACTERISTIC
/begin CHARACTERISTIC K_SMG_I_GANG_6 "Gear ratio [verified]" VALUE 0x7C3E8 RL_VAL_UW 0 CM_0016 0 63.99902344 /end CHARACTERISTIC
/begin CHARACTERISTIC K_SMG_I_GANG_7 "Gear ratio [verified]" VALUE 0x7C3EA RL_VAL_UW 0 CM_0016 0 63.99902344 /end CHARACTERISTIC
/begin CHARACTERISTIC K_SMG_I_GANG_N "Gear ratio [verified]" VALUE 0x7C3DC RL_VAL_UW 0 CM_0016 0 63.99902344 /end CHARACTERISTIC
/begin CHARACTERISTIC K_SMG_I_GANG_R "Gear ratio [verified]" VALUE 0x7C3DA RL_VAL_UW 0 CM_0016 0 63.99902344 /end CHARACTERISTIC
/begin CHARACTERISTIC K_SMG_I_HA "Rear-axle ratio [verified]" VALUE 0x7C3EC RL_VAL_UW 0 CM_0016 0 63.99902344 /end CHARACTERISTIC
/begin CHARACTERISTIC K_SMG_KI_AKS_AY_MAX "Auto-upshift lock at high lateral acceleration [verified]" VALUE 0x7C310 RL_VAL_SW 0 CM_0042 -819.2 819.175 /end CHARACTERISTIC
/begin CHARACTERISTIC K_SMG_KI_AKS_DAY_MAX "Auto-upshift lock on lateral-acceleration increase [verified]" VALUE 0x7C312 RL_VAL_SW 0 CM_0042 -819.2 819.175 /end CHARACTERISTIC
/begin CHARACTERISTIC K_SMG_KI_AUF_DSC "Maximum ramp-up index with DSC off [verified]" VALUE 0x7C309 RL_VAL_UB 0 CM_0000 0 255 /end CHARACTERISTIC
/begin CHARACTERISTIC K_SMG_KI_AUF_DSC2 "Maximum ramp-up index in DSC Sport [verified]" VALUE 0x7C30A RL_VAL_UB 0 CM_0000 0 255 /end CHARACTERISTIC
/begin CHARACTERISTIC K_SMG_KI_AUF_EINGR "Maximum ramp-up index during DSC intervention [verified]" VALUE 0x7C30B RL_VAL_UB 0 CM_0000 0 255 /end CHARACTERISTIC
/begin CHARACTERISTIC K_SMG_KI_AUF_T_EINGR "Maximum time with DSC intervention [verified]" VALUE 0x7C30E RL_VAL_UW 0 CM_0025 0 655.35 /end CHARACTERISTIC
/begin CHARACTERISTIC K_SMG_KI_AUF_ZR "Maximum ramp-up index on traction downshift [verified]" VALUE 0x7C30C RL_VAL_UB 0 CM_0000 0 255 /end CHARACTERISTIC
/begin CHARACTERISTIC K_SMG_KI_CFG "Shift-index configuration [verified]" VALUE 0x7C307 RL_VAL_UB 0 CM_0000 0 255 /end CHARACTERISTIC
/begin CHARACTERISTIC K_SMG_KI_DELTA_PWG "Re-determination of shift indices [verified]" VALUE 0x7C316 RL_VAL_SW 0 CM_0013 -3276.8 3276.7 /end CHARACTERISTIC
/begin CHARACTERISTIC K_SMG_KI_NEU_AY_MAX "No shift-index update at high lateral acceleration [verified]" VALUE 0x7C314 RL_VAL_SW 0 CM_0042 -819.2 819.175 /end CHARACTERISTIC
/begin CHARACTERISTIC K_SMG_KI_SCHALT_DSC "Maximum shift index with DSC active [verified]" VALUE 0x7C308 RL_VAL_UB 0 CM_0000 0 255 /end CHARACTERISTIC
/begin CHARACTERISTIC K_SMG_KSCHLUPF_AUF "Clutch slip threshold during ramp-up [verified]" VALUE 0x7C304 RL_VAL_UB 0 CM_0091 0 24.90234375 /end CHARACTERISTIC
/begin CHARACTERISTIC K_SMG_KSCHLUPF_DSC "Clutch slip during DSC intervention [verified]" VALUE 0x7C305 RL_VAL_UB 0 CM_0091 0 24.90234375 /end CHARACTERISTIC
/begin CHARACTERISTIC K_SMG_KSCHLUPF_N "Speed threshold, clutch slip [verified]" VALUE 0x7C302 RL_VAL_SW 0 CM_0002 -32768 32767 /end CHARACTERISTIC
/begin CHARACTERISTIC K_SMG_KSCHLUPF_T_SCHW "Time threshold for clutch slip [verified]" VALUE 0x7C306 RL_VAL_UB 0 CM_0025 0 2.55 /end CHARACTERISTIC
/begin CHARACTERISTIC K_SMG_KUPP_AUF_SCHW_N "Speed threshold for ramp-up oscillation [verified]" VALUE 0x7C34A RL_VAL_SW 0 CM_0002 -32768 32767 /end CHARACTERISTIC
/begin CHARACTERISTIC K_SMG_KUPP_DM_ABS "Clutch gradient during ABS intervention [verified]" VALUE 0x7C32D RL_VAL_UB 0 CM_0007 0 5100 /end CHARACTERISTIC
/begin CHARACTERISTIC K_SMG_KUPP_DM_MIN "Minimum clutch gradient [verified]" VALUE 0x7C32A RL_VAL_SW 0 CM_0007 -655360 655340 /end CHARACTERISTIC
/begin CHARACTERISTIC K_SMG_KUPP_DM_RAB "Clutch gradient during roll-back [verified]" VALUE 0x7C32C RL_VAL_UB 0 CM_0007 0 5100 /end CHARACTERISTIC
/begin CHARACTERISTIC K_SMG_KUPP_DM_SOLL_F "Factor on clutch gradient [verified]" VALUE 0x7C32E RL_VAL_UB 0 CM_0037 0 1.9921875 /end CHARACTERISTIC
/begin CHARACTERISTIC K_SMG_KUPP_M_MAX_1 "Maximum overrun torque in 1st gear [verified]" VALUE 0x7C330 RL_VAL_SW 0 CM_0017 -3276.8 3276.7 /end CHARACTERISTIC
/begin CHARACTERISTIC K_SMG_KUPP_M_MAX_2 "Maximum overrun torque in 2nd gear [verified]" VALUE 0x7C332 RL_VAL_SW 0 CM_0017 -3276.8 3276.7 /end CHARACTERISTIC
/begin CHARACTERISTIC K_SMG_KUPP_N_KSCHUTZ "Trigger threshold for clutch protection [verified]" VALUE 0x7C33C RL_VAL_SW 0 CM_0002 -32768 32767 /end CHARACTERISTIC
/begin CHARACTERISTIC K_SMG_KUPP_RAMPE_DM "Slope of clutch ramp [verified]" VALUE 0x7C33A RL_VAL_UB 0 CM_0099 0 0.255 /end CHARACTERISTIC
/begin CHARACTERISTIC K_SMG_KUPP_RAMPE_N "Trigger threshold, ramp [verified]" VALUE 0x7C338 RL_VAL_SW 0 CM_0002 -32768 32767 /end CHARACTERISTIC
/begin CHARACTERISTIC K_SMG_KUPP_RAMPE_N_ABW "Trigger threshold, ramp - stalling [verified]" VALUE 0x7C336 RL_VAL_SW 0 CM_0002 -32768 32767 /end CHARACTERISTIC
/begin CHARACTERISTIC K_SMG_KUPP_RAMPE_UL "Clutch ramp during overload [verified]" VALUE 0x7C346 RL_VAL_UW 0 CM_0073 0 6553.5 /end CHARACTERISTIC
/begin CHARACTERISTIC K_SMG_KUPP_REG_T "Controller switch-on threshold [verified]" VALUE 0x7C334 RL_VAL_UW 0 CM_0025 0 655.35 /end CHARACTERISTIC
/begin CHARACTERISTIC K_SMG_KUPP_UL_FW_DM "Driver-demand ramp during overload [verified]" VALUE 0x7C348 RL_VAL_UB 0 CM_0088 0 2550 /end CHARACTERISTIC
/begin CHARACTERISTIC K_SMG_KUPP_UL_FW_MAX "Maximum driver-demand reduction during overload [verified]" VALUE 0x7C344 RL_VAL_SW 0 CM_0017 -3276.8 3276.7 /end CHARACTERISTIC
/begin CHARACTERISTIC K_SMG_KUPP_UL_FW_SCHW "Minimum driver demand for clutch protection [verified]" VALUE 0x7C33E RL_VAL_SW 0 CM_0017 -3276.8 3276.7 /end CHARACTERISTIC
/begin CHARACTERISTIC K_SMG_KUPP_UL_MD_SCHW "Offset on actual torque [verified]" VALUE 0x7C340 RL_VAL_SW 0 CM_0017 -3276.8 3276.7 /end CHARACTERISTIC
/begin CHARACTERISTIC K_SMG_KUPP_UL_N_SCHW "Difference engine/gearbox [verified]" VALUE 0x7C342 RL_VAL_SW 0 CM_0002 -32768 32767 /end CHARACTERISTIC
/begin CHARACTERISTIC K_SMG_MD_FW_HYS_SCH "Hysteresis, overrun detection [verified]" VALUE 0x7C324 RL_VAL_SW 0 CM_0017 -3276.8 3276.7 /end CHARACTERISTIC
/begin CHARACTERISTIC K_SMG_MD_FW_HYS_ZUG "Hysteresis, traction detection [verified]" VALUE 0x7C322 RL_VAL_SW 0 CM_0017 -3276.8 3276.7 /end CHARACTERISTIC
/begin CHARACTERISTIC K_SMG_MD_FW_MIN_AB "Minimum ramp-down torque [verified]" VALUE 0x7C31E RL_VAL_SW 0 CM_0017 -3276.8 3276.7 /end CHARACTERISTIC
/begin CHARACTERISTIC K_SMG_MD_FW_MIN_AUF "Minimum ramp-up torque [verified]" VALUE 0x7C320 RL_VAL_SW 0 CM_0017 -3276.8 3276.7 /end CHARACTERISTIC
/begin CHARACTERISTIC K_SMG_MOT_ABS_DM_MAX "Decay of maximum torque during ABS intervention [verified]" VALUE 0x7C392 RL_VAL_SW 0 CM_0007 -655360 655340 /end CHARACTERISTIC
/begin CHARACTERISTIC K_SMG_MOT_ABS_M_MAX "Maximum torque during ABS intervention [verified]" VALUE 0x7C390 RL_VAL_SW 0 CM_0017 -3276.8 3276.7 /end CHARACTERISTIC
/begin CHARACTERISTIC K_SMG_MOT_ABS_M_MIN "Minimum torque during ABS intervention [verified]" VALUE 0x7C38E RL_VAL_SW 0 CM_0017 -3276.8 3276.7 /end CHARACTERISTIC
/begin CHARACTERISTIC K_SMG_MOT_ABS_N_OFF "Offset on gearbox speed during ABS intervention [verified]" VALUE 0x7C38C RL_VAL_SW 0 CM_0002 -32768 32767 /end CHARACTERISTIC
/begin CHARACTERISTIC K_SMG_MOT_ABS_T_MAX "Maximum time for ABS intervention [verified]" VALUE 0x7C394 RL_VAL_UW 0 CM_0025 0 655.35 /end CHARACTERISTIC
/begin CHARACTERISTIC K_SMG_MOT_AKS_N_SCHW "Maximum difference to rev limit for auto-upshift [verified]" VALUE 0x7C3C2 RL_VAL_SW 0 CM_0002 -32768 32767 /end CHARACTERISTIC
/begin CHARACTERISTIC K_SMG_MOT_ANF_DM_DSC "Ramp for DSC pull-away [verified]" VALUE 0x7C3B0 RL_VAL_SW 0 CM_0007 -655360 655340 /end CHARACTERISTIC
/begin CHARACTERISTIC K_SMG_MOT_ANF_FW_X "Ramp-down factor, pull-away speed [verified]" VALUE 0x7C3AC RL_VAL_SW 0 CM_0002 -32768 32767 /end CHARACTERISTIC
/begin CHARACTERISTIC K_SMG_MOT_ANF_M_MIN "Detection of pull-away from a shift [verified]" VALUE 0x7C3AE RL_VAL_SW 0 CM_0017 -3276.8 3276.7 /end CHARACTERISTIC
/begin CHARACTERISTIC K_SMG_MOT_ANF_N_OFF "Speed offset on pull-away speed [verified]" VALUE 0x7C3AA RL_VAL_SW 0 CM_0002 -32768 32767 /end CHARACTERISTIC
/begin CHARACTERISTIC K_SMG_MOT_DN_REG_I_N "Integral share, gradient controller, negative [verified]" VALUE 0x7C380 RL_VAL_UB 0 CM_0089 0 0.0255 /end CHARACTERISTIC
/begin CHARACTERISTIC K_SMG_MOT_DN_REG_I_P "Integral share, gradient controller, positive [verified]" VALUE 0x7C37F RL_VAL_UB 0 CM_0089 0 0.0255 /end CHARACTERISTIC
/begin CHARACTERISTIC K_SMG_MOT_DN_REG_I_S "Integral share, gradient controller, positive, overrun [verified]" VALUE 0x7C381 RL_VAL_UB 0 CM_0089 0 0.0255 /end CHARACTERISTIC
/begin CHARACTERISTIC K_SMG_MOT_DN_REG_T "Switch-on threshold, speed-gradient controller [verified]" VALUE 0x7C382 RL_VAL_UW 0 CM_0025 0 655.35 /end CHARACTERISTIC
/begin CHARACTERISTIC K_SMG_MOT_DN_SOLL_MIN "Minimum target speed gradient [verified]" VALUE 0x7C378 RL_VAL_SW 0 CM_0067 -32768 32767 /end CHARACTERISTIC
/begin CHARACTERISTIC K_SMG_MOT_DN_SOLL_VOR "Threshold for speed-gradient switchover [verified]" VALUE 0x7C37A RL_VAL_SW 0 CM_0002 -32768 32767 /end CHARACTERISTIC
/begin CHARACTERISTIC K_SMG_MOT_M_RES_ABW "Torque reserve against stalling [verified]" VALUE 0x7C370 RL_VAL_SW 0 CM_0017 -3276.8 3276.7 /end CHARACTERISTIC
/begin CHARACTERISTIC K_SMG_MOT_M_RES_AUF "Torque reserve during ramp-up [verified]" VALUE 0x7C36C RL_VAL_SW 0 CM_0017 -3276.8 3276.7 /end CHARACTERISTIC
/begin CHARACTERISTIC K_SMG_MOT_M_RES_EXT_MAX "Reserve inactive due to external reserve [verified]" VALUE 0x7C366 RL_VAL_SW 0 CM_0017 -3276.8 3276.7 /end CHARACTERISTIC
/begin CHARACTERISTIC K_SMG_MOT_M_RES_MAX "Maximum torque reserve [verified]" VALUE 0x7C368 RL_VAL_SW 0 CM_0017 -3276.8 3276.7 /end CHARACTERISTIC
/begin CHARACTERISTIC K_SMG_MOT_M_RES_POS_MAX "Start torque for positive reserve [verified]" VALUE 0x7C3C4 RL_VAL_SW 0 CM_0017 -3276.8 3276.7 /end CHARACTERISTIC
/begin CHARACTERISTIC K_SMG_MOT_M_RES_POS_N "Start engine speed for positive reserve [verified]" VALUE 0x7C3C6 RL_VAL_SW 0 CM_0002 -32768 32767 /end CHARACTERISTIC
/begin CHARACTERISTIC K_SMG_MOT_M_RES_RAMPE "Reserve ramp [verified]" VALUE 0x7C372 RL_VAL_SW 0 CM_0007 -655360 655340 /end CHARACTERISTIC
/begin CHARACTERISTIC K_SMG_MOT_M_RES_RAMPE_KS "Reserve ramp during clutch slip [verified]" VALUE 0x7C374 RL_VAL_SW 0 CM_0007 -655360 655340 /end CHARACTERISTIC
/begin CHARACTERISTIC K_SMG_MOT_M_RES_RS "Torque reserve, race start [verified]" VALUE 0x7C36E RL_VAL_SW 0 CM_0017 -3276.8 3276.7 /end CHARACTERISTIC
/begin CHARACTERISTIC K_SMG_MOT_M_RES_SCHA "Torque reserve, shifting [verified]" VALUE 0x7C36A RL_VAL_SW 0 CM_0017 -3276.8 3276.7 /end CHARACTERISTIC
/begin CHARACTERISTIC K_SMG_MOT_M_RES_T_MAX "Maximum time for torque reserve [verified]" VALUE 0x7C376 RL_VAL_UW 0 CM_0020 0 327.675 /end CHARACTERISTIC
/begin CHARACTERISTIC K_SMG_MOT_M_VOR_AUF "Look-ahead [verified]" VALUE 0x7C35A RL_VAL_UB 0 CM_0025 0 2.55 /end CHARACTERISTIC
/begin CHARACTERISTIC K_SMG_MOT_NL_DELTA_FW "Driver-demand abort threshold for ramp [verified]" VALUE 0x7C360 RL_VAL_UB 0 CM_0013 0 25.5 /end CHARACTERISTIC
/begin CHARACTERISTIC K_SMG_MOT_NL_ETA "Efficiency abort threshold for ramp [verified]" VALUE 0x7C362 RL_VAL_UW 0 CM_0050 0 199.9969474 /end CHARACTERISTIC
/begin CHARACTERISTIC K_SMG_MOT_NL_MD "Torque abort threshold for ramp [verified]" VALUE 0x7C361 RL_VAL_UB 0 CM_0017 0 25.5 /end CHARACTERISTIC
/begin CHARACTERISTIC K_SMG_MOT_NL_MD_MAX "Maximum driver-demand deviation, ignition follow-up [verified]" VALUE 0x7C35C RL_VAL_SW 0 CM_0017 -3276.8 3276.7 /end CHARACTERISTIC
/begin CHARACTERISTIC K_SMG_MOT_NL_TAU "Filter after end of ramp [verified]" VALUE 0x7C364 RL_VAL_UB 0 CM_0027 0 255 /end CHARACTERISTIC
/begin CHARACTERISTIC K_SMG_MOT_NL_T_MAX "Maximum ignition follow-up time [verified]" VALUE 0x7C35E RL_VAL_UW 0 CM_0020 0 327.675 /end CHARACTERISTIC
/begin CHARACTERISTIC K_SMG_MOT_N_REG_D_MAX "Maximum control error for derivative share [verified]" VALUE 0x7C3A2 RL_VAL_SW 0 CM_0002 -32768 32767 /end CHARACTERISTIC
/begin CHARACTERISTIC K_SMG_MOT_N_REG_D_MIN "Minimum control error for derivative share [verified]" VALUE 0x7C3A0 RL_VAL_SW 0 CM_0002 -32768 32767 /end CHARACTERISTIC
/begin CHARACTERISTIC K_SMG_MOT_N_REG_I_DN "Integral share, speed controller down [verified]" VALUE 0x7C397 RL_VAL_UB 0 CM_0099 0 0.255 /end CHARACTERISTIC
/begin CHARACTERISTIC K_SMG_MOT_N_REG_I_SCHW "Maximum control-error threshold for integral share (speed controller) [verified]" VALUE 0x7C398 RL_VAL_SW 0 CM_0002 -32768 32767 /end CHARACTERISTIC
/begin CHARACTERISTIC K_SMG_MOT_N_REG_I_T "Switch-on threshold, integral share [verified]" VALUE 0x7C39A RL_VAL_UW 0 CM_0020 0 327.675 /end CHARACTERISTIC
/begin CHARACTERISTIC K_SMG_MOT_N_REG_I_T_RAB "Switch-on threshold, integral share during roll-back [verified]" VALUE 0x7C39C RL_VAL_UW 0 CM_0020 0 327.675 /end CHARACTERISTIC
/begin CHARACTERISTIC K_SMG_MOT_N_REG_I_UP "Integral share, speed controller up [verified]" VALUE 0x7C396 RL_VAL_UB 0 CM_0099 0 0.255 /end CHARACTERISTIC
/begin CHARACTERISTIC K_SMG_MOT_N_REG_M_BEGR "Speed threshold for limitation [verified]" VALUE 0x7C3A8 RL_VAL_SW 0 CM_0010 -2048 2047.9375 /end CHARACTERISTIC
/begin CHARACTERISTIC K_SMG_MOT_N_REG_M_MAX "Maximum controller torque during ramp-up [verified]" VALUE 0x7C3A4 RL_VAL_SW 0 CM_0017 -3276.8 3276.7 /end CHARACTERISTIC
/begin CHARACTERISTIC K_SMG_MOT_N_REG_M_STG "Maximum torque for disturbance feed-forward [verified]" VALUE 0x7C39E RL_VAL_SW 0 CM_0017 -3276.8 3276.7 /end CHARACTERISTIC
/begin CHARACTERISTIC K_SMG_MOT_N_REG_T_MAX "Ramp-down time of maximum controller torque [verified]" VALUE 0x7C3A6 RL_VAL_UW 0 CM_0020 0 327.675 /end CHARACTERISTIC
/begin CHARACTERISTIC K_SMG_MOT_RAB_DM_MAX "Decay of maximum torque on wheel tear-off [verified]" VALUE 0x7C388 RL_VAL_SW 0 CM_0007 -655360 655340 /end CHARACTERISTIC
/begin CHARACTERISTIC K_SMG_MOT_RAB_M_MAX "Maximum torque on wheel tear-off [verified]" VALUE 0x7C386 RL_VAL_SW 0 CM_0017 -3276.8 3276.7 /end CHARACTERISTIC
/begin CHARACTERISTIC K_SMG_MOT_RAB_M_MIN "Minimum torque on wheel tear-off [verified]" VALUE 0x7C384 RL_VAL_SW 0 CM_0017 -3276.8 3276.7 /end CHARACTERISTIC
/begin CHARACTERISTIC K_SMG_MOT_RAB_T_MAX "Maximum time for wheel tear-off [verified]" VALUE 0x7C38A RL_VAL_UW 0 CM_0025 0 655.35 /end CHARACTERISTIC
/begin CHARACTERISTIC K_SMG_MOT_RSS_MD_EINGR "Race-start (launch) configuration [verified]" VALUE 0x7C3C0 RL_VAL_UB 0 CM_0000 0 255 /end CHARACTERISTIC
/begin CHARACTERISTIC K_SMG_MOT_RS_N_OFF "Offset on race-start pull-away speed [verified]" VALUE 0x7C3B6 RL_VAL_SW 0 CM_0002 -32768 32767 /end CHARACTERISTIC
/begin CHARACTERISTIC K_SMG_MOT_RS_N_SCHW "Speed abort threshold, race start [verified]" VALUE 0x7C3B2 RL_VAL_SW 0 CM_0002 -32768 32767 /end CHARACTERISTIC
/begin CHARACTERISTIC K_SMG_MOT_RS_S_SCHW "Slip abort threshold, race start [verified]" VALUE 0x7C3B4 RL_VAL_SW 0 CM_0091 -3200 3199.902344 /end CHARACTERISTIC
/begin CHARACTERISTIC K_SMG_MOT_RS_TI_TABG "Maximum exhaust temperature for injection intervention [verified]" VALUE 0x7C3BE RL_VAL_SW 0 CM_0006 -3550 3003.5 /end CHARACTERISTIC
/begin CHARACTERISTIC K_SMG_MOT_RS_TI_TIME "Time for injection intervention [verified]" VALUE 0x7C3BC RL_VAL_UW 0 CM_0020 0 327.675 /end CHARACTERISTIC
/begin CHARACTERISTIC K_SMG_MOT_RS_T_HI "High time [verified]" VALUE 0x7C3BA RL_VAL_UW 0 CM_0020 0 327.675 /end CHARACTERISTIC
/begin CHARACTERISTIC K_SMG_MOT_RS_T_LO "Low time [verified]" VALUE 0x7C3B8 RL_VAL_UW 0 CM_0020 0 327.675 /end CHARACTERISTIC
/begin CHARACTERISTIC K_SMG_M_NULL "Zero-torque threshold [verified]" VALUE 0x7C300 RL_VAL_SW 0 CM_0017 -3276.8 3276.7 /end CHARACTERISTIC
/begin CHARACTERISTIC K_SMG_NO_LW_N_SCHW "End at load change [verified]" VALUE 0x7C31C RL_VAL_UB 0 CM_0002 0 255 /end CHARACTERISTIC
/begin CHARACTERISTIC K_SMG_N_ABRISS_ANF "Tear-off detection threshold at pull-away [verified]" VALUE 0x7C2FC RL_VAL_SW 0 CM_0002 -32768 32767 /end CHARACTERISTIC
/begin CHARACTERISTIC K_SMG_N_ABRISS_HYS "Hysteresis for tear-off detection [verified]" VALUE 0x7C2FA RL_VAL_SW 0 CM_0002 -32768 32767 /end CHARACTERISTIC
/begin CHARACTERISTIC K_SMG_N_EKR_OFF_BEGR "Engine-drag-control offset on rev limiter [verified]" VALUE 0x7C355 RL_VAL_UB 0 CM_0002 0 255 /end CHARACTERISTIC
/begin CHARACTERISTIC K_SMG_N_NULL "Zero-speed threshold [verified]" VALUE 0x7C2FE RL_VAL_SW 0 CM_0002 -32768 32767 /end CHARACTERISTIC
/begin CHARACTERISTIC K_SMG_N_ZIEL_ABWUERG "Anti-stall target speed [verified]" VALUE 0x7C356 RL_VAL_SW 0 CM_0002 -32768 32767 /end CHARACTERISTIC
/begin CHARACTERISTIC K_SMG_N_ZIEL_ANF_V_MAX "Speed threshold for pull-away engine speed [verified]" VALUE 0x7C358 RL_VAL_SW 0 CM_0010 -2048 2047.9375 /end CHARACTERISTIC
/begin CHARACTERISTIC K_SMG_N_ZIEL_HYS "Maximum speed difference [verified]" VALUE 0x7C352 RL_VAL_SW 0 CM_0002 -32768 32767 /end CHARACTERISTIC
/begin CHARACTERISTIC K_SMG_N_ZIEL_OFF_BEGR "Offset on rev limiter [verified]" VALUE 0x7C354 RL_VAL_UB 0 CM_0002 0 255 /end CHARACTERISTIC
/begin CHARACTERISTIC K_SMG_N_ZIEL_OFF_SCH "Offset to drag-control target speed in overrun [verified]" VALUE 0x7C350 RL_VAL_SW 0 CM_0002 -32768 32767 /end CHARACTERISTIC
/begin CHARACTERISTIC K_SMG_N_ZIEL_OFF_ZH "Offset to drag-control target speed on traction upshift [verified]" VALUE 0x7C34E RL_VAL_SW 0 CM_0002 -32768 32767 /end CHARACTERISTIC
/begin CHARACTERISTIC K_SMG_OHNE_EINGR_OFF "Offset on sa_n_we [verified]" VALUE 0x7C3D8 RL_VAL_SW 0 CM_0002 -32768 32767 /end CHARACTERISTIC
/begin CHARACTERISTIC K_SMG_PROG_EINFAHR_WEG "Mileage for running-in limitation [verified]" VALUE 0x7C2F8 RL_VAL_UW 0 CM_0082 0 65535 /end CHARACTERISTIC
/begin CHARACTERISTIC K_SMG_PROG_FETRAWE_WEG "Permitted mileage for SMG limitation in factory/transport mode [verified]" VALUE 0x7C2F6 RL_VAL_UW 0 CM_0082 0 65535 /end CHARACTERISTIC
/begin CHARACTERISTIC K_SMG_PROG_MAX_ANH "Maximum program with trailer [verified]" VALUE 0x7C2F2 RL_VAL_UB 0 CM_0100 0 255 /end CHARACTERISTIC
/begin CHARACTERISTIC K_SMG_PROG_MAX_EINFAHR "Maximum program during running-in [verified]" VALUE 0x7C2F4 RL_VAL_UB 0 CM_0100 0 255 /end CHARACTERISTIC
/begin CHARACTERISTIC K_SMG_PROG_MAX_FETRAWE "Maximum program in factory/transport/workshop mode [verified]" VALUE 0x7C2F3 RL_VAL_UB 0 CM_0100 0 255 /end CHARACTERISTIC
/begin CHARACTERISTIC K_SMG_PROG_MIN_ANH "Minimum program with trailer [verified]" VALUE 0x7C2F1 RL_VAL_UB 0 CM_0100 0 255 /end CHARACTERISTIC
/begin CHARACTERISTIC K_SMG_PROG_MIN_ZR "Minimum program for traction downshift [verified]" VALUE 0x7C2F0 RL_VAL_UB 0 CM_0100 0 255 /end CHARACTERISTIC
/begin CHARACTERISTIC K_SMG_PWG_FW_SCH "Pedal-based overrun detection [verified]" VALUE 0x7C326 RL_VAL_SW 0 CM_0013 -3276.8 3276.7 /end CHARACTERISTIC
/begin CHARACTERISTIC K_SMG_PWG_FW_SCH_N_OFF "Idle offset for pedal-based overrun detection [verified]" VALUE 0x7C328 RL_VAL_SW 0 CM_0002 -32768 32767 /end CHARACTERISTIC
/begin CHARACTERISTIC K_SMG_R_DYN "Tyre radius [verified]" VALUE 0x7C3EE RL_VAL_UB 0 CM_0101 0 255 /end CHARACTERISTIC
/begin CHARACTERISTIC K_SMG_TAU_NGETR_ZIEL "Filter, gearbox target speed [verified]" VALUE 0x7CD10 RL_VAL_UB 0 CM_0027 0 255 /end CHARACTERISTIC
/begin CHARACTERISTIC K_SMG_TZ_EINGR_T_AB "Threshold for ramp-down with ignition intervention [verified]" VALUE 0x7C34C RL_VAL_UB 0 CM_0025 0 2.55 /end CHARACTERISTIC
/begin CHARACTERISTIC K_SMG_T_ABREGEL_AKS "Step to zero torque [verified]" VALUE 0x7C318 RL_VAL_UB 0 CM_0025 0 2.55 /end CHARACTERISTIC
/begin CHARACTERISTIC K_SMG_T_KORR_AB_FW "Shorten due to driver action [verified]" VALUE 0x7C31A RL_VAL_UW 0 CM_0017 0 6553.5 /end CHARACTERISTIC
/begin CHARACTERISTIC K_SMG_T_KORR_AB_MIN "Time shortening [verified]" VALUE 0x7C319 RL_VAL_UB 0 CM_0025 0 2.55 /end CHARACTERISTIC
/begin CHARACTERISTIC K_SMG_V_KRAFTS_ERSATZ "Speed threshold for drivetrain-engagement substitute value [verified]" VALUE 0x7CD0C RL_VAL_UB 0 CM_0010 0 15.9375 /end CHARACTERISTIC
/begin CHARACTERISTIC KF_TAN_MODELL_MR_TUMG_KAL "Engine-bay temperature calibration against ambient temperature [verified]" MAP 0x7D3FE RL_MAP_SW_SW_SW 0 CM_0040 -3276.8 3276.7 /begin AXIS_DESCR STD_AXIS NO_INPUT_QUANTITY CM_0006 6 -3550 3003.5 /end AXIS_DESCR /begin AXIS_DESCR STD_AXIS NO_INPUT_QUANTITY CM_0010 6 -2048 2047.9375 /end AXIS_DESCR /end CHARACTERISTIC
/begin CHARACTERISTIC KF_TAN_MODELL_V_RATIO "Map: engine-bay weighting [verified]" MAP 0x7D460 RL_MAP_SW_UW_UW 0 CM_0019 0 3.999941832 /begin AXIS_DESCR STD_AXIS NO_INPUT_QUANTITY CM_0010 6 -2048 2047.9375 /end AXIS_DESCR /begin AXIS_DESCR STD_AXIS NO_INPUT_QUANTITY CM_0023 4 0 6553.5 /end AXIS_DESCR /end CHARACTERISTIC
/begin CHARACTERISTIC KL_N_LW_TAN_LW_VERH_WURZEL "Square-root ratio of intake gas-exchange temperatures [verified]" CURVE 0x7AB10 RL_CUR_SW_UW 0 CM_0016 0 63.99902344 /begin AXIS_DESCR STD_AXIS NO_INPUT_QUANTITY CM_0006 7 -3550 3003.5 /end AXIS_DESCR /end CHARACTERISTIC
/begin CHARACTERISTIC KL_TAN_MODELL_ABREG "Curve: temperature ramp-down over time [verified]" CURVE 0x7D3B0 RL_CUR_UW_UW 0 CM_0019 0 3.999941832 /begin AXIS_DESCR STD_AXIS NO_INPUT_QUANTITY CM_0060 6 0 1092.250002 /end AXIS_DESCR /end CHARACTERISTIC
/begin CHARACTERISTIC KL_TAN_MODELL_ML_RATIO "Curve: intake air mass to time constant [verified]" CURVE 0x7D396 RL_CUR_SW_UW 0 CM_0019 0 3.999941832 /begin AXIS_DESCR STD_AXIS NO_INPUT_QUANTITY CM_0102 6 -3276.8 3276.7 /end AXIS_DESCR /end CHARACTERISTIC
/begin CHARACTERISTIC KL_TAN_MODELL_MR_ABREG "Curve: temperature ramp-down over time [verified]" CURVE 0x7D3CA RL_CUR_UW_UW 0 CM_0019 0 3.999941832 /begin AXIS_DESCR STD_AXIS NO_INPUT_QUANTITY CM_0060 6 0 1092.250002 /end AXIS_DESCR /end CHARACTERISTIC
/begin CHARACTERISTIC KL_TAN_MODELL_MR_TUMG_KAL "Engine-bay temperature calibration against ambient temperature [verified]" CURVE 0x7D3E4 RL_CUR_SW_SW 0 CM_0024 -3276.8 3276.7 /begin AXIS_DESCR STD_AXIS NO_INPUT_QUANTITY CM_0106 6 -32768 32767 /end AXIS_DESCR /end CHARACTERISTIC
/begin CHARACTERISTIC KL_TAN_NTC "Intake air temperature curve [verified]" CURVE 0x7D364 RL_CUR_SW_SW 0 CM_0107 -1092.35 546.025 /begin AXIS_DESCR STD_AXIS NO_INPUT_QUANTITY CM_0087 12 -32768 32767 /end AXIS_DESCR /end CHARACTERISTIC
/begin CHARACTERISTIC K_N_LW_A_NOFFS_MAX "Maximum limit, exhaust gas-exchange speed offset [Upm] [verified]" VALUE 0x7AAEC RL_VAL_SW 0 CM_0002 -32768 32767 /end CHARACTERISTIC
/begin CHARACTERISTIC K_N_LW_A_NOFFS_MIN "Minimum limit, exhaust gas-exchange speed offset [Upm] [verified]" VALUE 0x7AAEE RL_VAL_SW 0 CM_0002 -32768 32767 /end CHARACTERISTIC
/begin CHARACTERISTIC K_N_LW_CFG "Auswahlt Quelle Einlasstemperatur. [verified]" VALUE 0x7AAE6 RL_VAL_UB 0 CM_0000 0 255 /end CHARACTERISTIC
/begin CHARACTERISTIC K_N_LW_E_NOFFS_MAX "Maximum limit, intake gas-exchange speed offset [Upm] [verified]" VALUE 0x7AAE8 RL_VAL_SW 0 CM_0002 -32768 32767 /end CHARACTERISTIC
/begin CHARACTERISTIC K_N_LW_E_NOFFS_MIN "Minimum limit, intake gas-exchange speed offset [Upm] [verified]" VALUE 0x7AAEA RL_VAL_SW 0 CM_0002 -32768 32767 /end CHARACTERISTIC
/begin CHARACTERISTIC K_N_LW_NOFFS_MAX "Maximum limit, gas-exchange speed offset [Upm] [verified]" VALUE 0x7AAF0 RL_VAL_SW 0 CM_0002 -32768 32767 /end CHARACTERISTIC
/begin CHARACTERISTIC K_N_LW_NOFFS_MIN "Minimum limit, gas-exchange speed offset [Upm] [verified]" VALUE 0x7AAF2 RL_VAL_SW 0 CM_0002 -32768 32767 /end CHARACTERISTIC
/begin CHARACTERISTIC KL_TDME_NTC "ECU temperature curve [verified]" CURVE 0x7D4AE RL_CUR_SW_SW 0 CM_0107 -1092.35 546.025 /begin AXIS_DESCR STD_AXIS NO_INPUT_QUANTITY CM_0087 8 -32768 32767 /end AXIS_DESCR /end CHARACTERISTIC
/begin CHARACTERISTIC K_TDME_SCHWELLE_ZAEHLER "Threshold for long-term monitoring [verified]" VALUE 0x7D4AA RL_VAL_SW 0 CM_0006 -3550 3003.5 /end CHARACTERISTIC
/begin CHARACTERISTIC K_TDME_TAU "Filter constant for ECU temperature [verified]" VALUE 0x7D4AC RL_VAL_UB 0 CM_0027 0 255 /end CHARACTERISTIC
/begin CHARACTERISTIC KF_TMOT_MODELL_ML_WICHT "Air-mass weighting [verified]" MAP 0x7D782 RL_MAP_SW_SW_SW 0 CM_0102 -3276.8 3276.7 /begin AXIS_DESCR STD_AXIS NO_INPUT_QUANTITY CM_0006 7 -3550 3003.5 /end AXIS_DESCR /begin AXIS_DESCR STD_AXIS NO_INPUT_QUANTITY CM_0102 7 -3276.8 3276.7 /end AXIS_DESCR /end CHARACTERISTIC
/begin CHARACTERISTIC KL_TMOT_CC_HIGH_TMOT_1 "Threshold for yellow check-control message [verified]" CURVE 0x7D654 RL_CUR_UW_SW 0 CM_0006 -3550 3003.5 /begin AXIS_DESCR STD_AXIS NO_INPUT_QUANTITY CM_0025 4 0 655.35 /end AXIS_DESCR /end CHARACTERISTIC
/begin CHARACTERISTIC KL_TMOT_NTC "Engine temperature curve [verified]" CURVE 0x7D5D4 RL_CUR_SW_SW 0 CM_0107 -1092.35 546.025 /begin AXIS_DESCR STD_AXIS NO_INPUT_QUANTITY CM_0087 10 -32768 32767 /end AXIS_DESCR /end CHARACTERISTIC
/begin CHARACTERISTIC K_TMOT_CC_HIGH_HYS "Hysteresis for check-control messages [verified]" VALUE 0x7D5CA RL_VAL_UB 0 CM_0024 0 25.5 /end CHARACTERISTIC
/begin CHARACTERISTIC K_TMOT_CC_HIGH_TMOT_2 "Red check-control message over coolant temperature [verified]" VALUE 0x7D5C4 RL_VAL_SW 0 CM_0006 -3550 3003.5 /end CHARACTERISTIC
/begin CHARACTERISTIC K_TMOT_CC_HIGH_TOEL_1 "Yellow check-control message over oil temperature [verified]" VALUE 0x7D5C6 RL_VAL_SW 0 CM_0006 -3550 3003.5 /end CHARACTERISTIC
/begin CHARACTERISTIC K_TMOT_CC_HIGH_TOEL_2 "Red check-control message over oil temperature [verified]" VALUE 0x7D5C8 RL_VAL_SW 0 CM_0006 -3550 3003.5 /end CHARACTERISTIC
/begin CHARACTERISTIC K_TMOT_CC_HIGH_ZWS_OFF "Offset for forced (gear) shift [verified]" VALUE 0x7D5CB RL_VAL_UB 0 CM_0024 0 25.5 /end CHARACTERISTIC
/begin CHARACTERISTIC K_TMOT_CFG_TOEL "Check-control oil-temperature configuration [verified]" VALUE 0x7D5C0 RL_VAL_UB 0 CM_0000 0 255 /end CHARACTERISTIC
/begin CHARACTERISTIC KF_TOEL_V_TAN_MW "Oil cooling offset [verified]" MAP 0x7D8CE RL_MAP_SW_SW_SW 0 CM_0024 -3276.8 3276.7 /begin AXIS_DESCR STD_AXIS NO_INPUT_QUANTITY CM_0010 7 -2048 2047.9375 /end AXIS_DESCR /begin AXIS_DESCR STD_AXIS NO_INPUT_QUANTITY CM_0006 7 -3550 3003.5 /end AXIS_DESCR /end CHARACTERISTIC
/begin CHARACTERISTIC KL_TOEL_DN "Filtered engine-speed influence, engine friction [verified]" CURVE 0x7D8B4 RL_CUR_SW_SW 0 CM_0109 -3.2768 3.2767 /begin AXIS_DESCR STD_AXIS NO_INPUT_QUANTITY CM_0002 6 -32768 32767 /end AXIS_DESCR /end CHARACTERISTIC
/begin CHARACTERISTIC KL_TOEL_N "Engine-speed influence, engine friction [verified]" CURVE 0x7D89A RL_CUR_SW_SW 0 CM_0109 -3.2768 3.2767 /begin AXIS_DESCR STD_AXIS NO_INPUT_QUANTITY CM_0002 6 -32768 32767 /end AXIS_DESCR /end CHARACTERISTIC
/begin CHARACTERISTIC KL_TOEL_WICHT "Oil-sump temperature influence [verified]" CURVE 0x7D890 RL_CUR_SW_SW 0 CM_0110 -327.68 327.67 /begin AXIS_DESCR STD_AXIS NO_INPUT_QUANTITY CM_0006 2 -3550 3003.5 /end AXIS_DESCR /end CHARACTERISTIC
/begin CHARACTERISTIC K_TOEL_AEBEGR "Rate limit for oil temperature [verified]" VALUE 0x7D884 RL_VAL_SW 0 CM_0024 -3276.8 3276.7 /end CHARACTERISTIC
/begin CHARACTERISTIC K_TOEL_BEGR_OFFS "Temperature window limitation [verified]" VALUE 0x7D886 RL_VAL_SW 0 CM_0024 -3276.8 3276.7 /end CHARACTERISTIC
/begin CHARACTERISTIC K_TOEL_KOMBI_WSTATE "Wait time for valid time from instrument cluster [s] [verified]" VALUE 0x7D888 RL_VAL_UW 0 CM_0025 0 655.35 /end CHARACTERISTIC
/begin CHARACTERISTIC K_TOEL_N_T1 "PT1 filter time constant for toel_n_filt [verified]" VALUE 0x7D882 RL_VAL_UB 0 CM_0000 0 255 /end CHARACTERISTIC
/begin CHARACTERISTIC K_TOEL_TMOT_GRD_F "Oil-temperature gradient vs coolant temperature [verified]" VALUE 0x7D88E RL_VAL_SW 0 CM_0039 -327.68 327.67 /end CHARACTERISTIC
/begin CHARACTERISTIC K_TOEL_T_MS "Engine-stopped threshold [min] [verified]" VALUE 0x7D88A RL_VAL_UW 0 CM_0108 0 65535 /end CHARACTERISTIC
/begin CHARACTERISTIC K_TOEL_WANNE_GRD_F "Oil-temperature gradient vs sump temperature [verified]" VALUE 0x7D88C RL_VAL_SW 0 CM_0039 -327.68 327.67 /end CHARACTERISTIC
/begin CHARACTERISTIC K_TPU_IGN_MIN_SCI_POS "Initial minimum angle distance before ignition angle [verified]" VALUE 0x7DB88 RL_VAL_SW 0 CM_0061 -359.9999992 359.9890129 /end CHARACTERISTIC
/begin CHARACTERISTIC K_TPU_IGN_MISS_FIRE_TIME "Initial dwell time for output of misfires [verified]" VALUE 0x7DB86 RL_VAL_UB 0 CM_0112 0 291.4285714 /end CHARACTERISTIC
/begin CHARACTERISTIC K_TPU_KW_N_MIN__IGN_ "Under-speed [verified]" VALUE 0x7DB8A RL_VAL_UW 0 CM_0002 0 65535 /end CHARACTERISTIC
/begin CHARACTERISTIC K_TPU_KW_SYNC_ZAHN__IGN_ "Crankshaft interrupt tooth for camshaft sync [verified]" VALUE 0x7DB8C RL_VAL_UB 0 CM_0000 0 255 /end CHARACTERISTIC
/begin CHARACTERISTIC KL_TSGRW_F "Ratio factor [verified]" CURVE 0x7DBAA RL_CUR_SW_UW 0 CM_0051 0 1.999970916 /begin AXIS_DESCR STD_AXIS NO_INPUT_QUANTITY CM_0006 4 -3550 3003.5 /end AXIS_DESCR /end CHARACTERISTIC
/begin CHARACTERISTIC KL_TSGRW_OFFS "Offset curve [verified]" CURVE 0x7DB94 RL_CUR_SW_SW 0 CM_0113 -819.2 819.175 /begin AXIS_DESCR STD_AXIS NO_INPUT_QUANTITY CM_0003 5 -3.2768 3.2767 /end AXIS_DESCR /end CHARACTERISTIC
/begin CHARACTERISTIC K_TSGRW_CFG "Switch selecting intake-manifold wall temperature source [verified]" VALUE 0x7DB90 RL_VAL_UB 0 CM_0000 0 255 /end CHARACTERISTIC
/begin CHARACTERISTIC K_TSGRW_TAU "Filter constant for intake-manifold wall temperature [verified]" VALUE 0x7DB91 RL_VAL_UB 0 CM_0027 0 255 /end CHARACTERISTIC
/begin CHARACTERISTIC K_TSGRW_TAU_MS "Filter constant for intake-manifold wall temperature with engine stopped [verified]" VALUE 0x7DB92 RL_VAL_UB 0 CM_0027 0 255 /end CHARACTERISTIC
/begin CHARACTERISTIC K_TSGRW_TU "Tuning of intake-manifold wall temperature [verified]" VALUE 0x7DB8E RL_VAL_SW 0 CM_0114 -1092.4 545.975 /end CHARACTERISTIC
/begin CHARACTERISTIC K_DSP_MESSEN "Switch enabling DSP measurement: 0 = off, 1 = active [verified]" VALUE 0x7EE6A RL_VAL_UB 0 CM_0000 0 255 /end CHARACTERISTIC
/begin CHARACTERISTIC K_V_DIREKT_FAK "Conversion factor [verified]" VALUE 0x7E4D4 RL_VAL_UL 0 CM_0000 0 4294967295 /end CHARACTERISTIC
/begin CHARACTERISTIC K_V_DIREKT_TAU "Time constant, speed sensing [verified]" VALUE 0x7E4D0 RL_VAL_UB 0 CM_0027 0 255 /end CHARACTERISTIC
/begin CHARACTERISTIC K_UB_ERSATZ "Substitute value, battery voltage [verified]" VALUE 0x7E4AE RL_VAL_SW 0 CM_0116 -51.08269056 51.08113164 /end CHARACTERISTIC
/begin CHARACTERISTIC K_UB_GRAD_INT_REDUKTION "Integral reduction per pass [verified]" VALUE 0x7E4B4 RL_VAL_SW 0 CM_0117 -51.08269056 51.08113164 /end CHARACTERISTIC
/begin CHARACTERISTIC K_UB_GRAD_MAX "End stop of the integral [verified]" VALUE 0x7E4B0 RL_VAL_SW 0 CM_0116 -51.08269056 51.08113164 /end CHARACTERISTIC
/begin CHARACTERISTIC K_UB_ML_MIN "Lower limit, battery voltage with engine running [verified]" VALUE 0x7E4AC RL_VAL_SW 0 CM_0116 -51.08269056 51.08113164 /end CHARACTERISTIC
/begin CHARACTERISTIC K_UB_START_TIME "Plausibility response time [verified]" VALUE 0x7E4B6 RL_VAL_UB 0 CM_0027 0 255 /end CHARACTERISTIC
/begin CHARACTERISTIC K_UB_TAU "Filter constant, battery-voltage sensing [verified]" VALUE 0x7E4A6 RL_VAL_UB 0 CM_0027 0 255 /end CHARACTERISTIC
/begin CHARACTERISTIC K_UB_TAU_START "Filter constant, battery-voltage sensing during start [verified]" VALUE 0x7E4A7 RL_VAL_UB 0 CM_0027 0 255 /end CHARACTERISTIC
/begin CHARACTERISTIC K_UEXT_ERSATZ "Substitute value, supply voltage [verified]" VALUE 0x7E4BE RL_VAL_UW 0 CM_0118 0 426.6601584 /end CHARACTERISTIC
/begin CHARACTERISTIC K_UEXT_TAU "Filter constant, supply voltage [verified]" VALUE 0x7E4B8 RL_VAL_UB 0 CM_0027 0 255 /end CHARACTERISTIC
/begin CHARACTERISTIC K_UINTERN_AD_1_8_MAX "Maximum A/D value, internal supply voltage [verified]" VALUE 0x7E4C0 RL_VAL_SW 0 CM_0087 -32768 32767 /end CHARACTERISTIC
/begin CHARACTERISTIC K_UINTERN_AD_1_8_MIN "Minimum A/D value, internal supply voltage [verified]" VALUE 0x7E4C2 RL_VAL_SW 0 CM_0087 -32768 32767 /end CHARACTERISTIC
/begin CHARACTERISTIC K_UINTERN_AD_2_55_MAX "Maximum A/D value, internal supply voltage [verified]" VALUE 0x7E4C4 RL_VAL_SW 0 CM_0087 -32768 32767 /end CHARACTERISTIC
/begin CHARACTERISTIC K_UINTERN_AD_2_55_MIN "Minimum A/D value, internal supply voltage [verified]" VALUE 0x7E4C6 RL_VAL_SW 0 CM_0087 -32768 32767 /end CHARACTERISTIC
/begin CHARACTERISTIC K_UINTERN_AD_3_3_MAX "Maximum A/D value, internal supply voltage [verified]" VALUE 0x7E4C8 RL_VAL_SW 0 CM_0087 -32768 32767 /end CHARACTERISTIC
/begin CHARACTERISTIC K_UINTERN_AD_3_3_MIN "Minimum A/D value, internal supply voltage [verified]" VALUE 0x7E4CA RL_VAL_SW 0 CM_0087 -32768 32767 /end CHARACTERISTIC
/begin CHARACTERISTIC KL_TOEL_MODELL_AUFHEIZ_OFFS "Time for dwell-time offset during start [verified]" CURVE 0x7D978 RL_CUR_SW_UW 0 CM_0025 0 655.35 /begin AXIS_DESCR STD_AXIS NO_INPUT_QUANTITY CM_0006 6 -3550 3003.5 /end AXIS_DESCR /end CHARACTERISTIC
/begin CHARACTERISTIC KF_KH_MD_ETA_F_LLMKS "Cat-heating efficiency factor map [EST]" MAP 0x74272 RL_MAP_SW_SW_UW 0 CM_0016 0 63.99902344 /begin AXIS_DESCR STD_AXIS NO_INPUT_QUANTITY CM_0006 8 -3550 3003.5 /end AXIS_DESCR /begin AXIS_DESCR STD_AXIS NO_INPUT_QUANTITY CM_0270 8 -163.84 163.835 /end AXIS_DESCR /end CHARACTERISTIC
/begin CHARACTERISTIC KF_KH_MD_ETA_F_LLMKS_SL "Cat-heating efficiency factor map [EST]" MAP 0x74314 RL_MAP_SW_SW_UW 0 CM_0016 0 63.99902344 /begin AXIS_DESCR STD_AXIS NO_INPUT_QUANTITY CM_0006 8 -3550 3003.5 /end AXIS_DESCR /begin AXIS_DESCR STD_AXIS NO_INPUT_QUANTITY CM_0270 8 -163.84 163.835 /end AXIS_DESCR /end CHARACTERISTIC
/begin CHARACTERISTIC KF_KH_MD_ETA_F_LLOKS "Cat-heating efficiency factor map [EST]" MAP 0x743B6 RL_MAP_SW_SW_UW 0 CM_0016 0 63.99902344 /begin AXIS_DESCR STD_AXIS NO_INPUT_QUANTITY CM_0006 8 -3550 3003.5 /end AXIS_DESCR /begin AXIS_DESCR STD_AXIS NO_INPUT_QUANTITY CM_0270 8 -163.84 163.835 /end AXIS_DESCR /end CHARACTERISTIC
/begin CHARACTERISTIC KF_KH_MD_ETA_F_LLOKS_SL "Cat-heating efficiency factor map [EST]" MAP 0x74458 RL_MAP_SW_SW_UW 0 CM_0016 0 63.99902344 /begin AXIS_DESCR STD_AXIS NO_INPUT_QUANTITY CM_0006 8 -3550 3003.5 /end AXIS_DESCR /begin AXIS_DESCR STD_AXIS NO_INPUT_QUANTITY CM_0270 8 -163.84 163.835 /end AXIS_DESCR /end CHARACTERISTIC
/begin CHARACTERISTIC KF_KH_MD_ETA_F_SB "Cat-heating efficiency factor map [EST]" MAP 0x744FA RL_MAP_SW_SW_UW 0 CM_0016 0 63.99902344 /begin AXIS_DESCR STD_AXIS NO_INPUT_QUANTITY CM_0006 8 -3550 3003.5 /end AXIS_DESCR /begin AXIS_DESCR STD_AXIS NO_INPUT_QUANTITY CM_0270 8 -163.84 163.835 /end AXIS_DESCR /end CHARACTERISTIC
/begin CHARACTERISTIC KF_KH_MD_ETA_F_SB_SL "Cat-heating efficiency factor map [EST]" MAP 0x7459C RL_MAP_SW_SW_UW 0 CM_0016 0 63.99902344 /begin AXIS_DESCR STD_AXIS NO_INPUT_QUANTITY CM_0006 8 -3550 3003.5 /end AXIS_DESCR /begin AXIS_DESCR STD_AXIS NO_INPUT_QUANTITY CM_0270 8 -163.84 163.835 /end AXIS_DESCR /end CHARACTERISTIC
/begin CHARACTERISTIC KF_KH_MD_ETA_F_TL "Cat-heating efficiency factor map [EST]" MAP 0x7463E RL_MAP_SW_SW_UW 0 CM_0016 0 63.99902344 /begin AXIS_DESCR STD_AXIS NO_INPUT_QUANTITY CM_0006 8 -3550 3003.5 /end AXIS_DESCR /begin AXIS_DESCR STD_AXIS NO_INPUT_QUANTITY CM_0270 8 -163.84 163.835 /end AXIS_DESCR /end CHARACTERISTIC
/begin CHARACTERISTIC KF_KH_MD_ETA_F_TL_SL "Cat-heating efficiency factor map [EST]" MAP 0x746E0 RL_MAP_SW_SW_UW 0 CM_0016 0 63.99902344 /begin AXIS_DESCR STD_AXIS NO_INPUT_QUANTITY CM_0006 8 -3550 3003.5 /end AXIS_DESCR /begin AXIS_DESCR STD_AXIS NO_INPUT_QUANTITY CM_0270 8 -163.84 163.835 /end AXIS_DESCR /end CHARACTERISTIC
/begin CHARACTERISTIC KF_KH_MD_ETA_F_TL_SL_DKG "Cat-heating efficiency factor map [EST]" MAP 0x74782 RL_MAP_SW_SW_UW 0 CM_0016 0 63.99902344 /begin AXIS_DESCR STD_AXIS NO_INPUT_QUANTITY CM_0006 8 -3550 3003.5 /end AXIS_DESCR /begin AXIS_DESCR STD_AXIS NO_INPUT_QUANTITY CM_0270 8 -163.84 163.835 /end AXIS_DESCR /end CHARACTERISTIC
/begin CHARACTERISTIC KF_KH_MD_ETA_GRUND_DYN "Cat-heating base efficiency map (10x10) [EST]" MAP 0x74824 RL_MAP_SW_SW_UW 0 CM_0271 0 199.9969482 /begin AXIS_DESCR STD_AXIS NO_INPUT_QUANTITY CM_0235 10 -32768 32767 /end AXIS_DESCR /begin AXIS_DESCR STD_AXIS NO_INPUT_QUANTITY CM_0017 10 -3276.8 3276.7 /end AXIS_DESCR /end CHARACTERISTIC
/begin CHARACTERISTIC KF_KH_MD_ETA_GRUND_SL_DYN "Cat-heating base efficiency map (10x10) [EST]" MAP 0x74916 RL_MAP_SW_SW_UW 0 CM_0271 0 199.9969482 /begin AXIS_DESCR STD_AXIS NO_INPUT_QUANTITY CM_0235 10 -32768 32767 /end AXIS_DESCR /begin AXIS_DESCR STD_AXIS NO_INPUT_QUANTITY CM_0017 10 -3276.8 3276.7 /end AXIS_DESCR /end CHARACTERISTIC
/begin CHARACTERISTIC KF_KH_MD_ETA_GRUND_SL_STAT "Cat-heating base efficiency map (10x10) [EST]" MAP 0x74A08 RL_MAP_SW_SW_UW 0 CM_0271 0 199.9969482 /begin AXIS_DESCR STD_AXIS NO_INPUT_QUANTITY CM_0235 10 -32768 32767 /end AXIS_DESCR /begin AXIS_DESCR STD_AXIS NO_INPUT_QUANTITY CM_0017 10 -3276.8 3276.7 /end AXIS_DESCR /end CHARACTERISTIC
/begin CHARACTERISTIC KF_KH_MD_ETA_GRUND_STAT "Cat-heating base efficiency map (10x10) [EST]" MAP 0x74AFA RL_MAP_SW_SW_UW 0 CM_0271 0 199.9969482 /begin AXIS_DESCR STD_AXIS NO_INPUT_QUANTITY CM_0235 10 -32768 32767 /end AXIS_DESCR /begin AXIS_DESCR STD_AXIS NO_INPUT_QUANTITY CM_0017 10 -3276.8 3276.7 /end AXIS_DESCR /end CHARACTERISTIC
/begin CHARACTERISTIC KF_KH_MD_ETA_GRUND_LL "Cat-heating base efficiency map, idle (4x4) [EST]" MAP 0x74BEC RL_MAP_SW_SW_UW 0 CM_0271 0 199.9969482 /begin AXIS_DESCR STD_AXIS NO_INPUT_QUANTITY CM_0235 4 -32768 32767 /end AXIS_DESCR /begin AXIS_DESCR STD_AXIS NO_INPUT_QUANTITY CM_0017 4 -3276.8 3276.7 /end AXIS_DESCR /end CHARACTERISTIC
/begin CHARACTERISTIC KF_KH_MD_ETA_GRUND_LL_DKG "Cat-heating base efficiency map, idle (4x4) [EST]" MAP 0x74C1E RL_MAP_SW_SW_UW 0 CM_0271 0 199.9969482 /begin AXIS_DESCR STD_AXIS NO_INPUT_QUANTITY CM_0235 4 -32768 32767 /end AXIS_DESCR /begin AXIS_DESCR STD_AXIS NO_INPUT_QUANTITY CM_0017 4 -3276.8 3276.7 /end AXIS_DESCR /end CHARACTERISTIC
/begin CHARACTERISTIC KF_KH_MD_ETA_GRUND_LL_KH3 "Cat-heating base efficiency map, idle (4x4) [EST]" MAP 0x74C50 RL_MAP_SW_SW_UW 0 CM_0271 0 199.9969482 /begin AXIS_DESCR STD_AXIS NO_INPUT_QUANTITY CM_0235 4 -32768 32767 /end AXIS_DESCR /begin AXIS_DESCR STD_AXIS NO_INPUT_QUANTITY CM_0017 4 -3276.8 3276.7 /end AXIS_DESCR /end CHARACTERISTIC
/begin CHARACTERISTIC KF_KH_MD_ETA_GRUND_LL_SL "Cat-heating base efficiency map, idle (4x4) [EST]" MAP 0x74C82 RL_MAP_SW_SW_UW 0 CM_0271 0 199.9969482 /begin AXIS_DESCR STD_AXIS NO_INPUT_QUANTITY CM_0235 4 -32768 32767 /end AXIS_DESCR /begin AXIS_DESCR STD_AXIS NO_INPUT_QUANTITY CM_0017 4 -3276.8 3276.7 /end AXIS_DESCR /end CHARACTERISTIC
/begin CHARACTERISTIC KF_KH_MD_ETA_GRUND_LL_SL_DKG "Cat-heating base efficiency map, idle (4x4) [EST]" MAP 0x74CB4 RL_MAP_SW_SW_UW 0 CM_0271 0 199.9969482 /begin AXIS_DESCR STD_AXIS NO_INPUT_QUANTITY CM_0235 4 -32768 32767 /end AXIS_DESCR /begin AXIS_DESCR STD_AXIS NO_INPUT_QUANTITY CM_0017 4 -3276.8 3276.7 /end AXIS_DESCR /end CHARACTERISTIC
/begin CHARACTERISTIC KF_KH_MD_ETA_GRAD_INAKTIV "Efficiency rate limit when cat heating inactive [%/5ms, x*100/32768] [verified]" MAP 0x74CE6 RL_MAP_SW_SW_UW 0 CM_0000 0 65535 /begin AXIS_DESCR STD_AXIS NO_INPUT_QUANTITY CM_0235 6 -32768 32767 /end AXIS_DESCR /begin AXIS_DESCR STD_AXIS NO_INPUT_QUANTITY CM_0017 6 -3276.8 3276.7 /end AXIS_DESCR /end CHARACTERISTIC
/begin CHARACTERISTIC KL_KH_MD_ETA_F_PUMG_KH3 "Ambient-pressure correction factor, KH3 [verified]" CURVE 0x741FC RL_CUR_SW_UW 0 CM_0016 0 63.99902344 /begin AXIS_DESCR STD_AXIS NO_INPUT_QUANTITY CM_0022 5 -2048 2047.9375 /end AXIS_DESCR /end CHARACTERISTIC
/begin CHARACTERISTIC KL_KH_TKAT_HYST_MSA "MSA hysteresis for cat-temperature end of KH vs standing time [verified]" CURVE 0x74242 RL_CUR_UW_SW 0 CM_0272 -3276.8 3276.7 /begin AXIS_DESCR STD_AXIS NO_INPUT_QUANTITY CM_0233 5 0 1092.25 /end AXIS_DESCR /end CHARACTERISTIC
/begin CHARACTERISTIC KL_KH_ALT_OFFSET_KM "Mileage-dependent cat-aging offset [EST]" CURVE 0x7415A RL_CUR_UW_SW 0 CM_0272 -3276.8 3276.7 /begin AXIS_DESCR STD_AXIS NO_INPUT_QUANTITY CM_0238 4 0 131070 /end AXIS_DESCR /end CHARACTERISTIC
/begin CHARACTERISTIC KL_KH_ALT_OFFSET_KM_DKG "Mileage-dependent cat-aging offset [EST]" CURVE 0x7416C RL_CUR_UW_SW 0 CM_0272 -3276.8 3276.7 /begin AXIS_DESCR STD_AXIS NO_INPUT_QUANTITY CM_0238 4 0 131070 /end AXIS_DESCR /end CHARACTERISTIC
/begin CHARACTERISTIC KL_KH_ALT_OFFSET_KM_MSA "Mileage-dependent cat-aging offset [EST]" CURVE 0x7417E RL_CUR_UW_SW 0 CM_0272 -3276.8 3276.7 /begin AXIS_DESCR STD_AXIS NO_INPUT_QUANTITY CM_0238 4 0 131070 /end AXIS_DESCR /end CHARACTERISTIC
/begin CHARACTERISTIC K_KH_TKAT_ENDE "Temperaturschwelle fuer Katheizende [EST]" VALUE 0x74084 RL_VAL_SW 0 CM_0258 -3550 3003.5 /end CHARACTERISTIC
/begin CHARACTERISTIC K_KH_TKAT_HYST "Temperaturschwelle fuer Katheizende [EST]" VALUE 0x74086 RL_VAL_SW 0 CM_0272 -3276.8 3276.7 /end CHARACTERISTIC
/begin CHARACTERISTIC K_KH_TKAT_CFG "0x1 vkat 0x2 nkat 0x8 kat ELSE ungueltig Konfigbyte zur Kat.Temperaturwahl fuer die Alterung [EST]" VALUE 0x74097 RL_VAL_UB 0 CM_0000 0 255 /end CHARACTERISTIC
/begin CHARACTERISTIC K_KH_RF_MAX "Lastschwelle fuer Katheizen aus [verified]" VALUE 0x7409A RL_VAL_SW 0 CM_0003 -3.2768 3.2767 /end CHARACTERISTIC
/begin CHARACTERISTIC K_KH_RF_MAX_HYS "Lasthysterese fuer Katheizen aus [EST]" VALUE 0x7409C RL_VAL_SW 0 CM_0003 -3.2768 3.2767 /end CHARACTERISTIC
/begin CHARACTERISTIC K_KH_N_MAX "Drehzahlschwelle fuer Katheizen aus [EST]" VALUE 0x740A0 RL_VAL_SW 0 CM_0235 -32768 32767 /end CHARACTERISTIC
/begin CHARACTERISTIC K_KH_N_MAX_HYS "Drehzahlhysterese fuer Katheizen aus [EST]" VALUE 0x7409E RL_VAL_SW 0 CM_0235 -32768 32767 /end CHARACTERISTIC
/begin CHARACTERISTIC K_KH_SMG_TMOT_MIN "min. Temperaturschwelle fuer SMG-KH [EST]" VALUE 0x740AA RL_VAL_SW 0 CM_0258 -3550 3003.5 /end CHARACTERISTIC
/begin CHARACTERISTIC K_KH_SMG_TMOT_MAX "Temperaturschwelle fuer SMG-KH [EST]" VALUE 0x740AC RL_VAL_SW 0 CM_0258 -3550 3003.5 /end CHARACTERISTIC
/begin CHARACTERISTIC K_KH_VAN_TMOT_MAX "Katheizen Obergrenze [EST]" VALUE 0x740DC RL_VAL_SW 0 CM_0258 -3550 3003.5 /end CHARACTERISTIC
/begin CHARACTERISTIC K_KH_PKSR_PL_TMOT_MIN "tmot Sperrschwelle fuer Prueflauf [EST]" VALUE 0x740A2 RL_VAL_SW 0 CM_0258 -3550 3003.5 /end CHARACTERISTIC
/begin CHARACTERISTIC K_KH_MD_ETA_MIN "minimales ETA bei KH [EST]" VALUE 0x740D8 RL_VAL_UW 0 CM_0271 0 199.9969482 /end CHARACTERISTIC
/begin CHARACTERISTIC K_KH_MD_ETA_MAX "maximales ETA bei KH [EST]" VALUE 0x740DA RL_VAL_UW 0 CM_0271 0 199.9969482 /end CHARACTERISTIC
/begin CHARACTERISTIC K_KH_DYN_T_HOLD "Dynamik halten f?r andere Module [EST]" VALUE 0x74090 RL_VAL_UB 0 CM_0270 0 1.275 /end CHARACTERISTIC
/begin CHARACTERISTIC K_KH_MD_GRAD_NEG "Gradientenschwelle Wunschmoment [EST]" VALUE 0x74088 RL_VAL_SW 0 CM_0017 -3276.8 3276.7 /end CHARACTERISTIC
/begin CHARACTERISTIC K_KH_MD_GRAD_POS "Gradientenschwelle Wunschmoment [EST]" VALUE 0x7408A RL_VAL_SW 0 CM_0017 -3276.8 3276.7 /end CHARACTERISTIC
/begin CHARACTERISTIC K_KH_MD_GRAD_NEG_HYS "Hysterese zur Gradientenschwelle Wunschmoment [EST]" VALUE 0x7408C RL_VAL_SW 0 CM_0017 -3276.8 3276.7 /end CHARACTERISTIC
/begin CHARACTERISTIC K_KH_MD_GRAD_POS_HYS "Hysterese zur Gradientenschwelle Wunschmoment [EST]" VALUE 0x7408E RL_VAL_SW 0 CM_0017 -3276.8 3276.7 /end CHARACTERISTIC
/begin CHARACTERISTIC K_LLR_KH_V "max. Geschwindigkeit KH3 [verified]" VALUE 0x76270 RL_VAL_SW 0 CM_0260 -2048 2047.9375 /end CHARACTERISTIC
/begin CHARACTERISTIC K_LLR_KH_TIME_ML "Sperrzeit KH3 [verified]" VALUE 0x7626C RL_VAL_UW 0 CM_0247 0 655.35 /end CHARACTERISTIC
/begin CHARACTERISTIC K_LLR_N_SOLL_NF_FAKTOR "Faktor Nachf?hrsolldrehzahl [verified]" VALUE 0x76226 RL_VAL_UW 0 CM_0245 0 63.99902344 /end CHARACTERISTIC
/begin CHARACTERISTIC K_LLR_N_SOLL_MIN "min. Solldrehzahl [verified]" VALUE 0x76220 RL_VAL_SW 0 CM_0002 -32768 32767 /end CHARACTERISTIC
/begin CHARACTERISTIC K_FGR_LDM_V_SOLL_OFF_BESCLEUNIGEN "Offset f?r Soll Geschw. Berechnung Beschleunigen [verified]" VALUE 0x7257C RL_VAL_SL 0 CM_0283 -131072 131071.9999 /end CHARACTERISTIC
/begin CHARACTERISTIC K_FGR_LDM_V_SOLL_OFF_VERZOEGERN "Offset f?r Soll Geschw. Berechnung Verz?gern [verified]" VALUE 0x72580 RL_VAL_SL 0 CM_0283 -131072 131071.9999 /end CHARACTERISTIC
/begin CHARACTERISTIC K_FGR_FAK_V_MIN "Schwelle unterer Bereich [verified]" VALUE 0x72516 RL_VAL_SW 0 CM_0260 -2048 2047.9375 /end CHARACTERISTIC
/begin CHARACTERISTIC K_FGR_FAK_V_SPORT "Wichtung Bereich Sport [EST]" VALUE 0x7251C RL_VAL_UB 0 CM_0284 0 1 /end CHARACTERISTIC
/begin CHARACTERISTIC K_FGR_FAK_V_KOMFORT "Wichtung Bereich Komfort [EST]" VALUE 0x7251D RL_VAL_UB 0 CM_0284 0 1 /end CHARACTERISTIC
/begin CHARACTERISTIC K_FGR_FAK_V_NORMAL "Wichtung Bereich Normal [EST]" VALUE 0x7251E RL_VAL_UB 0 CM_0284 0 1 /end CHARACTERISTIC
/begin CHARACTERISTIC K_FGR_V_DIF_MIN_AUFST "Min. Regelabweichung bevor Rampe wartet [EST]" VALUE 0x72518 RL_VAL_SW 0 CM_0260 -2048 2047.9375 /end CHARACTERISTIC
/begin CHARACTERISTIC K_FGR_V_DIF_MAX_AUFST "Max. Regelabweichung bevor Rampe wartet [EST]" VALUE 0x7251A RL_VAL_SW 0 CM_0260 -2048 2047.9375 /end CHARACTERISTIC
/begin CHARACTERISTIC K_FGR_V_DIF_MIN_LL "Min. Reglerabweichung zur Ausl?sung SA [EST]" VALUE 0x72512 RL_VAL_SW 0 CM_0260 -2048 2047.9375 /end CHARACTERISTIC
/begin CHARACTERISTIC K_FGR_V_DIF_MAX_LL "Max. Reglerabweichung zur Ausl?sung SA [EST]" VALUE 0x72522 RL_VAL_SW 0 CM_0260 -2048 2047.9375 /end CHARACTERISTIC
/begin CHARACTERISTIC K_FGR_N_DIF_MAX "N Dif. max Begrenzung [EST]" VALUE 0x72524 RL_VAL_SW 0 CM_0002 -32768 32767 /end CHARACTERISTIC
/begin CHARACTERISTIC K_FGR_N_BEGR_EGAS_SCHW "N max Begrenzung Katschutz [EST]" VALUE 0x72526 RL_VAL_SW 0 CM_0002 -32768 32767 /end CHARACTERISTIC
/begin CHARACTERISTIC K_FGR_MSW_T_MIN "Wartezeit f?r langes Dr?cken [EST]" VALUE 0x724E6 RL_VAL_UB 0 CM_0247 0 2.55 /end CHARACTERISTIC
/begin CHARACTERISTIC K_FGR_TIP_T_MIN "Wartezeit f?r Entprellung Tipp [EST]" VALUE 0x724E7 RL_VAL_UB 0 CM_0247 0 2.55 /end CHARACTERISTIC
/begin CHARACTERISTIC K_FGR_STEP_T_MIN "Wartezeit f?r wiederholte Markenspr?nge [EST]" VALUE 0x724E8 RL_VAL_UB 0 CM_0247 0 2.55 /end CHARACTERISTIC
/begin CHARACTERISTIC K_FGR_LDM_AX_SOLL_I "0x0 aus 0x1 ein LDM AX I-Anteil Ein/Aus [EST]" VALUE 0x7255B RL_VAL_UB 0 CM_0000 0 255 /end CHARACTERISTIC
/begin CHARACTERISTIC K_FGR_LDM_AX_SOLL_P "0x0 aus 0x1 ein LDM AX P-Anteil Ein/Aus [EST]" VALUE 0x7255C RL_VAL_UB 0 CM_0000 0 255 /end CHARACTERISTIC
/begin CHARACTERISTIC K_FGR_LDM_AY "0x0 aus 0x1 ein LDM AY Ein/Aus [EST]" VALUE 0x7255D RL_VAL_UB 0 CM_0000 0 255 /end CHARACTERISTIC
/begin CHARACTERISTIC K_FGR_LDM_AY_STOER "0x0 aus 0x1 ein LDM AY St?r Ein/Aus [EST]" VALUE 0x7255E RL_VAL_UB 0 CM_0000 0 255 /end CHARACTERISTIC
/begin CHARACTERISTIC K_FGR_LDM_MASSENAUSGLEICH "0x0 aus 0x1 ein LDM Massenausgleich Ein/Aus [EST]" VALUE 0x7255F RL_VAL_UB 0 CM_0000 0 255 /end CHARACTERISTIC
/begin CHARACTERISTIC K_FGR_LDM_RUCK "0x0 aus 0x1 ein LDM Ruckbegrentzung Ein/Aus [EST]" VALUE 0x72560 RL_VAL_UB 0 CM_0000 0 255 /end CHARACTERISTIC
/begin CHARACTERISTIC K_FGR_LDM_AY_TAU "Filterkonstante AY [EST]" VALUE 0x72562 RL_VAL_UB 0 CM_0277 0.01003921569 2.56 /end CHARACTERISTIC
/begin CHARACTERISTIC K_FGR_LDM_AX_BUFFER_SIZE "Filterkonstante AY [verified]" VALUE 0x72564 RL_VAL_UW 0 CM_0285 0 65535 /end CHARACTERISTIC
/begin CHARACTERISTIC K_FGR_LDM_V_TACHO_TAU "Filterkonstante V-Tacho [EST]" VALUE 0x72566 RL_VAL_UB 0 CM_0277 0.01003921569 2.56 /end CHARACTERISTIC
/begin CHARACTERISTIC K_FGR_LDM_V_VEH_TAU "Filterkonstante V-Veh [EST]" VALUE 0x72567 RL_VAL_UB 0 CM_0277 0.01003921569 2.56 /end CHARACTERISTIC
/begin CHARACTERISTIC K_FGR_LDM_AX_BERG_TAU "Tau fuer pt1-Filterung AX Berg [verified]" VALUE 0x72568 RL_VAL_UW 0 CM_0286 0.01 655.35 /end CHARACTERISTIC
/begin CHARACTERISTIC K_FGR_LDM_AX_STOER_OFF "AX St?r Offset [EST]" VALUE 0x7256A RL_VAL_SW 0 CM_0287 -8.192 8.19175 /end CHARACTERISTIC
/begin CHARACTERISTIC K_FGR_LDM_AX_SOLL_MAX "Max. Fahrzeug L?ngsbeschleunigung [EST]" VALUE 0x7256C RL_VAL_SW 0 CM_0288 -819.2 819.175 /end CHARACTERISTIC
/begin CHARACTERISTIC K_FGR_LDM_AY_SOLL "Soll Fahrzeug Querbeschleunigung [EST]" VALUE 0x7256E RL_VAL_SW 0 CM_0288 -819.2 819.175 /end CHARACTERISTIC
/begin CHARACTERISTIC K_FGR_LDM_AX_SOLL_MIN "Min. Fahrzeug L?ngsbeschleunigung [verified]" VALUE 0x72570 RL_VAL_SW 0 CM_0288 -819.2 819.175 /end CHARACTERISTIC
/begin CHARACTERISTIC K_FGR_LDM_RUCK_SCHW_AB "Gradient Ruckschwelle negativ [EST]" VALUE 0x72572 RL_VAL_UW 0 CM_0289 0 6553.5 /end CHARACTERISTIC
/begin CHARACTERISTIC K_FGR_LDM_RUCK_SCHW_AUF "Gradient Ruckschwelle positiv [EST]" VALUE 0x72574 RL_VAL_UW 0 CM_0289 0 6553.5 /end CHARACTERISTIC
/begin CHARACTERISTIC K_FGR_LDM_M_FZG "Fahrzeug Masse [EST]" VALUE 0x72576 RL_VAL_UW 0 CM_0290 0 65535 /end CHARACTERISTIC
/begin CHARACTERISTIC K_FGR_LDM_M_FZG_CABRIO "Fahrzeug Masse Cabrio [EST]" VALUE 0x72578 RL_VAL_UW 0 CM_0290 0 65535 /end CHARACTERISTIC
/begin CHARACTERISTIC K_FGR_LDM_M_ANHAENGER "Anh?nger Masse [verified]" VALUE 0x7257A RL_VAL_UW 0 CM_0290 0 65535 /end CHARACTERISTIC
/begin CHARACTERISTIC K_TMOT_MAX_NEG_GRADIENT "Neg. Gradientenschwelle bei laufen-dem Motor [verified]" VALUE 0x7D58A RL_VAL_SW 0 CM_0305 -8192 8191.75 /end CHARACTERISTIC
/begin CHARACTERISTIC K_TMOT_MAX_POS_GRADIENT "Pos. Gradientenschwelle bei laufe n-dem Motor [verified]" VALUE 0x7D58C RL_VAL_SW 0 CM_0305 -8192 8191.75 /end CHARACTERISTIC
/begin CHARACTERISTIC K_TMOT_TAU "Filterkonstante fuer die Kuehlwasse r-erfassung [EST]" VALUE 0x7D594 RL_VAL_UB 0 CM_0306 0.1003921569 25.6 /end CHARACTERISTIC
/begin CHARACTERISTIC K_TMOT_MODELL_C_MOTOR "Waermekapazitaet Motor [verified]" VALUE 0x7D598 RL_VAL_UW 0 CM_0245 0 63.99902344 /end CHARACTERISTIC
/begin CHARACTERISTIC K_TMOT_MODELL_TI_F "Kraftstoffenergieeintragsfaktor [verified]" VALUE 0x7D59A RL_VAL_UW 0 CM_0245 0 63.99902344 /end CHARACTERISTIC
/begin CHARACTERISTIC K_TMOT_MODELL_F_MOTOR "Faktor fuer Motorabwaerme [verified]" VALUE 0x7D59C RL_VAL_UW 0 CM_0245 0 63.99902344 /end CHARACTERISTIC
/begin CHARACTERISTIC K_TMOT_MODELL_GAIN "Integratorkonstante [EST]" VALUE 0x7D59E RL_VAL_UW 0 CM_0307 0 1.999969482 /end CHARACTERISTIC
/begin CHARACTERISTIC K_TMOT_MODELL_LAM_MIN "Min. Lambdabegrenzung [verified]" VALUE 0x7D5AC RL_VAL_UW 0 CM_0259 0 3.999938965 /end CHARACTERISTIC
/begin CHARACTERISTIC K_GANG_I_HA_HS "Uebersetzungsverhaeltnis Hinterachse Handschalter [EST]" VALUE 0x73636 RL_VAL_SW 0 CM_0245 -32 31.99902344 /end CHARACTERISTIC
/begin CHARACTERISTIC K_GANG_R_RAD_DYN_NV "Radhalbmesser dyn amisch adaptiert, temporaere Kon- stante [EST]" VALUE 0x73638 RL_VAL_SW 0 CM_0320 -32 31.99902344 /end CHARACTERISTIC
/begin CHARACTERISTIC K_TOEL_MODELL_BEGR_OFFS "Grenzwertueberwachung toel_modell_aufheiz [verified]" VALUE 0x7D952 RL_VAL_SW 0 CM_0323 -3276.8 3276.7 /end CHARACTERISTIC
/begin CHARACTERISTIC K_TOEL_MODELL_LM_INTEGRATOR_DT "Tau fuer toel_modell_lm-Integrator [verified]" VALUE 0x7D94E RL_VAL_UW 0 CM_0324 0.1 6553.5 /end CHARACTERISTIC
/begin CHARACTERISTIC K_TOEL_MODELL_AEBEGR "Aenderungsbegrenzung toel_modell [verified]" VALUE 0x7D950 RL_VAL_UW 0 CM_0323 0 6553.5 /end CHARACTERISTIC
/begin CHARACTERISTIC K_TOEL_MODELL_AUFHEIZ_TAU "Filterkonstante fuer PT1 -Glied toel_modell_aufheiz [EST]" VALUE 0x7D954 RL_VAL_UB 0 CM_0306 0.1003921569 25.6 /end CHARACTERISTIC
/begin CHARACTERISTIC K_TOEL_MODELL_WARM_TAU "Filterkonstante fuer PT1 -Glied toel_modell_warm [EST]" VALUE 0x7D955 RL_VAL_UB 0 CM_0306 0.1003921569 25.6 /end CHARACTERISTIC
/begin CHARACTERISTIC KL_TOEL_MODELL_TIME_MS "Oil model init: engine-off time needed vs (oil temp at shut-off - ambient) [verified]" CURVE 0x7D966 RL_CUR_SW_UW 0 CM_0000 0 65535 /begin AXIS_DESCR STD_AXIS NO_INPUT_QUANTITY CM_0000 4 -32768 32767 /end AXIS_DESCR /end CHARACTERISTIC
/begin CHARACTERISTIC KL_TOEL_MODELL_AUFHEIZ_WICHT "Oil model heat-up weighting vs coolant temperature [verified]" CURVE 0x7D990 RL_CUR_SW_UW 0 CM_0000 0 65535 /begin AXIS_DESCR STD_AXIS NO_INPUT_QUANTITY CM_0006 0 -3550 3003.5 /end AXIS_DESCR /end CHARACTERISTIC
/begin CHARACTERISTIC KF_TOEL_MODELL_V_TAN "Oil model cooling term vs vehicle speed and intake air temperature [verified]" MAP 0x7DA0A RL_MAP_SW_SW_SW 0 CM_0000 -32768 32767 /begin AXIS_DESCR STD_AXIS NO_INPUT_QUANTITY CM_0000 7 -32768 32767 /end AXIS_DESCR /begin AXIS_DESCR STD_AXIS NO_INPUT_QUANTITY CM_0006 7 -3550 3003.5 /end AXIS_DESCR /end CHARACTERISTIC
/begin CHARACTERISTIC KF_TOEL_MODELL_RATIO1 "Oil model ratio 1 vs integrated air mass and start coolant temperature [EST]" MAP 0x7DA8A RL_MAP_SW_SW_SW 0 CM_0000 -32768 32767 /begin AXIS_DESCR STD_AXIS NO_INPUT_QUANTITY CM_0000 6 -32768 32767 /end AXIS_DESCR /begin AXIS_DESCR STD_AXIS NO_INPUT_QUANTITY CM_0006 8 -3550 3003.5 /end AXIS_DESCR /end CHARACTERISTIC
/begin CHARACTERISTIC KF_TOEL_MODELL_RATIO2 "Oil model ratio 2 [EST]" MAP 0x7DB08 RL_MAP_SW_SW_SW 0 CM_0000 -32768 32767 /begin AXIS_DESCR STD_AXIS NO_INPUT_QUANTITY CM_0000 6 -32768 32767 /end AXIS_DESCR /begin AXIS_DESCR STD_AXIS NO_INPUT_QUANTITY CM_0006 8 -3550 3003.5 /end AXIS_DESCR /end CHARACTERISTIC
/begin CHARACTERISTIC K_TMOT_MODELL_GAIN_TMOT_DKG "Schwelle DKG Einfluss [verified]" VALUE 0x7D5AA RL_VAL_SW 0 CM_0256 -3550 3003.5 /end CHARACTERISTIC
/begin CHARACTERISTIC K_TMOT_MODELL_GAIN_DKG "Integratorkonstante bei DKG ab Te m-peraturschwelle [EST]" VALUE 0x7D5A6 RL_VAL_UW 0 CM_0307 0 1.999969482 /end CHARACTERISTIC
/begin CHARACTERISTIC K_TMOT_MODELL_TAU_KRAFT "Filterkonstante Kraftstoffenergieei n-trag [EST]" VALUE 0x7D596 RL_VAL_UB 0 CM_0306 0.1003921569 25.6 /end CHARACTERISTIC
/begin CHARACTERISTIC K_LLR_N_KH_AUFR "Kath-Aufregelrampe [verified]" VALUE 0x76214 RL_VAL_UW 0 CM_0081 0 655350 /end CHARACTERISTIC
/begin CHARACTERISTIC K_LLR_N_KH_ABR "Kath-Abregelrampe [verified]" VALUE 0x76216 RL_VAL_UW 0 CM_0081 0 655350 /end CHARACTERISTIC
/begin CHARACTERISTIC K_LLR_N_KH_AUFR_KH3 "Kath-Aufregelrampe bei KH3 [verified]" VALUE 0x76218 RL_VAL_UW 0 CM_0081 0 655350 /end CHARACTERISTIC
/begin CHARACTERISTIC K_LLR_N_KH_ABR_KH3 "Kath-Abregelrampe bei KH3 [verified]" VALUE 0x7621A RL_VAL_UW 0 CM_0081 0 655350 /end CHARACTERISTIC
/begin CHARACTERISTIC K_KH_ANZ_DLY_MD "Buffergr??e [EST]" VALUE 0x74094 RL_VAL_UB 0 CM_0000 0 255 /end CHARACTERISTIC
/begin CHARACTERISTIC K_N_GETR_ABTRIEB_MIN "Getriebeabtriebssdrehzahl Minimum [EST]" VALUE 0x7AAD2 RL_VAL_SW 0 CM_0002 -32768 32767 /end CHARACTERISTIC
/begin CHARACTERISTIC K_N_GETR_ABTRIEB_MAX "Getriebeabtriebssdrehzahl Maximum [EST]" VALUE 0x7AAD4 RL_VAL_SW 0 CM_0002 -32768 32767 /end CHARACTERISTIC
/begin CHARACTERISTIC K_SERVO_MAX_TAST_MS "max. Tastverhaeltnis bei stehendem Motor [verified]" VALUE 0x7BC26 RL_VAL_UW 0 CM_0176 0 3199.951172 /end CHARACTERISTIC
/begin CHARACTERISTIC K_SERVO_STROM_SOLL_TAU_POS "PT1 Filterkonstante f ?r positive Gradienten [verified]" VALUE 0x7BC28 RL_VAL_UB 0 CM_0277 0.01003921569 2.56 /end CHARACTERISTIC
/begin CHARACTERISTIC K_SERVO_STROM_SOLL_TAU_NEG "PT1 Filterkonstante f?r negative Gradienten [verified]" VALUE 0x7BC29 RL_VAL_UB 0 CM_0277 0.01003921569 2.56 /end CHARACTERISTIC
/begin CHARACTERISTIC K_SERVO_STROM_ERSATZ "Ersatzwert Servo-Ventilstrom [verified]" VALUE 0x7BC2A RL_VAL_UW 0 CM_0343 0 58326.15 /end CHARACTERISTIC
/begin CHARACTERISTIC K_SERVO_KP "Stromregler P-Anteil [verified]" VALUE 0x7BC38 RL_VAL_UW 0 CM_0345 0 65535 /end CHARACTERISTIC
/begin CHARACTERISTIC K_SERVO_KD "Stromregler D-Anteil [verified]" VALUE 0x7BC3A RL_VAL_UW 0 CM_0346 0 1310700 /end CHARACTERISTIC
/begin CHARACTERISTIC K_SERVO_SCHALT "Kennlinien-Umschaltzeit [verified]" VALUE 0x7BC3C RL_VAL_UB 0 CM_0347 40.15686275 10240 /end CHARACTERISTIC
/begin CHARACTERISTIC K_SERVO_ANSCHLAG_LRW_MAX "Lenkradwinkel fuer Anschlagerkennung [verified]" VALUE 0x7BC3E RL_VAL_UW 0 CM_0220 0 2880.26325 /end CHARACTERISTIC
/begin CHARACTERISTIC K_SERVO_ANSCHLAG_LRW_HYST "Hysterese Lenkradwinkel fuer Anschlagerkennung [verified]" VALUE 0x7BC40 RL_VAL_UW 0 CM_0220 0 2880.26325 /end CHARACTERISTIC
/begin CHARACTERISTIC K_SERVO_STROM_PUMPENSCHUTZ_MIN "Pumpenschutz Servo-Ventilstrom [verified]" VALUE 0x7BC42 RL_VAL_UW 0 CM_0343 0 58326.15 /end CHARACTERISTIC
/begin CHARACTERISTIC KL_SERVO_KOMFORT "SERVO KOMFORT-Kennlinie Coupe [verified]" CURVE 0x7BC46 RL_CUR_SW_UW 0 CM_0343 0 58326.15 /begin AXIS_DESCR STD_AXIS NO_INPUT_QUANTITY CM_0260 16 -2048 2047.9375 /end AXIS_DESCR /end CHARACTERISTIC
/begin CHARACTERISTIC KL_SERVO_SPORT "SERVO SPORT-Kennlinie Coupe [verified]" CURVE 0x7BC88 RL_CUR_SW_UW 0 CM_0343 0 58326.15 /begin AXIS_DESCR STD_AXIS NO_INPUT_QUANTITY CM_0260 16 -2048 2047.9375 /end AXIS_DESCR /end CHARACTERISTIC
/begin CHARACTERISTIC KL_SERVO_MDRV_AUS "KL_SERVO_MDRV_AUS [verified]" CURVE 0x7BCCA RL_CUR_SW_UW 0 CM_0343 0 58326.15 /begin AXIS_DESCR STD_AXIS NO_INPUT_QUANTITY CM_0260 16 -2048 2047.9375 /end AXIS_DESCR /end CHARACTERISTIC
/begin CHARACTERISTIC KL_SERVO_KOMFORT_CABRIO "SERVO KOMFORT-Kennlinie Cabrio [verified]" CURVE 0x7BD0C RL_CUR_SW_UW 0 CM_0343 0 58326.15 /begin AXIS_DESCR STD_AXIS NO_INPUT_QUANTITY CM_0260 16 -2048 2047.9375 /end AXIS_DESCR /end CHARACTERISTIC
/begin CHARACTERISTIC KL_SERVO_SPORT_CABRIO "SERVO SPORT-Kennlinie Cabrio [verified]" CURVE 0x7BD4E RL_CUR_SW_UW 0 CM_0343 0 58326.15 /begin AXIS_DESCR STD_AXIS NO_INPUT_QUANTITY CM_0260 16 -2048 2047.9375 /end AXIS_DESCR /end CHARACTERISTIC
/begin CHARACTERISTIC KL_SERVO_MDRV_AUS_CABRIO "Servotronic current curve M-Drive off, convertible (12th curve of the 4x3 body/mode grid) [EST]" CURVE 0x7BD90 RL_CUR_SW_UW 0 CM_0343 0 58326.15 /begin AXIS_DESCR STD_AXIS NO_INPUT_QUANTITY CM_0260 16 -2048 2047.9375 /end AXIS_DESCR /end CHARACTERISTIC
/begin CHARACTERISTIC KL_SERVO_KOMFORT_LIMOUSINE "SERVO KOMFORT-Kennlinie Limousine [verified]" CURVE 0x7BDD2 RL_CUR_SW_UW 0 CM_0343 0 58326.15 /begin AXIS_DESCR STD_AXIS NO_INPUT_QUANTITY CM_0260 16 -2048 2047.9375 /end AXIS_DESCR /end CHARACTERISTIC
/begin CHARACTERISTIC KL_SERVO_SPORT_LIMOUSINE "SERVO SPORT-Kennlinie Limousine [verified]" CURVE 0x7BE14 RL_CUR_SW_UW 0 CM_0343 0 58326.15 /begin AXIS_DESCR STD_AXIS NO_INPUT_QUANTITY CM_0260 16 -2048 2047.9375 /end AXIS_DESCR /end CHARACTERISTIC
/begin CHARACTERISTIC KL_SERVO_MDRV_AUS_LIMOUSINE "KL_SERVO_MDRV_AUS_LIMOUSINE [verified]" CURVE 0x7BE56 RL_CUR_SW_UW 0 CM_0343 0 58326.15 /begin AXIS_DESCR STD_AXIS NO_INPUT_QUANTITY CM_0260 16 -2048 2047.9375 /end AXIS_DESCR /end CHARACTERISTIC
/begin CHARACTERISTIC KL_SERVO_KOMFORT_TOURING "SERVO KOMFORT-Kennlinie Touring [verified]" CURVE 0x7BE98 RL_CUR_SW_UW 0 CM_0343 0 58326.15 /begin AXIS_DESCR STD_AXIS NO_INPUT_QUANTITY CM_0260 16 -2048 2047.9375 /end AXIS_DESCR /end CHARACTERISTIC
/begin CHARACTERISTIC KL_SERVO_SPORT_TOURING "SERVO SPORT-Kennlinie Cabrio [verified]" CURVE 0x7BEDA RL_CUR_SW_UW 0 CM_0343 0 58326.15 /begin AXIS_DESCR STD_AXIS NO_INPUT_QUANTITY CM_0260 16 -2048 2047.9375 /end AXIS_DESCR /end CHARACTERISTIC
/begin CHARACTERISTIC KL_SERVO_MDRV_AUS_TOURING "KL_SERVO_MDRV_AUS_TOURING [verified]" CURVE 0x7BF1C RL_CUR_SW_UW 0 CM_0343 0 58326.15 /begin AXIS_DESCR STD_AXIS NO_INPUT_QUANTITY CM_0260 16 -2048 2047.9375 /end AXIS_DESCR /end CHARACTERISTIC
/begin CHARACTERISTIC KL_SERVO_PUMPENSCHUTZ_RAMPE_DOWN "KL_SERVO_PUMPENSCHUTZ_RAMPE_DOWN [verified]" CURVE 0x7BF5E RL_CUR_SW_SB 0 CM_0371 -11392 11303 /begin AXIS_DESCR STD_AXIS NO_INPUT_QUANTITY CM_0002 4 -32768 32767 /end AXIS_DESCR /end CHARACTERISTIC
/begin CHARACTERISTIC KL_SERVO_PUMPENSCHUTZ_RAMPE_UP "KL_SERVO_PUMPENSCHUTZ_RAMPE_UP [verified]" CURVE 0x7BF6C RL_CUR_SW_UB 0 CM_0371 0 22695 /begin AXIS_DESCR STD_AXIS NO_INPUT_QUANTITY CM_0002 4 -32768 32767 /end AXIS_DESCR /end CHARACTERISTIC
/begin CHARACTERISTIC KL_SERVO_PUMPENSCHUTZ_DELAYTIME "KL_SERVO_PUMPENSCHUTZ_DELAYTIME [verified]" CURVE 0x7BF7A RL_CUR_SW_UW 0 CM_0247 0 655.35 /begin AXIS_DESCR STD_AXIS NO_INPUT_QUANTITY CM_0002 4 -32768 32767 /end AXIS_DESCR /end CHARACTERISTIC
/begin CHARACTERISTIC KF_SERVO_ANSCHLAG "Wichtung Servostrom Sollwert KV Coupe [verified]" MAP 0x7BF8C RL_MAP_SW_SW_UW 0 CM_0245 0 63.99902344 /begin AXIS_DESCR STD_AXIS NO_INPUT_QUANTITY CM_0372 6 -32768 32767 /end AXIS_DESCR /begin AXIS_DESCR STD_AXIS NO_INPUT_QUANTITY CM_0373 6 -1440.1536 1440.10965 /end AXIS_DESCR /end CHARACTERISTIC
/begin CHARACTERISTIC KF_SERVO_ANSCHLAG_CABRIO "Wichtung Servostrom Sollwert KV Cabrio [verified]" MAP 0x7BFEE RL_MAP_SW_SW_UW 0 CM_0245 0 63.99902344 /begin AXIS_DESCR STD_AXIS NO_INPUT_QUANTITY CM_0372 6 -32768 32767 /end AXIS_DESCR /begin AXIS_DESCR STD_AXIS NO_INPUT_QUANTITY CM_0373 6 -1440.1536 1440.10965 /end AXIS_DESCR /end CHARACTERISTIC
/begin CHARACTERISTIC KF_SERVO_ANSCHLAG_LIMOUSINE "Wichtung Servostrom Sollwert KV Limousine [verified]" MAP 0x7C050 RL_MAP_SW_SW_UW 0 CM_0245 0 63.99902344 /begin AXIS_DESCR STD_AXIS NO_INPUT_QUANTITY CM_0372 6 -32768 32767 /end AXIS_DESCR /begin AXIS_DESCR STD_AXIS NO_INPUT_QUANTITY CM_0373 6 -1440.1536 1440.10965 /end AXIS_DESCR /end CHARACTERISTIC
/begin CHARACTERISTIC KF_SERVO_ANSCHLAG_TOURING "Wichtung Servostrom Sollwert KV Touring [verified]" MAP 0x7C0B2 RL_MAP_SW_SW_UW 0 CM_0245 0 63.99902344 /begin AXIS_DESCR STD_AXIS NO_INPUT_QUANTITY CM_0372 6 -32768 32767 /end AXIS_DESCR /begin AXIS_DESCR STD_AXIS NO_INPUT_QUANTITY CM_0373 6 -1440.1536 1440.10965 /end AXIS_DESCR /end CHARACTERISTIC
/begin CHARACTERISTIC KL_FGR_LDM_MD_RAD_FAHRWIND "LDM AX P-Reg [verified]" CURVE 0x72862 RL_CUR_SW_UW 0 CM_0322 0 6553.5 /begin AXIS_DESCR STD_AXIS NO_INPUT_QUANTITY CM_0260 16 -2048 2047.9375 /end AXIS_DESCR /end CHARACTERISTIC
/begin CHARACTERISTIC K_AUSS_ASP_SA_CNT "Min Anzahl Arbeitspiele waehren SA vor Adaption. [EST]" VALUE 0x705B2 RL_VAL_UW 0 CM_0000 0 65535 /end CHARACTERISTIC
/begin CHARACTERISTIC K_AUSS_ED_WICHT_SPARK "Gewichtungsfaktors fuer Fehlereintrag Zuendauss. [A2L-ref]" VALUE 0x705BC RL_VAL_UW 0 CM_0164 0 255.9960938 /end CHARACTERISTIC
/begin CHARACTERISTIC K_AUSS_FETRAWE_N "Drehzahlgrenze bei Abschaltung im FeTraWe-Mode. [A2L-ref]" VALUE 0x705D2 RL_VAL_SW 0 CM_0002 -32768 32767 /end CHARACTERISTIC
/begin CHARACTERISTIC K_AUSS_FETRAWE_RF "Lastgrenze bei Abschaltung im FeTraWe-Mode. [A2L-ref]" VALUE 0x705D4 RL_VAL_SW 0 CM_0003 -3.2768 3.2767 /end CHARACTERISTIC
/begin CHARACTERISTIC K_AUSS_FETRAWE_TIME_ML "Zeitgrenze bei Abschaltung im FeTraWe-Mode. [A2L-ref]" VALUE 0x705D8 RL_VAL_UL 0 CM_0025 0 42949672.95 /end CHARACTERISTIC
/begin CHARACTERISTIC K_AUSS_INT_START_FAKTOR_KOR "Faktor-Korrekturwert waerend Startphase. [A2L-ref]" VALUE 0x705CE RL_VAL_SW 0 CM_0377 -200 199.9938965 /end CHARACTERISTIC
/begin CHARACTERISTIC K_AUSS_LP_MIN_SA_MAX_INI "Initialwert vom max Offset im Aussetzerfenster bei SA. [EST]" VALUE 0x70610 RL_VAL_SW 0 CM_0054 -26.39986688 26.39906122 /end CHARACTERISTIC
/begin CHARACTERISTIC K_AUSS_MAX_OFFSET_CFG "Schalter Minimalwertbegrenzung [A2L-ref]" VALUE 0x705A5 RL_VAL_UB 0 CM_0000 0 255 /end CHARACTERISTIC
/begin CHARACTERISTIC K_AUSS_MIN_LAM "Minimal zul. Lambda [A2L-ref]" VALUE 0x705B8 RL_VAL_UW 0 CM_0236 0 3.999938965 /end CHARACTERISTIC
/begin CHARACTERISTIC K_AUSS_NS_MAX_ASP "Anzahl Arbeitspiele nach Start zur Aktivierung der Nebenschlusserkennung. [A2L-ref]" VALUE 0x705BA RL_VAL_UW 0 CM_0000 0 65535 /end CHARACTERISTIC
/begin CHARACTERISTIC K_FGR_FAK_V_TIP "Wichtung Tippen [A2L-ref]" VALUE 0x7251F RL_VAL_UB 0 CM_0039 0 2.55 /end CHARACTERISTIC
/begin CHARACTERISTIC K_FGR_FSP_EIN "0x0 Aus 0x1 Ein FGR Fehlerspeicher Einschalten 1: Ein, 0: Aus [A2L-ref]" VALUE 0x724DF RL_VAL_UB 0 CM_0000 0 255 /end CHARACTERISTIC
/begin CHARACTERISTIC K_FGR_SMG_MCS "0x0 nicht sperren 0x1 sperren FGR Abschaltung durch SMG sperren [A2L-ref]" VALUE 0x724E3 RL_VAL_UB 0 CM_0000 0 255 /end CHARACTERISTIC
/begin CHARACTERISTIC K_FGR_STATE_AG "FGR STATE AG 1: Ein, 0: Aus 0x0 Aus 0x1 Ein [A2L-ref]" VALUE 0x724E1 RL_VAL_UB 0 CM_0000 0 255 /end CHARACTERISTIC
/begin CHARACTERISTIC K_FR_CFG "Konfiguration [EST]" VALUE 0x73074 RL_VAL_UB 0 CM_0000 0 255 /end CHARACTERISTIC
/begin CHARACTERISTIC K_GANG_1_TIMER_MAX "Zeit bis Anzeige 1.Gang [A2L-ref]" VALUE 0x7363C RL_VAL_SW 0 CM_0052 -327680 327670 /end CHARACTERISTIC
/begin CHARACTERISTIC K_GANG_I_HA_ADAPT_CNT_MAX "maximale Zahl Messwerte Adaption Hinterachse [A2L-ref]" VALUE 0x7362C RL_VAL_UW 0 CM_0000 0 65535 /end CHARACTERISTIC
/begin CHARACTERISTIC K_GANG_I_HA_ADAPT_GANG_MAX_HS "maximaler Gang Adaption Hinterachse [A2L-ref]" VALUE 0x73621 RL_VAL_SB 0 CM_0015 -128 127 /end CHARACTERISTIC
/begin CHARACTERISTIC K_GANG_I_HA_ADAPT_GANG_MIN_HS "minimaler Gang Adaption Hinterachse [A2L-ref]" VALUE 0x73620 RL_VAL_SB 0 CM_0015 -128 127 /end CHARACTERISTIC
/begin CHARACTERISTIC K_GANG_I_HA_ADAPT_MAX "maximaler Adaptionswert Hinterachse [A2L-ref]" VALUE 0x73630 RL_VAL_SW 0 CM_0016 -32 31.99902344 /end CHARACTERISTIC
/begin CHARACTERISTIC K_GANG_I_HA_ADAPT_MD_MAX_HS "maximales Kupplungsm o-ment Adaption Hinterachse [A2L-ref]" VALUE 0x73624 RL_VAL_SW 0 CM_0017 -3276.8 3276.7 /end CHARACTERISTIC
/begin CHARACTERISTIC K_GANG_I_HA_ADAPT_MD_MIN_HS "minimales Kupplungsmo-ment Adaption Hinterachse [A2L-ref]" VALUE 0x73622 RL_VAL_SW 0 CM_0017 -3276.8 3276.7 /end CHARACTERISTIC
/begin CHARACTERISTIC K_GANG_I_HA_ADAPT_MIN "minimaler Adaptionswert Hinterachse [A2L-ref]" VALUE 0x7362E RL_VAL_SW 0 CM_0016 -32 31.99902344 /end CHARACTERISTIC
/begin CHARACTERISTIC K_GANG_I_HA_ADAPT_SCHLUPF_MIN_HS "minimaler Schlupf Adapt ion Hinterachse [A2L-ref]" VALUE 0x73626 RL_VAL_SW 0 CM_0044 -327.68 327.67 /end CHARACTERISTIC
/begin CHARACTERISTIC K_GANG_I_HA_ADAPT_V_MAX_HS "maximale Geschwindig keit Adaption Hinterachse [A2L-ref]" VALUE 0x7362A RL_VAL_SW 0 CM_0010 -2048 2047.9375 /end CHARACTERISTIC
/begin CHARACTERISTIC K_GANG_I_HA_ADAPT_V_MIN_HS "minimale Geschwindigkeit Adaption Hinterachse [A2L-ref]" VALUE 0x73628 RL_VAL_SW 0 CM_0010 -2048 2047.9375 /end CHARACTERISTIC
/begin CHARACTERISTIC K_GANG_I_HA_DKG "Uebersetzungsverhaeltnis Hinterachse DKG [A2L-ref]" VALUE 0x73634 RL_VAL_SW 0 CM_0016 -32 31.99902344 /end CHARACTERISTIC
/begin CHARACTERISTIC K_GANG_I_HA_SMG "Uebersetzungsverhaeltnis Hinterachse SMG [A2L-ref]" VALUE 0x73632 RL_VAL_SW 0 CM_0016 -32 31.99902344 /end CHARACTERISTIC
/begin CHARACTERISTIC K_KH_TZ_ABS_AB "Aenderungsbegr. Faktor Ende KH [A2L-ref]" VALUE 0x740A8 RL_VAL_UW 0 CM_0381 0 3.999938965 /end CHARACTERISTIC
/begin CHARACTERISTIC K_KH_VAN_AB_Auslass "Katheizen Abregelzeit [EST]" VALUE 0x740A6 RL_VAL_SW 0 CM_0027 -32768 32767 /end CHARACTERISTIC
/begin CHARACTERISTIC K_KUS_CFG "Schalter Konfiguration Kupplungsschlupfregelung [A2L-ref]" VALUE 0x7611E RL_VAL_UB 0 CM_0000 0 255 /end CHARACTERISTIC
/begin CHARACTERISTIC K_KUS_GANG_MAX "maximaler Gang, bei dem noch eine Freigabe erfolgt [A2L-ref]" VALUE 0x76124 RL_VAL_SB 0 CM_0015 -128 127 /end CHARACTERISTIC
/begin CHARACTERISTIC K_KUS_N_DELTA_AUS "Begrenzung Abregelrampe Motordrehzahl [A2L-ref]" VALUE 0x76122 RL_VAL_UW 0 CM_0382 0 13107000 /end CHARACTERISTIC
/begin CHARACTERISTIC K_KUS_N_DELTA_EIN "Begrenzung Abregelrampe Motordrehzahl [A2L-ref]" VALUE 0x76120 RL_VAL_UW 0 CM_0382 0 13107000 /end CHARACTERISTIC
/begin CHARACTERISTIC K_KUS_N_GETR_EIN_HYS "Hysterese minimale Getriebeeingangsdrehzahl KUS Timer [A2L-ref]" VALUE 0x76128 RL_VAL_SW 0 CM_0002 -32768 32767 /end CHARACTERISTIC
/begin CHARACTERISTIC K_KUS_N_GETR_EIN_MIN "minimale Getriebeeingangsdrehzahl KUS Timer [A2L-ref]" VALUE 0x76126 RL_VAL_SW 0 CM_0002 -32768 32767 /end CHARACTERISTIC
/begin CHARACTERISTIC K_KUS_N_HYS "Hysterese minimale Motordrehzahl KUS Timer [A2L-ref]" VALUE 0x7612C RL_VAL_SW 0 CM_0002 -32768 32767 /end CHARACTERISTIC
/begin CHARACTERISTIC K_KUS_N_MIN "minimale Motordrehzahl KUS Timer [A2L-ref]" VALUE 0x7612A RL_VAL_SW 0 CM_0002 -32768 32767 /end CHARACTERISTIC
/begin CHARACTERISTIC K_KUS_STUFE "Eingriffsstufe Kupplungsschlupfregelung [A2L-ref]" VALUE 0x7611F RL_VAL_UB 0 CM_0000 0 255 /end CHARACTERISTIC
/begin CHARACTERISTIC K_KUS_V_VORNE_HYS "Hysterese maximale Geschwindigkeit, bei der noch Freigabe [A2L-ref]" VALUE 0x76130 RL_VAL_SW 0 CM_0010 -2048 2047.9375 /end CHARACTERISTIC
/begin CHARACTERISTIC K_KUS_V_VORNE_MAX "maximale Geschwindigkeit, bei der noch Freigabe [A2L-ref]" VALUE 0x7612E RL_VAL_SW 0 CM_0010 -2048 2047.9375 /end CHARACTERISTIC
/begin CHARACTERISTIC K_LLR_AD_AC_MAX "Maxwert Klima [verified]" VALUE 0x769FA RL_VAL_SW 0 CM_0017 -3276.8 3276.7 /end CHARACTERISTIC
/begin CHARACTERISTIC K_LLR_AD_AC_MIN "Minwert Klima [verified]" VALUE 0x769F8 RL_VAL_SW 0 CM_0017 -3276.8 3276.7 /end CHARACTERISTIC
/begin CHARACTERISTIC K_LLR_AD_CFG "0x0 Aus 0x1 Ein 0x2 Ein o.TE 0xff Init Konfiguration [verified]" VALUE 0x76802 RL_VAL_UB 0 CM_0000 0 255 /end CHARACTERISTIC
/begin CHARACTERISTIC K_LLR_AD_I_ANTEIL_OFF "Restwert I-Anteil [verified]" VALUE 0x769FE RL_VAL_SW 0 CM_0017 -3276.8 3276.7 /end CHARACTERISTIC
/begin CHARACTERISTIC K_LLR_AD_MD_GRAD "?nderungsbegrenzung [verified]" VALUE 0x769FC RL_VAL_SW 0 CM_0073 -3276.8 3276.7 /end CHARACTERISTIC
/begin CHARACTERISTIC K_LLR_AD_NORM_MAX "Maxwert normal [verified]" VALUE 0x769F6 RL_VAL_SW 0 CM_0017 -3276.8 3276.7 /end CHARACTERISTIC
/begin CHARACTERISTIC K_LLR_AD_N_HYS_NEG "negativer Offset [verified]" VALUE 0x769EE RL_VAL_SW 0 CM_0002 -32768 32767 /end CHARACTERISTIC
/begin CHARACTERISTIC K_LLR_AD_TIME_STABIL "Stabilisierzeit [verified]" VALUE 0x769F0 RL_VAL_UW 0 CM_0023 0 6553.5 /end CHARACTERISTIC
/begin CHARACTERISTIC K_LLR_AD_TMOT "Tmot-Schwelle [verified]" VALUE 0x769E8 RL_VAL_SW 0 CM_0006 -3550 3003.5 /end CHARACTERISTIC
/begin CHARACTERISTIC K_LLR_MD_RES_WAIT "Wartezeit fuer Reserve [verified]" VALUE 0x76244 RL_VAL_UW 0 CM_0025 0 655.35 /end CHARACTERISTIC
/begin CHARACTERISTIC K_LLR_MD_TZ_RUECK_HYS "Hysterese TZ-Rueckfuehrung [verified]" VALUE 0x76247 RL_VAL_UB 0 CM_0017 0 25.5 /end CHARACTERISTIC
/begin CHARACTERISTIC K_LLR_MD_TZ_RUECK_NEG "Negative TZ-Rueckfuehrung [verified]" VALUE 0x7624A RL_VAL_SW 0 CM_0383 -16.384 16.3835 /end CHARACTERISTIC
/begin CHARACTERISTIC K_LLR_MD_TZ_RUECK_POS "Positive TZ-Rueckfuehrung [verified]" VALUE 0x76248 RL_VAL_SW 0 CM_0383 -16.384 16.3835 /end CHARACTERISTIC
/begin CHARACTERISTIC K_LLR_MD_TZ_TAU "Filter LLR TZ-Eingriff [verified]" VALUE 0x76246 RL_VAL_UB 0 CM_0306 0.1003921569 25.6 /end CHARACTERISTIC
/begin CHARACTERISTIC K_LLR_N_EINGEREGELT "Schwelle fuer n eingeregelt [verified]" VALUE 0x76202 RL_VAL_UB 0 CM_0002 0 255 /end CHARACTERISTIC
/begin CHARACTERISTIC K_LLR_N_RESET "Resetschwelle [verified]" VALUE 0x7623C RL_VAL_SW 0 CM_0002 -32768 32767 /end CHARACTERISTIC
/begin CHARACTERISTIC K_LLR_N_SOLL_AC_OFFSET "Offset durch Klima [verified]" VALUE 0x7621C RL_VAL_SW 0 CM_0002 -32768 32767 /end CHARACTERISTIC
/begin CHARACTERISTIC K_LLR_N_SOLL_MAX "max. Solldrehzahl [verified]" VALUE 0x76224 RL_VAL_SW 0 CM_0002 -32768 32767 /end CHARACTERISTIC
/begin CHARACTERISTIC K_LLR_N_SOLL_NF_MAX "max. Nachf?hrsolldrehzahl [verified]" VALUE 0x76228 RL_VAL_SW 0 CM_0002 -32768 32767 /end CHARACTERISTIC
/begin CHARACTERISTIC K_LLR_N_SOLL_TAU "Filter Solldrehzahl [A2L-ref]" VALUE 0x76203 RL_VAL_UB 0 CM_0027 0 255 /end CHARACTERISTIC
/begin CHARACTERISTIC K_LLR_N_SOLL_ZH_OFFSET "Offset durch Zusatzheizung [verified]" VALUE 0x7621E RL_VAL_SW 0 CM_0002 -32768 32767 /end CHARACTERISTIC
/begin CHARACTERISTIC K_SMG_MOT_DN_GANG_1of3_ "DN-Wichtung ueber Gang [EST]" VALUE 0x7C37C RL_VAL_UB 0 CM_0037 0 1.9921875 /end CHARACTERISTIC
/begin CHARACTERISTIC K_SMG_MOT_DN_GANG_2of3_ "DN-Wichtung ueber Gang [EST]" VALUE 0x7C37D RL_VAL_UB 0 CM_0037 0 1.9921875 /end CHARACTERISTIC
/begin CHARACTERISTIC K_SMG_MOT_DN_GANG_3of3_ "DN-Wichtung ueber Gang [EST]" VALUE 0x7C37E RL_VAL_UB 0 CM_0037 0 1.9921875 /end CHARACTERISTIC
/begin CHARACTERISTIC K_SMG_MOT_J_MOTOR_ZR "Faktor fuer Vorst 2 bei ZR [A2L-ref]" VALUE 0x7C2ED RL_VAL_UB 0 CM_0096 0 1.9921875 /end CHARACTERISTIC
/begin CHARACTERISTIC K_SMG_PROG_V_SCHW "v-Schwelle fuer Schub-Programm [A2L-ref]" VALUE 0x7C2EE RL_VAL_SW 0 CM_0010 -2048 2047.9375 /end CHARACTERISTIC
/begin CHARACTERISTIC K_SMG_TAU_AX_BERECH "Filter berech. ax [A2L-ref]" VALUE 0x7C2E8 RL_VAL_UB 0 CM_0027 0 255 /end CHARACTERISTIC
/begin CHARACTERISTIC K_SMG_TAU_AX_BERG "Filter Steigung [A2L-ref]" VALUE 0x7C2EA RL_VAL_UB 0 CM_0027 0 255 /end CHARACTERISTIC
/begin CHARACTERISTIC K_SMG_TAU_AX_MESS "Filter gem. ax [A2L-ref]" VALUE 0x7C2E9 RL_VAL_UB 0 CM_0027 0 255 /end CHARACTERISTIC
/begin CHARACTERISTIC K_SMG_TAU_DN_FILTER "Filter Drehzahlgradient [A2L-ref]" VALUE 0x7C2E5 RL_VAL_UB 0 CM_0027 0 255 /end CHARACTERISTIC
/begin CHARACTERISTIC K_SMG_TAU_DN_GETR "Filter Getriebedrehzahlgradient [A2L-ref]" VALUE 0x7C2E6 RL_VAL_UB 0 CM_0027 0 255 /end CHARACTERISTIC
/begin CHARACTERISTIC K_SMG_TAU_DSC_ABS "Filter DSC-Anforderung [A2L-ref]" VALUE 0x7C2EC RL_VAL_UB 0 CM_0027 0 255 /end CHARACTERISTIC
/begin CHARACTERISTIC K_SMG_TAU_KSCHLUPF "Filter Kupplungsschlupf [A2L-ref]" VALUE 0x7C2E7 RL_VAL_UB 0 CM_0027 0 255 /end CHARACTERISTIC
/begin CHARACTERISTIC K_SMG_TAU_MD_FAHRER "Filter Fahrerwunsch [A2L-ref]" VALUE 0x7C2E4 RL_VAL_UB 0 CM_0027 0 255 /end CHARACTERISTIC
/begin CHARACTERISTIC K_SMG_TAU_RSCHLUPF "Filter Radschlupf [A2L-ref]" VALUE 0x7C2EB RL_VAL_UB 0 CM_0027 0 255 /end CHARACTERISTIC
/begin CHARACTERISTIC K_TAN_AEBEGR "Aenderungsbegrenzung fuer tan_filter [A2L-ref]" VALUE 0x7D32E RL_VAL_UW 0 CM_0390 -273.15 16110.6 /end CHARACTERISTIC
/begin CHARACTERISTIC K_TAN_ERSATZ "Ersatzwert fuer die Ansauglufttemperatur [verified]" VALUE 0x7D32C RL_VAL_SW 0 CM_0107 -1092.35 546.025 /end CHARACTERISTIC
/begin CHARACTERISTIC K_TAN_MW_ABGR_NEG "neg. Aenderungsbegr. Ansauglufttemperatur pro 100ms [A2L-ref]" VALUE 0x7D330 RL_VAL_UW 0 CM_0006 -273.2 6280.3 /end CHARACTERISTIC
/begin CHARACTERISTIC K_TAN_MW_ABGR_POS "pos. Aenderungsbegr. Ansauglufttemperatur pro 100ms [A2L-ref]" VALUE 0x7D332 RL_VAL_UW 0 CM_0006 -273.2 6280.3 /end CHARACTERISTIC
/begin CHARACTERISTIC K_TAN_TAU "Filterkonstante fuer die Ansauglufttemperaturerfassung [A2L-ref]" VALUE 0x7D334 RL_VAL_UB 0 CM_0027 0 255 /end CHARACTERISTIC
/begin CHARACTERISTIC K_TMOT_MODELL_ERSATZ "Obergrenze Ersatzwert [A2L-ref]" VALUE 0x7D5BC RL_VAL_SW 0 CM_0006 -3550 3003.5 /end CHARACTERISTIC
/begin CHARACTERISTIC K_TMOT_MODELL_TKA_ERSATZ_DELTA "Obergrenzendelta zum Kuehleraustritt bei heissem tka [A2L-ref]" VALUE 0x7D5BE RL_VAL_SW 0 CM_0024 -3276.8 3276.7 /end CHARACTERISTIC
/begin CHARACTERISTIC K_ZOELP_AN "Querbeschleunigungsschwelle fuer OELP an [EST]" VALUE 0x7E706 RL_VAL_SW 0 CM_0042 -819.2 819.175 /end CHARACTERISTIC
/begin CHARACTERISTIC K_ZOELP_CFG "Konfig ZOELP [EST]" VALUE 0x7E704 RL_VAL_UB 0 CM_0000 0 255 /end CHARACTERISTIC
/begin CHARACTERISTIC K_ZOELP_HYS "Querbeschleunigungshysterese fuer OELP an [EST]" VALUE 0x7E708 RL_VAL_SW 0 CM_0042 -819.2 819.175 /end CHARACTERISTIC
/begin CHARACTERISTIC K_ZOELP_MAN_T_AUS "ZOELP aus Zeit im manuellem Betrieb [A2L-ref]" VALUE 0x7E70C RL_VAL_UB 0 CM_0023 0 25.5 /end CHARACTERISTIC
/begin CHARACTERISTIC cfg.getriebetyp "Konfigurationsparameter: Getriebetyp [A2L-ref]" VALUE 0x7D107 RL_VAL_UB 0 CM_0000 0 255 /end CHARACTERISTIC
/begin CHARACTERISTIC cfg.la_variante "Konfigurationsparameter: LA-Variante [A2L-ref]" VALUE 0x7D108 RL_VAL_UB 0 CM_0000 0 255 /end CHARACTERISTIC
/begin CHARACTERISTIC K_LLR_AD_I_TAU "Filterzeit [verified]" VALUE 0x769E7 RL_VAL_UB 0 CM_0424 1.003921569 256 /end CHARACTERISTIC
/begin CHARACTERISTIC K_LLR_AD_N_HYS_POS "positiver Offset [verified]" VALUE 0x769EC RL_VAL_SW 0 CM_0002 -32768 32767 /end CHARACTERISTIC
/begin CHARACTERISTIC K_LLR_AD_TOEL "Toel-Schwelle [verified]" VALUE 0x769EA RL_VAL_SW 0 CM_0006 -3550 3003.5 /end CHARACTERISTIC
/begin CHARACTERISTIC K_LLR_OMEGA_TAU "Omega-Tau [verified]" VALUE 0x76242 RL_VAL_UB 0 CM_0065 0.005019607843 1.28 /end CHARACTERISTIC
/begin CHARACTERISTIC K_TAN_MODELL_ALLOW_NO_TUMG "Fehler Umgebungstemperatur zulassen [A2L-ref]" VALUE 0x7D339 RL_VAL_UB 0 CM_0000 0 255 /end CHARACTERISTIC
/begin CHARACTERISTIC K_TAN_MODELL_MR_TAU "Filterkonstante fuer Motorraumtemperatur [EST]" VALUE 0x7D336 RL_VAL_UW 0 CM_0027 0 65535 /end CHARACTERISTIC
/begin CHARACTERISTIC K_TMOT_MODELL_TAU_UMG "Filterkonstante Umgebungswaermeabfuhr [EST]" VALUE 0x7D597 RL_VAL_UB 0 CM_0027 0 255 /end CHARACTERISTIC
/begin CHARACTERISTIC K_TMOT_MODELL_TMOT_MODELL_ML "Umschaltschwelle auf tmot [EST]" VALUE 0x7D5B2 RL_VAL_SW 0 CM_0006 -3550 3003.5 /end CHARACTERISTIC
/begin CHARACTERISTIC K_ZOELP_FG_N "Freigaengigkeits Schwelle abh. von n [EST]" VALUE 0x7E714 RL_VAL_SW 0 CM_0002 -32768 32767 /end CHARACTERISTIC
/begin CHARACTERISTIC K_ZOELP_FG_T_AN "Freigaengigkeits Anzeit [EST]" VALUE 0x7E70D RL_VAL_UB 0 CM_0023 0 25.5 /end CHARACTERISTIC
/begin CHARACTERISTIC K_ZOELP_FG_T_AUS "Freigaengigkeits Auszeit [EST]" VALUE 0x7E70E RL_VAL_UW 0 CM_0023 0 6553.5 /end CHARACTERISTIC
/begin CHARACTERISTIC K_ZOELP_MAN_T_AN "ZOELP an Zeit im manuellem Betrieb [A2L-ref]" VALUE 0x7E70B RL_VAL_UB 0 CM_0023 0 25.5 /end CHARACTERISTIC
/begin CHARACTERISTIC K_ZOELP_TOEL "Freigaengigkeits und Diagnose-Schwelle abh. von toel [A2L-ref]" VALUE 0x7E712 RL_VAL_SW 0 CM_0006 -3550 3003.5 /end CHARACTERISTIC
/begin CHARACTERISTIC K_ZOELP_UM "Vorzeichenumkehr fuer can_ay [EST]" VALUE 0x7E70A RL_VAL_SB 0 CM_0000 -128 127 /end CHARACTERISTIC
/begin CHARACTERISTIC K_DKG_SPERR_ST "0 Inaktiv 1 CAN 2 DME 4 DKG 8 nReg 16 Md 255 Alle Konfiguration Sperre [verified]" VALUE 0x70A6A RL_VAL_UB 0 CM_0000 0 255 /end CHARACTERISTIC
/begin CHARACTERISTIC K_DKG_MD_TI_OFFS "Offset fuer SA-Anforderung [EST]" VALUE 0x70A6C RL_VAL_SW 0 CM_0322 -3276.8 3276.7 /end CHARACTERISTIC
/begin CHARACTERISTIC K_DKG_KUPP_SCHLEIF_MAX "max. Stoergroesse Kupplung [verified]" VALUE 0x70A6E RL_VAL_SW 0 CM_0322 -3276.8 3276.7 /end CHARACTERISTIC
/begin CHARACTERISTIC K_DKG_KUPP_SCHLEIF_MAX_AK "max. Stoergroesse Kupplung - offen [verified]" VALUE 0x70A70 RL_VAL_SW 0 CM_0322 -3276.8 3276.7 /end CHARACTERISTIC
/begin CHARACTERISTIC K_DKG_MD_ML_RAMPE "Steigung ML-Rampe [verified]" VALUE 0x70A72 RL_VAL_SW 0 CM_0007 -655360 655340 /end CHARACTERISTIC
/begin CHARACTERISTIC K_DKG_MD_TZ_RAMPE "Steigung TZ-Rampe [verified]" VALUE 0x70A74 RL_VAL_SW 0 CM_0007 -655360 655340 /end CHARACTERISTIC
/begin CHARACTERISTIC K_DKG_KRIECH_RAMPE "Steigung Kriech-Rampe [verified]" VALUE 0x70A76 RL_VAL_SW 0 CM_0007 -655360 655340 /end CHARACTERISTIC
/begin CHARACTERISTIC K_DKG_T_WAIT "Wartezeit vor DKG-Rampe [verified]" VALUE 0x70A78 RL_VAL_UW 0 CM_0270 0 327.675 /end CHARACTERISTIC
/begin CHARACTERISTIC K_DKG_N_DYN_CFG "0x0 aus 0x1 ein 0x2 ohne DKG nDyn-Konfiguration [verified]" VALUE 0x70A7E RL_VAL_UB 0 CM_0000 0 255 /end CHARACTERISTIC
/begin CHARACTERISTIC K_DKG_N_DYN_N_MIN "n-Schwelle fuer Dynamisierung [verified]" VALUE 0x70A80 RL_VAL_SW 0 CM_0002 -32768 32767 /end CHARACTERISTIC
/begin CHARACTERISTIC K_DKG_N_DYN_N_AB_MIN "nAb-Schwelle fuer Dynamisierung [verified]" VALUE 0x70A82 RL_VAL_SW 0 CM_0002 -32768 32767 /end CHARACTERISTIC
/begin CHARACTERISTIC K_DKG_N_DYN_N_AB_MAX "nAb-Schwelle fuer Dynamisierung [verified]" VALUE 0x70A84 RL_VAL_SW 0 CM_0002 -32768 32767 /end CHARACTERISTIC
/begin CHARACTERISTIC K_DKG_N_DYN_GANG_MIN "Min. Gang fuer Dynamisierung [verified]" VALUE 0x70A86 RL_VAL_SB 0 CM_0015 -128 127 /end CHARACTERISTIC
/begin CHARACTERISTIC K_DKG_N_DYN_GANG_MAX "Max. Gang fuer Dynamisierung [verified]" VALUE 0x70A87 RL_VAL_SB 0 CM_0015 -128 127 /end CHARACTERISTIC
/begin CHARACTERISTIC K_DKG_N_DYN_T "max. nDyn-Speicherzeit [verified]" VALUE 0x70A88 RL_VAL_UW 0 CM_0270 0 327.675 /end CHARACTERISTIC
/begin CHARACTERISTIC K_DKG_N_DYN_FAK_LL "nDyn-Faktor bei LL [verified]" VALUE 0x70A8A RL_VAL_UW 0 CM_0245 0 63.99902344 /end CHARACTERISTIC
/begin CHARACTERISTIC K_DKG_LL_MD_MAX "MD-Schwelle f?r LL aktiv [verified]" VALUE 0x70A90 RL_VAL_SW 0 CM_0322 -3276.8 3276.7 /end CHARACTERISTIC
/begin CHARACTERISTIC K_DKG_LL_N_OFFS "N-Offset f?r LL aktiv [verified]" VALUE 0x70A92 RL_VAL_SW 0 CM_0002 -32768 32767 /end CHARACTERISTIC
/begin CHARACTERISTIC KL_DKG_KUPP_KRIECH_MAX "max. Kriechmoment der Kupplung [verified]" CURVE 0x70A94 RL_CUR_SW_SW 0 CM_0322 -3276.8 3276.7 /begin AXIS_DESCR STD_AXIS NO_INPUT_QUANTITY CM_0002 4 -32768 32767 /end AXIS_DESCR /end CHARACTERISTIC
/begin CHARACTERISTIC K_SPA_CFG "SPA Konfiguration [verified]" VALUE 0x7CD14 RL_VAL_UW 0 CM_0000 0 65535 /end CHARACTERISTIC
/begin CHARACTERISTIC K_SPA_N_GRAD_ASP_TAU "Drehzahlgradient (Arbeitsspiel) Filterkonstante [verified]" VALUE 0x7CD17 RL_VAL_UB 0 CM_0277 0.01003921569 2.56 /end CHARACTERISTIC
/begin CHARACTERISTIC K_SPA_PWG_SOLL_GRAD_TAU "PWG Gradient Filterkonstante [verified]" VALUE 0x7CD18 RL_VAL_UB 0 CM_0277 0.01003921569 2.56 /end CHARACTERISTIC
/begin CHARACTERISTIC K_SPA_GANG_MIN "minimaler Gang [verified]" VALUE 0x7CD19 RL_VAL_SB 0 CM_0015 -128 127 /end CHARACTERISTIC
/begin CHARACTERISTIC K_SPA_BLS_ON_T "S_BLS on Timedelay [verified]" VALUE 0x7CD1A RL_VAL_UW 0 CM_0247 0 655.35 /end CHARACTERISTIC
/begin CHARACTERISTIC K_SPA_BLS_OFF_T "S_BLS off Timedelay [verified]" VALUE 0x7CD1C RL_VAL_UW 0 CM_0247 0 655.35 /end CHARACTERISTIC
/begin CHARACTERISTIC K_SPA_MD_WUNSCH_REL_MIN "min Schwelle rel. Wunschmoment fuer SPA [verified]" VALUE 0x7CD1E RL_VAL_SW 0 CM_0276 -3276.8 3276.7 /end CHARACTERISTIC
/begin CHARACTERISTIC K_SPA_MD_WUNSCH_REL_MAX "max Schwelle rel. Wunschmoment fuer SPA [verified]" VALUE 0x7CD20 RL_VAL_SW 0 CM_0276 -3276.8 3276.7 /end CHARACTERISTIC
/begin CHARACTERISTIC K_SPA_MD_WUNSCH_REL_T "md_wunsch_rel Timedelay [verified]" VALUE 0x7CD22 RL_VAL_UW 0 CM_0247 0 655.35 /end CHARACTERISTIC
/begin CHARACTERISTIC K_SPA_BEGR_MD_WUNSCH_REL_ "Md_wunsch_rel aus Timedelay f?r Begrenzung [EST]" VALUE 0x7CD26 RL_VAL_UW 0 CM_0425 0 655.35 /end CHARACTERISTIC
/begin CHARACTERISTIC K_SPA_MD_KUPP_IST_MIN "untere Schwelle md_kupp_ist zur Plausi von B_KRAFTSCHLUSS [verified]" VALUE 0x7CD28 RL_VAL_SW 0 CM_0322 -3276.8 3276.7 /end CHARACTERISTIC
/begin CHARACTERISTIC K_SPA_MD_KUPP_IST_MAX "obere Schwelle md_kupp_ist zur Plausi von B_KRAFTSCHLUSS [verified]" VALUE 0x7CD2A RL_VAL_SW 0 CM_0322 -3276.8 3276.7 /end CHARACTERISTIC
/begin CHARACTERISTIC K_SPA_MD_KUPP_IST_T "md_kupp_ist Timedelay zur Plausi von B_KRAFTSCHLUSS [verified]" VALUE 0x7CD2C RL_VAL_UW 0 CM_0247 0 655.35 /end CHARACTERISTIC
/begin CHARACTERISTIC K_SPA_KRAFTSCHLUSS_OFF_T "B_KRAFTSCHLUSS Timedelay [verified]" VALUE 0x7CD2E RL_VAL_UW 0 CM_0247 0 655.35 /end CHARACTERISTIC
/begin CHARACTERISTIC K_SPA_N_MIN "min Schwelle Motordrehzahl zur Freischaltung SPA [verified]" VALUE 0x7CD30 RL_VAL_SW 0 CM_0002 -32768 32767 /end CHARACTERISTIC
/begin CHARACTERISTIC K_SPA_N_MAX "max Schwelle Motordrehzahl zur Freischaltung SPA [verified]" VALUE 0x7CD32 RL_VAL_SW 0 CM_0002 -32768 32767 /end CHARACTERISTIC
/begin CHARACTERISTIC K_SPA_N_T "Motordrehzahl Timedelay [verified]" VALUE 0x7CD34 RL_VAL_UW 0 CM_0247 0 655.35 /end CHARACTERISTIC
/begin CHARACTERISTIC K_SPA_V_MIN "min Schwelle Geschwindigkeit zur Freischaltung SPA [verified]" VALUE 0x7CD36 RL_VAL_SW 0 CM_0260 -2048 2047.9375 /end CHARACTERISTIC
/begin CHARACTERISTIC K_SPA_V_MAX "max Schwelle Geschwindigkeit zur Freischaltung SPA [verified]" VALUE 0x7CD38 RL_VAL_SW 0 CM_0260 -2048 2047.9375 /end CHARACTERISTIC
/begin CHARACTERISTIC K_SPA_V_T "Geschwindigkeit Timedelay [verified]" VALUE 0x7CD3A RL_VAL_UW 0 CM_0247 0 655.35 /end CHARACTERISTIC
/begin CHARACTERISTIC K_SPA_CAN_AY_MAX "Schwelle Querbeschleunigung zur Freischaltung SPA [verified]" VALUE 0x7CD3C RL_VAL_SW 0 CM_0288 -819.2 819.175 /end CHARACTERISTIC
/begin CHARACTERISTIC K_SPA_CAN_AY_T "Querbeschleunigung Timedelay [verified]" VALUE 0x7CD3E RL_VAL_UW 0 CM_0247 0 655.35 /end CHARACTERISTIC
/begin CHARACTERISTIC K_SPA_MD_IND_TZ_ST "Maske externen Momenteneingriff [verified]" VALUE 0x7CD40 RL_VAL_UW 0 CM_0000 0 65535 /end CHARACTERISTIC
/begin CHARACTERISTIC K_SPA_N_GRAD_ASP_MAX "Schwelle Absolutbetrag Drehzahlgradient (Arbeitsspiel) fuer SPA [verified]" VALUE 0x7CD42 RL_VAL_SW 0 CM_0067 -32768 32767 /end CHARACTERISTIC
/begin CHARACTERISTIC K_SPA_N_GRAD_ASP_T "Absolutbetrag Drehzahlgradient (Arbeitsspiel) Timedelay [verified]" VALUE 0x7CD44 RL_VAL_UW 0 CM_0247 0 655.35 /end CHARACTERISTIC
/begin CHARACTERISTIC K_SPA_PWG_SOLL_GRAD_POS "max positiver Gradient ausgegebener Pedalwert [verified]" VALUE 0x7CD46 RL_VAL_SW 0 CM_0426 -327680 327670 /end CHARACTERISTIC
/begin CHARACTERISTIC K_SPA_PWG_SOLL_GRAD_NEG "min negativer G radient ausgegebener Pedalwert [verified]" VALUE 0x7CD48 RL_VAL_SW 0 CM_0426 -327680 327670 /end CHARACTERISTIC
/begin CHARACTERISTIC K_SPA_PWG_SOLL_GRAD_T "ausgegebener Pedalwert Timedelay [verified]" VALUE 0x7CD4A RL_VAL_UW 0 CM_0247 0 655.35 /end CHARACTERISTIC
/begin CHARACTERISTIC K_SPA_N_BEGR_EGAS_HYS_MIN "min. Hysterese Drehzahlbegrenzung fuer HS Hinweis [EST]" VALUE 0x7CD4C RL_VAL_SW 0 CM_0002 -32768 32767 /end CHARACTERISTIC
/begin CHARACTERISTIC K_SPA_N_BEGR_EGAS_HYS_MAX "max. Hysterese Drehzahlbegrenzung fuer HS Hinweis [EST]" VALUE 0x7CD4E RL_VAL_SW 0 CM_0002 -32768 32767 /end CHARACTERISTIC
/begin CHARACTERISTIC K_SPA_N_GRAD_ASP_BERG_MAX "Dynamik-Schwelle zur Steigungserkennung [EST]" VALUE 0x7CD50 RL_VAL_SW 0 CM_0067 -32768 32767 /end CHARACTERISTIC
/begin CHARACTERISTIC K_SPA_LLR_N_SOLL_HYS "Hysterese Abstand zur Leerlaufdrehzahl [verified]" VALUE 0x7CD52 RL_VAL_SW 0 CM_0002 -32768 32767 /end CHARACTERISTIC
/begin CHARACTERISTIC K_SPA_MD_KUPP_WUNSCH_HYS "Hysterese Abstand zum Wunschmoment [verified]" VALUE 0x7CD54 RL_VAL_SW 0 CM_0322 -3276.8 3276.7 /end CHARACTERISTIC
/begin CHARACTERISTIC K_SPA_N_BEGR_EGAS_HYS "Hysterese Abstand zur max Getriebeeingangsdrehzahl [verified]" VALUE 0x7CD56 RL_VAL_SW 0 CM_0002 -32768 32767 /end CHARACTERISTIC
/begin CHARACTERISTIC K_SPA_ANZ_ON_T "B_SPA_ON Timedelay [EST]" VALUE 0x7CD58 RL_VAL_UW 0 CM_0247 0 655.35 /end CHARACTERISTIC
/begin CHARACTERISTIC K_SPA_ANZ_T "Zeitdauer fuer die Gang nach Ungueltigkeit der Anzeigebedingungen noch angezeigt wird [EST]" VALUE 0x7CD5A RL_VAL_UW 0 CM_0247 0 655.35 /end CHARACTERISTIC
/begin CHARACTERISTIC K_SPA_ANZ_GANG_CAN_OFF "Offset auf spa_begr_gang fuer CAN-Nachricht [verified]" VALUE 0x7CD5C RL_VAL_UB 0 CM_0000 0 255 /end CHARACTERISTIC
/begin CHARACTERISTIC K_SPA_ANZ_ART_RUECK "Ausgabegroesse fuer Rueckschaltung [EST]" VALUE 0x7CD5D RL_VAL_UB 0 CM_0000 0 255 /end CHARACTERISTIC
/begin CHARACTERISTIC K_SPA_ANZ_ART_HOCH "Ausgabegroesse fuer Hochschaltung [EST]" VALUE 0x7CD5E RL_VAL_UB 0 CM_0000 0 255 /end CHARACTERISTIC
/begin CHARACTERISTIC K_SPA_ANZ_ART_AUS "Artanzeige bei ausgeschalteter Schaltpunktanzeige [verified]" VALUE 0x7CD5F RL_VAL_UB 0 CM_0000 0 255 /end CHARACTERISTIC
/begin CHARACTERISTIC K_SPA_ANZ_GANG_AUS "Ganganzeige bei ausgeschalteter Schaltpunktanzeige [verified]" VALUE 0x7CD60 RL_VAL_UB 0 CM_0000 0 255 /end CHARACTERISTIC
/begin CHARACTERISTIC K_SPA_BEGR_GANG_MINUS "zugelassene Rueckschaltungen vom aktuellen Gang [verified]" VALUE 0x7CD61 RL_VAL_SB 0 CM_0015 -128 127 /end CHARACTERISTIC
/begin CHARACTERISTIC K_SPA_BEGR_GANG_PLUS "zugelassene Hochschaltungen vom aktuellen Gang [verified]" VALUE 0x7CD62 RL_VAL_SB 0 CM_0015 -128 127 /end CHARACTERISTIC
/begin CHARACTERISTIC K_SPA_BEGR_MD_WUNSCH_REL_MIN "Schwelle rel. Wunschmoment betaetigt [verified]" VALUE 0x7CD64 RL_VAL_SW 0 CM_0276 -3276.8 3276.7 /end CHARACTERISTIC
/begin CHARACTERISTIC K_SPA_BEGR_N_MAX "Drehzahlschwelle zum Abschalten des Rueckschalthinweises [EST]" VALUE 0x7CD66 RL_VAL_SW 0 CM_0002 -32768 32767 /end CHARACTERISTIC
/begin CHARACTERISTIC K_SPA_BEGR_BERG_FWST_STEIG_TAU "Fahrwiderstand durch Steigung / Gefaelle, Filterkonstante [verified]" VALUE 0x7CD6A RL_VAL_UB 0 CM_0277 0.01003921569 2.56 /end CHARACTERISTIC
/begin CHARACTERISTIC K_SPA_BEGR_BERG_FWST_STEIG_PHYS "Schwelle Umschaltung auf phys. Bergbetrachtung [verified]" VALUE 0x7CD6C RL_VAL_SL 0 CM_0322 -214748364.8 214748364.7 /end CHARACTERISTIC
/begin CHARACTERISTIC K_SPA_BEGR_BERG_FZGMASSE "Fahrzeugmasse [verified]" VALUE 0x7CD70 RL_VAL_UW 0 CM_0427 0 6553.5 /end CHARACTERISTIC
/begin CHARACTERISTIC K_LLR_N_SOLL_ABSE_GRAD "Gradient bei Absenkung aktiv [verified]" VALUE 0x76204 RL_VAL_UW 0 CM_0438 0 1310700 /end CHARACTERISTIC
/begin CHARACTERISTIC K_LLR_N_SOLL_GRAD "Gradient bei Absenkung inaktiv [verified]" VALUE 0x76206 RL_VAL_UW 0 CM_0438 0 1310700 /end CHARACTERISTIC
/begin CHARACTERISTIC K_LLR_N_SOLL_ABSE "Solldrehzahl bei Absenkung [verified]" VALUE 0x76272 RL_VAL_SW 0 CM_0002 -32768 32767 /end CHARACTERISTIC
/begin CHARACTERISTIC K_LLR_N_SOLL_PKS_PL "Solldrehzahl bei PKS-PL [verified]" VALUE 0x76274 RL_VAL_SW 0 CM_0002 -32768 32767 /end CHARACTERISTIC
/begin CHARACTERISTIC K_LLR_N_SOLL_ABSE_LRW_MAX "max. Lenkwinkel fuer Absenkung [verified]" VALUE 0x76276 RL_VAL_SW 0 CM_0220 -1440.1536 1440.10965 /end CHARACTERISTIC
/begin CHARACTERISTIC K_LLR_N_SOLL_ABSE_LRW_HYS "Lenkwinkel-Hys fuer Absenkung [verified]" VALUE 0x76278 RL_VAL_SW 0 CM_0220 -1440.1536 1440.10965 /end CHARACTERISTIC
/begin CHARACTERISTIC K_LLR_N_SOLL_ABSE_LRWV_MAX "max. Lenkgeschw. fuer Absenkung [verified]" VALUE 0x7627A RL_VAL_SW 0 CM_0373 -1440.1536 1440.10965 /end CHARACTERISTIC
/begin CHARACTERISTIC K_LLR_N_SOLL_ABSE_V_MAX "max. Geschwindigkeit fuer Absenkung [verified]" VALUE 0x7627C RL_VAL_SW 0 CM_0260 -2048 2047.9375 /end CHARACTERISTIC
/begin CHARACTERISTIC K_LLR_N_SOLL_ABSE_TSPERR "Sperrzeit [verified]" VALUE 0x7627E RL_VAL_UW 0 CM_0270 0 327.675 /end CHARACTERISTIC
/begin CHARACTERISTIC K_LLR_N_SOLL_ABSE_MD_KKOS_MAX "Schwelle fuer Klimaanforderung [verified]" VALUE 0x76280 RL_VAL_UB 0 CM_0322 0 25.5 /end CHARACTERISTIC
/begin CHARACTERISTIC K_LLR_N_SOLL_ABSE_MD_KKOS_HYS "Hysterese fuer Klimaanforderung [verified]" VALUE 0x76281 RL_VAL_UB 0 CM_0322 0 25.5 /end CHARACTERISTIC
/begin CHARACTERISTIC K_LLR_N_SOLL_ABSE_CNT_MAX "Absenkzaehler [verified]" VALUE 0x76282 RL_VAL_UB 0 CM_0000 0 255 /end CHARACTERISTIC
/begin CHARACTERISTIC K_LLR_N_SOLL_ABSE_GANG_DKG "DKG-Gangkonfiguration [verified]" VALUE 0x76283 RL_VAL_UB 0 CM_0439 0 255 /end CHARACTERISTIC
/begin CHARACTERISTIC K_LLR_N_SOLL_ABSE_TMOT_MIN "Tmot-Schwelle fuer Absenkung [verified]" VALUE 0x76284 RL_VAL_SW 0 CM_0256 -3550 3003.5 /end CHARACTERISTIC
/begin CHARACTERISTIC K_LLR_N_OFFSET_B1 "Offset fuer Start IA_B1 [verified]" VALUE 0x7620A RL_VAL_SW 0 CM_0002 -32768 32767 /end CHARACTERISTIC
/begin CHARACTERISTIC K_LLR_N_OFFSET_B2 "Offset fuer Start IA_B2 [verified]" VALUE 0x7620C RL_VAL_SW 0 CM_0002 -32768 32767 /end CHARACTERISTIC
/begin CHARACTERISTIC K_LLR_IA_B1_ABR "Absteuerrampe B1 [verified]" VALUE 0x7622A RL_VAL_UW 0 CM_0440 0 13107 /end CHARACTERISTIC
/begin CHARACTERISTIC K_LLR_IA_B2_ABR "Absteuerrampe B2 [verified]" VALUE 0x7622C RL_VAL_UW 0 CM_0440 0 13107 /end CHARACTERISTIC
/begin CHARACTERISTIC K_LLR_MD_OKS_MIN "min. I-Anteil oKS [verified]" VALUE 0x7622E RL_VAL_SW 0 CM_0322 -3276.8 3276.7 /end CHARACTERISTIC
/begin CHARACTERISTIC K_LLR_MD_OKS_MAX "max. I-Anteil oKS [verified]" VALUE 0x76230 RL_VAL_SW 0 CM_0322 -3276.8 3276.7 /end CHARACTERISTIC
/begin CHARACTERISTIC K_LLR_MD_MKS_MIN "min. I-Anteil mKS [verified]" VALUE 0x76232 RL_VAL_SW 0 CM_0322 -3276.8 3276.7 /end CHARACTERISTIC
/begin CHARACTERISTIC K_LLR_MD_MKS_MAX "max. I-Anteil mKS [verified]" VALUE 0x76234 RL_VAL_SW 0 CM_0322 -3276.8 3276.7 /end CHARACTERISTIC
/begin CHARACTERISTIC K_LLR_MD_MKS_MAX_BLS "max. I-Anteil mKS und Bremse [verified]" VALUE 0x76236 RL_VAL_SW 0 CM_0322 -3276.8 3276.7 /end CHARACTERISTIC
/begin CHARACTERISTIC K_LLR_MD_MKS_MAX_AUFR "Aufsteuerrampe Imax [verified]" VALUE 0x76288 RL_VAL_UW 0 CM_0440 0 13107 /end CHARACTERISTIC
/begin CHARACTERISTIC K_LLR_MD_MKS_MAX_ABR "Aufsteuerrampe Imax [verified]" VALUE 0x7628A RL_VAL_UW 0 CM_0440 0 13107 /end CHARACTERISTIC
/begin CHARACTERISTIC K_LLR_MD_RES_AUFR "Rampe fuer Reserve [verified]" VALUE 0x76243 RL_VAL_UB 0 CM_0068 0 255 /end CHARACTERISTIC
/begin CHARACTERISTIC K_LLR_MD_I_STOP_OKS "Stopschwelle oKS [verified]" VALUE 0x7624C RL_VAL_SW 0 CM_0322 -3276.8 3276.7 /end CHARACTERISTIC
/begin CHARACTERISTIC K_FGR_DSC_CFG "0x0 aus 0x1 ein FGR Abwurf bei DSC aus 0: FGR aus, 1: FGR ein [verified]" VALUE 0x724E0 RL_VAL_UB 0 CM_0000 0 255 /end CHARACTERISTIC
/begin CHARACTERISTIC K_FGR_CFG_VORST "0x0 Aus 0x1 Ein FGR Vorsteuerung 1: Ein, 0: Aus [verified]" VALUE 0x724E2 RL_VAL_UB 0 CM_0000 0 255 /end CHARACTERISTIC
/begin CHARACTERISTIC K_KH_MD_ETA_GRAD_START_SL "Gradient Aenderungsbegrenzung [verified]" VALUE 0x740B8 RL_VAL_UW 0 CM_0451 0 199.9969482 /end CHARACTERISTIC
/begin CHARACTERISTIC K_KH_MD_ETA_GRAD_START "Gradient Aenderungsbegrenzung [verified]" VALUE 0x740BA RL_VAL_UW 0 CM_0451 0 199.9969482 /end CHARACTERISTIC
/begin CHARACTERISTIC K_KH_MD_ETA_GRAD_LLMKS_SL "Gradient Aenderungsbegrenzung [EST]" VALUE 0x740BC RL_VAL_UW 0 CM_0451 0 199.9969482 /end CHARACTERISTIC
/begin CHARACTERISTIC K_KH_MD_ETA_GRAD_LLMKS "Gradient Aenderungsbegrenzung [EST]" VALUE 0x740BE RL_VAL_UW 0 CM_0451 0 199.9969482 /end CHARACTERISTIC
/begin CHARACTERISTIC K_KH_MD_ETA_GRAD_LLOKS_SL "Gradient Aenderungsbegrenzung [EST]" VALUE 0x740C0 RL_VAL_UW 0 CM_0451 0 199.9969482 /end CHARACTERISTIC
/begin CHARACTERISTIC K_KH_MD_ETA_GRAD_LLOKS "Gradient Aenderungsbegrenzung [EST]" VALUE 0x740C2 RL_VAL_UW 0 CM_0451 0 199.9969482 /end CHARACTERISTIC
/begin CHARACTERISTIC K_KH_MD_ETA_GRAD_TL_SL_STAT_POS "Gradient Aenderungsbegrenzung [verified]" VALUE 0x740C4 RL_VAL_UW 0 CM_0451 0 199.9969482 /end CHARACTERISTIC
/begin CHARACTERISTIC K_KH_MD_ETA_GRAD_TL_STAT_POS "Gradient Aenderungsbegrenzung [verified]" VALUE 0x740C6 RL_VAL_UW 0 CM_0451 0 199.9969482 /end CHARACTERISTIC
/begin CHARACTERISTIC K_KH_MD_ETA_GRAD_TL_SL_DYN_POS "Gradient Aenderungsbegrenzung [verified]" VALUE 0x740C8 RL_VAL_UW 0 CM_0451 0 199.9969482 /end CHARACTERISTIC
/begin CHARACTERISTIC K_KH_MD_ETA_GRAD_TL_DYN_POS "Gradient Aenderungsbegrenzung [verified]" VALUE 0x740CA RL_VAL_UW 0 CM_0451 0 199.9969482 /end CHARACTERISTIC
/begin CHARACTERISTIC K_KH_MD_ETA_GRAD_TL_SL_STAT_NEG "Gradient Aenderungsbegrenzung [verified]" VALUE 0x740CC RL_VAL_UW 0 CM_0451 0 199.9969482 /end CHARACTERISTIC
/begin CHARACTERISTIC K_KH_MD_ETA_GRAD_TL_STAT_NEG "Gradient Aenderungsbegrenzung [verified]" VALUE 0x740CE RL_VAL_UW 0 CM_0451 0 199.9969482 /end CHARACTERISTIC
/begin CHARACTERISTIC K_KH_MD_ETA_GRAD_TL_SL_DYN_NEG "Gradient Aenderungsbegrenzung [verified]" VALUE 0x740D0 RL_VAL_UW 0 CM_0451 0 199.9969482 /end CHARACTERISTIC
/begin CHARACTERISTIC K_KH_MD_ETA_GRAD_TL_DYN_NEG "Gradient Aenderungsbegrenzung [verified]" VALUE 0x740D2 RL_VAL_UW 0 CM_0451 0 199.9969482 /end CHARACTERISTIC
/begin CHARACTERISTIC K_KH_MD_ETA_GRAD_SB_SL "Gradient Aenderungsbegrenzung [EST]" VALUE 0x740D4 RL_VAL_UW 0 CM_0451 0 199.9969482 /end CHARACTERISTIC
/begin CHARACTERISTIC K_KH_MD_ETA_GRAD_SB "Gradient Aenderungsbegrenzung [EST]" VALUE 0x740D6 RL_VAL_UW 0 CM_0451 0 199.9969482 /end CHARACTERISTIC
/begin CHARACTERISTIC K_KH_MD_ETA_DIFF_LIM "Grenze: Rohwert -?nderungsbegrenzung [verified]" VALUE 0x74092 RL_VAL_UW 0 CM_0452 0 199.9969482 /end CHARACTERISTIC
/begin CHARACTERISTIC K_KH_MD_CFG "0 wunsch_ges 1 wunsch_tz Else undef Welche Wuschmoment f?r Dynamikerkennung [verified]" VALUE 0x74095 RL_VAL_UB 0 CM_0453 0 255 /end CHARACTERISTIC
/begin CHARACTERISTIC K_KH_ERW_DKG_CFG "Katheiz-Schaltprogramm [EST]" VALUE 0x74096 RL_VAL_UB 0 CM_0453 0 255 /end CHARACTERISTIC
/begin CHARACTERISTIC K_KH_MD_ETA_KORR_CFG "0 EU5-Korr aus 1 EU5- Korr normal Else ung?ltig EU5-Korrekturschalter [verified]" VALUE 0x74098 RL_VAL_UB 0 CM_0453 0 255 /end CHARACTERISTIC
/begin CHARACTERISTIC K_LLR_AD_UMSCHALT_RAMPE "Umschaltrampe [verified]" VALUE 0x769F2 RL_VAL_SW 0 CM_0459 -3276.8 3276.7 /end CHARACTERISTIC
/begin CHARACTERISTIC K_LLR_AD_NORM_MIN "Minwert normal [verified]" VALUE 0x769F4 RL_VAL_SW 0 CM_0322 -3276.8 3276.7 /end CHARACTERISTIC
/begin CHARACTERISTIC K_LLR_AD_MD_ZYKLUS_MAX "max. ?nderung pro Zyklus [verified]" VALUE 0x76A00 RL_VAL_SW 0 CM_0322 -3276.8 3276.7 /end CHARACTERISTIC
/begin CHARACTERISTIC K_LLR_AD_MD_NEUZUSTAND "Werte Neuzustand [verified]" VALUE 0x76A02 RL_VAL_SW 0 CM_0322 -3276.8 3276.7 /end CHARACTERISTIC
/begin CHARACTERISTIC K_LLR_AD_CAN_LRW "Sperre ueber Lenkwinkel [verified]" VALUE 0x76A04 RL_VAL_SW 0 CM_0220 -1440.1536 1440.10965 /end CHARACTERISTIC
/begin CHARACTERISTIC K_LLR_AD_CAN_LRW_V "Sperre ueber Lenkgeschwindigkeit [verified]" VALUE 0x76A06 RL_VAL_SW 0 CM_0373 -1440.1536 1440.10965 /end CHARACTERISTIC
/begin CHARACTERISTIC K_LLR_AD_MD_KKOS_MIN "Schwelle fuer Klimaanforderung [verified]" VALUE 0x76A08 RL_VAL_UB 0 CM_0322 0 25.5 /end CHARACTERISTIC
/begin CHARACTERISTIC K_LLR_AD_MD_KKOS_HYS "Hysterese fuer Klimaanforderung [verified]" VALUE 0x76A09 RL_VAL_UB 0 CM_0322 0 25.5 /end CHARACTERISTIC
/begin CHARACTERISTIC K_LLR_AD_V_VORNE "v-Schwelle [verified]" VALUE 0x76A0A RL_VAL_UB 0 CM_0460 0 15.9375 /end CHARACTERISTIC
/begin CHARACTERISTIC KL_SPA_SOLL_HS12 "1-2 Hochschaltschwelle Getriebeabtriebsdrehzahl [verified]" CURVE 0x7CD7A RL_CUR_SW_SW 0 CM_0002 -32768 32767 /begin AXIS_DESCR STD_AXIS NO_INPUT_QUANTITY CM_0276 6 -3276.8 3276.7 /end AXIS_DESCR /end CHARACTERISTIC
/begin CHARACTERISTIC KL_SPA_SOLL_HS23 "2-3 Hochschaltschwelle Getriebeabtriebsdrehzahl [verified]" CURVE 0x7CD94 RL_CUR_SW_SW 0 CM_0002 -32768 32767 /begin AXIS_DESCR STD_AXIS NO_INPUT_QUANTITY CM_0276 6 -3276.8 3276.7 /end AXIS_DESCR /end CHARACTERISTIC
/begin CHARACTERISTIC KL_SPA_SOLL_HS34 "3-4 Hochschaltschwelle Getriebeabtriebsdrehzahl [verified]" CURVE 0x7CDAE RL_CUR_SW_SW 0 CM_0002 -32768 32767 /begin AXIS_DESCR STD_AXIS NO_INPUT_QUANTITY CM_0276 6 -3276.8 3276.7 /end AXIS_DESCR /end CHARACTERISTIC
/begin CHARACTERISTIC KL_SPA_SOLL_HS45 "4-5 Hochschaltschwelle Getriebeabtriebsdrehzahl [verified]" CURVE 0x7CDC8 RL_CUR_SW_SW 0 CM_0002 -32768 32767 /begin AXIS_DESCR STD_AXIS NO_INPUT_QUANTITY CM_0276 6 -3276.8 3276.7 /end AXIS_DESCR /end CHARACTERISTIC
/begin CHARACTERISTIC KL_SPA_SOLL_HS56 "5-6 Hochschalt schwelle Getriebeabtriebsdrehzahl [verified]" CURVE 0x7CDE2 RL_CUR_SW_SW 0 CM_0002 -32768 32767 /begin AXIS_DESCR STD_AXIS NO_INPUT_QUANTITY CM_0276 6 -3276.8 3276.7 /end AXIS_DESCR /end CHARACTERISTIC
/begin CHARACTERISTIC KL_SPA_SOLL_HSHYS12 "1-2 Hochschalthysterese Getriebeabtriebsdrehzahl [verified]" CURVE 0x7CDFC RL_CUR_SW_SW 0 CM_0002 -32768 32767 /begin AXIS_DESCR STD_AXIS NO_INPUT_QUANTITY CM_0276 6 -3276.8 3276.7 /end AXIS_DESCR /end CHARACTERISTIC
/begin CHARACTERISTIC KL_SPA_SOLL_HSHYS23 "2-3 Hochschalthysterese Getriebeabtriebsdrehzahl [verified]" CURVE 0x7CE16 RL_CUR_SW_SW 0 CM_0002 -32768 32767 /begin AXIS_DESCR STD_AXIS NO_INPUT_QUANTITY CM_0276 6 -3276.8 3276.7 /end AXIS_DESCR /end CHARACTERISTIC
/begin CHARACTERISTIC KL_SPA_SOLL_HSHYS34 "3-4 Hochschalthysterese Getriebeabtriebsdrehzahl [verified]" CURVE 0x7CE30 RL_CUR_SW_SW 0 CM_0002 -32768 32767 /begin AXIS_DESCR STD_AXIS NO_INPUT_QUANTITY CM_0276 6 -3276.8 3276.7 /end AXIS_DESCR /end CHARACTERISTIC
/begin CHARACTERISTIC KL_SPA_SOLL_HSHYS45 "4-5 Hochschalthysterese Getriebeabtriebsdrehzahl [verified]" CURVE 0x7CE4A RL_CUR_SW_SW 0 CM_0002 -32768 32767 /begin AXIS_DESCR STD_AXIS NO_INPUT_QUANTITY CM_0276 6 -3276.8 3276.7 /end AXIS_DESCR /end CHARACTERISTIC
/begin CHARACTERISTIC KL_SPA_SOLL_HSHYS56 "5-6 Hochschalthysterese Getriebeabtriebsdrehzahl [verified]" CURVE 0x7CE64 RL_CUR_SW_SW 0 CM_0002 -32768 32767 /begin AXIS_DESCR STD_AXIS NO_INPUT_QUANTITY CM_0276 6 -3276.8 3276.7 /end AXIS_DESCR /end CHARACTERISTIC
/begin CHARACTERISTIC KL_SPA_SOLL_RS21 "2-1 Rueckschaltschwelle Getriebeabtriebsdrehzahl [verified]" CURVE 0x7CE7E RL_CUR_SW_SW 0 CM_0002 -32768 32767 /begin AXIS_DESCR STD_AXIS NO_INPUT_QUANTITY CM_0276 4 -3276.8 3276.7 /end AXIS_DESCR /end CHARACTERISTIC
/begin CHARACTERISTIC KL_SPA_SOLL_RS32 "3-2 Rueckschaltschwelle Getriebeabtriebsdrehzahl [verified]" CURVE 0x7CE90 RL_CUR_SW_SW 0 CM_0002 -32768 32767 /begin AXIS_DESCR STD_AXIS NO_INPUT_QUANTITY CM_0276 4 -3276.8 3276.7 /end AXIS_DESCR /end CHARACTERISTIC
/begin CHARACTERISTIC KL_SPA_SOLL_RS43 "4-3 Rueckschaltschwelle Getriebeabtriebsdrehzahl [verified]" CURVE 0x7CEA2 RL_CUR_SW_SW 0 CM_0002 -32768 32767 /begin AXIS_DESCR STD_AXIS NO_INPUT_QUANTITY CM_0276 4 -3276.8 3276.7 /end AXIS_DESCR /end CHARACTERISTIC
/begin CHARACTERISTIC KL_SPA_SOLL_RS54 "5-4 Rueckschaltschwelle Getriebeabtriebsdrehzahl [verified]" CURVE 0x7CEB4 RL_CUR_SW_SW 0 CM_0002 -32768 32767 /begin AXIS_DESCR STD_AXIS NO_INPUT_QUANTITY CM_0276 4 -3276.8 3276.7 /end AXIS_DESCR /end CHARACTERISTIC
/begin CHARACTERISTIC KL_SPA_SOLL_RS65 "6-5 Rueckschaltschwelle Getriebeabtriebsdrehzahl [verified]" CURVE 0x7CEC6 RL_CUR_SW_SW 0 CM_0002 -32768 32767 /begin AXIS_DESCR STD_AXIS NO_INPUT_QUANTITY CM_0276 4 -3276.8 3276.7 /end AXIS_DESCR /end CHARACTERISTIC
/begin CHARACTERISTIC KL_SPA_SOLL_RSHYS21 "2-1 Rueckschalthysterese Getriebeabtriebsdrehzahl [verified]" CURVE 0x7CED8 RL_CUR_SW_SW 0 CM_0002 -32768 32767 /begin AXIS_DESCR STD_AXIS NO_INPUT_QUANTITY CM_0276 4 -3276.8 3276.7 /end AXIS_DESCR /end CHARACTERISTIC
/begin CHARACTERISTIC KL_SPA_SOLL_RSHYS32 "3-2 Rueckschalthysterese Getriebeabtriebsdrehzahl [verified]" CURVE 0x7CEEA RL_CUR_SW_SW 0 CM_0002 -32768 32767 /begin AXIS_DESCR STD_AXIS NO_INPUT_QUANTITY CM_0276 4 -3276.8 3276.7 /end AXIS_DESCR /end CHARACTERISTIC
/begin CHARACTERISTIC KL_SPA_SOLL_RSHYS43 "4-3 Rueckschalthysterese Getriebeabtriebsdrehzahl [verified]" CURVE 0x7CEFC RL_CUR_SW_SW 0 CM_0002 -32768 32767 /begin AXIS_DESCR STD_AXIS NO_INPUT_QUANTITY CM_0276 4 -3276.8 3276.7 /end AXIS_DESCR /end CHARACTERISTIC
/begin CHARACTERISTIC KL_SPA_SOLL_RSHYS54 "5-4 Rueckschalthysterese Getriebeabtriebsdrehzahl [verified]" CURVE 0x7CF0E RL_CUR_SW_SW 0 CM_0002 -32768 32767 /begin AXIS_DESCR STD_AXIS NO_INPUT_QUANTITY CM_0276 4 -3276.8 3276.7 /end AXIS_DESCR /end CHARACTERISTIC
/begin CHARACTERISTIC KL_SPA_SOLL_RSHYS65 "6-5 Rueckschalthysterese Getriebeabtriebsdrehzahl [verified]" CURVE 0x7CF20 RL_CUR_SW_SW 0 CM_0002 -32768 32767 /begin AXIS_DESCR STD_AXIS NO_INPUT_QUANTITY CM_0276 4 -3276.8 3276.7 /end AXIS_DESCR /end CHARACTERISTIC
/begin CHARACTERISTIC KL_SPA_SOLL_N_GETR_ABTRIEB_OFF_KATH_HS "Offset Getriebeabtriebsdrehzahl zum Katheizen [verified]" CURVE 0x7CF32 RL_CUR_UB_SW 0 CM_0002 -32768 32767 /begin AXIS_DESCR STD_AXIS NO_INPUT_QUANTITY CM_0000 6 0 255 /end AXIS_DESCR /end CHARACTERISTIC
/begin CHARACTERISTIC KL_SPA_SOLL_N_GETR_ABTRIEB_OFF_KATH_F_TMOT_HS "KL_SPA_SOLL_N_GETR_ABTRIEB_OFF_KATH_F_TMOT_HS [verified]" CURVE 0x7CF46 RL_CUR_SW_SB 0 CM_0461 -128 127 /begin AXIS_DESCR STD_AXIS NO_INPUT_QUANTITY CM_0006 8 -3550 3003.5 /end AXIS_DESCR /end CHARACTERISTIC
/begin CHARACTERISTIC KL_SPA_SOLL_N_GETR_ABTRIEB_OFF_F_LAST_HS "Wichtungsfaktor fuer HS -Schaltpunktverschiebung [verified]" CURVE 0x7CF60 RL_CUR_SW_SB 0 CM_0461 -128 127 /begin AXIS_DESCR STD_AXIS NO_INPUT_QUANTITY CM_0276 6 -3276.8 3276.7 /end AXIS_DESCR /end CHARACTERISTIC
/begin CHARACTERISTIC KL_SPA_MD_KUPP_MAX "max Kupplungsmoment [verified]" CURVE 0x7CF74 RL_CUR_SW_SW 0 CM_0322 -3276.8 3276.7 /begin AXIS_DESCR STD_AXIS NO_INPUT_QUANTITY CM_0002 11 -32768 32767 /end AXIS_DESCR /end CHARACTERISTIC
/begin CHARACTERISTIC KL_SPA_MD_KUPP_MAX_HYS "Hysterese max Kupplungsmoment [verified]" CURVE 0x7CFA2 RL_CUR_SW_SW 0 CM_0322 -3276.8 3276.7 /begin AXIS_DESCR STD_AXIS NO_INPUT_QUANTITY CM_0002 6 -32768 32767 /end AXIS_DESCR /end CHARACTERISTIC
/begin CHARACTERISTIC KL_SPA_BEGR_BERG_FWST_EBENE "Fahrwiderstand in der Ebene [verified]" CURVE 0x7CFBC RL_CUR_SW_SW 0 CM_0322 -3276.8 3276.7 /begin AXIS_DESCR STD_AXIS NO_INPUT_QUANTITY CM_0260 12 -2048 2047.9375 /end AXIS_DESCR /end CHARACTERISTIC
/begin CHARACTERISTIC KL_SPA_BEGR_BERG_GANG "max zulaessiger Gang aus Fahrwiderstand [verified]" CURVE 0x7CFEE RL_CUR_SW_SB 0 CM_0015 -128 127 /begin AXIS_DESCR STD_AXIS NO_INPUT_QUANTITY CM_0322 8 -3276.8 3276.7 /end AXIS_DESCR /end CHARACTERISTIC
/begin CHARACTERISTIC KF_SPA_SOLL_N_GETR_ABTRIEB_ "OFF_PUMG_HS [EST]" MAP 0x7D030 RL_MAP_SW_SW_SW 0 CM_0002 -32768 32767 /begin AXIS_DESCR STD_AXIS NO_INPUT_QUANTITY CM_0000 6 -32768 32767 /end AXIS_DESCR /begin AXIS_DESCR STD_AXIS NO_INPUT_QUANTITY CM_0291 4 -2048 2047.9375 /end AXIS_DESCR /end CHARACTERISTIC
/begin COMPU_METHOD CM_0000 "X" RAT_FUNC "%.4g" "-" COEFFS 0 1 0 0 0 1 /end COMPU_METHOD
/begin COMPU_METHOD CM_0001 "X*0.01952206" RAT_FUNC "%.4g" "nSs" COEFFS 0 1 0 0 0 0.01952206 /end COMPU_METHOD
/begin COMPU_METHOD CM_0002 "X" RAT_FUNC "%.4g" "Upm" COEFFS 0 1 0 0 0 1 /end COMPU_METHOD
/begin COMPU_METHOD CM_0003 "X*0.0001" RAT_FUNC "%.4g" "-" COEFFS 0 1 0 0 0 0.0001 /end COMPU_METHOD
/begin COMPU_METHOD CM_0004 "X*0.0001428571" RAT_FUNC "%.4g" "ms" COEFFS 0 1 0 0 0 0.0001428571 /end COMPU_METHOD
/begin COMPU_METHOD CM_0005 "X*0.0061035156" RAT_FUNC "%.4g" "%" COEFFS 0 1 0 0 0 0.0061035156 /end COMPU_METHOD
/begin COMPU_METHOD CM_0006 "X*0.1-273.2" RAT_FUNC "%.4g" "?C" COEFFS 0 1 273.2 0 0 0.1 /end COMPU_METHOD
/begin COMPU_METHOD CM_0007 "X*20.0" RAT_FUNC "%.4g" "Nm/s" COEFFS 0 1 0 0 0 20 /end COMPU_METHOD
/begin COMPU_METHOD CM_0009 "X*0.0039215686" RAT_FUNC "%.4g" "-" COEFFS 0 1 0 0 0 0.0039215686 /end COMPU_METHOD
/begin COMPU_METHOD CM_0010 "X*0.0625" RAT_FUNC "%.4g" "km/h" COEFFS 0 1 0 0 0 0.0625 /end COMPU_METHOD
/begin COMPU_METHOD CM_0013 "X*0.1" RAT_FUNC "%.4g" "%" COEFFS 0 1 0 0 0 0.1 /end COMPU_METHOD
/begin COMPU_METHOD CM_0015 "X" RAT_FUNC "%.4g" ".Gang" COEFFS 0 1 0 0 0 1 /end COMPU_METHOD
/begin COMPU_METHOD CM_0016 "X*0.0009765625" RAT_FUNC "%.4g" "-" COEFFS 0 1 0 0 0 0.0009765625 /end COMPU_METHOD
/begin COMPU_METHOD CM_0017 "X*0.1" RAT_FUNC "%.4g" "Nm" COEFFS 0 1 0 0 0 0.1 /end COMPU_METHOD
/begin COMPU_METHOD CM_0019 "X*0.0000610352" RAT_FUNC "%.4g" "-" COEFFS 0 1 0 0 0 6.10352e-05 /end COMPU_METHOD
/begin COMPU_METHOD CM_0020 "X*0.005" RAT_FUNC "%.4g" "s" COEFFS 0 1 0 0 0 0.005 /end COMPU_METHOD
/begin COMPU_METHOD CM_0021 "X*0.1" RAT_FUNC "%.4g" "V" COEFFS 0 1 0 0 0 0.1 /end COMPU_METHOD
/begin COMPU_METHOD CM_0022 "X*0.0625" RAT_FUNC "%.4g" "mbar" COEFFS 0 1 0 0 0 0.0625 /end COMPU_METHOD
/begin COMPU_METHOD CM_0023 "X*0.1" RAT_FUNC "%.4g" "s" COEFFS 0 1 0 0 0 0.1 /end COMPU_METHOD
/begin COMPU_METHOD CM_0024 "X*0.1" RAT_FUNC "%.4g" "Kelvin" COEFFS 0 1 0 0 0 0.1 /end COMPU_METHOD
/begin COMPU_METHOD CM_0025 "X*0.01" RAT_FUNC "%.4g" "s" COEFFS 0 1 0 0 0 0.01 /end COMPU_METHOD
/begin COMPU_METHOD CM_0026 "X*0.78125" RAT_FUNC "%.4g" "%" COEFFS 0 1 0 0 0 0.78125 /end COMPU_METHOD
/begin COMPU_METHOD CM_0027 "X" RAT_FUNC "%.4g" "s" COEFFS 0 1 0 0 0 1 /end COMPU_METHOD
/begin COMPU_METHOD CM_0034 "X*0.0015625" RAT_FUNC "%.4g" "%/km/h" COEFFS 0 1 0 0 0 0.0015625 /end COMPU_METHOD
/begin COMPU_METHOD CM_0035 "X*0.0015625" RAT_FUNC "%.4g" "sek" COEFFS 0 1 0 0 0 0.0015625 /end COMPU_METHOD
/begin COMPU_METHOD CM_0036 "X*0.0015625" RAT_FUNC "%.4g" "%" COEFFS 0 1 0 0 0 0.0015625 /end COMPU_METHOD
/begin COMPU_METHOD CM_0037 "X*0.0078125" RAT_FUNC "%.4g" "-" COEFFS 0 1 0 0 0 0.0078125 /end COMPU_METHOD
/begin COMPU_METHOD CM_0038 "X*0.0078125" RAT_FUNC "%.4g" "sek" COEFFS 0 1 0 0 0 0.0078125 /end COMPU_METHOD
/begin COMPU_METHOD CM_0039 "X*0.01" RAT_FUNC "%.4g" "-" COEFFS 0 1 0 0 0 0.01 /end COMPU_METHOD
/begin COMPU_METHOD CM_0040 "X*0.1" RAT_FUNC "%.4g" "-" COEFFS 0 1 0 0 0 0.1 /end COMPU_METHOD
/begin COMPU_METHOD CM_0041 "X*0.1" RAT_FUNC "%.4g" "%/sek" COEFFS 0 1 0 0 0 0.1 /end COMPU_METHOD
/begin COMPU_METHOD CM_0042 "X*0.025" RAT_FUNC "%.4g" "m/(s*s)" COEFFS 0 1 0 0 0 0.025 /end COMPU_METHOD
/begin COMPU_METHOD CM_0043 "X*0.0000038147" RAT_FUNC "%.4g" "-" COEFFS 0 1 0 0 0 3.8147e-06 /end COMPU_METHOD
/begin COMPU_METHOD CM_0044 "X*0.01" RAT_FUNC "%.4g" "%" COEFFS 0 1 0 0 0 0.01 /end COMPU_METHOD
/begin COMPU_METHOD CM_0045 "X*0.0625" RAT_FUNC "%.4g" "mph" COEFFS 0 1 0 0 0 0.0625 /end COMPU_METHOD
/begin COMPU_METHOD CM_0046 "X*0.01" RAT_FUNC "%.4g" "sek" COEFFS 0 1 0 0 0 0.01 /end COMPU_METHOD
/begin COMPU_METHOD CM_0050 "X*0.0030517578" RAT_FUNC "%.4g" "%" COEFFS 0 1 0 0 0 0.0030517578 /end COMPU_METHOD
/begin COMPU_METHOD CM_0051 "X*0.0000305176" RAT_FUNC "%.4g" "-" COEFFS 0 1 0 0 0 3.05176e-05 /end COMPU_METHOD
/begin COMPU_METHOD CM_0052 "X*10.0" RAT_FUNC "%.4g" "ms" COEFFS 0 1 0 0 0 10 /end COMPU_METHOD
/begin COMPU_METHOD CM_0054 "X*0.00080566" RAT_FUNC "%.4g" "V" COEFFS 0 1 0 0 0 0.00080566 /end COMPU_METHOD
/begin COMPU_METHOD CM_0059 "X*4" RAT_FUNC "%.4g" "km" COEFFS 0 1 0 0 0 4 /end COMPU_METHOD
/begin COMPU_METHOD CM_0060 "X*0.0166666667" RAT_FUNC "%.4g" "min" COEFFS 0 1 0 0 0 0.0166666667 /end COMPU_METHOD
/begin COMPU_METHOD CM_0061 "X*0.0109863281" RAT_FUNC "%.4g" "?KW" COEFFS 0 1 0 0 0 0.0109863281 /end COMPU_METHOD
/begin COMPU_METHOD CM_0063 "X*0.01" RAT_FUNC "%.4g" "Nm/Upm" COEFFS 0 1 0 0 0 0.01 /end COMPU_METHOD
/begin COMPU_METHOD CM_0064 "X*0.001" RAT_FUNC "%.4g" "s" COEFFS 0 1 0 0 0 0.001 /end COMPU_METHOD
/begin COMPU_METHOD CM_0065 "1.28/X" RAT_FUNC "%.4g" "s" COEFFS 0 0 -1.28 0 -1 0 /end COMPU_METHOD
/begin COMPU_METHOD CM_0067 "X" RAT_FUNC "%.4g" "Upm/s" COEFFS 0 1 0 0 0 1 /end COMPU_METHOD
/begin COMPU_METHOD CM_0068 "X" RAT_FUNC "%.4g" "Nm/s" COEFFS 0 1 0 0 0 1 /end COMPU_METHOD
/begin COMPU_METHOD CM_0073 "X*0.1" RAT_FUNC "%.4g" "Nm/s" COEFFS 0 1 0 0 0 0.1 /end COMPU_METHOD
/begin COMPU_METHOD CM_0081 "X*10" RAT_FUNC "%.4g" "Upm/s" COEFFS 0 1 0 0 0 10 /end COMPU_METHOD
/begin COMPU_METHOD CM_0082 "X" RAT_FUNC "%.4g" "km" COEFFS 0 1 0 0 0 1 /end COMPU_METHOD
/begin COMPU_METHOD CM_0083 "X*100.0" RAT_FUNC "%.4g" "Upm/s" COEFFS 0 1 0 0 0 100 /end COMPU_METHOD
/begin COMPU_METHOD CM_0084 "X*6.0" RAT_FUNC "%.4g" "us" COEFFS 0 1 0 0 0 6 /end COMPU_METHOD
/begin COMPU_METHOD CM_0087 "X" RAT_FUNC "%.4g" "digit" COEFFS 0 1 0 0 0 1 /end COMPU_METHOD
/begin COMPU_METHOD CM_0088 "X*10.0" RAT_FUNC "%.4g" "Nm/s" COEFFS 0 1 0 0 0 10 /end COMPU_METHOD
/begin COMPU_METHOD CM_0089 "X*0.0001" RAT_FUNC "%.4g" "Nms/Upm" COEFFS 0 1 0 0 0 0.0001 /end COMPU_METHOD
/begin COMPU_METHOD CM_0090 "X*0.0078125+1.0" RAT_FUNC "%.4g" "-" COEFFS 0 1 -1 0 0 0.0078125 /end COMPU_METHOD
/begin COMPU_METHOD CM_0091 "X*0.09765625" RAT_FUNC "%.4g" "%" COEFFS 0 1 0 0 0 0.09765625 /end COMPU_METHOD
/begin COMPU_METHOD CM_0092 "X*0.78125" RAT_FUNC "%.4g" "%FW" COEFFS 0 1 0 0 0 0.78125 /end COMPU_METHOD
/begin COMPU_METHOD CM_0093 "X*0.78125" RAT_FUNC "%.4g" "%t_END" COEFFS 0 1 0 0 0 0.78125 /end COMPU_METHOD
/begin COMPU_METHOD CM_0094 "X*0.0078125" RAT_FUNC "%.4g" "2" COEFFS 0 1 0 0 0 0.0078125 /end COMPU_METHOD
/begin COMPU_METHOD CM_0095 "X*0.001" RAT_FUNC "%.4g" "Nms/Upm" COEFFS 0 1 0 0 0 0.001 /end COMPU_METHOD
/begin COMPU_METHOD CM_0096 "X*0.0078125" RAT_FUNC "%.4g" "Nms2" COEFFS 0 1 0 0 0 0.0078125 /end COMPU_METHOD
/begin COMPU_METHOD CM_0097 "X*0.1" RAT_FUNC "%.4g" "Nm/Upm" COEFFS 0 1 0 0 0 0.1 /end COMPU_METHOD
/begin COMPU_METHOD CM_0098 "X" RAT_FUNC "%.4g" "Prog" COEFFS 0 1 0 0 0 1 /end COMPU_METHOD
/begin COMPU_METHOD CM_0099 "X*0.001" RAT_FUNC "%.4g" "Nm/Upm" COEFFS 0 1 0 0 0 0.001 /end COMPU_METHOD
/begin COMPU_METHOD CM_0100 "X" RAT_FUNC "%.4g" ".Prog" COEFFS 0 1 0 0 0 1 /end COMPU_METHOD
/begin COMPU_METHOD CM_0101 "X" RAT_FUNC "%.4g" "cm" COEFFS 0 1 0 0 0 1 /end COMPU_METHOD
/begin COMPU_METHOD CM_0102 "X*0.1" RAT_FUNC "%.4g" "kg/h" COEFFS 0 1 0 0 0 0.1 /end COMPU_METHOD
/begin COMPU_METHOD CM_0106 "X" RAT_FUNC "%.4g" "raw" COEFFS 0 1 0 0 0 1 /end COMPU_METHOD
/begin COMPU_METHOD CM_0107 "X*0.025-273.15" RAT_FUNC "%.4g" "?C" COEFFS 0 1 273.15 0 0 0.025 /end COMPU_METHOD
/begin COMPU_METHOD CM_0108 "X" RAT_FUNC "%.4g" "min" COEFFS 0 1 0 0 0 1 /end COMPU_METHOD
/begin COMPU_METHOD CM_0109 "X*0.0001" RAT_FUNC "%.4g" "Kelvin" COEFFS 0 1 0 0 0 0.0001 /end COMPU_METHOD
/begin COMPU_METHOD CM_0110 "X*0.01" RAT_FUNC "%.4g" "Anteil [0..1]" COEFFS 0 1 0 0 0 0.01 /end COMPU_METHOD
/begin COMPU_METHOD CM_0112 "X*1.1428571429" RAT_FUNC "%.4g" "us" COEFFS 0 1 0 0 0 1.142857143 /end COMPU_METHOD
/begin COMPU_METHOD CM_0113 "X*0.025" RAT_FUNC "%.4g" "Kelvin" COEFFS 0 1 0 0 0 0.025 /end COMPU_METHOD
/begin COMPU_METHOD CM_0114 "X*0.025-273.2" RAT_FUNC "%.4g" "?C" COEFFS 0 1 273.2 0 0 0.025 /end COMPU_METHOD
/begin COMPU_METHOD CM_0116 "X*0.00155892" RAT_FUNC "%.4g" "V" COEFFS 0 1 0 0 0 0.00155892 /end COMPU_METHOD
/begin COMPU_METHOD CM_0117 "X*0.00155892" RAT_FUNC "%.4g" "V/5ms" COEFFS 0 1 0 0 0 0.00155892 /end COMPU_METHOD
/begin COMPU_METHOD CM_0118 "X*0.0065104167" RAT_FUNC "%.4g" "V" COEFFS 0 1 0 0 0 0.0065104167 /end COMPU_METHOD
/begin COMPU_METHOD CM_0164 "X*0.00390625" RAT_FUNC "%.4g" "-" COEFFS 0 1 0 0 0 0.00390625 /end COMPU_METHOD
/begin COMPU_METHOD CM_0176 "X*0.0488281250" RAT_FUNC "%.4g" "%" COEFFS 0 1 0 0 0 0.048828125 /end COMPU_METHOD
/begin COMPU_METHOD CM_0220 "X*0.04395" RAT_FUNC "%.4g" "Grad" COEFFS 0 1 0 0 0 0.04395 /end COMPU_METHOD
/begin COMPU_METHOD CM_0233 "X/60" RAT_FUNC "%.4g" "min" COEFFS 0 60 0 0 0 1 /end COMPU_METHOD
/begin COMPU_METHOD CM_0235 "X" RAT_FUNC "%.4g" "rpm" COEFFS 0 1 0 0 0 1 /end COMPU_METHOD
/begin COMPU_METHOD CM_0236 "X*0.00006103515625" RAT_FUNC "%.4g" "-" COEFFS 0 1 0 0 0 6.103515625e-05 /end COMPU_METHOD
/begin COMPU_METHOD CM_0238 "X*2" RAT_FUNC "%.4g" "km" COEFFS 0 1 0 0 0 2 /end COMPU_METHOD
/begin COMPU_METHOD CM_0245 "X*32/32768" RAT_FUNC "%.4g" "-" COEFFS 0 1024 0 0 0 1 /end COMPU_METHOD
/begin COMPU_METHOD CM_0247 "X/100" RAT_FUNC "%.4g" "s" COEFFS 0 100 0 0 0 1 /end COMPU_METHOD
/begin COMPU_METHOD CM_0256 "(X-2732)/10" RAT_FUNC "%.4g" "?C" COEFFS 0 10 2732 0 0 1 /end COMPU_METHOD
/begin COMPU_METHOD CM_0258 "X*0.1-273.2" RAT_FUNC "%.4g" "degC" COEFFS 0 1 273.2 0 0 0.1 /end COMPU_METHOD
/begin COMPU_METHOD CM_0259 "X/16384" RAT_FUNC "%.4g" "-" COEFFS 0 16384 0 0 0 1 /end COMPU_METHOD
/begin COMPU_METHOD CM_0260 "X/16" RAT_FUNC "%.4g" "km/h" COEFFS 0 16 0 0 0 1 /end COMPU_METHOD
/begin COMPU_METHOD CM_0270 "X/200" RAT_FUNC "%.4g" "s" COEFFS 0 200 0 0 0 1 /end COMPU_METHOD
/begin COMPU_METHOD CM_0271 "X*100/32768" RAT_FUNC "%.4g" "%" COEFFS 0 8192 0 0 0 25 /end COMPU_METHOD
/begin COMPU_METHOD CM_0272 "X*0.1" RAT_FUNC "%.4g" "K" COEFFS 0 1 0 0 0 0.1 /end COMPU_METHOD
/begin COMPU_METHOD CM_0276 "X/10" RAT_FUNC "%.4g" "%" COEFFS 0 10 0 0 0 1 /end COMPU_METHOD
/begin COMPU_METHOD CM_0277 "2.56/X" RAT_FUNC "%.4g" "s" COEFFS 0 0 -2.56 0 -1 0 /end COMPU_METHOD
/begin COMPU_METHOD CM_0283 "X/16384" RAT_FUNC "%.4g" "km/h" COEFFS 0 16384 0 0 0 1 /end COMPU_METHOD
/begin COMPU_METHOD CM_0284 "X/255" RAT_FUNC "%.4g" "-" COEFFS 0 255 0 0 0 1 /end COMPU_METHOD
/begin COMPU_METHOD CM_0285 "X" RAT_FUNC "%.4g" "Anzahl" COEFFS 0 1 0 0 0 1 /end COMPU_METHOD
/begin COMPU_METHOD CM_0286 "655.35/X" RAT_FUNC "%.4g" "s" COEFFS 0 0 -655.35 0 -1 0 /end COMPU_METHOD
/begin COMPU_METHOD CM_0287 "X/4000" RAT_FUNC "%.4g" "m/(s*s)" COEFFS 0 4000 0 0 0 1 /end COMPU_METHOD
/begin COMPU_METHOD CM_0288 "X/40" RAT_FUNC "%.4g" "m/(s*s)" COEFFS 0 40 0 0 0 1 /end COMPU_METHOD
/begin COMPU_METHOD CM_0289 "X/10" RAT_FUNC "%.4g" "%/s" COEFFS 0 10 0 0 0 1 /end COMPU_METHOD
/begin COMPU_METHOD CM_0290 "X" RAT_FUNC "%.4g" "kg" COEFFS 0 1 0 0 0 1 /end COMPU_METHOD
/begin COMPU_METHOD CM_0291 "X/16" RAT_FUNC "%.4g" "mbar" COEFFS 0 16 0 0 0 1 /end COMPU_METHOD
/begin COMPU_METHOD CM_0305 "X/4" RAT_FUNC "%.4g" "K/s" COEFFS 0 4 0 0 0 1 /end COMPU_METHOD
/begin COMPU_METHOD CM_0306 "25.6/X" RAT_FUNC "%.4g" "s" COEFFS 0 0 -25.6 0 -1 0 /end COMPU_METHOD
/begin COMPU_METHOD CM_0307 "X/32768" RAT_FUNC "%.4g" "-" COEFFS 0 32768 0 0 0 1 /end COMPU_METHOD
/begin COMPU_METHOD CM_0320 "X/1024" RAT_FUNC "%.4g" "m" COEFFS 0 1024 0 0 0 1 /end COMPU_METHOD
/begin COMPU_METHOD CM_0322 "X/10" RAT_FUNC "%.4g" "Nm" COEFFS 0 10 0 0 0 1 /end COMPU_METHOD
/begin COMPU_METHOD CM_0323 "X/10" RAT_FUNC "%.4g" "Kelvin" COEFFS 0 10 0 0 0 1 /end COMPU_METHOD
/begin COMPU_METHOD CM_0324 "6553.5/X" RAT_FUNC "%.4g" "s" COEFFS 0 0 -6553.5 0 -1 0 /end COMPU_METHOD
/begin COMPU_METHOD CM_0343 "X*0.89" RAT_FUNC "%.4g" "mA" COEFFS 0 1 0 0 0 0.89 /end COMPU_METHOD
/begin COMPU_METHOD CM_0345 "X" RAT_FUNC "%.4g" "Dig/mA" COEFFS 0 1 0 0 0 1 /end COMPU_METHOD
/begin COMPU_METHOD CM_0346 "X*20" RAT_FUNC "%.4g" "ms/mA" COEFFS 0 1 0 0 0 20 /end COMPU_METHOD
/begin COMPU_METHOD CM_0347 "10240/X" RAT_FUNC "%.4g" "ms" COEFFS 0 0 -10240 0 -1 0 /end COMPU_METHOD
/begin COMPU_METHOD CM_0371 "X*89" RAT_FUNC "%.4g" "mA/s" COEFFS 0 1 0 0 0 89 /end COMPU_METHOD
/begin COMPU_METHOD CM_0372 "X" RAT_FUNC "%.4g" "can_lrw[6]" COEFFS 0 1 0 0 0 1 /end COMPU_METHOD
/begin COMPU_METHOD CM_0373 "X*0.04395" RAT_FUNC "%.4g" "Grad/s" COEFFS 0 1 0 0 0 0.04395 /end COMPU_METHOD
/begin COMPU_METHOD CM_0377 "X*0.006103515625" RAT_FUNC "%.4g" "%" COEFFS 0 1 0 0 0 0.006103515625 /end COMPU_METHOD
/begin COMPU_METHOD CM_0381 "X*6.103515625e-05" RAT_FUNC "%.4g" "-/seg(144???KW)" COEFFS 0 1 0 0 0 6.103515625e-05 /end COMPU_METHOD
/begin COMPU_METHOD CM_0382 "X*200" RAT_FUNC "%.4g" "Upm/s" COEFFS 0 1 0 0 0 200 /end COMPU_METHOD
/begin COMPU_METHOD CM_0383 "X*0.0005" RAT_FUNC "%.4g" "Nm/s" COEFFS 0 1 0 0 0 0.0005 /end COMPU_METHOD
/begin COMPU_METHOD CM_0390 "X*0.25-273.15" RAT_FUNC "%.4g" "???C/s" COEFFS 0 1 273.15 0 0 0.25 /end COMPU_METHOD
/begin COMPU_METHOD CM_0424 "256/X" RAT_FUNC "%.4g" "s" COEFFS 0 0 -256 0 -1 0 /end COMPU_METHOD
/begin COMPU_METHOD CM_0425 "X/100" RAT_FUNC "%.4g" "OFF_T" COEFFS 0 100 0 0 0 1 /end COMPU_METHOD
/begin COMPU_METHOD CM_0426 "X*10" RAT_FUNC "%.4g" "%/s" COEFFS 0 1 0 0 0 10 /end COMPU_METHOD
/begin COMPU_METHOD CM_0427 "X/10" RAT_FUNC "%.4g" "kg" COEFFS 0 10 0 0 0 1 /end COMPU_METHOD
/begin COMPU_METHOD CM_0438 "X*20" RAT_FUNC "%.4g" "Upm/s" COEFFS 0 1 0 0 0 20 /end COMPU_METHOD
/begin COMPU_METHOD CM_0439 "X" RAT_FUNC "%.4g" "Bitcodiert" COEFFS 0 1 0 0 0 1 /end COMPU_METHOD
/begin COMPU_METHOD CM_0440 "X/5" RAT_FUNC "%.4g" "Nm/s" COEFFS 0 5 0 0 0 1 /end COMPU_METHOD
/begin COMPU_METHOD CM_0451 "X*100/32768" RAT_FUNC "%.4g" "%/5ms" COEFFS 0 8192 0 0 0 25 /end COMPU_METHOD
/begin COMPU_METHOD CM_0452 "X*100/32768" RAT_FUNC "%.4g" "DIFF_LIM" COEFFS 0 8192 0 0 0 25 /end COMPU_METHOD
/begin COMPU_METHOD CM_0453 "X" RAT_FUNC "%.4g" "[-]" COEFFS 0 1 0 0 0 1 /end COMPU_METHOD
/begin COMPU_METHOD CM_0459 "X/10" RAT_FUNC "%.4g" "Nm/s" COEFFS 0 10 0 0 0 1 /end COMPU_METHOD
/begin COMPU_METHOD CM_0460 "X/16" RAT_FUNC "%.4g" "Km/h" COEFFS 0 16 0 0 0 1 /end COMPU_METHOD
/begin COMPU_METHOD CM_0461 "X" RAT_FUNC "%.4g" "kl_spa_soll_n_getr_a" COEFFS 0 1 0 0 0 1 /end COMPU_METHOD
/begin RECORD_LAYOUT RL_BLK_F32 FNC_VALUES 1 FLOAT32_IEEE ROW_DIR DIRECT /end RECORD_LAYOUT
/begin RECORD_LAYOUT RL_CUR_SB_UB FNC_VALUES 4 UBYTE COLUMN_DIR DIRECT AXIS_PTS_X 3 SBYTE INDEX_INCR DIRECT NO_AXIS_PTS_X 1 UBYTE RESERVED 2 BYTE /end RECORD_LAYOUT
/begin RECORD_LAYOUT RL_CUR_SW_SB FNC_VALUES 4 SBYTE COLUMN_DIR DIRECT AXIS_PTS_X 3 SWORD INDEX_INCR DIRECT NO_AXIS_PTS_X 1 UBYTE RESERVED 2 BYTE /end RECORD_LAYOUT
/begin RECORD_LAYOUT RL_CUR_SW_SW FNC_VALUES 4 SWORD COLUMN_DIR DIRECT AXIS_PTS_X 3 SWORD INDEX_INCR DIRECT NO_AXIS_PTS_X 1 UBYTE RESERVED 2 BYTE /end RECORD_LAYOUT
/begin RECORD_LAYOUT RL_CUR_SW_UB FNC_VALUES 4 UBYTE COLUMN_DIR DIRECT AXIS_PTS_X 3 SWORD INDEX_INCR DIRECT NO_AXIS_PTS_X 1 UBYTE RESERVED 2 BYTE /end RECORD_LAYOUT
/begin RECORD_LAYOUT RL_CUR_SW_UW FNC_VALUES 4 UWORD COLUMN_DIR DIRECT AXIS_PTS_X 3 SWORD INDEX_INCR DIRECT NO_AXIS_PTS_X 1 UBYTE RESERVED 2 BYTE /end RECORD_LAYOUT
/begin RECORD_LAYOUT RL_CUR_UB_SW FNC_VALUES 4 SWORD COLUMN_DIR DIRECT AXIS_PTS_X 3 UBYTE INDEX_INCR DIRECT NO_AXIS_PTS_X 1 UBYTE RESERVED 2 BYTE /end RECORD_LAYOUT
/begin RECORD_LAYOUT RL_CUR_UB_UB FNC_VALUES 4 UBYTE COLUMN_DIR DIRECT AXIS_PTS_X 3 UBYTE INDEX_INCR DIRECT NO_AXIS_PTS_X 1 UBYTE RESERVED 2 BYTE /end RECORD_LAYOUT
/begin RECORD_LAYOUT RL_CUR_UW_SW FNC_VALUES 4 SWORD COLUMN_DIR DIRECT AXIS_PTS_X 3 UWORD INDEX_INCR DIRECT NO_AXIS_PTS_X 1 UBYTE RESERVED 2 BYTE /end RECORD_LAYOUT
/begin RECORD_LAYOUT RL_CUR_UW_UW FNC_VALUES 4 UWORD COLUMN_DIR DIRECT AXIS_PTS_X 3 UWORD INDEX_INCR DIRECT NO_AXIS_PTS_X 1 UBYTE RESERVED 2 BYTE /end RECORD_LAYOUT
/begin RECORD_LAYOUT RL_MAP_SW_SW_SW FNC_VALUES 5 SWORD COLUMN_DIR DIRECT AXIS_PTS_X 3 SWORD INDEX_INCR DIRECT AXIS_PTS_Y 4 SWORD INDEX_INCR DIRECT NO_AXIS_PTS_X 1 UBYTE NO_AXIS_PTS_Y 2 UBYTE /end RECORD_LAYOUT
/begin RECORD_LAYOUT RL_MAP_SW_SW_UB FNC_VALUES 5 UBYTE COLUMN_DIR DIRECT AXIS_PTS_X 3 SWORD INDEX_INCR DIRECT AXIS_PTS_Y 4 SWORD INDEX_INCR DIRECT NO_AXIS_PTS_X 1 UBYTE NO_AXIS_PTS_Y 2 UBYTE /end RECORD_LAYOUT
/begin RECORD_LAYOUT RL_MAP_SW_SW_UW FNC_VALUES 5 UWORD COLUMN_DIR DIRECT AXIS_PTS_X 3 SWORD INDEX_INCR DIRECT AXIS_PTS_Y 4 SWORD INDEX_INCR DIRECT NO_AXIS_PTS_X 1 UBYTE NO_AXIS_PTS_Y 2 UBYTE /end RECORD_LAYOUT
/begin RECORD_LAYOUT RL_MAP_SW_UW_UW FNC_VALUES 5 UWORD COLUMN_DIR DIRECT AXIS_PTS_X 3 SWORD INDEX_INCR DIRECT AXIS_PTS_Y 4 UWORD INDEX_INCR DIRECT NO_AXIS_PTS_X 1 UBYTE NO_AXIS_PTS_Y 2 UBYTE /end RECORD_LAYOUT
/begin RECORD_LAYOUT RL_MAP_UB_UB_UB FNC_VALUES 5 UBYTE COLUMN_DIR DIRECT AXIS_PTS_X 3 UBYTE INDEX_INCR DIRECT AXIS_PTS_Y 4 UBYTE INDEX_INCR DIRECT NO_AXIS_PTS_X 1 UBYTE NO_AXIS_PTS_Y 2 UBYTE /end RECORD_LAYOUT
/begin RECORD_LAYOUT RL_VAL_SB FNC_VALUES 1 SBYTE COLUMN_DIR DIRECT /end RECORD_LAYOUT
/begin RECORD_LAYOUT RL_VAL_SL FNC_VALUES 1 SLONG COLUMN_DIR DIRECT /end RECORD_LAYOUT
/begin RECORD_LAYOUT RL_VAL_SW FNC_VALUES 1 SWORD COLUMN_DIR DIRECT /end RECORD_LAYOUT
/begin RECORD_LAYOUT RL_VAL_UB FNC_VALUES 1 UBYTE COLUMN_DIR DIRECT /end RECORD_LAYOUT
/begin RECORD_LAYOUT RL_VAL_UL FNC_VALUES 1 ULONG COLUMN_DIR DIRECT /end RECORD_LAYOUT
/begin RECORD_LAYOUT RL_VAL_UW FNC_VALUES 1 UWORD COLUMN_DIR DIRECT /end RECORD_LAYOUT
/begin GROUP G_7_Idle___settings "7 Idle - settings" ROOT
 /begin REF_CHARACTERISTIC K_LLR_CFG_MIN K_LLR_CFG_N_NACHF K_LLR_D_GRAD K_LLR_D_OFFSET K_LLR_MD_D_MAX K_LLR_MD_D_MIN K_LLR_KH_V K_LLR_KH_TIME_ML K_LLR_N_SOLL_NF_FAKTOR K_LLR_N_SOLL_MIN K_LLR_N_KH_AUFR K_LLR_N_KH_ABR K_LLR_N_KH_AUFR_KH3 K_LLR_N_KH_ABR_KH3 K_LLR_AD_AC_MAX K_LLR_AD_AC_MIN K_LLR_AD_CFG K_LLR_AD_I_ANTEIL_OFF K_LLR_AD_MD_GRAD K_LLR_AD_NORM_MAX K_LLR_AD_N_HYS_NEG K_LLR_AD_TIME_STABIL K_LLR_AD_TMOT K_LLR_MD_RES_WAIT K_LLR_MD_TZ_RUECK_HYS K_LLR_MD_TZ_RUECK_NEG K_LLR_MD_TZ_RUECK_POS K_LLR_MD_TZ_TAU K_LLR_N_EINGEREGELT K_LLR_N_RESET K_LLR_N_SOLL_AC_OFFSET K_LLR_N_SOLL_MAX K_LLR_N_SOLL_NF_MAX K_LLR_N_SOLL_TAU K_LLR_N_SOLL_ZH_OFFSET K_LLR_AD_I_TAU K_LLR_AD_N_HYS_POS K_LLR_AD_TOEL K_LLR_OMEGA_TAU K_LLR_N_SOLL_ABSE_GRAD K_LLR_N_SOLL_GRAD K_LLR_N_SOLL_ABSE K_LLR_N_SOLL_PKS_PL K_LLR_N_SOLL_ABSE_LRW_MAX K_LLR_N_SOLL_ABSE_LRW_HYS K_LLR_N_SOLL_ABSE_LRWV_MAX K_LLR_N_SOLL_ABSE_V_MAX K_LLR_N_SOLL_ABSE_TSPERR K_LLR_N_SOLL_ABSE_MD_KKOS_MAX K_LLR_N_SOLL_ABSE_MD_KKOS_HYS K_LLR_N_SOLL_ABSE_CNT_MAX K_LLR_N_SOLL_ABSE_GANG_DKG K_LLR_N_SOLL_ABSE_TMOT_MIN K_LLR_N_OFFSET_B1 K_LLR_N_OFFSET_B2 K_LLR_IA_B1_ABR K_LLR_IA_B2_ABR K_LLR_MD_OKS_MIN K_LLR_MD_OKS_MAX K_LLR_MD_MKS_MIN K_LLR_MD_MKS_MAX K_LLR_MD_MKS_MAX_BLS K_LLR_MD_MKS_MAX_AUFR K_LLR_MD_MKS_MAX_ABR K_LLR_MD_RES_AUFR K_LLR_MD_I_STOP_OKS K_LLR_AD_UMSCHALT_RAMPE K_LLR_AD_NORM_MIN K_LLR_AD_MD_ZYKLUS_MAX K_LLR_AD_MD_NEUZUSTAND K_LLR_AD_CAN_LRW K_LLR_AD_CAN_LRW_V K_LLR_AD_MD_KKOS_MIN K_LLR_AD_MD_KKOS_HYS K_LLR_AD_V_VORNE /end REF_CHARACTERISTIC
/end GROUP
/begin GROUP G_8_Limiters___launch___settings "8 Limiters & launch - settings" ROOT /begin REF_CHARACTERISTIC K_V_DIREKT_FAK K_V_DIREKT_TAU /end REF_CHARACTERISTIC /end GROUP
/begin GROUP G_9_Engine_states___sensors___maps "9 Engine states & sensors - maps" ROOT
 /begin REF_CHARACTERISTIC KF_TAN_MODELL_MR_TUMG_KAL KF_TAN_MODELL_V_RATIO KL_N_LW_TAN_LW_VERH_WURZEL KL_TAN_MODELL_ABREG KL_TAN_MODELL_ML_RATIO KL_TAN_MODELL_MR_ABREG KL_TAN_MODELL_MR_TUMG_KAL KL_TAN_NTC KF_TMOT_MODELL_ML_WICHT KL_TMOT_CC_HIGH_TMOT_1 KL_TMOT_NTC KF_TOEL_V_TAN_MW KL_TOEL_DN KL_TOEL_N KL_TOEL_WICHT KL_TSGRW_F KL_TSGRW_OFFS KL_TOEL_MODELL_AUFHEIZ_OFFS KL_TOEL_MODELL_TIME_MS KL_TOEL_MODELL_AUFHEIZ_WICHT KF_TOEL_MODELL_V_TAN KF_TOEL_MODELL_RATIO1 KF_TOEL_MODELL_RATIO2 /end REF_CHARACTERISTIC
/end GROUP
/begin GROUP G_9_Engine_states___sensors___settings "9 Engine states & sensors - settings" ROOT
 /begin REF_CHARACTERISTIC K_N_MIN_FREEZE__IGN_ K_N_OBERGRENZE__IGN_ K_N_ZEIT_STOERUNG__IGN_ K_N_LW_A_NOFFS_MAX K_N_LW_A_NOFFS_MIN K_N_LW_CFG K_N_LW_E_NOFFS_MAX K_N_LW_E_NOFFS_MIN K_N_LW_NOFFS_MAX K_N_LW_NOFFS_MIN K_TMOT_CC_HIGH_HYS K_TMOT_CC_HIGH_TMOT_2 K_TMOT_CC_HIGH_TOEL_1 K_TMOT_CC_HIGH_TOEL_2 K_TMOT_CC_HIGH_ZWS_OFF K_TMOT_CFG_TOEL K_TOEL_AEBEGR K_TOEL_BEGR_OFFS K_TOEL_KOMBI_WSTATE K_TOEL_N_T1 K_TOEL_TMOT_GRD_F K_TOEL_T_MS K_TOEL_WANNE_GRD_F K_TSGRW_CFG K_TSGRW_TAU K_TSGRW_TAU_MS K_TSGRW_TU K_TMOT_MAX_NEG_GRADIENT K_TMOT_MAX_POS_GRADIENT K_TMOT_TAU K_TMOT_MODELL_C_MOTOR K_TMOT_MODELL_TI_F K_TMOT_MODELL_F_MOTOR K_TMOT_MODELL_GAIN K_TMOT_MODELL_LAM_MIN K_TOEL_MODELL_BEGR_OFFS K_TOEL_MODELL_LM_INTEGRATOR_DT K_TOEL_MODELL_AEBEGR K_TOEL_MODELL_AUFHEIZ_TAU K_TOEL_MODELL_WARM_TAU K_TMOT_MODELL_GAIN_TMOT_DKG K_TMOT_MODELL_GAIN_DKG K_TMOT_MODELL_TAU_KRAFT K_TAN_AEBEGR K_TAN_ERSATZ K_TAN_MW_ABGR_NEG K_TAN_MW_ABGR_POS K_TAN_TAU K_TMOT_MODELL_ERSATZ K_TMOT_MODELL_TKA_ERSATZ_DELTA K_ZOELP_AN K_ZOELP_CFG K_ZOELP_HYS K_ZOELP_MAN_T_AUS cfg.la_variante K_TAN_MODELL_ALLOW_NO_TUMG K_TAN_MODELL_MR_TAU K_TMOT_MODELL_TAU_UMG K_TMOT_MODELL_TMOT_MODELL_ML K_ZOELP_FG_N K_ZOELP_FG_T_AN K_ZOELP_FG_T_AUS K_ZOELP_MAN_T_AN K_ZOELP_TOEL K_ZOELP_UM /end REF_CHARACTERISTIC
/end GROUP
/begin GROUP G_Other___Electrical__cooling___comfort "Other - Electrical, cooling & comfort" ROOT
 /begin REF_CHARACTERISTIC KF_FGR_FAK_V_WA KF_FGR_KR KF_FGR_KR_CONST KF_FGR_TN KF_FGR_TN_CONST KF_FGR_TV KF_FGR_TV_CONST KF_FGR_VORST KF_FGR_VORST_UP KL_FGR_FAK_T_BESCHL KL_FGR_FAK_T_VERZ KL_FGR_FAK_T_WA KL_FGR_FAK_V_TIP KL_FGR_KOEFF_WICHT KL_FGR_KR_FAK KL_FGR_MD_FW_LL KL_FGR_MD_RAMPE_DELTA KL_FGR_TN_FAK KL_FGR_TV_FAK KL_FGR_VERZ_WA KL_FGR_V_FIL_A1 KL_FGR_V_FIL_B1 KL_FGR_V_FIL_B2 KL_FGR_V_SA_SPERRE K_FGR_A1 K_FGR_AX_TAU K_FGR_BESCHL_KOMFORT K_FGR_BESCHL_NORMAL K_FGR_BESCHL_SPORT K_FGR_BESCHL_TIP K_FGR_BESCHL_WA_KOMFORT K_FGR_BESCHL_WA_NORMAL K_FGR_BESCHL_WA_SPORT K_FGR_CFG_V_IST K_FGR_CFG_V_MAX K_FGR_DSC_BLS_T K_FGR_DSC_MD_BLS_T K_FGR_DSC_MD_T K_FGR_EIN K_FGR_FAK_V_MAX K_FGR_MARKE_CFG K_FGR_MD_DELTA K_FGR_MD_FW_HYS K_FGR_MD_FW_LL_HYS K_FGR_N_MAX K_FGR_STUFE_KMH K_FGR_STUFE_MPH K_FGR_T_AUS K_FGR_T_CONSTF_RAMPE K_FGR_T_MIN_SA K_FGR_T_STRICH K_FGR_T_UEBERHOL_MAX K_FGR_VERZ K_FGR_VERZ_TIP K_FGR_V_DIF_MAX K_FGR_V_DIF_MIN K_FGR_V_DIF_MIN_UEBERHOL K_FGR_V_IST_MIN K_FGR_V_IST_TAU K_FGR_V_MAX K_FGR_V_SOLL_DIF_KONST K_FGR_V_SOLL_DIF_MAX K_FGR_V_SOLL_DIF_MIN K_FGR_V_SOLL_MAX_HYS K_FGR_V_SOLL_MAX_KMH K_FGR_V_SOLL_MAX_MPH K_FGR_V_SOLL_MAX_T K_FGR_V_SOLL_MIN_KMH K_FGR_V_SOLL_MIN_MPH K_FGR_V_SOLL_OFFSET K_FGR_V_TIP_INC_DEC KL_TDME_NTC K_TDME_SCHWELLE_ZAEHLER K_TDME_TAU K_UB_ERSATZ K_UB_GRAD_INT_REDUKTION K_UB_GRAD_MAX K_UB_ML_MIN K_UB_START_TIME K_UB_TAU K_UB_TAU_START K_UEXT_ERSATZ K_UEXT_TAU K_UINTERN_AD_1_8_MAX K_UINTERN_AD_1_8_MIN K_UINTERN_AD_2_55_MAX K_UINTERN_AD_2_55_MIN K_UINTERN_AD_3_3_MAX K_UINTERN_AD_3_3_MIN K_FGR_LDM_V_SOLL_OFF_BESCLEUNIGEN K_FGR_LDM_V_SOLL_OFF_VERZOEGERN K_FGR_FAK_V_MIN K_FGR_FAK_V_SPORT K_FGR_FAK_V_KOMFORT K_FGR_FAK_V_NORMAL K_FGR_V_DIF_MIN_AUFST K_FGR_V_DIF_MAX_AUFST K_FGR_V_DIF_MIN_LL K_FGR_V_DIF_MAX_LL K_FGR_N_DIF_MAX K_FGR_N_BEGR_EGAS_SCHW K_FGR_MSW_T_MIN K_FGR_TIP_T_MIN K_FGR_STEP_T_MIN K_FGR_LDM_AX_SOLL_I K_FGR_LDM_AX_SOLL_P K_FGR_LDM_AY K_FGR_LDM_AY_STOER K_FGR_LDM_MASSENAUSGLEICH K_FGR_LDM_RUCK K_FGR_LDM_AY_TAU K_FGR_LDM_AX_BUFFER_SIZE K_FGR_LDM_V_TACHO_TAU K_FGR_LDM_V_VEH_TAU K_FGR_LDM_AX_BERG_TAU K_FGR_LDM_AX_STOER_OFF K_FGR_LDM_AX_SOLL_MAX K_FGR_LDM_AY_SOLL K_FGR_LDM_AX_SOLL_MIN K_FGR_LDM_RUCK_SCHW_AB K_FGR_LDM_RUCK_SCHW_AUF K_FGR_LDM_M_FZG K_FGR_LDM_M_FZG_CABRIO K_FGR_LDM_M_ANHAENGER K_SERVO_MAX_TAST_MS K_SERVO_STROM_SOLL_TAU_POS K_SERVO_STROM_SOLL_TAU_NEG K_SERVO_STROM_ERSATZ K_SERVO_KP K_SERVO_KD K_SERVO_SCHALT K_SERVO_ANSCHLAG_LRW_MAX K_SERVO_ANSCHLAG_LRW_HYST K_SERVO_STROM_PUMPENSCHUTZ_MIN KL_SERVO_KOMFORT KL_SERVO_SPORT KL_SERVO_MDRV_AUS KL_SERVO_KOMFORT_CABRIO KL_SERVO_SPORT_CABRIO KL_SERVO_MDRV_AUS_CABRIO KL_SERVO_KOMFORT_LIMOUSINE KL_SERVO_SPORT_LIMOUSINE KL_SERVO_MDRV_AUS_LIMOUSINE KL_SERVO_KOMFORT_TOURING KL_SERVO_SPORT_TOURING KL_SERVO_MDRV_AUS_TOURING KL_SERVO_PUMPENSCHUTZ_RAMPE_DOWN KL_SERVO_PUMPENSCHUTZ_RAMPE_UP KL_SERVO_PUMPENSCHUTZ_DELAYTIME KF_SERVO_ANSCHLAG KF_SERVO_ANSCHLAG_CABRIO KF_SERVO_ANSCHLAG_LIMOUSINE KF_SERVO_ANSCHLAG_TOURING KL_FGR_LDM_MD_RAD_FAHRWIND K_FGR_FAK_V_TIP K_FGR_FSP_EIN K_FGR_SMG_MCS K_FGR_STATE_AG K_FR_CFG K_FGR_DSC_CFG K_FGR_CFG_VORST /end REF_CHARACTERISTIC
/end GROUP
/begin GROUP G_Other___Emissions___catalyst "Other - Emissions & catalyst" ROOT
 /begin REF_CHARACTERISTIC KF_AUSS_LP_INT_MIN KF_AUSS_SPARK_TIME_MAX KL_AUSS_INT_TMOT_FAKTOR KL_AUSS_START_FAKTOR K_AG_TZ_ANZ K_AG_TZ_CFG K_AG_TZ_PAUSE K_AG_TZ_V_MIN K_AG_TZ_ZYL KF_KH_SMG_T_DLY KL_KH_ALT_OFFSET KL_KH_MD_ETA_F_LLOKS_KH3 KL_KH_MD_ETA_F_PUMG KL_KH_MD_ETA_START KL_KH_MD_ETA_START_SL KL_KH_TKAT_ENDE_MSA KL_KH_T_MAX KL_KH_VAN_AUF_TMOT_A KL_KH_VAN_AUF_TMOT_E KL_KH_VAN_DELAY_TMOT KL_KH_VAN_TMOT_F K_KH_PUMG_MIN K_KH_PUMG_MIN_HYS K_KH_SLP_DAUER_MIN K_KH_TAN_MAX K_KH_TAN_MAX_HYS K_KH_VAN_AB_Einlass KF_KH_MD_ETA_F_LLMKS KF_KH_MD_ETA_F_LLMKS_SL KF_KH_MD_ETA_F_LLOKS KF_KH_MD_ETA_F_LLOKS_SL KF_KH_MD_ETA_F_SB KF_KH_MD_ETA_F_SB_SL KF_KH_MD_ETA_F_TL KF_KH_MD_ETA_F_TL_SL KF_KH_MD_ETA_F_TL_SL_DKG KF_KH_MD_ETA_GRUND_DYN KF_KH_MD_ETA_GRUND_SL_DYN KF_KH_MD_ETA_GRUND_SL_STAT KF_KH_MD_ETA_GRUND_STAT KF_KH_MD_ETA_GRUND_LL KF_KH_MD_ETA_GRUND_LL_DKG KF_KH_MD_ETA_GRUND_LL_KH3 KF_KH_MD_ETA_GRUND_LL_SL KF_KH_MD_ETA_GRUND_LL_SL_DKG KF_KH_MD_ETA_GRAD_INAKTIV KL_KH_MD_ETA_F_PUMG_KH3 KL_KH_TKAT_HYST_MSA KL_KH_ALT_OFFSET_KM KL_KH_ALT_OFFSET_KM_DKG KL_KH_ALT_OFFSET_KM_MSA K_KH_TKAT_ENDE K_KH_TKAT_HYST K_KH_TKAT_CFG K_KH_RF_MAX K_KH_RF_MAX_HYS K_KH_N_MAX K_KH_N_MAX_HYS K_KH_SMG_TMOT_MIN K_KH_SMG_TMOT_MAX K_KH_VAN_TMOT_MAX K_KH_PKSR_PL_TMOT_MIN K_KH_MD_ETA_MIN K_KH_MD_ETA_MAX K_KH_DYN_T_HOLD K_KH_MD_GRAD_NEG K_KH_MD_GRAD_POS K_KH_MD_GRAD_NEG_HYS K_KH_MD_GRAD_POS_HYS K_KH_ANZ_DLY_MD K_AUSS_ASP_SA_CNT K_AUSS_ED_WICHT_SPARK K_AUSS_FETRAWE_N K_AUSS_FETRAWE_RF K_AUSS_FETRAWE_TIME_ML K_AUSS_INT_START_FAKTOR_KOR K_AUSS_LP_MIN_SA_MAX_INI K_AUSS_MAX_OFFSET_CFG K_AUSS_MIN_LAM K_AUSS_NS_MAX_ASP K_KH_TZ_ABS_AB K_KH_VAN_AB_Auslass K_KH_MD_ETA_GRAD_START_SL K_KH_MD_ETA_GRAD_START K_KH_MD_ETA_GRAD_LLMKS_SL K_KH_MD_ETA_GRAD_LLMKS K_KH_MD_ETA_GRAD_LLOKS_SL K_KH_MD_ETA_GRAD_LLOKS K_KH_MD_ETA_GRAD_TL_SL_STAT_POS K_KH_MD_ETA_GRAD_TL_STAT_POS K_KH_MD_ETA_GRAD_TL_SL_DYN_POS K_KH_MD_ETA_GRAD_TL_DYN_POS K_KH_MD_ETA_GRAD_TL_SL_STAT_NEG K_KH_MD_ETA_GRAD_TL_STAT_NEG K_KH_MD_ETA_GRAD_TL_SL_DYN_NEG K_KH_MD_ETA_GRAD_TL_DYN_NEG K_KH_MD_ETA_GRAD_SB_SL K_KH_MD_ETA_GRAD_SB K_KH_MD_ETA_DIFF_LIM K_KH_MD_CFG K_KH_ERW_DKG_CFG K_KH_MD_ETA_KORR_CFG /end REF_CHARACTERISTIC
/end GROUP
/begin GROUP G_Other___Gearbox__SMG_DKG_ "Other - Gearbox (SMG/DKG)" ROOT
 /begin REF_CHARACTERISTIC KL_GANG_I_DKG KL_GANG_I_HS KL_GANG_I_SMG K_GANG_GLG_TIMER_MAX K_GANG_I_RW_DKG K_GANG_I_RW_HS K_GANG_I_RW_SMG K_GANG_N_VERH_MAX K_GANG_N_VERH_MIN KF_KUS_N_MIN KF_MD_KUS_TN KL_KUS_GANG_FAK KL_KUS_N_MIN_AFZ KL_KUS_SCHLUPF_MAX K_N_GETR_CFG K_N_GETR_F_HS K_N_GETR_MAX_PERIOD_HS KF_SMG_BW_NULL KF_SMG_KI_AB_K KF_SMG_KI_AB_S KF_SMG_KI_AB_SCH_K KF_SMG_KI_AB_SCH_S KF_SMG_KI_AUF_K KF_SMG_KI_AUF_S KF_SMG_KI_AUF_SCH_K KF_SMG_KI_AUF_SCH_S KF_SMG_KI_SCHA_K KF_SMG_KI_SCHA_S KF_SMG_KI_SCHA_SCH_K KF_SMG_KI_SCHA_SCH_S KF_SMG_KUPP_LW_RAMPE KF_SMG_KUPP_REG_I_SCH KF_SMG_KUPP_REG_I_ZUG KF_SMG_MOT_ANF_M_RAMPE_1R KF_SMG_MOT_ANF_M_RAMPE_2 KF_SMG_MOT_N_REG_M_MAX KF_SMG_MOT_N_REG_P_KO KF_SMG_N_ZIEL_OFF_K KF_SMG_N_ZIEL_OFF_S KF_SMG_T_ABREGEL KF_SMG_T_AUFREGEL KL_SMG_FW_REL_VIRT KL_SMG_KI_AKS_GANG KL_SMG_KI_DAY_MAX KL_SMG_KUPP_M_AB_ANF KL_SMG_KUPP_M_AB_OFF KL_SMG_KUPP_M_AB_SH KL_SMG_KUPP_M_AB_SR KL_SMG_KUPP_M_AB_ZH KL_SMG_KUPP_M_AB_ZR KL_SMG_KUPP_M_AUF_KI KL_SMG_KUPP_M_AUF_OFF KL_SMG_KUPP_M_AUF_S1 KL_SMG_KUPP_M_AUF_Z1 KL_SMG_KUPP_REG_I_F KL_SMG_KUPP_UL_DN_POS KL_SMG_MOT_DN_REG_P KL_SMG_MOT_DN_SOLL KL_SMG_MOT_J_MOTOR KL_SMG_MOT_M_AB_SH KL_SMG_MOT_M_AB_SR KL_SMG_MOT_M_AB_ZH KL_SMG_MOT_M_AB_ZR KL_SMG_MOT_M_RES_AUF KL_SMG_MOT_M_VOR_AUF KL_SMG_MOT_N_REG_D_DN KL_SMG_MOT_N_REG_D_UP KL_SMG_MOT_N_REG_M_LW KL_SMG_MOT_N_REG_P_DN KL_SMG_MOT_N_REG_P_UP KL_SMG_MOT_N_REG_SA_DIFF KL_SMG_MOT_VOR_2_KI KL_SMG_N_ABRISS_SCHW KL_SMG_N_ZIEL_OFF_ANF KL_SMG_N_ZIEL_OFF_LL KL_SMG_N_ZIEL_OFF_MAX KL_SMG_N_ZIEL_OFF_RAB KL_SMG_N_ZIEL_OFF_ZR KL_SMG_PROG_AUTOMAT KL_SMG_PROG_MANUELL KL_SMG_PROG_MAX_TOEL KL_SMG_PROG_MIN_BERG KL_SMG_T_KORR_AB K_SMG_ADAPT_IHAR_CNT K_SMG_ADAPT_IHAR_DFLT K_SMG_ADAPT_IHAR_MAX K_SMG_ADAPT_IHAR_MIN K_SMG_ADAPT_SP_DMD_FW K_SMG_ADAPT_SP_DM_MAX K_SMG_ADAPT_SP_N_MAX K_SMG_ADAPT_SP_N_MIN K_SMG_ADAPT_SP_TOEL K_SMG_BERG_MD_KW_SCHW K_SMG_BERG_V_MAX_SCHW K_SMG_BERG_V_MIN_SCHW K_SMG_CAN_ED_TSPERR K_SMG_CAN_ED_UB_MIN K_SMG_CAN_KL87_TMAX K_SMG_I_GANG_1 K_SMG_I_GANG_2 K_SMG_I_GANG_3 K_SMG_I_GANG_4 K_SMG_I_GANG_5 K_SMG_I_GANG_6 K_SMG_I_GANG_7 K_SMG_I_GANG_N K_SMG_I_GANG_R K_SMG_I_HA K_SMG_KI_AKS_AY_MAX K_SMG_KI_AKS_DAY_MAX K_SMG_KI_AUF_DSC K_SMG_KI_AUF_DSC2 K_SMG_KI_AUF_EINGR K_SMG_KI_AUF_T_EINGR K_SMG_KI_AUF_ZR K_SMG_KI_CFG K_SMG_KI_DELTA_PWG K_SMG_KI_NEU_AY_MAX K_SMG_KI_SCHALT_DSC K_SMG_KSCHLUPF_AUF K_SMG_KSCHLUPF_DSC K_SMG_KSCHLUPF_N K_SMG_KSCHLUPF_T_SCHW K_SMG_KUPP_AUF_SCHW_N K_SMG_KUPP_DM_ABS K_SMG_KUPP_DM_MIN K_SMG_KUPP_DM_RAB K_SMG_KUPP_DM_SOLL_F K_SMG_KUPP_M_MAX_1 K_SMG_KUPP_M_MAX_2 K_SMG_KUPP_N_KSCHUTZ K_SMG_KUPP_RAMPE_DM K_SMG_KUPP_RAMPE_N K_SMG_KUPP_RAMPE_N_ABW K_SMG_KUPP_RAMPE_UL K_SMG_KUPP_REG_T K_SMG_KUPP_UL_FW_DM K_SMG_KUPP_UL_FW_MAX K_SMG_KUPP_UL_FW_SCHW K_SMG_KUPP_UL_MD_SCHW K_SMG_KUPP_UL_N_SCHW K_SMG_MD_FW_HYS_SCH K_SMG_MD_FW_HYS_ZUG K_SMG_MD_FW_MIN_AB K_SMG_MD_FW_MIN_AUF K_SMG_MOT_ABS_DM_MAX K_SMG_MOT_ABS_M_MAX K_SMG_MOT_ABS_M_MIN K_SMG_MOT_ABS_N_OFF K_SMG_MOT_ABS_T_MAX K_SMG_MOT_AKS_N_SCHW K_SMG_MOT_ANF_DM_DSC K_SMG_MOT_ANF_FW_X K_SMG_MOT_ANF_M_MIN K_SMG_MOT_ANF_N_OFF K_SMG_MOT_DN_REG_I_N K_SMG_MOT_DN_REG_I_P K_SMG_MOT_DN_REG_I_S K_SMG_MOT_DN_REG_T K_SMG_MOT_DN_SOLL_MIN K_SMG_MOT_DN_SOLL_VOR K_SMG_MOT_M_RES_ABW K_SMG_MOT_M_RES_AUF K_SMG_MOT_M_RES_EXT_MAX K_SMG_MOT_M_RES_MAX K_SMG_MOT_M_RES_POS_MAX K_SMG_MOT_M_RES_POS_N K_SMG_MOT_M_RES_RAMPE K_SMG_MOT_M_RES_RAMPE_KS K_SMG_MOT_M_RES_RS K_SMG_MOT_M_RES_SCHA K_SMG_MOT_M_RES_T_MAX K_SMG_MOT_M_VOR_AUF K_SMG_MOT_NL_DELTA_FW K_SMG_MOT_NL_ETA K_SMG_MOT_NL_MD K_SMG_MOT_NL_MD_MAX K_SMG_MOT_NL_TAU K_SMG_MOT_NL_T_MAX K_SMG_MOT_N_REG_D_MAX K_SMG_MOT_N_REG_D_MIN K_SMG_MOT_N_REG_I_DN K_SMG_MOT_N_REG_I_SCHW K_SMG_MOT_N_REG_I_T K_SMG_MOT_N_REG_I_T_RAB K_SMG_MOT_N_REG_I_UP K_SMG_MOT_N_REG_M_BEGR K_SMG_MOT_N_REG_M_MAX K_SMG_MOT_N_REG_M_STG K_SMG_MOT_N_REG_T_MAX K_SMG_MOT_RAB_DM_MAX K_SMG_MOT_RAB_M_MAX K_SMG_MOT_RAB_M_MIN K_SMG_MOT_RAB_T_MAX K_SMG_MOT_RSS_MD_EINGR K_SMG_MOT_RS_N_OFF K_SMG_MOT_RS_N_SCHW K_SMG_MOT_RS_S_SCHW K_SMG_MOT_RS_TI_TABG K_SMG_MOT_RS_TI_TIME K_SMG_MOT_RS_T_HI K_SMG_MOT_RS_T_LO K_SMG_M_NULL K_SMG_NO_LW_N_SCHW K_SMG_N_ABRISS_ANF K_SMG_N_ABRISS_HYS K_SMG_N_EKR_OFF_BEGR K_SMG_N_NULL K_SMG_N_ZIEL_ABWUERG K_SMG_N_ZIEL_ANF_V_MAX K_SMG_N_ZIEL_HYS K_SMG_N_ZIEL_OFF_BEGR K_SMG_N_ZIEL_OFF_SCH K_SMG_N_ZIEL_OFF_ZH K_SMG_OHNE_EINGR_OFF K_SMG_PROG_EINFAHR_WEG K_SMG_PROG_FETRAWE_WEG K_SMG_PROG_MAX_ANH K_SMG_PROG_MAX_EINFAHR K_SMG_PROG_MAX_FETRAWE K_SMG_PROG_MIN_ANH K_SMG_PROG_MIN_ZR K_SMG_PWG_FW_SCH K_SMG_PWG_FW_SCH_N_OFF K_SMG_R_DYN K_SMG_TAU_NGETR_ZIEL K_SMG_TZ_EINGR_T_AB K_SMG_T_ABREGEL_AKS K_SMG_T_KORR_AB_FW K_SMG_T_KORR_AB_MIN K_SMG_V_KRAFTS_ERSATZ K_GANG_I_HA_HS K_GANG_R_RAD_DYN_NV K_N_GETR_ABTRIEB_MIN K_N_GETR_ABTRIEB_MAX K_GANG_1_TIMER_MAX K_GANG_I_HA_ADAPT_CNT_MAX K_GANG_I_HA_ADAPT_GANG_MAX_HS K_GANG_I_HA_ADAPT_GANG_MIN_HS K_GANG_I_HA_ADAPT_MAX K_GANG_I_HA_ADAPT_MD_MAX_HS K_GANG_I_HA_ADAPT_MD_MIN_HS K_GANG_I_HA_ADAPT_MIN K_GANG_I_HA_ADAPT_SCHLUPF_MIN_HS K_GANG_I_HA_ADAPT_V_MAX_HS K_GANG_I_HA_ADAPT_V_MIN_HS K_GANG_I_HA_DKG K_GANG_I_HA_SMG K_KUS_CFG K_KUS_GANG_MAX K_KUS_N_DELTA_AUS K_KUS_N_DELTA_EIN K_KUS_N_GETR_EIN_HYS K_KUS_N_GETR_EIN_MIN K_KUS_N_HYS K_KUS_N_MIN K_KUS_STUFE K_KUS_V_VORNE_HYS K_KUS_V_VORNE_MAX K_SMG_MOT_DN_GANG_1of3_ K_SMG_MOT_DN_GANG_2of3_ K_SMG_MOT_DN_GANG_3of3_ K_SMG_MOT_J_MOTOR_ZR K_SMG_PROG_V_SCHW K_SMG_TAU_AX_BERECH K_SMG_TAU_AX_BERG K_SMG_TAU_AX_MESS K_SMG_TAU_DN_FILTER K_SMG_TAU_DN_GETR K_SMG_TAU_DSC_ABS K_SMG_TAU_KSCHLUPF K_SMG_TAU_MD_FAHRER K_SMG_TAU_RSCHLUPF cfg.getriebetyp K_DKG_SPERR_ST K_DKG_MD_TI_OFFS K_DKG_KUPP_SCHLEIF_MAX K_DKG_KUPP_SCHLEIF_MAX_AK K_DKG_MD_ML_RAMPE K_DKG_MD_TZ_RAMPE K_DKG_KRIECH_RAMPE K_DKG_T_WAIT K_DKG_N_DYN_CFG K_DKG_N_DYN_N_MIN K_DKG_N_DYN_N_AB_MIN K_DKG_N_DYN_N_AB_MAX K_DKG_N_DYN_GANG_MIN K_DKG_N_DYN_GANG_MAX K_DKG_N_DYN_T K_DKG_N_DYN_FAK_LL K_DKG_LL_MD_MAX K_DKG_LL_N_OFFS KL_DKG_KUPP_KRIECH_MAX K_SPA_CFG K_SPA_N_GRAD_ASP_TAU K_SPA_PWG_SOLL_GRAD_TAU K_SPA_GANG_MIN K_SPA_BLS_ON_T K_SPA_BLS_OFF_T K_SPA_MD_WUNSCH_REL_MIN K_SPA_MD_WUNSCH_REL_MAX K_SPA_MD_WUNSCH_REL_T K_SPA_BEGR_MD_WUNSCH_REL_ K_SPA_MD_KUPP_IST_MIN K_SPA_MD_KUPP_IST_MAX K_SPA_MD_KUPP_IST_T K_SPA_KRAFTSCHLUSS_OFF_T K_SPA_N_MIN K_SPA_N_MAX K_SPA_N_T K_SPA_V_MIN K_SPA_V_MAX K_SPA_V_T K_SPA_CAN_AY_MAX K_SPA_CAN_AY_T K_SPA_MD_IND_TZ_ST K_SPA_N_GRAD_ASP_MAX K_SPA_N_GRAD_ASP_T K_SPA_PWG_SOLL_GRAD_POS K_SPA_PWG_SOLL_GRAD_NEG K_SPA_PWG_SOLL_GRAD_T K_SPA_N_BEGR_EGAS_HYS_MIN K_SPA_N_BEGR_EGAS_HYS_MAX K_SPA_N_GRAD_ASP_BERG_MAX K_SPA_LLR_N_SOLL_HYS K_SPA_MD_KUPP_WUNSCH_HYS K_SPA_N_BEGR_EGAS_HYS K_SPA_ANZ_ON_T K_SPA_ANZ_T K_SPA_ANZ_GANG_CAN_OFF K_SPA_ANZ_ART_RUECK K_SPA_ANZ_ART_HOCH K_SPA_ANZ_ART_AUS K_SPA_ANZ_GANG_AUS K_SPA_BEGR_GANG_MINUS K_SPA_BEGR_GANG_PLUS K_SPA_BEGR_MD_WUNSCH_REL_MIN K_SPA_BEGR_N_MAX K_SPA_BEGR_BERG_FWST_STEIG_TAU K_SPA_BEGR_BERG_FWST_STEIG_PHYS K_SPA_BEGR_BERG_FZGMASSE KL_SPA_SOLL_HS12 KL_SPA_SOLL_HS23 KL_SPA_SOLL_HS34 KL_SPA_SOLL_HS45 KL_SPA_SOLL_HS56 KL_SPA_SOLL_HSHYS12 KL_SPA_SOLL_HSHYS23 KL_SPA_SOLL_HSHYS34 KL_SPA_SOLL_HSHYS45 KL_SPA_SOLL_HSHYS56 KL_SPA_SOLL_RS21 KL_SPA_SOLL_RS32 KL_SPA_SOLL_RS43 KL_SPA_SOLL_RS54 KL_SPA_SOLL_RS65 KL_SPA_SOLL_RSHYS21 KL_SPA_SOLL_RSHYS32 KL_SPA_SOLL_RSHYS43 KL_SPA_SOLL_RSHYS54 KL_SPA_SOLL_RSHYS65 KL_SPA_SOLL_N_GETR_ABTRIEB_OFF_KATH_HS KL_SPA_SOLL_N_GETR_ABTRIEB_OFF_KATH_F_TMOT_HS KL_SPA_SOLL_N_GETR_ABTRIEB_OFF_F_LAST_HS KL_SPA_MD_KUPP_MAX KL_SPA_MD_KUPP_MAX_HYS KL_SPA_BEGR_BERG_FWST_EBENE KL_SPA_BEGR_BERG_GANG KF_SPA_SOLL_N_GETR_ABTRIEB_ /end REF_CHARACTERISTIC
/end GROUP
/begin GROUP G_Other___System___communication "Other - System & communication" ROOT
 /begin REF_CHARACTERISTIC KL_E_FUNKTION__IGN_ K_VERS_DATEN__IGN_ K_VERS_PROG__IGN_ K_VERS_PROZ__IGN_ K_DEBUG_READ_ADR__IGN_ K_DEBUG_RW_LENGTH__IGN_ K_DEBUG_WRITE_ADR__IGN_ K_DEBUG_WRITE_VALUE__IGN_ K_KIS_ACTIVE_PULSE K_KIS_CFG K_KIS_LEN K_KIS_PERIOD K_KIS_START K_KIS_TIME_OUT K_TPU_IGN_MIN_SCI_POS K_TPU_IGN_MISS_FIRE_TIME K_TPU_KW_N_MIN__IGN_ K_TPU_KW_SYNC_ZAHN__IGN_ K_DSP_MESSEN /end REF_CHARACTERISTIC
/end GROUP
/end MODULE
/end PROJECT
