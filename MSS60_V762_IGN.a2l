ASAP2_VERSION 1 60
/begin PROJECT MSS60_V762_IGN "MSS60 (S65) V762 IGN CPU - production calibration 7848136 (V762.01-B500.02)"
/begin HEADER "Calibration description. Measurements: V530 RAM names transferred to V762 addresses (confidence in each long identifier). Status tag in every long identifier: verified (checked against the code) / A2L-ref (placed from the V530 A2L) / EST (estimated) / unassigned (unidentified)." VERSION "V762-RE-04112026" /end HEADER
/begin MODULE IGN "MSS60 V762 IGN"
/begin MOD_COMMON "" BYTE_ORDER MSB_FIRST ALIGNMENT_BYTE 1 ALIGNMENT_WORD 2 ALIGNMENT_LONG 4 /end MOD_COMMON
/begin MEASUREMENT llr_md_tz_rueck "LLR TZ-Rueckfuehrung [RAM name from V530, voted 1]" SWORD M_FORMULA_0742 0 0 -16.384 16.3835 ECU_ADDRESS 0x3FD002 /end MEASUREMENT
/begin MEASUREMENT llr_ad_zustand "Zustand [RAM name from V530, voted 4]" UBYTE NO_COMPU_METHOD 0 0 0 255 ECU_ADDRESS 0x3FD016 FORMAT "%.4g" /end MEASUREMENT
/begin MEASUREMENT llr_ad_flags "Zustand [RAM name from V530, voted 4]" UBYTE M_FORMULA_0003 0 0 0 255 ECU_ADDRESS 0x3FD017 /end MEASUREMENT
/begin MEASUREMENT llr_ad_i_smooth "Mittelwert I-Anteil [RAM name from V530, voted 3]" SWORD M_FORMULA_0009 0 0 -3276.8 3276.7 ECU_ADDRESS 0x3FD018 /end MEASUREMENT
/begin MEASUREMENT llr_ad_md "aktueller Adaptionwert [RAM name from V530, voted 4]" SWORD M_FORMULA_0009 0 0 -3276.8 3276.7 ECU_ADDRESS 0x3FD01A /end MEASUREMENT
/begin MEASUREMENT llr_ad_timer "Timer [RAM name from V530, voted 2]" UWORD M_FORMULA_0071 0 0 0 6553.5 ECU_ADDRESS 0x3FD01C /end MEASUREMENT
/begin MEASUREMENT md_rf_min "rf_min [RAM name from V530, voted 1]" SWORD M_FORMULA_0007 0 0 -3.2768 3.2767 ECU_ADDRESS 0x3FD054 /end MEASUREMENT
/begin MEASUREMENT md_ind_min_schub "min. ind. Schubmoment [RAM name from V530, voted 2]" SWORD M_FORMULA_0009 0 0 -3276.8 3276.7 ECU_ADDRESS 0x3FD05A /end MEASUREMENT
/begin MEASUREMENT md_ind_rf_min "Moment bei Rfmin [RAM name from V530, voted 2]" SWORD M_FORMULA_0009 0 0 -3276.8 3276.7 ECU_ADDRESS 0x3FD05C /end MEASUREMENT
/begin MEASUREMENT md_ind_reib_roh "Reibverluste (Rohwert) [RAM name from V530, voted 2]" SWORD M_FORMULA_0009 0 0 -3276.8 3276.7 ECU_ADDRESS 0x3FD05E /end MEASUREMENT
/begin MEASUREMENT md_ind_reib_offset "Reibverluste (Offset) [RAM name from V530, voted 1]" SWORD M_FORMULA_0758 0 0 -327.68 327.67 ECU_ADDRESS 0x3FD060 /end MEASUREMENT
/begin MEASUREMENT md_ind_lw_max "LW-Verluste bei MAX [RAM name from V530, voted 1]" SWORD M_FORMULA_0009 0 0 -3276.8 3276.7 ECU_ADDRESS 0x3FD068 /end MEASUREMENT
/begin MEASUREMENT md_ind_lw_ist "LW-Verluste [RAM name from V530, voted 1]" SWORD M_FORMULA_0009 0 0 -3276.8 3276.7 ECU_ADDRESS 0x3FD06A /end MEASUREMENT
/begin MEASUREMENT md_verbr_fzg "Verbraucheroffset Fzg [RAM name from V530, voted 2]" SWORD M_FORMULA_0009 0 0 -3276.8 3276.7 ECU_ADDRESS 0x3FD076 /end MEASUREMENT
/begin MEASUREMENT md_start_offset "Offset beim Start [RAM name from V530, voted 4]" SWORD M_FORMULA_0009 0 0 -3276.8 3276.7 ECU_ADDRESS 0x3FD078 /end MEASUREMENT
/begin MEASUREMENT md_ind_max_roh "ind. Maximalmoment [RAM name from V530, voted 1]" SWORD M_FORMULA_0009 0 0 -3276.8 3276.7 ECU_ADDRESS 0x3FD07E /end MEASUREMENT
/begin MEASUREMENT md_ind_max "ind. Maximalmoment mit LA-Korr [RAM name from V530, voted 4]" SWORD M_FORMULA_0009 0 0 -3276.8 3276.7 ECU_ADDRESS 0x3FD080 /end MEASUREMENT
/begin MEASUREMENT md_ind_opt "Indiziertes Istmoment [RAM name from V530, voted 1]" SWORD M_FORMULA_0009 0 0 -3276.8 3276.7 ECU_ADDRESS 0x3FD082 /end MEASUREMENT
/begin MEASUREMENT md_ind_opt_la_rg "ind. Istmoment mit LA-/RG-Einfluss [RAM name from V530, voted 1]" SWORD M_FORMULA_0009 0 0 -3276.8 3276.7 ECU_ADDRESS 0x3FD084 /end MEASUREMENT
/begin MEASUREMENT md_eta_la_vl "ETA-Lambda-VL [RAM name from V530, voted 2]" UWORD M_FORMULA_0437 0 0 0 199.9969482 ECU_ADDRESS 0x3FD088 /end MEASUREMENT
/begin MEASUREMENT md_eta_la_ist "ETA-Lambda-Ist [RAM name from V530, voted 3]" UWORD M_FORMULA_0437 0 0 0 199.9969482 ECU_ADDRESS 0x3FD08A /end MEASUREMENT
/begin MEASUREMENT md_eta_rg_lw "ETA-Restgas-Lastwechsel [RAM name from V530, voted 1]" UWORD M_FORMULA_0437 0 0 0 199.9969482 ECU_ADDRESS 0x3FD08E /end MEASUREMENT
/begin MEASUREMENT md_eta_zw_min "Wirkungsgrad tz_min [RAM name from V530, voted 5]" UWORD M_FORMULA_0437 0 0 0 199.9969482 ECU_ADDRESS 0x3FD08E /end MEASUREMENT
/begin MEASUREMENT md_eta_zw_stat "Wirkungsgrad tz_stat [RAM name from V530, voted 2]" UWORD M_FORMULA_0437 0 0 0 199.9969482 ECU_ADDRESS 0x3FD090 /end MEASUREMENT
/begin MEASUREMENT md_eta_zw_ne "Wirkungsgrad nach Eingriff [RAM name from V530, voted 10]" UWORD M_FORMULA_0437 0 0 0 199.9969482 ECU_ADDRESS 0x3FD094 /end MEASUREMENT
/begin MEASUREMENT md_eta_ausblend "ETA-Ausblend [RAM name from V530, voted 1]" UWORD M_FORMULA_0437 0 0 0 199.9969482 ECU_ADDRESS 0x3FD096 /end MEASUREMENT
/begin MEASUREMENT md_eta_ausbl_sk "ETA-Ausblend ueber SK [RAM name from V530, voted 4]" UWORD M_FORMULA_0437 0 0 0 199.9969482 ECU_ADDRESS 0x3FD098 /end MEASUREMENT
/begin MEASUREMENT md_eta_zw_soll "Sollwirkungsgrad [RAM name from V530, voted 2]" UWORD M_FORMULA_0437 0 0 0 199.9969482 ECU_ADDRESS 0x3FD09A /end MEASUREMENT
/begin MEASUREMENT md_zw_opt "opt. Z???ndwinkel [RAM name from V530, voted 2]" SWORD M_FORMULA_0102 0 0 -3276.8 3276.7 ECU_ADDRESS 0x3FD09C /end MEASUREMENT
/begin MEASUREMENT md_zw_opt_rg "opt. ZW mit RG [RAM name from V530, voted 1]" SWORD M_FORMULA_0102 0 0 -3276.8 3276.7 ECU_ADDRESS 0x3FD0A4 /end MEASUREMENT
/begin MEASUREMENT md_polynom_a "Polynom_a [RAM name from V530, voted 5]" SWORD M_FORMULA_0760 0 0 -327.68 327.67 ECU_ADDRESS 0x3FD0A8 /end MEASUREMENT
/begin MEASUREMENT md_polynom_b "Polynom_b [RAM name from V530, voted 5]" SWORD M_FORMULA_0760 0 0 -327.68 327.67 ECU_ADDRESS 0x3FD0AA /end MEASUREMENT
/begin MEASUREMENT md_puls_timer "Generator-Timer [RAM name from V530, voted 2]" UWORD M_FORMULA_0109 0 0 0 327.675 ECU_ADDRESS 0x3FD0AC /end MEASUREMENT
/begin MEASUREMENT md_kupp_wunsch_puls "Stollis Pulsgenerator [RAM name from V530, voted 2]" SWORD M_FORMULA_0009 0 0 -3276.8 3276.7 ECU_ADDRESS 0x3FD0AE /end MEASUREMENT
/begin MEASUREMENT md_n_grad_fil "gef. Gradient [RAM name from V530, voted 4]" SWORD M_FORMULA_0105 0 0 -32768 32767 ECU_ADDRESS 0x3FD0B0 /end MEASUREMENT
/begin MEASUREMENT md_kupp_max_mdrv "CAN-Maximalmoment bei MDrv [RAM name from V530, voted 3]" SWORD M_FORMULA_0009 0 0 -3276.8 3276.7 ECU_ADDRESS 0x3FD0B4 /end MEASUREMENT
/begin MEASUREMENT md_kupp_asc_ml "ASC-Sollmoment Luft [RAM name from V530, voted 5]" SWORD M_FORMULA_0009 0 0 -3276.8 3276.7 ECU_ADDRESS 0x3FD0B8 /end MEASUREMENT
/begin MEASUREMENT md_kupp_asc_tz "ASC-Sollmoment TZ [RAM name from V530, voted 5]" SWORD M_FORMULA_0009 0 0 -3276.8 3276.7 ECU_ADDRESS 0x3FD0BA /end MEASUREMENT
/begin MEASUREMENT md_kupp_msr_ml "MSR-Sollmoment Luft [RAM name from V530, voted 3]" SWORD M_FORMULA_0009 0 0 -3276.8 3276.7 ECU_ADDRESS 0x3FD0BC /end MEASUREMENT
/begin MEASUREMENT md_kupp_msr_tz "MSR-Sollmoment TZ [RAM name from V530, voted 3]" SWORD M_FORMULA_0009 0 0 -3276.8 3276.7 ECU_ADDRESS 0x3FD0BE /end MEASUREMENT
/begin MEASUREMENT md_dsc_t_wait "Wartezeit vor DSC-Rampe [RAM name from V530, voted 6]" UWORD M_FORMULA_0590 0 0 0 327.675 ECU_ADDRESS 0x3FD0C0 /end MEASUREMENT
/begin MEASUREMENT md_kkos_freig_st "KKOS-Freigabe [RAM name from V530, voted 20]" UBYTE NO_COMPU_METHOD 0 0 0 255 ECU_ADDRESS 0x3FD0C2 FORMAT "%.4g" /end MEASUREMENT
/begin MEASUREMENT md_kkos_sperr_st "KKOS-Sperre [RAM name from V530, voted 6]" UBYTE NO_COMPU_METHOD 0 0 0 255 ECU_ADDRESS 0x3FD0C3 FORMAT "%.4g" /end MEASUREMENT
/begin MEASUREMENT md_kkos_s "KKOS-Schalter [RAM name from V530, voted 21]" UBYTE NO_COMPU_METHOD 0 0 0 255 ECU_ADDRESS 0x3F8728 FORMAT "%.4g" /end MEASUREMENT
/begin MEASUREMENT md_kkos_time_ba "Zeit BA-Abschaltung [RAM name from V530, voted 4]" UWORD M_FORMULA_0021 0 0 0 655.35 ECU_ADDRESS 0x3FD0C6 /end MEASUREMENT
/begin MEASUREMENT md_kkos_time_vl "Zeit VL-Abschaltung [RAM name from V530, voted 4]" UWORD M_FORMULA_0021 0 0 0 655.35 ECU_ADDRESS 0x3FD0C8 /end MEASUREMENT
/begin MEASUREMENT md_kkos_time_wh "Zeit WH-Abschaltung [RAM name from V530, voted 7]" UWORD M_FORMULA_0021 0 0 0 655.35 ECU_ADDRESS 0x3FD0CA /end MEASUREMENT
/begin MEASUREMENT md_kkos_time_delay "Zeit Delay [RAM name from V530, voted 6]" UWORD M_FORMULA_0021 0 0 0 655.35 ECU_ADDRESS 0x3FD0CC /end MEASUREMENT
/begin MEASUREMENT md_kkos "MD-Anf KKOS aus KF+Adapt [RAM name from V530, voted 1]" SWORD M_FORMULA_0009 0 0 -3276.8 3276.7 ECU_ADDRESS 0x3FD0CE /end MEASUREMENT
/begin MEASUREMENT md_kkos_fil "MD-Anf KKOS nach Filter [RAM name from V530, voted 6]" SWORD M_FORMULA_0009 0 0 -3276.8 3276.7 ECU_ADDRESS 0x3F85B6 /end MEASUREMENT
/begin MEASUREMENT md_kkos_res_max "Maxwert fuer KKOS-Reserve [RAM name from V530, voted 1]" SWORD M_FORMULA_0009 0 0 -3276.8 3276.7 ECU_ADDRESS 0x3FD0D0 /end MEASUREMENT
/begin MEASUREMENT md_kkos_res "KKOS-Reserve [RAM name from V530, voted 6]" SWORD M_FORMULA_0009 0 0 -3276.8 3276.7 ECU_ADDRESS 0x3FD0D2 /end MEASUREMENT
/begin MEASUREMENT md_kkos_zh_res_max "Maxwert fuer KKOS-Reserve [RAM name from V530, voted 2]" SWORD M_FORMULA_0009 0 0 -3276.8 3276.7 ECU_ADDRESS 0x3FD0D6 /end MEASUREMENT
/begin MEASUREMENT md_kkos_zh_res "KKOS-Reserve [RAM name from V530, voted 8]" SWORD M_FORMULA_0009 0 0 -3276.8 3276.7 ECU_ADDRESS 0x3FD0D8 /end MEASUREMENT
/begin MEASUREMENT md_kkos_zh_time_res "MaxZeit fuer KKOS-Reserve [RAM name from V530, voted 4]" UWORD M_FORMULA_0021 0 0 0 655.35 ECU_ADDRESS 0x3FD0DA /end MEASUREMENT
/begin MEASUREMENT md_lrw "MD-Anf LRW aus KF [RAM name from V530, voted 1]" SWORD M_FORMULA_0009 0 0 -3276.8 3276.7 ECU_ADDRESS 0x3FD0DC /end MEASUREMENT
/begin MEASUREMENT md_lrw_res "LRW-Reserve [RAM name from V530, voted 4]" SWORD M_FORMULA_0009 0 0 -3276.8 3276.7 ECU_ADDRESS 0x3FD0DE /end MEASUREMENT
/begin MEASUREMENT md_gen_st "Generatorstatus [RAM name from V530, voted 1]" UBYTE NO_COMPU_METHOD 0 0 0 255 ECU_ADDRESS 0x3FD0E0 FORMAT "%.4g" /end MEASUREMENT
/begin MEASUREMENT md_gen "Generatormoment [RAM name from V530, voted 3]" SWORD M_FORMULA_0009 0 0 -3276.8 3276.7 ECU_ADDRESS 0x3FD0E2 /end MEASUREMENT
/begin MEASUREMENT md_exd_kkos_max "ExdKKOS Maxwert [RAM name from V530, voted 1]" SWORD M_FORMULA_0009 0 0 -3276.8 3276.7 ECU_ADDRESS 0x3FD0E4 /end MEASUREMENT
/begin MEASUREMENT md_exd_kkos_timeout "ExdKKOS Timeout [RAM name from V530, voted 1]" UWORD M_FORMULA_0021 0 0 0 655.35 ECU_ADDRESS 0x3FD0E6 /end MEASUREMENT
/begin MEASUREMENT md_dyn_st "Filterstatus [RAM name from V530, voted 17]" UBYTE NO_COMPU_METHOD 0 0 0 255 ECU_ADDRESS 0x3FD0E9 FORMAT "%.4g" /end MEASUREMENT
/begin MEASUREMENT md_dyn_st_anff "Filterstatus Anfahrfilter [RAM name from V530, voted 17]" UBYTE NO_COMPU_METHOD 0 0 0 255 ECU_ADDRESS 0x3FD0E9 FORMAT "%.4g" /end MEASUREMENT
/begin MEASUREMENT md_dyn_st_tz_min "Filterstatus tz_min [RAM name from V530, voted 17]" UBYTE NO_COMPU_METHOD 0 0 0 255 ECU_ADDRESS 0x3FD0E9 FORMAT "%.4g" /end MEASUREMENT
/begin MEASUREMENT md_dyn_flags "diverse Flags [RAM name from V530, voted 3]" UBYTE M_FORMULA_0003 0 0 0 255 ECU_ADDRESS 0x3FD0EA /end MEASUREMENT
/begin MEASUREMENT md_dyn_freigabe "Freigabestatus [RAM name from V530, voted 3]" UBYTE NO_COMPU_METHOD 0 0 0 255 ECU_ADDRESS 0x3FD0EA FORMAT "%.4g" /end MEASUREMENT
/begin MEASUREMENT md_richtung "Filterrichtung [RAM name from V530, voted 3]" SBYTE NO_COMPU_METHOD 0 0 -128 127 ECU_ADDRESS 0x3FD0EB FORMAT "%.4g" /end MEASUREMENT
/begin MEASUREMENT md_bereich "Bereich [RAM name from V530, voted 5]" UBYTE NO_COMPU_METHOD 0 0 0 255 ECU_ADDRESS 0x3FD0EC FORMAT "%.4g" /end MEASUREMENT
/begin MEASUREMENT md_grad_anf "Fahrergradient [RAM name from V530, voted 3]" SLONG M_FORMULA_0785 0 0 -2147483648 2147483647 ECU_ADDRESS 0x3FD0F0 /end MEASUREMENT
/begin MEASUREMENT md_grad_dp "DP-Maximalgradient [RAM name from V530, voted 1]" SWORD M_FORMULA_0786 0 0 -32768 32767 ECU_ADDRESS 0x3FD0F6 /end MEASUREMENT
/begin MEASUREMENT md_grad_max "Maximalgradient [RAM name from V530, voted 1]" SWORD M_FORMULA_0786 0 0 -32768 32767 ECU_ADDRESS 0x3FD0F8 /end MEASUREMENT
/begin MEASUREMENT md_kupp_grenz_lsd_o "obere Grenze fuer LSD-Bereichsauswahl [RAM name from V530, voted 2]" SWORD M_FORMULA_0009 0 0 -3276.8 3276.7 ECU_ADDRESS 0x3FD0FE /end MEASUREMENT
/begin MEASUREMENT md_kupp_grenz_dp_u "untere Grenze fuer DP-Bereichsauswahl [RAM name from V530, voted 2]" SWORD M_FORMULA_0009 0 0 -3276.8 3276.7 ECU_ADDRESS 0x3FD100 /end MEASUREMENT
/begin MEASUREMENT md_kupp_grenz_dp_o "obere Grenze fuer DP-Bereichsauswahl [RAM name from V530, voted 1]" SWORD M_FORMULA_0009 0 0 -3276.8 3276.7 ECU_ADDRESS 0x3FD102 /end MEASUREMENT
/begin MEASUREMENT md_kupp_grenz_u "untere Grenze fuer Bereichsauswahl [RAM name from V530, voted 7]" SWORD M_FORMULA_0009 0 0 -3276.8 3276.7 ECU_ADDRESS 0x3FD104 /end MEASUREMENT
/begin MEASUREMENT md_kupp_grenz_o "obere Grenze fuer Bereichsauswahl [RAM name from V530, voted 3]" SWORD M_FORMULA_0009 0 0 -3276.8 3276.7 ECU_ADDRESS 0x3FD106 /end MEASUREMENT
/begin MEASUREMENT md_kupp_wunsch_fil_roh "Filterwert [RAM name from V530, voted 4]" SLONG M_FORMULA_0787 0 0 -10737418.24 10737418.23 ECU_ADDRESS 0x3FD108 /end MEASUREMENT
/begin MEASUREMENT md_dyn_fil_res_roh "Momentenreserve Dynamikfilter ohne Begr [RAM name from V530, voted 1]" SWORD M_FORMULA_0009 0 0 -3276.8 3276.7 ECU_ADDRESS 0x3FD10C /end MEASUREMENT
/begin MEASUREMENT md_dyn_fil_res "Momentenreserve Dynamikfilter [RAM name from V530, voted 3]" SWORD M_FORMULA_0009 0 0 -3276.8 3276.7 ECU_ADDRESS 0x3FD10E /end MEASUREMENT
/begin MEASUREMENT md_kupp_wunsch_grad_max "Maximalgradient [RAM name from V530, voted 4]" SWORD M_FORMULA_0562 0 0 -655360 655340 ECU_ADDRESS 0x3FD110 /end MEASUREMENT
/begin MEASUREMENT md_kupp_wunsch_fil_dp "gefilt. Fahrerwunsch fuer DP-Wichtung [RAM name from V530, voted 3]" SWORD M_FORMULA_0009 0 0 -3276.8 3276.7 ECU_ADDRESS 0x3FD112 /end MEASUREMENT
/begin MEASUREMENT B_MD_IPM_POS "IPM-Bereich [RAM name from V530, voted 6]" UBYTE NO_COMPU_METHOD 0 0 0 255 ECU_ADDRESS 0x3FD118 FORMAT "%.4g" /end MEASUREMENT
/begin MEASUREMENT md_ipm_st "IPM-Status [RAM name from V530, voted 6]" UBYTE M_FORMULA_0003 0 0 0 255 ECU_ADDRESS 0x3FD118 /end MEASUREMENT
/begin MEASUREMENT md_ipm_n_opt_max "Drehzahl [RAM name from V530, voted 1]" SWORD M_FORMULA_0006 0 0 -32768 32767 ECU_ADDRESS 0x3FD11A /end MEASUREMENT
/begin MEASUREMENT md_abtrieb_min "Min. Abtriebsmoment [RAM name from V530, voted 2]" SWORD M_FORMULA_0009 0 0 -3276.8 3276.7 ECU_ADDRESS 0x3FD11C /end MEASUREMENT
/begin MEASUREMENT md_abtrieb_max "Max. Abtriebsmoment [RAM name from V530, voted 1]" SWORD M_FORMULA_0009 0 0 -3276.8 3276.7 ECU_ADDRESS 0x3FD11E /end MEASUREMENT
/begin MEASUREMENT md_ipm_pwg_null "Nulllinie [RAM name from V530, voted 3]" SWORD M_FORMULA_0001 0 0 -3276.8 3276.7 ECU_ADDRESS 0x3FD120 /end MEASUREMENT
/begin MEASUREMENT md_ipm_pwg_diff "Differenz [RAM name from V530, voted 2]" SWORD M_FORMULA_0001 0 0 -3276.8 3276.7 ECU_ADDRESS 0x3FD122 /end MEASUREMENT
/begin MEASUREMENT md_ipm_pwg_pos "pos. Fahrerwunsch [RAM name from V530, voted 4]" SWORD M_FORMULA_0001 0 0 -3276.8 3276.7 ECU_ADDRESS 0x3FD124 /end MEASUREMENT
/begin MEASUREMENT md_ipm_pwg_neg "neg. Fahrerwunsch [RAM name from V530, voted 2]" SWORD M_FORMULA_0001 0 0 -3276.8 3276.7 ECU_ADDRESS 0x3FD126 /end MEASUREMENT
/begin MEASUREMENT md_abtrieb_pos_rel "rel. Abtriebswunsch [RAM name from V530, voted 2]" SWORD M_FORMULA_0001 0 0 -3276.8 3276.7 ECU_ADDRESS 0x3FD128 /end MEASUREMENT
/begin MEASUREMENT md_abtrieb_neg "neg. Abtriebswunsch [RAM name from V530, voted 2]" SWORD M_FORMULA_0009 0 0 -3276.8 3276.7 ECU_ADDRESS 0x3FD12A /end MEASUREMENT
/begin MEASUREMENT md_abtrieb_pos "pos. Abtriebswunsch [RAM name from V530, voted 2]" SWORD M_FORMULA_0009 0 0 -3276.8 3276.7 ECU_ADDRESS 0x3FD12C /end MEASUREMENT
/begin MEASUREMENT md_abtrieb_wunsch "Abtriebswunsch [RAM name from V530, voted 1]" SWORD M_FORMULA_0009 0 0 -3276.8 3276.7 ECU_ADDRESS 0x3FD12E /end MEASUREMENT
/begin MEASUREMENT md_abtrieb_steigung "Steigungseinfluss [RAM name from V530, voted 4]" SWORD M_FORMULA_0009 0 0 -3276.8 3276.7 ECU_ADDRESS 0x3FD130 /end MEASUREMENT
/begin MEASUREMENT md_rad_wunsch "Radsollmoment [RAM name from V530, voted 1]" SLONG M_FORMULA_0272 0 0 -214748364.8 214748364.7 ECU_ADDRESS 0x3FD134 /end MEASUREMENT
/begin MEASUREMENT md_rad_steigung_fil "Steigung gefiltert [RAM name from V530, voted 4]" SWORD M_FORMULA_0009 0 0 -3276.8 3276.7 ECU_ADDRESS 0x3FD138 /end MEASUREMENT
/begin MEASUREMENT md_rad_bremse "Bremsradmoment [RAM name from V530, voted 3]" SLONG M_FORMULA_0272 0 0 -214748364.8 214748364.7 ECU_ADDRESS 0x3FD13C /end MEASUREMENT
/begin MEASUREMENT md_i_getr_md_min "Uebersetzung fuer PVMAX [RAM name from V530, voted 1]" UWORD M_FORMULA_0073 0 0 0 63.99902344 ECU_ADDRESS 0x3FD146 /end MEASUREMENT
/begin MEASUREMENT md_i_getr_md_max "Uebersetzung fuer PEMAX [RAM name from V530, voted 3]" UWORD M_FORMULA_0073 0 0 0 63.99902344 ECU_ADDRESS 0x3FD148 /end MEASUREMENT
/begin MEASUREMENT md_idx_fp "Umnormierter FP-Index [RAM name from V530, voted 5]" SWORD M_FORMULA_0073 0 0 -32 31.99902344 ECU_ADDRESS 0x3FD14A /end MEASUREMENT
/begin MEASUREMENT md_kus_n_dif "Regelabweichung, Kupplungsschlupf [RAM name from V530, voted 6]" SWORD M_FORMULA_0006 0 0 -32768 32767 ECU_ADDRESS 0x3FD150 /end MEASUREMENT
/begin MEASUREMENT md_kus_n_dif_verz1 "Regelabweichung, 1 x verzoegert, Kupplungsschlupf [RAM name from V530, voted 4]" SWORD M_FORMULA_0006 0 0 -32768 32767 ECU_ADDRESS 0x3FD152 /end MEASUREMENT
/begin MEASUREMENT md_kus_n_dif_verz2 "Regelabweichung, 2 x verzoegert, Kupplungsschlupf [RAM name from V530, voted 2]" SWORD M_FORMULA_0006 0 0 -32768 32767 ECU_ADDRESS 0x3FD154 /end MEASUREMENT
/begin MEASUREMENT md_kus_pid_b0 "Koeffizient b0, PID-Regler [RAM name from V530, voted 2]" SLONG M_FORMULA_0795 0 0 -2147483.648 2147483.647 ECU_ADDRESS 0x3FD158 /end MEASUREMENT
/begin MEASUREMENT md_kus_pid_b1 "Koeffizient b1, PID-Regler [RAM name from V530, voted 2]" SLONG M_FORMULA_0795 0 0 -2147483.648 2147483.647 ECU_ADDRESS 0x3FD15C /end MEASUREMENT
/begin MEASUREMENT md_kus_pid_b2 "Koeffizient b2, PID-Regler [RAM name from V530, voted 2]" SLONG M_FORMULA_0795 0 0 -2147483.648 2147483.647 ECU_ADDRESS 0x3FD160 /end MEASUREMENT
/begin MEASUREMENT md_kus_pid "Motormomentenbegrenzung des PID-Reglers [RAM name from V530, voted 1]" SWORD M_FORMULA_0009 0 0 -3276.8 3276.7 ECU_ADDRESS 0x3FD164 /end MEASUREMENT
/begin MEASUREMENT md_kus_begr1 "effektive Motormomentenbegrenzung, PT1 [RAM name from V530, voted 5]" SWORD M_FORMULA_0009 0 0 -3276.8 3276.7 ECU_ADDRESS 0x3FD166 /end MEASUREMENT
/begin MEASUREMENT md_kus_begr "effektive Motormomentenbegrenzung [RAM name from V530, voted 8]" SWORD M_FORMULA_0009 0 0 -3276.8 3276.7 ECU_ADDRESS 0x3FD168 /end MEASUREMENT
/begin MEASUREMENT md_kus_st_freigabe_alt "Status Kupplungsschlupf-Funktion [RAM name from V530, voted 2]" UBYTE M_FORMULA_0037 0 0 0 255 ECU_ADDRESS 0x3FD16A /end MEASUREMENT
/begin MEASUREMENT md_kus_st_freigabe_alt_enable "Status Kupplungsschlupf-Funktion Enable [RAM name from V530, voted 2]" UBYTE NO_COMPU_METHOD 0 0 0 255 ECU_ADDRESS 0x3FD16A FORMAT "%.4g" /end MEASUREMENT
/begin MEASUREMENT md_sk_timer_0 "SK-Timer bei pwg=0 [RAM name from V530, voted 4]" UWORD M_FORMULA_0021 0 0 0 655.35 ECU_ADDRESS 0x3FD16E /end MEASUREMENT
/begin MEASUREMENT md_sk_timer_1 "SK-Timer bei pwg>0 [RAM name from V530, voted 3]" UWORD M_FORMULA_0021 0 0 0 655.35 ECU_ADDRESS 0x3FD170 /end MEASUREMENT
/begin MEASUREMENT md_sk_fehler "SK-Fehlerinfo [RAM name from V530, voted 15]" UBYTE NO_COMPU_METHOD 0 0 0 255 ECU_ADDRESS 0x3FD172 FORMAT "%.4g" /end MEASUREMENT
/begin MEASUREMENT md_sk_wdkmax "zulaesssiger DK-Winkel bei pwg=0 [RAM name from V530, voted 4]" SWORD M_FORMULA_0001 0 0 -3276.8 3276.7 ECU_ADDRESS 0x3FD174 /end MEASUREMENT
/begin MEASUREMENT md_sk_vergl_soll "Vergleichssollmoment [RAM name from V530, voted 1]" SWORD M_FORMULA_0009 0 0 -3276.8 3276.7 ECU_ADDRESS 0x3FD178 /end MEASUREMENT
/begin MEASUREMENT md_sk_diff_max "max. zulaessige Abweichung [RAM name from V530, voted 1]" SWORD M_FORMULA_0009 0 0 -3276.8 3276.7 ECU_ADDRESS 0x3FD17A /end MEASUREMENT
/begin MEASUREMENT md_sk_vergl_diff "Soll-/Istabweichung [RAM name from V530, voted 1]" SWORD M_FORMULA_0009 0 0 -3276.8 3276.7 ECU_ADDRESS 0x3FD17C /end MEASUREMENT
/begin MEASUREMENT md_sk_wunsch_begr_ml "Begrenzung Luftmoment [RAM name from V530, voted 4]" SWORD M_FORMULA_0009 0 0 -3276.8 3276.7 ECU_ADDRESS 0x3FD17E /end MEASUREMENT
/begin MEASUREMENT md_sk_wunsch_begr_tz "Begrenzung Z???ndungsmoment [RAM name from V530, voted 4]" SWORD M_FORMULA_0009 0 0 -3276.8 3276.7 ECU_ADDRESS 0x3FD180 /end MEASUREMENT
/begin MEASUREMENT md_sk_grad_max "Begrenzung Dynamikfilter [RAM name from V530, voted 3]" SWORD M_FORMULA_0562 0 0 -655360 655340 ECU_ADDRESS 0x3FD182 /end MEASUREMENT
/begin MEASUREMENT md_sk_tired "Anzahl freigegebener Einspritzkanaele [RAM name from V530, voted 4]" UBYTE M_FORMULA_0003 0 0 0 255 ECU_ADDRESS 0x3FD186 /end MEASUREMENT
/begin MEASUREMENT md_sk_verh "Verhaeltnis Sollmoment zu min.Istmoment [RAM name from V530, voted 2]" UWORD M_FORMULA_0073 0 0 0 63.99902344 ECU_ADDRESS 0x3FD188 /end MEASUREMENT
/begin MEASUREMENT md_fw_fgr "rel. Wunschmoment vom FGR [RAM name from V530, voted 10]" SWORD M_FORMULA_0001 0 0 -3276.8 3276.7 ECU_ADDRESS 0x3FD1A0 /end MEASUREMENT
/begin MEASUREMENT md_kupp_min_asc "min. Moment fuer ASC-Eingriff [RAM name from V530, voted 2]" SWORD M_FORMULA_0009 0 0 -3276.8 3276.7 ECU_ADDRESS 0x3FD1A2 /end MEASUREMENT
/begin MEASUREMENT md_kupp_wunsch_grad "Gradient Fahrerwunsch [RAM name from V530, voted 5]" SWORD M_FORMULA_0562 0 0 -655360 655340 ECU_ADDRESS 0x3FD1A4 /end MEASUREMENT
/begin MEASUREMENT md_kupp_wunsch_filter "Wunschmoment nach Dynamikfilter [RAM name from V530, voted 11]" SWORD M_FORMULA_0009 0 0 -3276.8 3276.7 ECU_ADDRESS 0x3FD1A6 /end MEASUREMENT
/begin MEASUREMENT md_kupp_wunsch_ges "Wunschmoment nach Dynamikf./RPS [RAM name from V530, voted 42]" SWORD M_FORMULA_0009 0 0 -3276.8 3276.7 ECU_ADDRESS 0x3FD1A8 /end MEASUREMENT
/begin MEASUREMENT md_kupp_wunsch_begr_eff "effektives Begrenzermoment [RAM name from V530, voted 7]" SWORD M_FORMULA_0009 0 0 -3276.8 3276.7 ECU_ADDRESS 0x3FD1AA /end MEASUREMENT
/begin MEASUREMENT md_kupp_wunsch_ml_komp "komp. Wunschmoment fuer den Luftpfad [RAM name from V530, voted 1]" SWORD M_FORMULA_0009 0 0 -3276.8 3276.7 ECU_ADDRESS 0x3FD1AC /end MEASUREMENT
/begin MEASUREMENT md_kupp_begrenzer "Wunschmomentbegrenzer [RAM name from V530, voted 1]" SWORD M_FORMULA_0009 0 0 -3276.8 3276.7 ECU_ADDRESS 0x3FD1AE /end MEASUREMENT
/begin MEASUREMENT md_eta_zw_komp "Eta-Kompensation ZW [RAM name from V530, voted 3]" UWORD M_FORMULA_0437 0 0 0 199.9969482 ECU_ADDRESS 0x3FD1B0 /end MEASUREMENT
/begin MEASUREMENT md_eta_la_sk "Eta-Kompensation LA+SK [RAM name from V530, voted 2]" UWORD M_FORMULA_0437 0 0 0 199.9969482 ECU_ADDRESS 0x3FD1B2 /end MEASUREMENT
/begin MEASUREMENT md_res_max "max. Momentenreserve [RAM name from V530, voted 1]" SWORD M_FORMULA_0009 0 0 -3276.8 3276.7 ECU_ADDRESS 0x3FD1B6 /end MEASUREMENT
/begin MEASUREMENT md_res_anf "angeforderte Momentenreserve [RAM name from V530, voted 1]" SWORD M_FORMULA_0009 0 0 -3276.8 3276.7 ECU_ADDRESS 0x3FD1B8 /end MEASUREMENT
/begin MEASUREMENT md_res_zw "Momentenreserve ZW-Kompensation [RAM name from V530, voted 3]" SWORD M_FORMULA_0009 0 0 -3276.8 3276.7 ECU_ADDRESS 0x3FD1BA /end MEASUREMENT
/begin MEASUREMENT md_res "Momentenreserve [RAM name from V530, voted 3]" SWORD M_FORMULA_0009 0 0 -3276.8 3276.7 ECU_ADDRESS 0x3FD1BE /end MEASUREMENT
/begin MEASUREMENT md_ind_wunsch_ges "ind. Wunschmoment [RAM name from V530, voted 1]" SWORD M_FORMULA_0009 0 0 -3276.8 3276.7 ECU_ADDRESS 0x3FD1C0 /end MEASUREMENT
/begin MEASUREMENT md_ind_wunsch_ml "ind. Wunschmoment fuer den Luftpfad [RAM name from V530, voted 3]" SWORD M_FORMULA_0009 0 0 -3276.8 3276.7 ECU_ADDRESS 0x3FD1C2 /end MEASUREMENT
/begin MEASUREMENT md_ind_wunsch_ml_komp "Luft-Wunschmoment nach Kompensation [RAM name from V530, voted 5]" SWORD M_FORMULA_0009 0 0 -3276.8 3276.7 ECU_ADDRESS 0x3FD1C4 /end MEASUREMENT
/begin MEASUREMENT md_ind_wunsch_tz_grad "Gradient Sollmoment [RAM name from V530, voted 4]" SWORD M_FORMULA_0562 0 0 -655360 655340 ECU_ADDRESS 0x3FD1C6 /end MEASUREMENT
/begin MEASUREMENT md_eta_bezug "Bezugsmoment Eta-Berechnung [RAM name from V530, voted 3]" SWORD M_FORMULA_0009 0 0 -3276.8 3276.7 ECU_ADDRESS 0x3FD1C8 /end MEASUREMENT
/begin MEASUREMENT md_mzyl_soll_asp_b1 "Soll-Mzyl [RAM name from V530, voted 1]" SWORD M_FORMULA_0104 0 0 -3276.8 3276.7 ECU_ADDRESS 0x3FD1CA /end MEASUREMENT
/begin MEASUREMENT md_rf_soll_pt_rg_fr_b1 "Soll-rf mit pt-,rg-,fr-Korr [RAM name from V530, voted 2]" SWORD M_FORMULA_0007 0 0 -3.2768 3.2767 ECU_ADDRESS 0x3FD1CE /end MEASUREMENT
/begin MEASUREMENT md_tz_eingr_aktiv "TZ-Eingriff [RAM name from V530, voted 1]" UBYTE NO_COMPU_METHOD 0 0 0 255 ECU_ADDRESS 0x3FD1DE FORMAT "%.4g" /end MEASUREMENT
/begin MEASUREMENT md_tz_eingr_bezug "TZ-Bezugsmoment [RAM name from V530, voted 3]" UBYTE NO_COMPU_METHOD 0 0 0 255 ECU_ADDRESS 0x3FD1DF FORMAT "%.4g" /end MEASUREMENT
/begin MEASUREMENT md_tz_st "TZ-Status [RAM name from V530, voted 5]" UWORD M_FORMULA_0010 0 0 0 65535 ECU_ADDRESS 0x3FD1E0 /end MEASUREMENT
/begin MEASUREMENT md_tz_soll_zyl1 "Soll-TZ [RAM name from V530, voted 4]" SWORD M_FORMULA_0102 0 0 -3276.8 3276.7 ECU_ADDRESS 0x3FD1E2 /end MEASUREMENT
/begin MEASUREMENT md_kupp_nbegr "max. Moment bei Drehzahlbegrenzung [RAM name from V530, voted 3]" SWORD M_FORMULA_0009 0 0 -3276.8 3276.7 ECU_ADDRESS 0x3FD1F6 /end MEASUREMENT
/begin MEASUREMENT md_kupp_vbegr "Moment Geschwindigkeitsbegrenzung [RAM name from V530, voted 6]" SWORD M_FORMULA_0009 0 0 -3276.8 3276.7 ECU_ADDRESS 0x3FD1FC /end MEASUREMENT
/begin MEASUREMENT md_vbegr_t "Timer Geschwindigkeitsbegrenzung [RAM name from V530, voted 4]" UWORD M_FORMULA_0109 0 0 0 327.675 ECU_ADDRESS 0x3FD204 /end MEASUREMENT
/begin MEASUREMENT md_nbegr_gang "Ganginfo [RAM name from V530, voted 5]" UBYTE M_FORMULA_0135 0 0 0 255 ECU_ADDRESS 0x3FD206 /end MEASUREMENT
/begin MEASUREMENT md_nbegr_b0 "Reglerfaktor b0 [RAM name from V530, voted 1]" ULONG M_FORMULA_0795 0 0 0 4294967.295 ECU_ADDRESS 0x3FD210 /end MEASUREMENT
/begin MEASUREMENT md_nbegr_b1 "Reglerfaktor b1 [RAM name from V530, voted 2]" ULONG M_FORMULA_0799 0 0 -4294967.295 0 ECU_ADDRESS 0x3FD214 /end MEASUREMENT
/begin MEASUREMENT md_nbegr_b2 "Reglerfaktor b2 [RAM name from V530, voted 2]" ULONG M_FORMULA_0795 0 0 0 4294967.295 ECU_ADDRESS 0x3FD218 /end MEASUREMENT
/begin MEASUREMENT md_vbegr_b0 "Reglerfaktor b0 [RAM name from V530, voted 2]" ULONG M_FORMULA_0800 0 0 0 4294967.295 ECU_ADDRESS 0x3FD21C /end MEASUREMENT
/begin MEASUREMENT md_vbegr_b1 "Reglerfaktor b1 [RAM name from V530, voted 2]" ULONG M_FORMULA_0801 0 0 -4294967.295 0 ECU_ADDRESS 0x3FD220 /end MEASUREMENT
/begin MEASUREMENT md_vbegr_b2 "Reglerfaktor b2 [RAM name from V530, voted 2]" ULONG M_FORMULA_0800 0 0 0 4294967.295 ECU_ADDRESS 0x3FD224 /end MEASUREMENT
/begin MEASUREMENT md_v_max_delta "Regeldifferenz gefiltert [RAM name from V530, voted 9]" SWORD M_FORMULA_0076 0 0 -2048 2047.9375 ECU_ADDRESS 0x3FD228 /end MEASUREMENT
/begin MEASUREMENT md_noise_st "Noisestatus [RAM name from V530, voted 5]" UBYTE NO_COMPU_METHOD 0 0 0 255 ECU_ADDRESS 0x3FD22A FORMAT "%.4g" /end MEASUREMENT
/begin MEASUREMENT md_noise_t "Noisetime [RAM name from V530, voted 2]" UWORD M_FORMULA_0071 0 0 0 6553.5 ECU_ADDRESS 0x3FD22C /end MEASUREMENT
/begin MEASUREMENT md_kupp_noise_max "max. Moment bei Noise [RAM name from V530, voted 5]" SWORD M_FORMULA_0009 0 0 -3276.8 3276.7 ECU_ADDRESS 0x3FD22E /end MEASUREMENT
/begin MEASUREMENT md_rf_soll_pt_fr_wicht_fil_b1 "Soll-rf mit pt-Korr+fr+wicht und gefiltert [RAM name from V530, voted 2]" SWORD M_FORMULA_0007 0 0 -3.2768 3.2767 ECU_ADDRESS 0x3F87AA /end MEASUREMENT
/begin MEASUREMENT n_st_a "Status Drehzahlerfassung [RAM name from V530, voted 9]" UBYTE NO_COMPU_METHOD 0 0 0 255 ECU_ADDRESS 0x3FD380 FORMAT "%.4g" /end MEASUREMENT
/begin MEASUREMENT n_st_b "Status Drehzahlerfassung [RAM name from V530, voted 5]" UBYTE NO_COMPU_METHOD 0 0 0 255 ECU_ADDRESS 0x3FD381 FORMAT "%.4g" /end MEASUREMENT
/begin MEASUREMENT n_timer_stoerung_a "Zeitzaehler fuer Freeze Drehzahlerfassung [RAM name from V530, voted 2]" SBYTE M_FORMULA_0306 0 0 -1.28 1.27 ECU_ADDRESS 0x3FD382 /end MEASUREMENT
/begin MEASUREMENT n_proz "Ersatzdrehzahl des jeweiligen Prozessors. [RAM name from V530, voted 3]" SWORD M_FORMULA_0006 0 0 -32768 32767 ECU_ADDRESS 0x3FD384 /end MEASUREMENT
/begin MEASUREMENT n_zahn_a "Drehzahl aus Zahnabstand [RAM name from V530, voted 2]" SWORD M_FORMULA_0006 0 0 -32768 32767 ECU_ADDRESS 0x3FD386 /end MEASUREMENT
/begin MEASUREMENT n_segm_a "Drehzahl aus Segmentabstand. [RAM name from V530, voted 5]" SWORD M_FORMULA_0006 0 0 -32768 32767 ECU_ADDRESS 0x3FD38A /end MEASUREMENT
/begin MEASUREMENT n_segm_b "Drehzahl aus Segmentabstand. [RAM name from V530, voted 2]" SWORD M_FORMULA_0006 0 0 -32768 32767 ECU_ADDRESS 0x3FD38C /end MEASUREMENT
/begin MEASUREMENT n_t_segm_a "Segmentzeit. [RAM name from V530, voted 1]" UWORD M_FORMULA_0354 0 0 0 104.856 ECU_ADDRESS 0x3FD38E /end MEASUREMENT
/begin MEASUREMENT n_t_segm_start_a "Segmentstartzeit. [RAM name from V530, voted 1]" ULONG M_FORMULA_0017 0 0 0 613566.7564 ECU_ADDRESS 0x3FD394 /end MEASUREMENT
/begin MEASUREMENT n_getr_ein_hs "Getriebeeingangsdrehzahl Handschalter [RAM name from V530, voted 4]" SWORD M_FORMULA_0006 0 0 -32768 32767 ECU_ADDRESS 0x3FD3A0 /end MEASUREMENT
/begin MEASUREMENT n_getr_abtrieb_ersatz "Getriebeabtriebsdrehzahl Ersatzwert [RAM name from V530, voted 1]" SWORD M_FORMULA_0006 0 0 -32768 32767 ECU_ADDRESS 0x3FD3A2 /end MEASUREMENT
/begin MEASUREMENT n_getr_abtrieb_ha "Getriebeabtriebsdrehzahl Hinterachse [RAM name from V530, voted 2]" SWORD M_FORMULA_0006 0 0 -32768 32767 ECU_ADDRESS 0x3FD3A4 /end MEASUREMENT
/begin MEASUREMENT os_err.id.cnt "OS-Err: ID [RAM name from V530, voted 4]" UBYTE M_FORMULA_0003 0 0 0 255 ECU_ADDRESS 0x3FD410 /end MEASUREMENT
/begin MEASUREMENT os_err.limit.cnt "OS-Err: Limit [RAM name from V530, voted 2]" UBYTE M_FORMULA_0003 0 0 0 255 ECU_ADDRESS 0x3FD412 /end MEASUREMENT
/begin MEASUREMENT os_err.tt_act.cnt "OS-Err: TT aktiv [RAM name from V530, voted 2]" UBYTE M_FORMULA_0003 0 0 0 255 ECU_ADDRESS 0x3FD414 /end MEASUREMENT
/begin MEASUREMENT os_err.tt_miss.cnt "OS-Err: TT missing [RAM name from V530, voted 2]" UBYTE M_FORMULA_0003 0 0 0 255 ECU_ADDRESS 0x3FD418 /end MEASUREMENT
/begin MEASUREMENT os_err.stack.cnt "OS-Err: Stack [RAM name from V530, voted 2]" UBYTE M_FORMULA_0003 0 0 0 255 ECU_ADDRESS 0x3FD41A /end MEASUREMENT
/begin MEASUREMENT os_err.deadline.cnt "OS-Err: Deadline [RAM name from V530, voted 2]" UBYTE M_FORMULA_0003 0 0 0 255 ECU_ADDRESS 0x3FD420 /end MEASUREMENT
/begin MEASUREMENT os_err.dflt.cnt "OS-Err: Default [RAM name from V530, voted 2]" UBYTE M_FORMULA_0003 0 0 0 255 ECU_ADDRESS 0x3FD422 /end MEASUREMENT
/begin MEASUREMENT os_err.dflt.task "OS-Err: Default [RAM name from V530, voted 1]" UBYTE NO_COMPU_METHOD 0 0 0 255 ECU_ADDRESS 0x3FD423 FORMAT "%.4g" /end MEASUREMENT
/begin MEASUREMENT os_err.addr "OS-Err: Adresse [RAM name from V530, voted 2]" ULONG M_FORMULA_0000 0 0 0 4294967295 ECU_ADDRESS 0x3FD424 /end MEASUREMENT
/begin MEASUREMENT os_err.sum_cnt "OS-Err: Summe [RAM name from V530, voted 2]" UBYTE M_FORMULA_0003 0 0 0 255 ECU_ADDRESS 0x3FD428 /end MEASUREMENT
/begin MEASUREMENT os_err.type "Fehlertyp [RAM name from V530, voted 2]" UBYTE NO_COMPU_METHOD 0 0 0 255 ECU_ADDRESS 0x3FD429 FORMAT "%.4g" /end MEASUREMENT
/begin MEASUREMENT pctrl_t_old_ipk "vorheriger Timer Wert aus der IPK [RAM name from V530, voted 3]" ULONG M_FORMULA_0000 0 0 0 4294967295 ECU_ADDRESS 0x3FD42C /end MEASUREMENT
/begin MEASUREMENT pctrl_task_tb "Timerwert Task-Ueberwachungszyklus [RAM name from V530, voted 3]" UBYTE M_FORMULA_0357 0 0 0 1.275 ECU_ADDRESS 0x3FD430 /end MEASUREMENT
/begin MEASUREMENT pctrl_proz_tb "Timerwert Prozess-Ueberwachungszyklus [RAM name from V530, voted 4]" UBYTE M_FORMULA_0357 0 0 0 1.275 ECU_ADDRESS 0x3FD431 /end MEASUREMENT
/begin MEASUREMENT pctrl_tout "Timeout Zaehler [RAM name from V530, voted 4]" UBYTE M_FORMULA_0358 0 0 0 2550 ECU_ADDRESS 0x3FD432 /end MEASUREMENT
/begin MEASUREMENT pctrl_task "Taskueberwachung [RAM name from V530, voted 21]" UBYTE M_FORMULA_0003 0 0 0 255 ECU_ADDRESS 0x3FD433 /end MEASUREMENT
/begin MEASUREMENT pctrl_task_err "Fehler Taskueberwachung [RAM name from V530, voted 7]" UBYTE M_FORMULA_0003 0 0 0 255 ECU_ADDRESS 0x3FD434 /end MEASUREMENT
/begin MEASUREMENT pctrl_proz "Prozessueberwachung [RAM name from V530, voted 30]" UWORD M_FORMULA_0010 0 0 0 65535 ECU_ADDRESS 0x3FD436 /end MEASUREMENT
/begin MEASUREMENT pctrl_proz_err "Fehler Prozessueberwachung [RAM name from V530, voted 8]" UWORD M_FORMULA_0010 0 0 0 65535 ECU_ADDRESS 0x3FD438 /end MEASUREMENT
/begin MEASUREMENT pks_can_timeout "PKS-Timeout [RAM name from V530, voted 2]" UWORD M_FORMULA_0109 0 0 0 327.675 ECU_ADDRESS 0x3FD43A /end MEASUREMENT
/begin MEASUREMENT pks_can_ed_tsperr "PKS-Diagosesperrzeit [RAM name from V530, voted 4]" UWORD M_FORMULA_0109 0 0 0 327.675 ECU_ADDRESS 0x3FD43C /end MEASUREMENT
/begin MEASUREMENT pks_can_alive "PKS-Alive [RAM name from V530, voted 2]" UBYTE M_FORMULA_0003 0 0 0 255 ECU_ADDRESS 0x3FD43E /end MEASUREMENT
/begin MEASUREMENT pwg_bls_st "Bremsenbegrenzungstatus [RAM name from V530, voted 6]" UBYTE M_FORMULA_0037 0 0 0 255 ECU_ADDRESS 0x3FD458 /end MEASUREMENT
/begin MEASUREMENT pwg_bls_st_begrenzung "PWG_BLS-Status [RAM name from V530, voted 6]" UBYTE NO_COMPU_METHOD 0 0 0 255 ECU_ADDRESS 0x3FD458 FORMAT "%.4g" /end MEASUREMENT
/begin MEASUREMENT pwg_bls_st_berganfahren "PWG_BLS-Status [RAM name from V530, voted 6]" UBYTE NO_COMPU_METHOD 0 0 0 255 ECU_ADDRESS 0x3FD458 FORMAT "%.4g" /end MEASUREMENT
/begin MEASUREMENT pwg_bls_st_druckerfassung "PWG_BLS-Status [RAM name from V530, voted 6]" UBYTE NO_COMPU_METHOD 0 0 0 255 ECU_ADDRESS 0x3FD458 FORMAT "%.4g" /end MEASUREMENT
/begin MEASUREMENT pwg_bls_st_v_begrenzung "PWG_BLS-Status [RAM name from V530, voted 6]" UBYTE NO_COMPU_METHOD 0 0 0 255 ECU_ADDRESS 0x3FD458 FORMAT "%.4g" /end MEASUREMENT
/begin MEASUREMENT pwg_bls_t_brp "Begrenzungsverzoegerung-Bremsdruck [RAM name from V530, voted 1]" UBYTE M_FORMULA_0584 0 0 0 1275 ECU_ADDRESS 0x3FD459 /end MEASUREMENT
/begin MEASUREMENT pwg_bls_t_v "Begrenzungsverzoegerung-Geschwindigkeit [RAM name from V530, voted 1]" UBYTE M_FORMULA_0584 0 0 0 1275 ECU_ADDRESS 0x3FD45A /end MEASUREMENT
/begin MEASUREMENT pwg_abschalt "Im Fehlerfall Abschaltung durch die Bremse [RAM name from V530, voted 4]" UBYTE M_FORMULA_0003 0 0 0 255 ECU_ADDRESS 0x3FD45F /end MEASUREMENT
/begin MEASUREMENT pwg_abschalt_bremse "Status der Sicherheitsabschaltung [RAM name from V530, voted 4]" UBYTE NO_COMPU_METHOD 0 0 0 255 ECU_ADDRESS 0x3FD45F FORMAT "%.4g" /end MEASUREMENT
/begin MEASUREMENT pwg_abschalt_sperre "Status der Sicherheitsabschaltung [RAM name from V530, voted 4]" UBYTE NO_COMPU_METHOD 0 0 0 255 ECU_ADDRESS 0x3FD45F FORMAT "%.4g" /end MEASUREMENT
/begin MEASUREMENT pwg_ab_rampe "Abregelrampe im Fehlerfall [RAM name from V530, voted 6]" UWORD M_FORMULA_0878 0 0 0 0.9999847412 ECU_ADDRESS 0x3FD460 /end MEASUREMENT
/begin MEASUREMENT pwg_max_diff "Maximal zulaessige Differenz der Pedalwertgeber [RAM name from V530, voted 1]" SWORD M_FORMULA_0001 0 0 -3276.8 3276.7 ECU_ADDRESS 0x3FD462 /end MEASUREMENT
/begin MEASUREMENT pwg1_ad "Eingelesener AD-Wert fuer Pedalwertgeber 1 [RAM name from V530, voted 2]" SWORD M_FORMULA_0114 0 0 -32768 32767 ECU_ADDRESS 0x3FD464 /end MEASUREMENT
/begin MEASUREMENT pwg2_ad "Eingelesener AD-Wert fuer Pedalwertgeber 2 [RAM name from V530, voted 1]" SWORD M_FORMULA_0114 0 0 -32768 32767 ECU_ADDRESS 0x3FD466 /end MEASUREMENT
/begin MEASUREMENT pwg2_roh "Relativer Rohwert PWG2 [RAM name from V530, voted 1]" SWORD M_FORMULA_0001 0 0 -3276.8 3276.7 ECU_ADDRESS 0x3FD46E /end MEASUREMENT
/begin MEASUREMENT pwg_filter "Gefilterter Messwert der Pedalwerterfassung [RAM name from V530, voted 3]" UWORD M_FORMULA_0448 0 0 0 102.3984375 ECU_ADDRESS 0x3FD470 /end MEASUREMENT
/begin MEASUREMENT pwg_begrenz "Durch Bremse begrenzter PWG [RAM name from V530, voted 1]" UWORD M_FORMULA_0448 0 0 0 102.3984375 ECU_ADDRESS 0x3FD472 /end MEASUREMENT
/begin MEASUREMENT pwg1_a0_zaehler "Zaehlervariable fuer die Aufwaertsadaption 1 [RAM name from V530, voted 7]" UBYTE M_FORMULA_0003 0 0 0 255 ECU_ADDRESS 0x3FD476 /end MEASUREMENT
/begin MEASUREMENT pwg2_a0_zaehler "Zaehlervariable fuer die Aufwaertsadaption 2 [RAM name from V530, voted 7]" UBYTE M_FORMULA_0003 0 0 0 255 ECU_ADDRESS 0x3FD477 /end MEASUREMENT
/begin MEASUREMENT pwg_soll_2gang_st "Status 2. Ganganfahrt [RAM name from V530, voted 5]" UBYTE NO_COMPU_METHOD 0 0 0 255 ECU_ADDRESS 0x3FD478 FORMAT "%.4g" /end MEASUREMENT
/begin MEASUREMENT pwg_soll_2gang_fak "Faktor 2. Ganganfahrt [RAM name from V530, voted 4]" UWORD M_FORMULA_0073 0 0 0 63.99902344 ECU_ADDRESS 0x3FD47A /end MEASUREMENT
/begin MEASUREMENT ram_chk_rptr "aktueller RAM_CHK Zeiger [RAM name from V530, voted 4]" ULONG M_FORMULA_0000 0 0 0 4294967295 ECU_ADDRESS 0x3FD484 /end MEASUREMENT
/begin MEASUREMENT ram_chk_freq "Ueberprufeungsfreuquenz RAM [RAM name from V530, voted 1]" UWORD M_FORMULA_0360 0 0 0 655.35 ECU_ADDRESS 0x3FD488 /end MEASUREMENT
/begin MEASUREMENT rf_kor_n_lw_sst8 "SST [RAM name from V530, voted 11]" ULONG M_FORMULA_0000 0 0 0 4294967295 ECU_ADDRESS 0x3FD48C /end MEASUREMENT
/begin MEASUREMENT rf_kor_md_rf_soll_pt_sst8 "Gruppenkennfledstuetzstelle fuer md_rf_soll_pt [RAM name from V530, voted 10]" ULONG M_FORMULA_0000 0 0 0 4294967295 ECU_ADDRESS 0x3FD490 /end MEASUREMENT
/begin MEASUREMENT rf_kor_van_soll_roh "Korrekturfaktor van_soll [RAM name from V530, voted 1]" UWORD M_FORMULA_0073 0 0 0 63.99902344 ECU_ADDRESS 0x3FD4E0 /end MEASUREMENT
/begin MEASUREMENT rf_kor_van_soll "Korrektur van_soll [RAM name from V530, voted 1]" UWORD M_FORMULA_0073 0 0 0 63.99902344 ECU_ADDRESS 0x3FD4E2 /end MEASUREMENT
/begin MEASUREMENT rf_kor_van_ist_roh_b1 "Korrekturfaktor van_ist [RAM name from V530, voted 1]" UWORD M_FORMULA_0073 0 0 0 63.99902344 ECU_ADDRESS 0x3FD4E4 /end MEASUREMENT
/begin MEASUREMENT rf_kor_van_ist_b1 "Korrektur van_ist [RAM name from V530, voted 2]" UWORD M_FORMULA_0073 0 0 0 63.99902344 ECU_ADDRESS 0x3FD4E8 /end MEASUREMENT
/begin MEASUREMENT schalter_wakeup_ad_ign "Eingelesener Spannungswert Wakeup [RAM name from V530, voted 1]" SWORD M_FORMULA_0114 0 0 -32768 32767 ECU_ADDRESS 0x3FD51C /end MEASUREMENT
/begin MEASUREMENT schalter_bls_ad_ign "Eingelesener Spannungswert Bremslichtschalter [RAM name from V530, voted 1]" SWORD M_FORMULA_0114 0 0 -32768 32767 ECU_ADDRESS 0x3FD51E /end MEASUREMENT
/begin MEASUREMENT schalter_kl87_ad "Eingelesener Spannungswert Klemme 87 [RAM name from V530, voted 1]" SWORD M_FORMULA_0114 0 0 -32768 32767 ECU_ADDRESS 0x3FD520 /end MEASUREMENT
/begin MEASUREMENT sk_fail_st_zyl "Zusammenfassung Ausblender [RAM name from V530, voted 6]" UWORD NO_COMPU_METHOD 0 0 0 65535 ECU_ADDRESS 0x3FD5A6 FORMAT "%.4g" /end MEASUREMENT
/begin MEASUREMENT sk_fm_gemisch "Eingang Gemisch-Matrix [RAM name from V530, voted 10]" UBYTE NO_COMPU_METHOD 0 0 0 255 ECU_ADDRESS 0x3FD5A8 FORMAT "%.4g" /end MEASUREMENT
/begin MEASUREMENT sk_fm_egas_exd "Abschaltung ueber Exd [RAM name from V530, voted 2]" UBYTE NO_COMPU_METHOD 0 0 0 255 ECU_ADDRESS 0x3FD5AA FORMAT "%.4g" /end MEASUREMENT
/begin MEASUREMENT sk_tr_error_cnt "Fehlerzaehler Testrechnung [RAM name from V530, voted 1]" UBYTE M_FORMULA_0003 0 0 0 255 ECU_ADDRESS 0x3FD5AE /end MEASUREMENT
/begin MEASUREMENT sk_fm_lam "Eingang LAM-Matrix [RAM name from V530, voted 5]" UBYTE NO_COMPU_METHOD 0 0 0 255 ECU_ADDRESS 0x3FD5AF FORMAT "%.4g" /end MEASUREMENT
/begin MEASUREMENT sk_md_begr_st "Ausloeser MD-Begrenzung [RAM name from V530, voted 10]" UWORD NO_COMPU_METHOD 0 0 0 65535 ECU_ADDRESS 0x3FD5B2 FORMAT "%.4g" /end MEASUREMENT
/begin MEASUREMENT sk_ti_off_st "Ausloeser TI-Abschaltung [RAM name from V530, voted 4]" UWORD NO_COMPU_METHOD 0 0 0 65535 ECU_ADDRESS 0x3FD5B4 FORMAT "%.4g" /end MEASUREMENT
/begin MEASUREMENT sk_egas_off_time_b1 "Zeit bis Egasabschaltung [RAM name from V530, voted 3]" UWORD M_FORMULA_0021 0 0 0 655.35 ECU_ADDRESS 0x3FD5B6 /end MEASUREMENT
/begin MEASUREMENT sk_egas_off_time_b2 "Zeit bis Egasabschaltung [RAM name from V530, voted 1]" UWORD M_FORMULA_0021 0 0 0 655.35 ECU_ADDRESS 0x3FD5B8 /end MEASUREMENT
/begin MEASUREMENT sk_ti_zyl_off_cnt "Anzahl der Ausblender [RAM name from V530, voted 8]" UBYTE M_FORMULA_0003 0 0 0 255 ECU_ADDRESS 0x3FD5BA /end MEASUREMENT
/begin MEASUREMENT sk_tr_retry "Retry-Counter [RAM name from V530, voted 4]" UBYTE M_FORMULA_0003 0 0 0 255 ECU_ADDRESS 0x3FD5BE /end MEASUREMENT
/begin MEASUREMENT sk_tr_timeout "Timeout - keine neue TR [RAM name from V530, voted 6]" UBYTE M_FORMULA_0306 0 0 0 2.55 ECU_ADDRESS 0x3FD5BF /end MEASUREMENT
/begin MEASUREMENT smg_old.t_korr "Verkuerzung der Abregelzeit [RAM name from V530, voted 17]" UWORD M_FORMULA_0896 0 0 0 51199.21875 ECU_ADDRESS 0x3FD5DA /end MEASUREMENT
/begin MEASUREMENT smg_old.modul "Modulstatus - gesichert [RAM name from V530, voted 6]" UBYTE NO_COMPU_METHOD 0 0 0 255 ECU_ADDRESS 0x3FD5EC FORMAT "%.4g" /end MEASUREMENT
/begin MEASUREMENT smg_old.flags "diverse Bits [RAM name from V530, voted 30]" UBYTE M_FORMULA_0003 0 0 0 255 ECU_ADDRESS 0x3FD5EE /end MEASUREMENT
/begin MEASUREMENT smg_old.flags_anf "Anfahren aus Schalten [RAM name from V530, voted 30]" UBYTE NO_COMPU_METHOD 0 0 0 255 ECU_ADDRESS 0x3FD5EE FORMAT "%.4g" /end MEASUREMENT
/begin MEASUREMENT smg_old.flags_nl "NL ueber Rampe [RAM name from V530, voted 30]" UBYTE NO_COMPU_METHOD 0 0 0 255 ECU_ADDRESS 0x3FD5EE FORMAT "%.4g" /end MEASUREMENT
/begin MEASUREMENT smg_old.flags_sa "Ausblendfreigabe [RAM name from V530, voted 30]" UBYTE NO_COMPU_METHOD 0 0 0 255 ECU_ADDRESS 0x3FD5EE FORMAT "%.4g" /end MEASUREMENT
/begin MEASUREMENT smg_old.schaltart "Schaltart - gesichert [RAM name from V530, voted 13]" UWORD M_FORMULA_0010 0 0 0 65535 ECU_ADDRESS 0x3FD5E6 /end MEASUREMENT
/begin MEASUREMENT smg_fw_rel_virt "Virtueller Fahrerwunsch [RAM name from V530, voted 3]" UBYTE M_FORMULA_0757 0 0 0 1.9921875 ECU_ADDRESS 0x3FD5F0 /end MEASUREMENT
/begin MEASUREMENT smg_md_fahrer_ab "Wunschmoment fuers Abregeln [RAM name from V530, voted 6]" SWORD M_FORMULA_0009 0 0 -3276.8 3276.7 ECU_ADDRESS 0x3FD5F2 /end MEASUREMENT
/begin MEASUREMENT smg_md_fahrer_auf "Wunschmoment fuers Aufregeln [RAM name from V530, voted 5]" SWORD M_FORMULA_0009 0 0 -3276.8 3276.7 ECU_ADDRESS 0x3FD5F4 /end MEASUREMENT
/begin MEASUREMENT smg_md_dsc_abs "Betrag der DSC-Anforderung [RAM name from V530, voted 3]" SWORD M_FORMULA_0009 0 0 -3276.8 3276.7 ECU_ADDRESS 0x3FD5F6 /end MEASUREMENT
/begin MEASUREMENT smg_n_diff_getr "Differenz Getriebe - Motor [RAM name from V530, voted 5]" SWORD M_FORMULA_0006 0 0 -32768 32767 ECU_ADDRESS 0x3FD5F8 /end MEASUREMENT
/begin MEASUREMENT smg_dn_filter "gefilt. Drehzahlgradient [RAM name from V530, voted 2]" SWORD M_FORMULA_0105 0 0 -32768 32767 ECU_ADDRESS 0x3FD600 /end MEASUREMENT
/begin MEASUREMENT smg_schaltart_lw_cnt "Lastwechsel-Z???hler [RAM name from V530, voted 6]" UBYTE M_FORMULA_0003 0 0 0 255 ECU_ADDRESS 0x3FD602 /end MEASUREMENT
/begin MEASUREMENT smg_ki_ab "Abregel-Kennung [RAM name from V530, voted 4]" UBYTE M_FORMULA_0003 0 0 0 255 ECU_ADDRESS 0x3FD603 /end MEASUREMENT
/begin MEASUREMENT smg_ki_scha "Schalt-Kennung [RAM name from V530, voted 6]" UBYTE M_FORMULA_0003 0 0 0 255 ECU_ADDRESS 0x3FD604 /end MEASUREMENT
/begin MEASUREMENT smg_ki_auf "Aufregel-Kennung [RAM name from V530, voted 5]" UBYTE M_FORMULA_0003 0 0 0 255 ECU_ADDRESS 0x3FD605 /end MEASUREMENT
/begin MEASUREMENT smg_st_ekr "Status Einkuppelfreigabe [RAM name from V530, voted 20]" UBYTE M_FORMULA_0003 0 0 0 255 ECU_ADDRESS 0x3FD606 /end MEASUREMENT
/begin MEASUREMENT smg_st_ekr_n "EKR-Sperre wg. n-Bezug [RAM name from V530, voted 20]" UBYTE NO_COMPU_METHOD 0 0 0 255 ECU_ADDRESS 0x3FD606 FORMAT "%.4g" /end MEASUREMENT
/begin MEASUREMENT smg_st_ekr_n_max "EKR-Sperre wg. Nmax [RAM name from V530, voted 20]" UBYTE NO_COMPU_METHOD 0 0 0 255 ECU_ADDRESS 0x3FD606 FORMAT "%.4g" /end MEASUREMENT
/begin MEASUREMENT smg_kschlupf_st "Kupplungsschlupf-Status [RAM name from V530, voted 6]" UBYTE NO_COMPU_METHOD 0 0 0 255 ECU_ADDRESS 0x3FD607 FORMAT "%.4g" /end MEASUREMENT
/begin MEASUREMENT smg_kschlupf "Kupplungsschlupf [RAM name from V530, voted 2]" SWORD M_FORMULA_0904 0 0 -3200 3199.902344 ECU_ADDRESS 0x3FD608 /end MEASUREMENT
/begin MEASUREMENT smg_radschlupf "Radschlupf [RAM name from V530, voted 3]" SWORD M_FORMULA_0904 0 0 -3200 3199.902344 ECU_ADDRESS 0x3FD60A /end MEASUREMENT
/begin MEASUREMENT smg_prog_max_toel "Toel-Programmbegrenzung [RAM name from V530, voted 2]" UBYTE M_FORMULA_0263 0 0 0 255 ECU_ADDRESS 0x3FD60C /end MEASUREMENT
/begin MEASUREMENT smg_prog_max_sk "SK-Programmbegrenzung [RAM name from V530, voted 1]" UBYTE M_FORMULA_0263 0 0 0 255 ECU_ADDRESS 0x3FD60D /end MEASUREMENT
/begin MEASUREMENT smg_prog_min_berg "Programmanhebung am Berg [RAM name from V530, voted 1]" UBYTE M_FORMULA_0263 0 0 0 255 ECU_ADDRESS 0x3FD60E /end MEASUREMENT
/begin MEASUREMENT smg_prog_info_intern "internes Programm [RAM name from V530, voted 2]" UBYTE M_FORMULA_0263 0 0 0 255 ECU_ADDRESS 0x3FD60F /end MEASUREMENT
/begin MEASUREMENT smg_n_getr_ein "gerechnete Drehzahl am Getriebeeingang [RAM name from V530, voted 1]" SWORD M_FORMULA_0006 0 0 -32768 32767 ECU_ADDRESS 0x3FD610 /end MEASUREMENT
/begin MEASUREMENT smg_dn_getr_ein_fil "gefilt. Drehzahl am Getriebeeingang [RAM name from V530, voted 1]" SWORD M_FORMULA_0105 0 0 -32768 32767 ECU_ADDRESS 0x3FD614 /end MEASUREMENT
/begin MEASUREMENT smg_dn_mot_getr "Gradient Motor/Getriebe [RAM name from V530, voted 3]" SWORD M_FORMULA_0105 0 0 -32768 32767 ECU_ADDRESS 0x3FD616 /end MEASUREMENT
/begin MEASUREMENT smg_ay_zunahme "Zunahme ay [RAM name from V530, voted 1]" SWORD M_FORMULA_0123 0 0 -819.2 819.175 ECU_ADDRESS 0x3FD618 /end MEASUREMENT
/begin MEASUREMENT smg_kupp_modul "Kupplungs-Modul [RAM name from V530, voted 12]" UBYTE NO_COMPU_METHOD 0 0 0 255 ECU_ADDRESS 0x3FD61A FORMAT "%.4g" /end MEASUREMENT
/begin MEASUREMENT smg_kupp_flags "Kupplung-Flags [RAM name from V530, voted 37]" UBYTE M_FORMULA_0003 0 0 0 255 ECU_ADDRESS 0x3FD61B /end MEASUREMENT
/begin MEASUREMENT smg_kupp_flags_abs "RAB mit ABS-Eingriff [RAM name from V530, voted 37]" UBYTE NO_COMPU_METHOD 0 0 0 255 ECU_ADDRESS 0x3FD61B FORMAT "%.4g" /end MEASUREMENT
/begin MEASUREMENT smg_kupp_flags_adapt "Adaptionssperre [RAM name from V530, voted 37]" UBYTE NO_COMPU_METHOD 0 0 0 255 ECU_ADDRESS 0x3FD61B FORMAT "%.4g" /end MEASUREMENT
/begin MEASUREMENT smg_kupp_flags_anf "Schaltung nach Anfahren [RAM name from V530, voted 37]" UBYTE NO_COMPU_METHOD 0 0 0 255 ECU_ADDRESS 0x3FD61B FORMAT "%.4g" /end MEASUREMENT
/begin MEASUREMENT smg_kupp_flags_dn "Status dn-Soll [RAM name from V530, voted 37]" UBYTE NO_COMPU_METHOD 0 0 0 255 ECU_ADDRESS 0x3FD61B FORMAT "%.4g" /end MEASUREMENT
/begin MEASUREMENT smg_kupp_flags_ekr "Begrenzung Ekr-Schwelle [RAM name from V530, voted 37]" UBYTE NO_COMPU_METHOD 0 0 0 255 ECU_ADDRESS 0x3FD61B FORMAT "%.4g" /end MEASUREMENT
/begin MEASUREMENT smg_kupp_flags_ks "Kupplungsschutz [RAM name from V530, voted 37]" UBYTE NO_COMPU_METHOD 0 0 0 255 ECU_ADDRESS 0x3FD61B FORMAT "%.4g" /end MEASUREMENT
/begin MEASUREMENT smg_kupp_flags_schw "Drehzahlschwinger beim Aufregeln [RAM name from V530, voted 37]" UBYTE NO_COMPU_METHOD 0 0 0 255 ECU_ADDRESS 0x3FD61B FORMAT "%.4g" /end MEASUREMENT
/begin MEASUREMENT smg_kupp_m_rel_fw "Kupplungssollmoment bzgl. Fahrerwunsch [RAM name from V530, voted 13]" UBYTE M_FORMULA_0913 0 0 0 199.21875 ECU_ADDRESS 0x3FD61C /end MEASUREMENT
/begin MEASUREMENT smg_kupp_m_voraus "Vorausschau Kupplungssollmoment [RAM name from V530, voted 7]" UBYTE M_FORMULA_0913 0 0 0 199.21875 ECU_ADDRESS 0x3FD61D /end MEASUREMENT
/begin MEASUREMENT smg_kupp_t_rest "Restzeit bis Kupplungsendmoment [RAM name from V530, voted 8]" UBYTE M_FORMULA_0306 0 0 0 2.55 ECU_ADDRESS 0x3FD61E /end MEASUREMENT
/begin MEASUREMENT smg_kupp_m_soll_abs "absolutes Kupplungssollmoment [RAM name from V530, voted 8]" SWORD M_FORMULA_0009 0 0 -3276.8 3276.7 ECU_ADDRESS 0x3FD620 /end MEASUREMENT
/begin MEASUREMENT smg_kupp_m_soll "relatives Kupplungssollmoment [RAM name from V530, voted 7]" UBYTE M_FORMULA_0914 0 0 0 99.609375 ECU_ADDRESS 0x3FD622 /end MEASUREMENT
/begin MEASUREMENT smg_kupp_m_ist_0 "Kupplungsmoment bei Abregelstart [RAM name from V530, voted 9]" UBYTE M_FORMULA_0914 0 0 0 99.609375 ECU_ADDRESS 0x3FD623 /end MEASUREMENT
/begin MEASUREMENT smg_kupp_m_20 "Kupplungssollmomente [RAM name from V530, voted 10]" UBYTE M_FORMULA_0914 0 0 0 99.609375 ECU_ADDRESS 0x3FD624 /end MEASUREMENT
/begin MEASUREMENT smg_kupp_m_40 "Kupplungssollmomente [RAM name from V530, voted 1]" UBYTE M_FORMULA_0914 0 0 0 99.609375 ECU_ADDRESS 0x3FD625 /end MEASUREMENT
/begin MEASUREMENT smg_kupp_m_60 "Kupplungssollmomente [RAM name from V530, voted 1]" UBYTE M_FORMULA_0914 0 0 0 99.609375 ECU_ADDRESS 0x3FD626 /end MEASUREMENT
/begin MEASUREMENT smg_kupp_m_80 "Kupplungssollmomente [RAM name from V530, voted 1]" UBYTE M_FORMULA_0914 0 0 0 99.609375 ECU_ADDRESS 0x3FD627 /end MEASUREMENT
/begin MEASUREMENT smg_kupp_m_end "Kupplungsendmoment [RAM name from V530, voted 9]" UBYTE M_FORMULA_0914 0 0 0 99.609375 ECU_ADDRESS 0x3FD628 /end MEASUREMENT
/begin MEASUREMENT smg_kupp_array "Arraykennung [RAM name from V530, voted 16]" UBYTE M_FORMULA_0003 0 0 0 255 ECU_ADDRESS 0x3FD629 /end MEASUREMENT
/begin MEASUREMENT smg_kupp_dm_soll "Kupplungsgradient [RAM name from V530, voted 1]" SWORD M_FORMULA_0562 0 0 -655360 655340 ECU_ADDRESS 0x3FD62A /end MEASUREMENT
/begin MEASUREMENT smg_kupp_m_soll_regler "Kupplungsregler [RAM name from V530, voted 4]" SLONG M_FORMULA_0915 0 0 -214748.3648 214748.3647 ECU_ADDRESS 0x3FD62C /end MEASUREMENT
/begin MEASUREMENT smg_kupp_m_soll_rampe "Kupplungsrampe [RAM name from V530, voted 7]" ULONG M_FORMULA_0916 0 0 0 4294967.295 ECU_ADDRESS 0x3FD630 /end MEASUREMENT
/begin MEASUREMENT smg_kupp_t_dn_null "Zeit mit konst. Drehzahl [RAM name from V530, voted 4]" UBYTE M_FORMULA_0306 0 0 0 2.55 ECU_ADDRESS 0x3FD634 /end MEASUREMENT
/begin MEASUREMENT smg_kupp_m_off_ab "Offset auf Fahrerwunsch beim Abregeln [RAM name from V530, voted 2]" SWORD M_FORMULA_0009 0 0 -3276.8 3276.7 ECU_ADDRESS 0x3FD636 /end MEASUREMENT
/begin MEASUREMENT smg_kupp_dn_soll_roh "Soll-Drehzahlgradient (Roh) [RAM name from V530, voted 3]" SWORD M_FORMULA_0105 0 0 -32768 32767 ECU_ADDRESS 0x3FD63A /end MEASUREMENT
/begin MEASUREMENT smg_kupp_dn_soll "Soll-Drehzahlgradient [RAM name from V530, voted 3]" SWORD M_FORMULA_0105 0 0 -32768 32767 ECU_ADDRESS 0x3FD63C /end MEASUREMENT
/begin MEASUREMENT smg_kupp_m_rab_start "Moment bei Ausloesung Radabriss [RAM name from V530, voted 4]" SWORD M_FORMULA_0009 0 0 -3276.8 3276.7 ECU_ADDRESS 0x3FD63E /end MEASUREMENT
/begin MEASUREMENT smg_kupp_m_lw_start "Moment beim Lastwechsel [RAM name from V530, voted 2]" SWORD M_FORMULA_0009 0 0 -3276.8 3276.7 ECU_ADDRESS 0x3FD640 /end MEASUREMENT
/begin MEASUREMENT smg_kupp_ul_fw_red "Reduktionsrampe bei Ueberlast [RAM name from V530, voted 3]" SWORD M_FORMULA_0009 0 0 -3276.8 3276.7 ECU_ADDRESS 0x3FD642 /end MEASUREMENT
/begin MEASUREMENT smg_kupp_ul_st "Ueberlaststatus [RAM name from V530, voted 8]" UBYTE NO_COMPU_METHOD 0 0 0 255 ECU_ADDRESS 0x3FD644 FORMAT "%.4g" /end MEASUREMENT
/begin MEASUREMENT smg_mot_modul "Motor-Modul [RAM name from V530, voted 21]" UBYTE NO_COMPU_METHOD 0 0 0 255 ECU_ADDRESS 0x3FD645 FORMAT "%.4g" /end MEASUREMENT
/begin MEASUREMENT smg_mot_flags "Motor-Flags [RAM name from V530, voted 12]" UBYTE M_FORMULA_0003 0 0 0 255 ECU_ADDRESS 0x3FD646 /end MEASUREMENT
/begin MEASUREMENT smg_mot_flags_begr "Begrenzung auf FW [RAM name from V530, voted 12]" UBYTE NO_COMPU_METHOD 0 0 0 255 ECU_ADDRESS 0x3FD646 FORMAT "%.4g" /end MEASUREMENT
/begin MEASUREMENT smg_mot_flags_nll "Drehzahlniveau bzgl. nLL [RAM name from V530, voted 12]" UBYTE NO_COMPU_METHOD 0 0 0 255 ECU_ADDRESS 0x3FD646 FORMAT "%.4g" /end MEASUREMENT
/begin MEASUREMENT smg_mot_flags_nziel "Motor-Flags [RAM name from V530, voted 12]" UBYTE NO_COMPU_METHOD 0 0 0 255 ECU_ADDRESS 0x3FD646 FORMAT "%.4g" /end MEASUREMENT
/begin MEASUREMENT smg_mot_m_soll_rel "relatives Motorsollmoment [RAM name from V530, voted 2]" SWORD M_FORMULA_0896 0 0 -25600 25599.21875 ECU_ADDRESS 0x3FD648 /end MEASUREMENT
/begin MEASUREMENT smg_mot_m_soll "Motorsollmoment [RAM name from V530, voted 22]" SWORD M_FORMULA_0009 0 0 -3276.8 3276.7 ECU_ADDRESS 0x3FD64A /end MEASUREMENT
/begin MEASUREMENT smg_mot_m_soll_voraus "Motorsollmoment DK-Rohwert [RAM name from V530, voted 16]" SWORD M_FORMULA_0009 0 0 -3276.8 3276.7 ECU_ADDRESS 0x3FD64C /end MEASUREMENT
/begin MEASUREMENT smg_mot_m_soll_tz "TZ-Motorsollmoment [RAM name from V530, voted 7]" SWORD M_FORMULA_0009 0 0 -3276.8 3276.7 ECU_ADDRESS 0x3FD64E /end MEASUREMENT
/begin MEASUREMENT smg_mot_m_soll_dk "DK-Motorsollmoment [RAM name from V530, voted 6]" SWORD M_FORMULA_0009 0 0 -3276.8 3276.7 ECU_ADDRESS 0x3FD650 /end MEASUREMENT
/begin MEASUREMENT smg_mot_m_res "Momentenreserve [RAM name from V530, voted 7]" SWORD M_FORMULA_0009 0 0 -3276.8 3276.7 ECU_ADDRESS 0x3FD652 /end MEASUREMENT
/begin MEASUREMENT smg_mot_m_res_time "Timer Momentenreserve [RAM name from V530, voted 6]" UWORD M_FORMULA_0109 0 0 0 327.675 ECU_ADDRESS 0x3FD654 /end MEASUREMENT
/begin MEASUREMENT smg_mot_m_soll_pA "P-Anteil Drehzahlregler [RAM name from V530, voted 6]" SLONG M_FORMULA_0921 0 0 -2147483.648 2147483.647 ECU_ADDRESS 0x3FD658 /end MEASUREMENT
/begin MEASUREMENT smg_mot_m_soll_iA "I-Anteil Drehzahlregler [RAM name from V530, voted 7]" SLONG M_FORMULA_0916 0 0 -2147483.648 2147483.647 ECU_ADDRESS 0x3FD65C /end MEASUREMENT
/begin MEASUREMENT smg_mot_m_soll_iA_2 "I-Anteil Gradientenregler [RAM name from V530, voted 6]" SLONG M_FORMULA_0915 0 0 -214748.3648 214748.3647 ECU_ADDRESS 0x3FD660 /end MEASUREMENT
/begin MEASUREMENT smg_mot_m_soll_dA "D-Anteil Drehzahlregler [RAM name from V530, voted 3]" SLONG M_FORMULA_0921 0 0 -2147483.648 2147483.647 ECU_ADDRESS 0x3FD664 /end MEASUREMENT
/begin MEASUREMENT smg_mot_n_soll "Solldrehzahl [RAM name from V530, voted 6]" SWORD M_FORMULA_0006 0 0 -32768 32767 ECU_ADDRESS 0x3FD668 /end MEASUREMENT
/begin MEASUREMENT smg_mot_n_ekr_schw "EKR-Schwelle [RAM name from V530, voted 4]" SWORD M_FORMULA_0006 0 0 -32768 32767 ECU_ADDRESS 0x3FD66A /end MEASUREMENT
/begin MEASUREMENT smg_mot_n_offset "Offset auf Zieldrehzahl [RAM name from V530, voted 9]" SWORD M_FORMULA_0006 0 0 -32768 32767 ECU_ADDRESS 0x3FD66C /end MEASUREMENT
/begin MEASUREMENT smg_mot_n_reg_st "Status Drehzahlreglers [RAM name from V530, voted 6]" UBYTE NO_COMPU_METHOD 0 0 0 255 ECU_ADDRESS 0x3FD66E FORMAT "%.4g" /end MEASUREMENT
/begin MEASUREMENT smg_mot_n_ziel_off "Faktor fuer Schubzieldrehzahl [RAM name from V530, voted 3]" UBYTE M_FORMULA_0923 0 0 0 199.21875 ECU_ADDRESS 0x3FD66F /end MEASUREMENT
/begin MEASUREMENT smg_mot_m_soll_vor_1 "Rampe auf Fahrerwunsch [RAM name from V530, voted 5]" SWORD M_FORMULA_0009 0 0 -3276.8 3276.7 ECU_ADDRESS 0x3FD670 /end MEASUREMENT
/begin MEASUREMENT smg_mot_m_soll_vor_2 "Anteil aus Gradient und Traegheit [RAM name from V530, voted 4]" SWORD M_FORMULA_0009 0 0 -3276.8 3276.7 ECU_ADDRESS 0x3FD672 /end MEASUREMENT
/begin MEASUREMENT smg_mot_m_soll_regler "Regleranteil [RAM name from V530, voted 2]" SWORD M_FORMULA_0009 0 0 -3276.8 3276.7 ECU_ADDRESS 0x3FD674 /end MEASUREMENT
/begin MEASUREMENT smg_mot_tz_nachlauf "TZ-Nachlaufzeit [RAM name from V530, voted 14]" UWORD M_FORMULA_0109 0 0 0 327.675 ECU_ADDRESS 0x3FD676 /end MEASUREMENT
/begin MEASUREMENT smg_mot_dm_soll "Soll-Gradient fuer TZ-Nachlauf [RAM name from V530, voted 12]" SWORD M_FORMULA_0562 0 0 -655360 655340 ECU_ADDRESS 0x3FD678 /end MEASUREMENT
/begin MEASUREMENT smg_mot_m_begr_min "min. Motorsollmoment [RAM name from V530, voted 7]" SWORD M_FORMULA_0009 0 0 -3276.8 3276.7 ECU_ADDRESS 0x3FD67A /end MEASUREMENT
/begin MEASUREMENT smg_mot_m_begr_max "max. Motorsollmoment [RAM name from V530, voted 4]" SWORD M_FORMULA_0009 0 0 -3276.8 3276.7 ECU_ADDRESS 0x3FD67C /end MEASUREMENT
/begin MEASUREMENT smg_mot_m_soll_stg "Stoergroessenaufschaltung [RAM name from V530, voted 1]" SWORD M_FORMULA_0009 0 0 -3276.8 3276.7 ECU_ADDRESS 0x3FD67E /end MEASUREMENT
/begin MEASUREMENT smg_t_aktuell "aktuelle Zeit der jeweiligen Schaltphase [RAM name from V530, voted 36]" UWORD M_FORMULA_0021 0 0 0 655.35 ECU_ADDRESS 0x3FD684 /end MEASUREMENT
/begin MEASUREMENT smg_t_aktuell_korr "korr. Zeit [RAM name from V530, voted 5]" UWORD M_FORMULA_0924 0 0 0 40959.375 ECU_ADDRESS 0x3FD686 /end MEASUREMENT
/begin MEASUREMENT smg_bw_null "Bewertung Nulldurchgang [RAM name from V530, voted 3]" UBYTE M_FORMULA_0003 0 0 0 255 ECU_ADDRESS 0x3FD688 /end MEASUREMENT
/begin MEASUREMENT smg_abbruch_grund "Grund fuer Schaltabbruch [RAM name from V530, voted 1]" UBYTE NO_COMPU_METHOD 0 0 0 255 ECU_ADDRESS 0x3FD689 FORMAT "%.4g" /end MEASUREMENT
/begin MEASUREMENT smg_abbruch_ges "Grund fuer Schaltabbruch - Summe [RAM name from V530, voted 13]" UBYTE NO_COMPU_METHOD 0 0 0 255 ECU_ADDRESS 0x3FD68A FORMAT "%.4g" /end MEASUREMENT
/begin MEASUREMENT smg_mot_j_motor "Faktor fuer Vorst 2 [RAM name from V530, voted 2]" UBYTE M_FORMULA_0926 0 0 0 1.9921875 ECU_ADDRESS 0x3FD68B /end MEASUREMENT
/begin MEASUREMENT smg_md_kw_ga "Motor-Moment am Getriebeausgang [RAM name from V530, voted 1]" SWORD M_FORMULA_0794 0 0 -32768 32767 ECU_ADDRESS 0x3FD68C /end MEASUREMENT
/begin MEASUREMENT smg_m_kupp_ist_ga "Kupplungs-Moment am Getriebeausgang [RAM name from V530, voted 1]" SWORD M_FORMULA_0794 0 0 -32768 32767 ECU_ADDRESS 0x3FD68E /end MEASUREMENT
/begin MEASUREMENT smg_ax_filter "ax gefilter mit Vorzeichen [RAM name from V530, voted 5]" SWORD M_FORMULA_0123 0 0 -819.2 819.175 ECU_ADDRESS 0x3FD690 /end MEASUREMENT
/begin MEASUREMENT smg_n_abriss "Abrissdrehzahl [RAM name from V530, voted 2]" SWORD M_FORMULA_0006 0 0 -32768 32767 ECU_ADDRESS 0x3FD696 /end MEASUREMENT
/begin MEASUREMENT smg_n_abriss_schw "Abriss-Schwelle [RAM name from V530, voted 1]" SWORD M_FORMULA_0006 0 0 -32768 32767 ECU_ADDRESS 0x3FD698 /end MEASUREMENT
/begin MEASUREMENT smg_ki_auf_t_eingr "Zeitzaehler fuer DSC beim Aufregeln [RAM name from V530, voted 1]" UWORD M_FORMULA_0021 0 0 0 655.35 ECU_ADDRESS 0x3FD69A /end MEASUREMENT
/begin MEASUREMENT smg_sk_t_phase "abs. Dauer einer Schaltphase [RAM name from V530, voted 9]" UWORD M_FORMULA_0021 0 0 0 655.35 ECU_ADDRESS 0x3FD69C /end MEASUREMENT
/begin MEASUREMENT smg_sk_flags "SK-Fehler [RAM name from V530, voted 30]" UWORD NO_COMPU_METHOD 0 0 0 65535 ECU_ADDRESS 0x3FD69E FORMAT "%.4g" /end MEASUREMENT
/begin MEASUREMENT smg_sk_t_dme_st "Ueberwachung DME-Status [RAM name from V530, voted 3]" UBYTE M_FORMULA_0306 0 0 0 2.55 ECU_ADDRESS 0x3FD6A0 /end MEASUREMENT
/begin MEASUREMENT smg_sk_t_kupp "Ueberwachung Kupplung [RAM name from V530, voted 3]" UBYTE M_FORMULA_0306 0 0 0 2.55 ECU_ADDRESS 0x3FD6A1 /end MEASUREMENT
/begin MEASUREMENT smg_sk_t_ngetr "Ueberwachung nGetr [RAM name from V530, voted 3]" UBYTE M_FORMULA_0306 0 0 0 2.55 ECU_ADDRESS 0x3FD6A2 /end MEASUREMENT
/begin MEASUREMENT smg_sk_t_nziel "Ueberwachung nZiel [RAM name from V530, voted 3]" UBYTE M_FORMULA_0306 0 0 0 2.55 ECU_ADDRESS 0x3FD6A3 /end MEASUREMENT
/begin MEASUREMENT smg_sk_t_nberech "Ueberwachung nBerech [RAM name from V530, voted 3]" UBYTE M_FORMULA_0306 0 0 0 2.55 ECU_ADDRESS 0x3FD6A4 /end MEASUREMENT
/begin MEASUREMENT smg_sk_t_ngetr_max "Ueberwachung max. nGetr [RAM name from V530, voted 3]" UBYTE M_FORMULA_0306 0 0 0 2.55 ECU_ADDRESS 0x3FD6A5 /end MEASUREMENT
/begin MEASUREMENT smg_sk_t_nziel_max "Ueberwachung max. nZiel [RAM name from V530, voted 3]" UBYTE M_FORMULA_0306 0 0 0 2.55 ECU_ADDRESS 0x3FD6A6 /end MEASUREMENT
/begin MEASUREMENT smg_sk_t_ngetr_plau "Ueberwachung nGetr [RAM name from V530, voted 4]" UBYTE M_FORMULA_0306 0 0 0 2.55 ECU_ADDRESS 0x3FD6A7 /end MEASUREMENT
/begin MEASUREMENT smg_sk_t_nziel_plau "Ueberwachung nZiel [RAM name from V530, voted 3]" UBYTE M_FORMULA_0306 0 0 0 2.55 ECU_ADDRESS 0x3FD6A8 /end MEASUREMENT
/begin MEASUREMENT smg_adapt_ihar_sum "Summenzaehler [RAM name from V530, voted 7]" ULONG M_FORMULA_0000 0 0 0 4294967295 ECU_ADDRESS 0x3FD6AC /end MEASUREMENT
/begin MEASUREMENT smg_adapt_ihar_cnt "Counter [RAM name from V530, voted 7]" UBYTE M_FORMULA_0003 0 0 0 255 ECU_ADDRESS 0x3FD6B0 /end MEASUREMENT
/begin MEASUREMENT smg_can_alive_smg1 "Alive SMG1 [RAM name from V530, voted 2]" UBYTE M_FORMULA_0003 0 0 0 255 ECU_ADDRESS 0x3FD6B7 /end MEASUREMENT
/begin MEASUREMENT smg_can_alive_smg2 "Alive SMG2 [RAM name from V530, voted 2]" UBYTE M_FORMULA_0003 0 0 0 255 ECU_ADDRESS 0x3FD6B8 /end MEASUREMENT
/begin MEASUREMENT smg_can_alive_smg3 "Alive SMG3 [RAM name from V530, voted 2]" UBYTE M_FORMULA_0003 0 0 0 255 ECU_ADDRESS 0x3FD6B9 /end MEASUREMENT
/begin MEASUREMENT smg_can_ed_tsperr "Diagnosesperrzeit [RAM name from V530, voted 8]" UWORD M_FORMULA_0109 0 0 0 327.675 ECU_ADDRESS 0x3FD6BA /end MEASUREMENT
/begin MEASUREMENT smg_can_empf_st "Empfangsstatus [RAM name from V530, voted 9]" UBYTE NO_COMPU_METHOD 0 0 0 255 ECU_ADDRESS 0x3FD6BC FORMAT "%.4g" /end MEASUREMENT
/begin MEASUREMENT smg_can_empf_st_hys "Empfangsstatus im SG-Zyklus [RAM name from V530, voted 3]" UBYTE NO_COMPU_METHOD 0 0 0 255 ECU_ADDRESS 0x3FD6BD FORMAT "%.4g" /end MEASUREMENT
/begin MEASUREMENT smg_can_st_smg "Empfangsstatus SMG [RAM name from V530, voted 4]" UWORD NO_COMPU_METHOD 0 0 0 65535 ECU_ADDRESS 0x3FD6BE FORMAT "%.4g" /end MEASUREMENT
/begin MEASUREMENT smg_can_st_smg1 "Empfangsstatus SMG1 [RAM name from V530, voted 5]" UWORD NO_COMPU_METHOD 0 0 0 65535 ECU_ADDRESS 0x3FD6C0 FORMAT "%.4g" /end MEASUREMENT
/begin MEASUREMENT smg_can_st_smg2 "Empfangsstatus SMG2 [RAM name from V530, voted 3]" UWORD NO_COMPU_METHOD 0 0 0 65535 ECU_ADDRESS 0x3FD6C2 FORMAT "%.4g" /end MEASUREMENT
/begin MEASUREMENT smg_can_st_smg3 "Empfangsstatus SMG3 [RAM name from V530, voted 5]" UWORD NO_COMPU_METHOD 0 0 0 65535 ECU_ADDRESS 0x3FD6C4 FORMAT "%.4g" /end MEASUREMENT
/begin MEASUREMENT smg_can_alive_smg1_cnt "Fehler Alivecounter [RAM name from V530, voted 4]" UBYTE M_FORMULA_0003 0 0 0 255 ECU_ADDRESS 0x3FD6C6 /end MEASUREMENT
/begin MEASUREMENT smg_can_chksum_smg1_cnt "Fehler Chksum [RAM name from V530, voted 4]" UBYTE M_FORMULA_0003 0 0 0 255 ECU_ADDRESS 0x3FD6C7 /end MEASUREMENT
/begin MEASUREMENT smg_can_alive_smg2_cnt "Fehler Alivecounter [RAM name from V530, voted 2]" UBYTE M_FORMULA_0003 0 0 0 255 ECU_ADDRESS 0x3FD6C8 /end MEASUREMENT
/begin MEASUREMENT smg_can_chksum_smg2_cnt "Fehler Chksum [RAM name from V530, voted 3]" UBYTE M_FORMULA_0003 0 0 0 255 ECU_ADDRESS 0x3FD6C9 /end MEASUREMENT
/begin MEASUREMENT smg_can_alive_smg3_cnt "Fehler Alivecounter [RAM name from V530, voted 4]" UBYTE M_FORMULA_0003 0 0 0 255 ECU_ADDRESS 0x3FD6CA /end MEASUREMENT
/begin MEASUREMENT smg_can_chksum_smg3_cnt "Fehler Chksum [RAM name from V530, voted 4]" UBYTE M_FORMULA_0003 0 0 0 255 ECU_ADDRESS 0x3FD6CB /end MEASUREMENT
/begin MEASUREMENT smg_can_s_fgr "FGR-Schalter [RAM name from V530, voted 13]" UBYTE NO_COMPU_METHOD 0 0 0 255 ECU_ADDRESS 0x3FD6CC FORMAT "%.4g" /end MEASUREMENT
/begin MEASUREMENT smg_can_s_he "HE-Schalter [RAM name from V530, voted 13]" UBYTE NO_COMPU_METHOD 0 0 0 255 ECU_ADDRESS 0x3FD6CC FORMAT "%.4g" /end MEASUREMENT
/begin MEASUREMENT smg_can_s_krafts "Kraftschlusstatus [RAM name from V530, voted 13]" UBYTE NO_COMPU_METHOD 0 0 0 255 ECU_ADDRESS 0x3FD6CC FORMAT "%.4g" /end MEASUREMENT
/begin MEASUREMENT smg_can_s_schalt "Schaltwunsch [RAM name from V530, voted 13]" UBYTE NO_COMPU_METHOD 0 0 0 255 ECU_ADDRESS 0x3FD6CC FORMAT "%.4g" /end MEASUREMENT
/begin MEASUREMENT smg_can_schalter "CAN-Schalter [RAM name from V530, voted 13]" UBYTE M_FORMULA_0003 0 0 0 255 ECU_ADDRESS 0x3FD6CC /end MEASUREMENT
/begin MEASUREMENT smg_can_n_getr_ziel_roh "Zieldrehzahl ungefiltert [RAM name from V530, voted 5]" SWORD M_FORMULA_0006 0 0 -32768 32767 ECU_ADDRESS 0x3FD6CE /end MEASUREMENT
/begin MEASUREMENT smg_can_n_anfahr "Anfahrdrehzahl [RAM name from V530, voted 4]" SWORD M_FORMULA_0006 0 0 -32768 32767 ECU_ADDRESS 0x3FD6D0 /end MEASUREMENT
/begin MEASUREMENT smg_can_t_rest_se "Restzeit bis Synchro-Ende [RAM name from V530, voted 2]" UBYTE M_FORMULA_0306 0 0 0 2.55 ECU_ADDRESS 0x3FD6D2 /end MEASUREMENT
/begin MEASUREMENT smg_can_t_rest_ekr "Restzeit bis Start Einkuppelrampe [RAM name from V530, voted 4]" UBYTE M_FORMULA_0306 0 0 0 2.55 ECU_ADDRESS 0x3FD6D3 /end MEASUREMENT
/begin MEASUREMENT smg_can_istgang "Istgang [RAM name from V530, voted 20]" SBYTE M_FORMULA_0135 0 0 -128 127 ECU_ADDRESS 0x3FD6D4 /end MEASUREMENT
/begin MEASUREMENT smg_can_zielgang "Zielgang [RAM name from V530, voted 5]" SBYTE M_FORMULA_0135 0 0 -128 127 ECU_ADDRESS 0x3FD6D5 /end MEASUREMENT
/begin MEASUREMENT smg_can_kupp_st "Kupplungsstatus [RAM name from V530, voted 7]" UBYTE NO_COMPU_METHOD 0 0 0 255 ECU_ADDRESS 0x3FD6D6 FORMAT "%.4g" /end MEASUREMENT
/begin MEASUREMENT smg_can_getr_st "Getriebestatus [RAM name from V530, voted 10]" UBYTE NO_COMPU_METHOD 0 0 0 255 ECU_ADDRESS 0x3FD6D7 FORMAT "%.4g" /end MEASUREMENT
/begin MEASUREMENT smg_can_m_kupp_max "Kupplungsmaximalmoment [RAM name from V530, voted 4]" SWORD M_FORMULA_0009 0 0 -3276.8 3276.7 ECU_ADDRESS 0x3FD6D8 /end MEASUREMENT
/begin MEASUREMENT smg_can_m_kupp_ist "Kupplungsistmoment [RAM name from V530, voted 7]" UBYTE M_FORMULA_0914 0 0 0 99.609375 ECU_ADDRESS 0x3FD6DA /end MEASUREMENT
/begin MEASUREMENT smg_can_m_kupp_ist_abs "absolutes Kupplungsmoment [RAM name from V530, voted 12]" SWORD M_FORMULA_0009 0 0 -3276.8 3276.7 ECU_ADDRESS 0x3FD6DC /end MEASUREMENT
/begin MEASUREMENT smg_can_ax_mess "AX gemessen [RAM name from V530, voted 4]" SWORD M_FORMULA_0123 0 0 -819.2 819.175 ECU_ADDRESS 0x3FD6DE /end MEASUREMENT
/begin MEASUREMENT smg_can_v_diff "Achsdifferenz [RAM name from V530, voted 4]" SBYTE M_FORMULA_0954 0 0 -8 7.9375 ECU_ADDRESS 0x3FD6E0 /end MEASUREMENT
/begin MEASUREMENT smg_can_pos_kupp_ist "Kupplungsposition [RAM name from V530, voted 2]" UBYTE M_FORMULA_0425 0 0 0 1020 ECU_ADDRESS 0x3FD6E1 /end MEASUREMENT
/begin MEASUREMENT smg_can_testmode "Vorgabe Testmode [RAM name from V530, voted 3]" UBYTE NO_COMPU_METHOD 0 0 0 255 ECU_ADDRESS 0x3FD6E2 FORMAT "%.4g" /end MEASUREMENT
/begin MEASUREMENT smg_can_r_testmode "Rueckgabe Testmode [RAM name from V530, voted 3]" UBYTE NO_COMPU_METHOD 0 0 0 255 ECU_ADDRESS 0x3FD6E3 FORMAT "%.4g" /end MEASUREMENT
/begin MEASUREMENT spim_errorcounter "Fehlerzaehler der Spi [RAM name from V530, voted 6]" UBYTE M_FORMULA_0003 0 0 0 255 ECU_ADDRESS 0x3FD76A /end MEASUREMENT
/begin MEASUREMENT spim_reqcounter "Anzahl der Auftraege in der Queue [RAM name from V530, voted 8]" UBYTE M_FORMULA_0003 0 0 0 255 ECU_ADDRESS 0x3FD76B /end MEASUREMENT
/begin MEASUREMENT spim_status "Statusvariable der SPI [RAM name from V530, voted 7]" UBYTE NO_COMPU_METHOD 0 0 0 255 ECU_ADDRESS 0x3FD76C FORMAT "%.4g" /end MEASUREMENT
/begin MEASUREMENT spim_errorcode "Statusvariable der SPI [RAM name from V530, voted 7]" UBYTE NO_COMPU_METHOD 0 0 0 255 ECU_ADDRESS 0x3FD76D FORMAT "%.4g" /end MEASUREMENT
/begin MEASUREMENT start_rl_st "Status der Startrelaisansteuerung [RAM name from V530, voted 22]" UBYTE NO_COMPU_METHOD 0 0 0 255 ECU_ADDRESS 0x3FD770 FORMAT "%.4g" /end MEASUREMENT
/begin MEASUREMENT start_rl_exd_timeout "KWP-Ansteuerzeit [RAM name from V530, voted 6]" UBYTE M_FORMULA_0492 0 0 0 25.5 ECU_ADDRESS 0x3FD771 /end MEASUREMENT
/begin MEASUREMENT start_rl_exd_beginn "Beginn der externen Ansteuerung [RAM name from V530, voted 2]" UWORD M_FORMULA_0010 0 0 0 65535 ECU_ADDRESS 0x3FD772 /end MEASUREMENT
/begin MEASUREMENT sys_zust "Betriebszustand des Systems [RAM name from V530, voted 6]" UWORD NO_COMPU_METHOD 0 0 0 65535 ECU_ADDRESS 0x3FD77A FORMAT "%.4g" /end MEASUREMENT
/begin MEASUREMENT sys_last_reset_st "Letzter Resetstatus [RAM name from V530, voted 2]" UBYTE NO_COMPU_METHOD 0 0 0 255 ECU_ADDRESS 0x3FD780 FORMAT "%.4g" /end MEASUREMENT
/begin MEASUREMENT tabg_ad_b1 "Eingelesener Spannungswert fuer Abgastemperatur [RAM name from V530, voted 3]" SWORD M_FORMULA_0114 0 0 -32768 32767 ECU_ADDRESS 0x3FD79C /end MEASUREMENT
/begin MEASUREMENT tabg_ad_b2 "Eingelesener Spannungswert fuer Abgastemperatur [RAM name from V530, voted 2]" SWORD M_FORMULA_0114 0 0 -32768 32767 ECU_ADDRESS 0x3FD79E /end MEASUREMENT
/begin MEASUREMENT tabg_roh_b1 "Ungefilterter Messwert der Abgastemperatur [RAM name from V530, voted 1]" SWORD M_FORMULA_0342 0 0 -1911.55 1365.2 ECU_ADDRESS 0x3FD7A0 /end MEASUREMENT
/begin MEASUREMENT tabg_vkat_f_reak_b1 "Faktor der Reaktion im Kruemmer [RAM name from V530, voted 2]" UWORD M_FORMULA_0073 0 0 0 63.99902344 ECU_ADDRESS 0x3FD7E4 /end MEASUREMENT
/begin MEASUREMENT tabg_st "TABG-Status [RAM name from V530, voted 8]" UBYTE M_FORMULA_0037 0 0 0 255 ECU_ADDRESS 0x3F875A /end MEASUREMENT
/begin MEASUREMENT tabg_st_aufregeln_b1 "Kat-Enthalpie Bank 1 [RAM name from V530, voted 8]" UBYTE NO_COMPU_METHOD 0 0 0 255 ECU_ADDRESS 0x3F875A FORMAT "%.4g" /end MEASUREMENT
/begin MEASUREMENT tabg_st_aufregeln_b2 "Kat-Enthalpie Bank 2 [RAM name from V530, voted 8]" UBYTE NO_COMPU_METHOD 0 0 0 255 ECU_ADDRESS 0x3F875A FORMAT "%.4g" /end MEASUREMENT
/begin MEASUREMENT tabg_st_init_b1 "CAN-Init Bank 1 [RAM name from V530, voted 8]" UBYTE NO_COMPU_METHOD 0 0 0 255 ECU_ADDRESS 0x3F875A FORMAT "%.4g" /end MEASUREMENT
/begin MEASUREMENT tabg_st_init_b2 "CAN-Init Bank 2 [RAM name from V530, voted 8]" UBYTE NO_COMPU_METHOD 0 0 0 255 ECU_ADDRESS 0x3F875A FORMAT "%.4g" /end MEASUREMENT
/begin MEASUREMENT tan_ad_b1 "Eingelesener Spannungswert fuer Ansauglufttemperatur [RAM name from V530, voted 1]" SWORD M_FORMULA_0114 0 0 -32768 32767 ECU_ADDRESS 0x3FD800 /end MEASUREMENT
/begin MEASUREMENT tan_ad_b2 "Eingelesener Spannungswert fuer Ansauglufttemperatur [RAM name from V530, voted 1]" SWORD M_FORMULA_0114 0 0 -32768 32767 ECU_ADDRESS 0x3FD802 /end MEASUREMENT
/begin MEASUREMENT tan_modell_mr "Temperatur Motorraum TAN-Modell [RAM name from V530, voted 2]" SWORD M_FORMULA_0023 0 0 -3550 3003.5 ECU_ADDRESS 0x3FD80C /end MEASUREMENT
/begin MEASUREMENT tan_tmot_tumg_delta "Temperaturdifferenz Motorraum zu Umgebung [RAM name from V530, voted 2]" SWORD M_FORMULA_0074 0 0 -3276.8 3276.7 ECU_ADDRESS 0x3FD80E /end MEASUREMENT
/begin MEASUREMENT tan_modell_raw_b1 "Temperatur Ansaugluft Modell ungefiltert [RAM name from V530, voted 1]" SWORD M_FORMULA_0023 0 0 -3550 3003.5 ECU_ADDRESS 0x3FD810 /end MEASUREMENT
/begin MEASUREMENT tan_modell_b1 "Ansauglufttemperatur Modell gefiltert [RAM name from V530, voted 3]" SWORD M_FORMULA_0023 0 0 -3550 3003.5 ECU_ADDRESS 0x3FD814 /end MEASUREMENT
/begin MEASUREMENT tan_modell_b2 "Ansauglufttemperatur Modell gefiltert [RAM name from V530, voted 2]" SWORD M_FORMULA_0023 0 0 -3550 3003.5 ECU_ADDRESS 0x3FD816 /end MEASUREMENT
/begin MEASUREMENT tan_modell_st "Status Modell Ansauglufttemperatur [RAM name from V530, voted 6]" UBYTE NO_COMPU_METHOD 0 0 0 255 ECU_ADDRESS 0x3FD820 FORMAT "%.4g" /end MEASUREMENT
/begin MEASUREMENT tan_obd_st "Status Plausibilisierung Ansauglufttemperatur [RAM name from V530, voted 8]" UBYTE M_FORMULA_0003 0 0 0 255 ECU_ADDRESS 0x3FD822 /end MEASUREMENT
/begin MEASUREMENT tan_obd_st_last "Status letzte Diagnose [RAM name from V530, voted 8]" UBYTE NO_COMPU_METHOD 0 0 0 255 ECU_ADDRESS 0x3FD822 FORMAT "%.4g" /end MEASUREMENT
/begin MEASUREMENT tan_obd_st_now "Status aktuelle Diagnose [RAM name from V530, voted 8]" UBYTE NO_COMPU_METHOD 0 0 0 255 ECU_ADDRESS 0x3FD822 FORMAT "%.4g" /end MEASUREMENT
/begin MEASUREMENT tan_obd_t_delta_yes "Zeit seit Abweichung [RAM name from V530, voted 4]" UWORD M_FORMULA_0980 0 0 0 6553.5 ECU_ADDRESS 0x3FD824 /end MEASUREMENT
/begin MEASUREMENT tan_obd_t_delta_no "Zeit seit keine Abweichung [RAM name from V530, voted 5]" UWORD M_FORMULA_0980 0 0 0 6553.5 ECU_ADDRESS 0x3FD826 /end MEASUREMENT
/begin MEASUREMENT tan_obd_dyn_delay "Zeit seit Dynamik???berschreitung [RAM name from V530, voted 3]" UWORD M_FORMULA_0980 0 0 0 6553.5 ECU_ADDRESS 0x3FD828 /end MEASUREMENT
/begin MEASUREMENT tan_n_dyn "Drehzahl gefiltert im tan-Modul [RAM name from V530, voted 4]" SWORD M_FORMULA_0105 0 0 -32768 32767 ECU_ADDRESS 0x3FD834 /end MEASUREMENT
/begin MEASUREMENT tdme_ad "Eingelesener Spannungswert fuer Steuergeraetetemperatur [RAM name from V530, voted 3]" SWORD M_FORMULA_0114 0 0 -32768 32767 ECU_ADDRESS 0x3FD83E /end MEASUREMENT
/begin MEASUREMENT tdme_roh "Ungefilterter Messwert der Steuergeraetetemperatur [RAM name from V530, voted 2]" SWORD M_FORMULA_0975 0 0 -1092.35 546.025 ECU_ADDRESS 0x3FD840 /end MEASUREMENT
/begin MEASUREMENT tdme_filter "Gefilterter Messwert der Steuergeraetetemperatur [RAM name from V530, voted 4]" SWORD M_FORMULA_0975 0 0 -1092.35 546.025 ECU_ADDRESS 0x3FD842 /end MEASUREMENT
/begin MEASUREMENT time_rel_obd_st "Steuervariable fuer Diagnose [RAM name from V530, voted 7]" UBYTE NO_COMPU_METHOD 0 0 0 255 ECU_ADDRESS 0x3FD844 FORMAT "%.4g" /end MEASUREMENT
/begin MEASUREMENT time_rel_st "Statusvariable [RAM name from V530, voted 7]" UBYTE NO_COMPU_METHOD 0 0 0 255 ECU_ADDRESS 0x3FD845 FORMAT "%.4g" /end MEASUREMENT
/begin MEASUREMENT time_rel_delta "Delta time_rel seit Start [RAM name from V530, voted 2]" ULONG M_FORMULA_0988 0 0 0 4294967295 ECU_ADDRESS 0x3FD848 /end MEASUREMENT
/begin MEASUREMENT tmot_ad "Eingelesener Spannungswert fuer Kuehlwassertemperatur [RAM name from V530, voted 3]" SWORD M_FORMULA_0114 0 0 -32768 32767 ECU_ADDRESS 0x3FD85C /end MEASUREMENT
/begin MEASUREMENT tmot_diag_grad_filter "Gradientenuberwachung ueber 100ms [RAM name from V530, voted 1]" SWORD M_FORMULA_0975 0 0 -1092.35 546.025 ECU_ADDRESS 0x3FD862 /end MEASUREMENT
/begin MEASUREMENT tmot_filter "Gefilterter Messwert der Kuehlwassertemperatur [RAM name from V530, voted 4]" SWORD M_FORMULA_0975 0 0 -1092.35 546.025 ECU_ADDRESS 0x3FD864 /end MEASUREMENT
/begin MEASUREMENT tmot_modell_temp_kraft "Gefilterter Kraftstoffenergieeintrag [RAM name from V530, voted 3]" SWORD M_FORMULA_0074 0 0 -3276.8 3276.7 ECU_ADDRESS 0x3FD868 /end MEASUREMENT
/begin MEASUREMENT tmot_modell_tumg "Gefilterter Umgebungsenergieabtrag [RAM name from V530, voted 3]" SWORD M_FORMULA_0074 0 0 -3276.8 3276.7 ECU_ADDRESS 0x3FD86C /end MEASUREMENT
/begin MEASUREMENT tmot_modell_delta "Abweichung Modell-Messwert [RAM name from V530, voted 2]" SWORD M_FORMULA_0074 0 0 -3276.8 3276.7 ECU_ADDRESS 0x3FD872 /end MEASUREMENT
/begin MEASUREMENT tmot_modell_ml_wicht "Gewichtete Gesamtluftmasse [RAM name from V530, voted 1]" SWORD M_FORMULA_0103 0 0 -3276.8 3276.7 ECU_ADDRESS 0x3FD874 /end MEASUREMENT
/begin MEASUREMENT tmot_obd_st "TMOT_OBD-Status [RAM name from V530, voted 8]" UBYTE M_FORMULA_0037 0 0 0 255 ECU_ADDRESS 0x3FD878 /end MEASUREMENT
/begin MEASUREMENT tmot_obd_st_block_sperre "TMOT_OBD-Status [RAM name from V530, voted 8]" UBYTE NO_COMPU_METHOD 0 0 0 255 ECU_ADDRESS 0x3FD878 FORMAT "%.4g" /end MEASUREMENT
/begin MEASUREMENT tmot_obd_st_fehlerz_sperre "TMOT_OBD-Status [RAM name from V530, voted 8]" UBYTE NO_COMPU_METHOD 0 0 0 255 ECU_ADDRESS 0x3FD878 FORMAT "%.4g" /end MEASUREMENT
/begin MEASUREMENT tmot_obd_st_haengt_nicht "TMOT_OBD-Status [RAM name from V530, voted 8]" UBYTE NO_COMPU_METHOD 0 0 0 255 ECU_ADDRESS 0x3FD878 FORMAT "%.4g" /end MEASUREMENT
/begin MEASUREMENT tmot_obd_st_init "TMOT_OBD-Status [RAM name from V530, voted 8]" UBYTE NO_COMPU_METHOD 0 0 0 255 ECU_ADDRESS 0x3FD878 FORMAT "%.4g" /end MEASUREMENT
/begin MEASUREMENT tmot_obd_st_ml_sperre "TMOT_OBD-Status [RAM name from V530, voted 8]" UBYTE NO_COMPU_METHOD 0 0 0 255 ECU_ADDRESS 0x3FD878 FORMAT "%.4g" /end MEASUREMENT
/begin MEASUREMENT tmot_obd_st_plausibel "TMOT_OBD-Status [RAM name from V530, voted 8]" UBYTE NO_COMPU_METHOD 0 0 0 255 ECU_ADDRESS 0x3FD878 FORMAT "%.4g" /end MEASUREMENT
/begin MEASUREMENT tmot_obd_st_sa_sperre "TMOT_OBD-Status [RAM name from V530, voted 8]" UBYTE NO_COMPU_METHOD 0 0 0 255 ECU_ADDRESS 0x3FD878 FORMAT "%.4g" /end MEASUREMENT
/begin MEASUREMENT tmot_obd_st_thermo_ok "TMOT_OBD-Status [RAM name from V530, voted 8]" UBYTE NO_COMPU_METHOD 0 0 0 255 ECU_ADDRESS 0x3FD878 FORMAT "%.4g" /end MEASUREMENT
/begin MEASUREMENT tmot_obd_diff_t_delta "Max. Zeit in der maximale Messwert-Modell-Differenz ueberschritten [RAM name from V530, voted 3]" UWORD M_FORMULA_0071 0 0 0 6553.5 ECU_ADDRESS 0x3FD88C /end MEASUREMENT
/begin MEASUREMENT tmot_obd_diff_t_delta_io "Zeit Messwert-Modell-Differenz o.k. [RAM name from V530, voted 2]" UWORD M_FORMULA_0071 0 0 0 6553.5 ECU_ADDRESS 0x3FD890 /end MEASUREMENT
/begin MEASUREMENT tmot_obd_diff_t_delta_nio "Zeit Messwert-Modell_Differenz nicht o.k. [RAM name from V530, voted 2]" UWORD M_FORMULA_0071 0 0 0 6553.5 ECU_ADDRESS 0x3FD892 /end MEASUREMENT
/begin MEASUREMENT tmot_obd_modell_min "Max. OBD-Modelltemperatur [RAM name from V530, voted 1]" SLONG M_FORMULA_0343 0 0 -209988.35 209442.0499 ECU_ADDRESS 0x3FD894 /end MEASUREMENT
/begin MEASUREMENT tmot_obd_modell_max "Max. OBD-Modelltemperatur [RAM name from V530, voted 1]" SLONG M_FORMULA_0343 0 0 -209988.35 209442.0499 ECU_ADDRESS 0x3FD898 /end MEASUREMENT
/begin MEASUREMENT tmot_obd_modell_delta "Delta OBD-Modelltemperatur [RAM name from V530, voted 2]" SLONG M_FORMULA_1002 0 0 -209715.2 209715.1999 ECU_ADDRESS 0x3FD89C /end MEASUREMENT
/begin MEASUREMENT tmot_obd_delta "Delta OBD-Kuehlwassertemperatur [RAM name from V530, voted 2]" SWORD M_FORMULA_0074 0 0 -3276.8 3276.7 ECU_ADDRESS 0x3FD8A4 /end MEASUREMENT
/begin MEASUREMENT toel_kalt_neu "Oeltemperatur aus Aufheizmodell mit Toel-Gradient [RAM name from V530, voted 11]" SLONG M_FORMULA_1010 0 0 -215021.5648 214475.1647 ECU_ADDRESS 0x3FD8A8 /end MEASUREMENT
/begin MEASUREMENT toel_dt "Summe Toel-Gradient [RAM name from V530, voted 2]" SWORD M_FORMULA_1011 0 0 -3.2768 3.2767 ECU_ADDRESS 0x3FD8AC /end MEASUREMENT
/begin MEASUREMENT toel_dt_dn "Toel-Gradient aus dn [RAM name from V530, voted 2]" SWORD M_FORMULA_1011 0 0 -3.2768 3.2767 ECU_ADDRESS 0x3FD8AE /end MEASUREMENT
/begin MEASUREMENT toel_dt_n "Toel-Gradient aus n [RAM name from V530, voted 2]" SWORD M_FORMULA_1011 0 0 -3.2768 3.2767 ECU_ADDRESS 0x3FD8B0 /end MEASUREMENT
/begin MEASUREMENT toel_dt_tmot "Toel-Gradient aus tmot [RAM name from V530, voted 1]" SWORD M_FORMULA_1011 0 0 -3.2768 3.2767 ECU_ADDRESS 0x3FD8B2 /end MEASUREMENT
/begin MEASUREMENT toel_dt_wanne "Toel-Gradient aus toel_wanne [RAM name from V530, voted 2]" SWORD M_FORMULA_1011 0 0 -3.2768 3.2767 ECU_ADDRESS 0x3FD8B4 /end MEASUREMENT
/begin MEASUREMENT toel_n_filt "PT1-gefilterte Motordrehzahl [RAM name from V530, voted 3]" SWORD M_FORMULA_0006 0 0 -32768 32767 ECU_ADDRESS 0x3FD8B6 /end MEASUREMENT
/begin MEASUREMENT toel_kalt "begrenzte Oeltemperatur aus Aufheizmodell [RAM name from V530, voted 5]" SLONG M_FORMULA_1010 0 0 -215021.5648 214475.1647 ECU_ADDRESS 0x3FD8B8 /end MEASUREMENT
/begin MEASUREMENT toel_save_abst "Oeltemperatur speichern bei Abstellen [RAM name from V530, voted 3]" UBYTE M_FORMULA_0003 0 0 0 255 ECU_ADDRESS 0x3FD8BC /end MEASUREMENT
/begin MEASUREMENT toel_start "Oeltemperatur im Start [RAM name from V530, voted 15]" SWORD M_FORMULA_0023 0 0 -3550 3003.5 ECU_ADDRESS 0x3FD8BE /end MEASUREMENT
/begin MEASUREMENT toel_warm "Oeltemperatur aus Heissmodell [RAM name from V530, voted 9]" SWORD M_FORMULA_0023 0 0 -3550 3003.5 ECU_ADDRESS 0x3FD8C0 /end MEASUREMENT
/begin MEASUREMENT toel_aufwaerm "Neue Soll-Oeltemperatur (vor Begrenzung) [RAM name from V530, voted 10]" SWORD M_FORMULA_0023 0 0 -3550 3003.5 ECU_ADDRESS 0x3FD8C2 /end MEASUREMENT
/begin MEASUREMENT tpu_code_status "TPU MicroCode Status. [RAM name from V530, voted 2]" UWORD M_FORMULA_0010 0 0 0 65535 ECU_ADDRESS 0x3FD912 /end MEASUREMENT
/begin MEASUREMENT tpu_st_a "Status TPU Synchronisation [RAM name from V530, voted 26]" UBYTE NO_COMPU_METHOD 0 0 0 255 ECU_ADDRESS 0x3FD914 FORMAT "%.4g" /end MEASUREMENT
/begin MEASUREMENT tpu_st_b "Status TPU Synchronisation [RAM name from V530, voted 13]" UBYTE NO_COMPU_METHOD 0 0 0 255 ECU_ADDRESS 0x3FD915 FORMAT "%.4g" /end MEASUREMENT
/begin MEASUREMENT tpu_zyl "aktueller Zylinder [RAM name from V530, voted 5]" UBYTE M_FORMULA_0408 0 0 1 256 ECU_ADDRESS 0x3FD916 /end MEASUREMENT
/begin MEASUREMENT tpu_zyl_p2 "zwei Zylinder in der Zukunft [RAM name from V530, voted 4]" UBYTE M_FORMULA_0408 0 0 1 256 ECU_ADDRESS 0x3FD917 /end MEASUREMENT
/begin MEASUREMENT tpu_bank "aktuelle Bank [RAM name from V530, voted 3]" UBYTE M_FORMULA_0408 0 0 1 256 ECU_ADDRESS 0x3FD918 /end MEASUREMENT
/begin MEASUREMENT tpu_zyl_bank "aktueller Zylinder der Bank [RAM name from V530, voted 3]" UBYTE M_FORMULA_0408 0 0 1 256 ECU_ADDRESS 0x3FD919 /end MEASUREMENT
/begin MEASUREMENT tpu_index "Segmentindex fuer den Gesamtmotor [RAM name from V530, voted 5]" UBYTE M_FORMULA_0003 0 0 0 255 ECU_ADDRESS 0x3FD91A /end MEASUREMENT
/begin MEASUREMENT tpu_kw_rot "Rotation. [RAM name from V530, voted 1]" UBYTE M_FORMULA_0003 0 0 0 255 ECU_ADDRESS 0x3FD91B /end MEASUREMENT
/begin MEASUREMENT tpu_idx_a "Segmentindex auf TPU [RAM name from V530, voted 4]" UBYTE M_FORMULA_0003 0 0 0 255 ECU_ADDRESS 0x3FD91C /end MEASUREMENT
/begin MEASUREMENT tpu_idx_b "Segmentindex auf TPU [RAM name from V530, voted 2]" UBYTE M_FORMULA_0003 0 0 0 255 ECU_ADDRESS 0x3FD91D /end MEASUREMENT
/begin MEASUREMENT tpu_kw_nw_sync_cnt_a "Umsynchronisationszaehler [RAM name from V530, voted 5]" UBYTE M_FORMULA_0003 0 0 0 255 ECU_ADDRESS 0x3FD91E /end MEASUREMENT
/begin MEASUREMENT tpu_kw_nw_sync_cnt_b "Umsynchronisationszaehler [RAM name from V530, voted 2]" UBYTE M_FORMULA_0003 0 0 0 255 ECU_ADDRESS 0x3FD91F /end MEASUREMENT
/begin MEASUREMENT tpu_kw_irq_a "Letzte KW Interruptart. [RAM name from V530, voted 6]" UBYTE NO_COMPU_METHOD 0 0 0 255 ECU_ADDRESS 0x3FD920 FORMAT "%.4g" /end MEASUREMENT
/begin MEASUREMENT tpu_kw_irq_error_a "Fehlerinterrupt. [RAM name from V530, voted 6]" UBYTE NO_COMPU_METHOD 0 0 0 255 ECU_ADDRESS 0x3FD920 FORMAT "%.4g" /end MEASUREMENT
/begin MEASUREMENT tpu_kw_irq_info_a "Infointerrupt (+/- ein Zahn). [RAM name from V530, voted 6]" UBYTE NO_COMPU_METHOD 0 0 0 255 ECU_ADDRESS 0x3FD920 FORMAT "%.4g" /end MEASUREMENT
/begin MEASUREMENT tpu_kw_irq_mess_a "Messfensterinterrupt (LU). [RAM name from V530, voted 6]" UBYTE NO_COMPU_METHOD 0 0 0 255 ECU_ADDRESS 0x3FD920 FORMAT "%.4g" /end MEASUREMENT
/begin MEASUREMENT tpu_kw_irq_n_min_a "Unterdrehzahlinterrupt. [RAM name from V530, voted 6]" UBYTE NO_COMPU_METHOD 0 0 0 255 ECU_ADDRESS 0x3FD920 FORMAT "%.4g" /end MEASUREMENT
/begin MEASUREMENT tpu_kw_irq_pre_sync_a "Pre-Sync-Interrupt (Start Lueckensuche). [RAM name from V530, voted 6]" UBYTE NO_COMPU_METHOD 0 0 0 255 ECU_ADDRESS 0x3FD920 FORMAT "%.4g" /end MEASUREMENT
/begin MEASUREMENT tpu_kw_irq_segm_a "Segmentinterrupt. [RAM name from V530, voted 6]" UBYTE NO_COMPU_METHOD 0 0 0 255 ECU_ADDRESS 0x3FD920 FORMAT "%.4g" /end MEASUREMENT
/begin MEASUREMENT tpu_kw_irq_sync_a "Sync-Interrupt (Luecke gefunden). [RAM name from V530, voted 6]" UBYTE NO_COMPU_METHOD 0 0 0 255 ECU_ADDRESS 0x3FD920 FORMAT "%.4g" /end MEASUREMENT
/begin MEASUREMENT tpu_kw_irq_tooth_a "Zahninterrupt. [RAM name from V530, voted 6]" UBYTE NO_COMPU_METHOD 0 0 0 255 ECU_ADDRESS 0x3FD920 FORMAT "%.4g" /end MEASUREMENT
/begin MEASUREMENT tpu_kw_irq_b "Letzte KW Interruptart. [RAM name from V530, voted 5]" UBYTE NO_COMPU_METHOD 0 0 0 255 ECU_ADDRESS 0x3FD921 FORMAT "%.4g" /end MEASUREMENT
/begin MEASUREMENT tpu_kw_irq_error_b "Fehlerinterrupt. [RAM name from V530, voted 5]" UBYTE NO_COMPU_METHOD 0 0 0 255 ECU_ADDRESS 0x3FD921 FORMAT "%.4g" /end MEASUREMENT
/begin MEASUREMENT tpu_kw_irq_info_b "Infointerrupt (+/- ein Zahn). [RAM name from V530, voted 5]" UBYTE NO_COMPU_METHOD 0 0 0 255 ECU_ADDRESS 0x3FD921 FORMAT "%.4g" /end MEASUREMENT
/begin MEASUREMENT tpu_kw_irq_mess_b "Messfensterinterrupt (LU). [RAM name from V530, voted 5]" UBYTE NO_COMPU_METHOD 0 0 0 255 ECU_ADDRESS 0x3FD921 FORMAT "%.4g" /end MEASUREMENT
/begin MEASUREMENT tpu_kw_irq_n_min_b "Unterdrehzahlinterrupt. [RAM name from V530, voted 5]" UBYTE NO_COMPU_METHOD 0 0 0 255 ECU_ADDRESS 0x3FD921 FORMAT "%.4g" /end MEASUREMENT
/begin MEASUREMENT tpu_kw_irq_pre_sync_b "Pre-Sync-Interrupt (Start Lueckensuche). [RAM name from V530, voted 5]" UBYTE NO_COMPU_METHOD 0 0 0 255 ECU_ADDRESS 0x3FD921 FORMAT "%.4g" /end MEASUREMENT
/begin MEASUREMENT tpu_kw_irq_segm_b "Segmentinterrupt. [RAM name from V530, voted 5]" UBYTE NO_COMPU_METHOD 0 0 0 255 ECU_ADDRESS 0x3FD921 FORMAT "%.4g" /end MEASUREMENT
/begin MEASUREMENT tpu_kw_irq_sync_b "Sync-Interrupt (Luecke gefunden). [RAM name from V530, voted 5]" UBYTE NO_COMPU_METHOD 0 0 0 255 ECU_ADDRESS 0x3FD921 FORMAT "%.4g" /end MEASUREMENT
/begin MEASUREMENT tpu_kw_irq_tooth_b "Zahninterrupt. [RAM name from V530, voted 5]" UBYTE NO_COMPU_METHOD 0 0 0 255 ECU_ADDRESS 0x3FD921 FORMAT "%.4g" /end MEASUREMENT
/begin MEASUREMENT tpu_kw_irq_zahn_a "Zahnnummer TPU bei Eintritt in ISR. [RAM name from V530, voted 3]" UBYTE M_FORMULA_0003 0 0 0 255 ECU_ADDRESS 0x3FD922 /end MEASUREMENT
/begin MEASUREMENT tpu_kw_irq_zahn_b "Zahnnummer TPU bei Eintritt in ISR. [RAM name from V530, voted 2]" UBYTE M_FORMULA_0003 0 0 0 255 ECU_ADDRESS 0x3FD923 /end MEASUREMENT
/begin MEASUREMENT tpu_kw_irq_cnt_a "TPU Interruptzaehler. [RAM name from V530, voted 4]" UBYTE M_FORMULA_0003 0 0 0 255 ECU_ADDRESS 0x3FD924 /end MEASUREMENT
/begin MEASUREMENT tpu_kw_irq_cnt_b "TPU Interruptzaehler. [RAM name from V530, voted 2]" UBYTE M_FORMULA_0003 0 0 0 255 ECU_ADDRESS 0x3FD925 /end MEASUREMENT
/begin MEASUREMENT tpu_kw_irq_segm_cnt_a "Anzahl Segmentinterrupts. [RAM name from V530, voted 5]" UBYTE M_FORMULA_0003 0 0 0 255 ECU_ADDRESS 0x3FD926 /end MEASUREMENT
/begin MEASUREMENT tpu_kw_irq_segm_cnt_b "Anzahl Segmentinterrupts. [RAM name from V530, voted 2]" UBYTE M_FORMULA_0003 0 0 0 255 ECU_ADDRESS 0x3FD927 /end MEASUREMENT
/begin MEASUREMENT tpu_kw_irq_tooth_cnt_a "Zahninterruptzaehler. [RAM name from V530, voted 5]" UBYTE M_FORMULA_0003 0 0 0 255 ECU_ADDRESS 0x3FD928 /end MEASUREMENT
/begin MEASUREMENT tpu_kw_irq_tooth_cnt_b "Zahninterruptzaehler. [RAM name from V530, voted 2]" UBYTE M_FORMULA_0003 0 0 0 255 ECU_ADDRESS 0x3FD929 /end MEASUREMENT
/begin MEASUREMENT tsgrw_roh_b1 "Ungefilterte Saugrohrwandtemperatur [RAM name from V530, voted 2]" SWORD M_FORMULA_0975 0 0 -1092.35 546.025 ECU_ADDRESS 0x3FD92A /end MEASUREMENT
/begin MEASUREMENT tsgrw_filter_b1 "Gefilterte Saugrohrwandtemperatur [RAM name from V530, voted 2]" SWORD M_FORMULA_0975 0 0 -1092.35 546.025 ECU_ADDRESS 0x3FD92E /end MEASUREMENT
/begin MEASUREMENT tumg_obd_model_delta "Abweichung absolut tumg zu tumg_diag_model [RAM name from V530, voted 1]" SWORD M_FORMULA_0074 0 0 -3276.8 3276.7 ECU_ADDRESS 0x3FD936 /end MEASUREMENT
/begin MEASUREMENT tumg_obd_output "tumg nach Diagnose [RAM name from V530, voted 1]" SWORD M_FORMULA_0023 0 0 -3550 3003.5 ECU_ADDRESS 0x3FD938 /end MEASUREMENT
/begin MEASUREMENT tumg_obd_error_counter "Zaehler fuer Fehlerentprellung [RAM name from V530, voted 1]" UBYTE M_FORMULA_0003 0 0 0 255 ECU_ADDRESS 0x3FD93A /end MEASUREMENT
/begin MEASUREMENT tumg_obd_ok_counter "Zaehler fuer ok-Entprellung [RAM name from V530, voted 2]" UBYTE M_FORMULA_0003 0 0 0 255 ECU_ADDRESS 0x3FD93B /end MEASUREMENT
/begin MEASUREMENT tz_zyl1 "Zuendwinkel [RAM name from V530, voted 3]" SWORD M_FORMULA_0102 0 0 -3276.8 3276.7 ECU_ADDRESS 0x3FD9CC /end MEASUREMENT
/begin MEASUREMENT tz_zyl5 "Zuendwinkel [RAM name from V530, voted 1]" SWORD M_FORMULA_0102 0 0 -3276.8 3276.7 ECU_ADDRESS 0x3FD9D4 /end MEASUREMENT
/begin MEASUREMENT tz_ve_zyl1 "Zuendwinkel ohne Momenteneingriff [RAM name from V530, voted 2]" SWORD M_FORMULA_0102 0 0 -3276.8 3276.7 ECU_ADDRESS 0x3FD9E0 /end MEASUREMENT
/begin MEASUREMENT tz_stat_b1 "stationaer Zuendwinkel [RAM name from V530, voted 2]" SWORD M_FORMULA_0102 0 0 -3276.8 3276.7 ECU_ADDRESS 0x3FD994 /end MEASUREMENT
/begin MEASUREMENT tz_stat_b2 "stationaer Zuendwinkel [RAM name from V530, voted 1]" SWORD M_FORMULA_0102 0 0 -3276.8 3276.7 ECU_ADDRESS 0x3FD996 /end MEASUREMENT
/begin MEASUREMENT tz_stat_dly_b1 "stationaer Zuendwinkel nach Ringpuffer [RAM name from V530, voted 1]" SWORD M_FORMULA_0102 0 0 -3276.8 3276.7 ECU_ADDRESS 0x3FD998 /end MEASUREMENT
/begin MEASUREMENT ub_filter "Gefilterter Messwert der U_KL87-Erfassung [RAM name from V530, voted 4]" SWORD M_FORMULA_0261 0 0 -51.08269056 51.08113164 ECU_ADDRESS 0x3FDA1C /end MEASUREMENT
/begin MEASUREMENT ub_old "UB bei der letzten Erfassung [RAM name from V530, voted 3]" SWORD M_FORMULA_0261 0 0 -51.08269056 51.08113164 ECU_ADDRESS 0x3FDA1E /end MEASUREMENT
/begin MEASUREMENT ub_grad_int "Integral des Gradienten [RAM name from V530, voted 6]" SWORD M_FORMULA_0261 0 0 -51.08269056 51.08113164 ECU_ADDRESS 0x3FDA20 /end MEASUREMENT
/begin MEASUREMENT ub_diag_kl87_sperre "Sperre der Diagnose nach KL87 aus [RAM name from V530, voted 6]" UBYTE M_FORMULA_0584 0 0 0 1275 ECU_ADDRESS 0x3FDA22 /end MEASUREMENT
/begin MEASUREMENT uext_ad_pin_111_219_514 "AD-Wert Versorgungsspannungen [RAM name from V530, voted 5]" SWORD M_FORMULA_0114 0 0 -32768 32767 ECU_ADDRESS 0x3FDA24 /end MEASUREMENT
/begin MEASUREMENT uext_ad_pin_124_512 "AD-Wert Versorgungsspannungen [RAM name from V530, voted 1]" SWORD M_FORMULA_0114 0 0 -32768 32767 ECU_ADDRESS 0x3FDA26 /end MEASUREMENT
/begin MEASUREMENT uext_roh_pin_111_219_514 "Roh-Wert d. Versorgungsspannungen [RAM name from V530, voted 2]" UWORD M_FORMULA_0247 0 0 0 6.666564941 ECU_ADDRESS 0x3FDA28 /end MEASUREMENT
/begin MEASUREMENT uintern_ad_1_8 "AD-Wert interne Versorgungsspannung [RAM name from V530, voted 1]" SWORD M_FORMULA_0114 0 0 -32768 32767 ECU_ADDRESS 0x3FDA2C /end MEASUREMENT
/begin MEASUREMENT uintern_ad_2_55 "AD-Wert interne Versorgungsspannung [RAM name from V530, voted 1]" SWORD M_FORMULA_0114 0 0 -32768 32767 ECU_ADDRESS 0x3FDA2E /end MEASUREMENT
/begin MEASUREMENT uintern_ad_3_3 "AD-Wert interne Versorgungsspannung [RAM name from V530, voted 1]" SWORD M_FORMULA_0114 0 0 -32768 32767 ECU_ADDRESS 0x3FDA30 /end MEASUREMENT
/begin MEASUREMENT uintern_fehler_zaehler_1_8 "Fehlerfilter [RAM name from V530, voted 2]" UWORD M_FORMULA_0010 0 0 0 65535 ECU_ADDRESS 0x3FDA32 /end MEASUREMENT
/begin MEASUREMENT uintern_fehler_zaehler_2_55 "Fehlerfilter [RAM name from V530, voted 2]" UWORD M_FORMULA_0010 0 0 0 65535 ECU_ADDRESS 0x3FDA34 /end MEASUREMENT
/begin MEASUREMENT uintern_fehler_zaehler_3_3 "Fehlerfilter [RAM name from V530, voted 2]" UWORD M_FORMULA_0010 0 0 0 65535 ECU_ADDRESS 0x3FDA36 /end MEASUREMENT
/begin MEASUREMENT vers_prog "Programmversion [RAM name from V530, voted 1]" UWORD M_FORMULA_0010 0 0 0 65535 ECU_ADDRESS 0x3FDA56 /end MEASUREMENT
/begin MEASUREMENT vers_index "Programmindex [RAM name from V530, voted 1]" UBYTE M_FORMULA_0003 0 0 0 255 ECU_ADDRESS 0x3FDA58 /end MEASUREMENT
/begin MEASUREMENT zoelp_st_b1 "Zusatzoelpumpenstatus [RAM name from V530, voted 24]" UBYTE NO_COMPU_METHOD 0 0 0 255 ECU_ADDRESS 0x3FDAE2 FORMAT "%.4g" /end MEASUREMENT
/begin MEASUREMENT zoelp_st_b2 "Zusatzoelpumpenstatus [RAM name from V530, voted 13]" UBYTE NO_COMPU_METHOD 0 0 0 255 ECU_ADDRESS 0x3FDAE3 FORMAT "%.4g" /end MEASUREMENT
/begin MEASUREMENT zoelp_fg_timer "Timer fuer den Freigraengigkeitsschutz [RAM name from V530, voted 5]" UWORD M_FORMULA_0071 0 0 0 6553.5 ECU_ADDRESS 0x3FDAE4 /end MEASUREMENT
/begin MEASUREMENT zoelp_time_on "Zeit fuer Pumpe an [RAM name from V530, voted 6]" UWORD M_FORMULA_0071 0 0 0 6553.5 ECU_ADDRESS 0x3FDAE6 /end MEASUREMENT
/begin MEASUREMENT zoelp_exd_timeout "Timer fuer die Tester Ansteuerung [RAM name from V530, voted 6]" UBYTE M_FORMULA_0492 0 0 0 25.5 ECU_ADDRESS 0x3FDAEA /end MEASUREMENT
/begin MEASUREMENT fgr_b_fehler_e2 "FGR Fehler Ebene 2 [RAM name from V530, voted 3]" UBYTE NO_COMPU_METHOD 0 0 0 255 ECU_ADDRESS 0x3FDB37 FORMAT "%.4g" /end MEASUREMENT
/begin MEASUREMENT llr_plausi_e2_err "Anzahl der Plausi-Fehler [RAM name from V530, voted 2]" UBYTE M_FORMULA_0003 0 0 0 255 ECU_ADDRESS 0x3FDB48 /end MEASUREMENT
/begin MEASUREMENT llr_n_soll_diff_e2 "Regeldifferenz Ebene 2 [RAM name from V530, voted 1]" SWORD M_FORMULA_0006 0 0 -32768 32767 ECU_ADDRESS 0x3FDB4A /end MEASUREMENT
/begin MEASUREMENT llr_md_i_max_e2 "max. I-Anteil Ebene 2 [RAM name from V530, voted 2]" SWORD M_FORMULA_0009 0 0 -3276.8 3276.7 ECU_ADDRESS 0x3FDB4C /end MEASUREMENT
/begin MEASUREMENT md_e2_fehler "Fehlerstatus Ebene 2 [RAM name from V530, voted 12]" UBYTE NO_COMPU_METHOD 0 0 0 255 ECU_ADDRESS 0x3FDB8E FORMAT "%.4g" /end MEASUREMENT
/begin MEASUREMENT md_e2_min_err "Minimalmoment fehlerhaft [RAM name from V530, voted 3]" UBYTE M_FORMULA_0492 0 0 0 25.5 ECU_ADDRESS 0x3FDB8F /end MEASUREMENT
/begin MEASUREMENT md_e2_max_err "Maximalmoment fehlerhaft [RAM name from V530, voted 3]" UBYTE M_FORMULA_0492 0 0 0 25.5 ECU_ADDRESS 0x3FDB90 /end MEASUREMENT
/begin MEASUREMENT md_e2_ist_err "Istmoment fehlerhaft [RAM name from V530, voted 3]" UBYTE M_FORMULA_0492 0 0 0 25.5 ECU_ADDRESS 0x3FDB91 /end MEASUREMENT
/begin MEASUREMENT md_e2_schlepp_err "Schleppmoment fehlerhaft [RAM name from V530, voted 3]" UBYTE M_FORMULA_0492 0 0 0 25.5 ECU_ADDRESS 0x3FDB92 /end MEASUREMENT
/begin MEASUREMENT md_e2_istsoll_err "Fehler Soll-Istvergleich [RAM name from V530, voted 2]" UBYTE M_FORMULA_0492 0 0 0 25.5 ECU_ADDRESS 0x3FDB93 /end MEASUREMENT
/begin MEASUREMENT md_e2_fw_rel_err "Fahrerwunsch fehlerhaft [RAM name from V530, voted 3]" UBYTE M_FORMULA_0492 0 0 0 25.5 ECU_ADDRESS 0x3FDB94 /end MEASUREMENT
/begin MEASUREMENT md_fw_rel_e2 "rel. Fahrerwunsch Ebene 2 [RAM name from V530, voted 3]" SWORD M_FORMULA_0001 0 0 -3276.8 3276.7 ECU_ADDRESS 0x3FDB96 /end MEASUREMENT
/begin MEASUREMENT md_fw_rel_diff "Differenz rel. Fahrerwunsch [RAM name from V530, voted 2]" SWORD M_FORMULA_0001 0 0 -3276.8 3276.7 ECU_ADDRESS 0x3FDB98 /end MEASUREMENT
/begin MEASUREMENT md_ind_opt_e2 "Indiziertes Istmoment [RAM name from V530, voted 3]" SWORD M_FORMULA_0009 0 0 -3276.8 3276.7 ECU_ADDRESS 0x3FDB9A /end MEASUREMENT
/begin MEASUREMENT md_ind_opt_diff "Differenz zum ind. Istmoment [RAM name from V530, voted 2]" SWORD M_FORMULA_0009 0 0 -3276.8 3276.7 ECU_ADDRESS 0x3FDB9C /end MEASUREMENT
/begin MEASUREMENT md_ind_max_e2 "Indiziertes Maxmoment [RAM name from V530, voted 1]" SWORD M_FORMULA_0009 0 0 -3276.8 3276.7 ECU_ADDRESS 0x3FDB9E /end MEASUREMENT
/begin MEASUREMENT md_kupp_max_e2 "Maxmoment [RAM name from V530, voted 2]" SWORD M_FORMULA_0009 0 0 -3276.8 3276.7 ECU_ADDRESS 0x3FDBA0 /end MEASUREMENT
/begin MEASUREMENT md_kupp_max_diff "Differenz zum Maxmoment [RAM name from V530, voted 2]" SWORD M_FORMULA_0009 0 0 -3276.8 3276.7 ECU_ADDRESS 0x3FDBA2 /end MEASUREMENT
/begin MEASUREMENT md_kupp_min_e2 "Minmoment [RAM name from V530, voted 1]" SWORD M_FORMULA_0009 0 0 -3276.8 3276.7 ECU_ADDRESS 0x3FDBA6 /end MEASUREMENT
/begin MEASUREMENT md_ind_lw_e2 "Ladungswechselverluste [RAM name from V530, voted 2]" SWORD M_FORMULA_0009 0 0 -3276.8 3276.7 ECU_ADDRESS 0x3FDBAA /end MEASUREMENT
/begin MEASUREMENT md_ind_reib_offset_e2 "Reibverluste (Offset) - Ebene 2 [RAM name from V530, voted 3]" SWORD M_FORMULA_0758 0 0 -327.68 327.67 ECU_ADDRESS 0x3FDBAE /end MEASUREMENT
/begin MEASUREMENT md_ind_schlepp_e2 "Schleppmoment [RAM name from V530, voted 5]" SWORD M_FORMULA_0009 0 0 -3276.8 3276.7 ECU_ADDRESS 0x3FDBB0 /end MEASUREMENT
/begin MEASUREMENT md_ind_schlepp_diff "Differenz zum Schleppmoment [RAM name from V530, voted 1]" SWORD M_FORMULA_0009 0 0 -3276.8 3276.7 ECU_ADDRESS 0x3FDBB2 /end MEASUREMENT
/begin MEASUREMENT md_kupp_wunsch_e2 "Wunschmoment [RAM name from V530, voted 1]" SWORD M_FORMULA_0009 0 0 -3276.8 3276.7 ECU_ADDRESS 0x3FDBB4 /end MEASUREMENT
/begin MEASUREMENT md_start_offset_e2 "Startmoment [RAM name from V530, voted 2]" SWORD M_FORMULA_0009 0 0 -3276.8 3276.7 ECU_ADDRESS 0x3FDBB6 /end MEASUREMENT
/begin MEASUREMENT md_zw_opt_e2 "Zuendwinkelbestwert Ebene 2 [RAM name from V530, voted 1]" SWORD M_FORMULA_0102 0 0 -3276.8 3276.7 ECU_ADDRESS 0x3FDBB8 /end MEASUREMENT
/begin MEASUREMENT md_eta_ausblend_e2 "ETA-Ausblend Ebene 2 [RAM name from V530, voted 1]" UWORD M_FORMULA_0437 0 0 0 199.9969482 ECU_ADDRESS 0x3FDBBA /end MEASUREMENT
/begin MEASUREMENT md_eta_zw_ne_e2 "ETA nach Eingriff Ebene 2 [RAM name from V530, voted 4]" UWORD M_FORMULA_0437 0 0 0 199.9969482 ECU_ADDRESS 0x3FDBBC /end MEASUREMENT
/begin MEASUREMENT md_kupp_ist_e2 "Istmoment Ebene 2 [RAM name from V530, voted 4]" SWORD M_FORMULA_0009 0 0 -3276.8 3276.7 ECU_ADDRESS 0x3FDBBE /end MEASUREMENT
/begin MEASUREMENT md_kupp_soll_e2 "Sollmoment Ebene 2 [RAM name from V530, voted 3]" SWORD M_FORMULA_0009 0 0 -3276.8 3276.7 ECU_ADDRESS 0x3FDBC2 /end MEASUREMENT
/begin MEASUREMENT md_kupp_msr_e2 "MSR-Sollvorgabe Ebene 2 [RAM name from V530, voted 3]" SWORD M_FORMULA_0009 0 0 -3276.8 3276.7 ECU_ADDRESS 0x3FDBC6 /end MEASUREMENT
/begin MEASUREMENT md_dsc_freig_st_e2 "DSC-Freigabe Ebene 2 [RAM name from V530, voted 3]" UBYTE NO_COMPU_METHOD 0 0 0 255 ECU_ADDRESS 0x3FDBC8 FORMAT "%.4g" /end MEASUREMENT
/begin MEASUREMENT md_fw_fgr_ "Komplement rel. Wunschmoment vom FGR [RAM name from V530, voted 3]" SWORD M_FORMULA_0001 0 0 -3276.8 3276.7 ECU_ADDRESS 0x3FDBCC /end MEASUREMENT
/begin MEASUREMENT n_e2_st "Status Drehzahl fuer Ebene 2 [RAM name from V530, voted 2]" UBYTE NO_COMPU_METHOD 0 0 0 255 ECU_ADDRESS 0x3FDBD2 FORMAT "%.4g" /end MEASUREMENT
/begin MEASUREMENT n_e2_t "Fehlerzeit der Drehzahl fuer Ebene 2 [RAM name from V530, voted 2]" UWORD M_FORMULA_0021 0 0 0 655.35 ECU_ADDRESS 0x3FDBD4 /end MEASUREMENT
/begin MEASUREMENT pwg_soll_e2 "Ausgegebener Pedalwert Ebene 2 [RAM name from V530, voted 2]" SWORD M_FORMULA_0001 0 0 -3276.8 3276.7 ECU_ADDRESS 0x3FDBE2 /end MEASUREMENT
/begin MEASUREMENT pwg_err_e2 "Anzahl der Vergleichs-Fehler [RAM name from V530, voted 2]" UBYTE M_FORMULA_0003 0 0 0 255 ECU_ADDRESS 0x3FDBE4 /end MEASUREMENT
/begin MEASUREMENT schalter_bls_entprell_cnt_e2 "Entprell-Zaehler fuer BLS E2 [RAM name from V530, voted 2]" UBYTE M_FORMULA_0003 0 0 0 255 ECU_ADDRESS 0x3FDC12 /end MEASUREMENT
/begin MEASUREMENT sk_e2_byte "Counter Byte-Komplement [RAM name from V530, voted 4]" UBYTE M_FORMULA_0003 0 0 0 255 ECU_ADDRESS 0x3FDC13 /end MEASUREMENT
/begin MEASUREMENT sk_e2_word "Counter Word-Komplement [RAM name from V530, voted 4]" UBYTE M_FORMULA_0003 0 0 0 255 ECU_ADDRESS 0x3FDC14 /end MEASUREMENT
/begin MEASUREMENT sk_e2_long "Counter Long-Komplement [RAM name from V530, voted 4]" UBYTE M_FORMULA_0003 0 0 0 255 ECU_ADDRESS 0x3FDC15 /end MEASUREMENT
/begin MEASUREMENT sk_e2_byte_err "Fehler Byte-Komplement [RAM name from V530, voted 1]" UBYTE M_FORMULA_0003 0 0 0 255 ECU_ADDRESS 0x3F97A0 /end MEASUREMENT
/begin MEASUREMENT sk_e2_word_err "Fehler Word-Komplement [RAM name from V530, voted 1]" UBYTE M_FORMULA_0003 0 0 0 255 ECU_ADDRESS 0x3F97A1 /end MEASUREMENT
/begin MEASUREMENT sk_e2_long_err "Fehler Long-Komplement [RAM name from V530, voted 1]" UBYTE M_FORMULA_0003 0 0 0 255 ECU_ADDRESS 0x3F97A2 /end MEASUREMENT
/begin MEASUREMENT sk_e2_komp_err "Anzahl der Komplement-Fehler [RAM name from V530, voted 11]" UBYTE M_FORMULA_0003 0 0 0 255 ECU_ADDRESS 0x3FDC16 /end MEASUREMENT
/begin MEASUREMENT smg_st_dme_e2 "DME-Status Ebene 2 [RAM name from V530, voted 3]" UBYTE NO_COMPU_METHOD 0 0 0 255 ECU_ADDRESS 0x3FDC33 FORMAT "%.4g" /end MEASUREMENT
/begin MEASUREMENT smg_st_mot_e2 "SMG-Motoreingriff Ebene 2 [RAM name from V530, voted 5]" UBYTE NO_COMPU_METHOD 0 0 0 255 ECU_ADDRESS 0x3FDC34 FORMAT "%.4g" /end MEASUREMENT
/begin MEASUREMENT smg_st_dme_e2_err "Anzahl der Vergleichs-Fehler [RAM name from V530, voted 3]" UBYTE M_FORMULA_0003 0 0 0 255 ECU_ADDRESS 0x3FDC35 /end MEASUREMENT
/begin MEASUREMENT smg_st_mot_e2_err "Anzahl der Vergleichs-Fehler [RAM name from V530, voted 2]" UBYTE M_FORMULA_0003 0 0 0 255 ECU_ADDRESS 0x3FDC36 /end MEASUREMENT
/begin MEASUREMENT smg_ngetr_e2_err "Anzahl der Vergleichs-Fehler [RAM name from V530, voted 4]" UBYTE M_FORMULA_0003 0 0 0 255 ECU_ADDRESS 0x3FDC37 /end MEASUREMENT
/begin MEASUREMENT smg_gang_e2_err "Anzahl der Vergleichs-Fehler [RAM name from V530, voted 1]" UBYTE M_FORMULA_0003 0 0 0 255 ECU_ADDRESS 0x3FDC38 /end MEASUREMENT
/begin MEASUREMENT smg_flags_e2 "diverse Flags Ebene 2 [RAM name from V530, voted 10]" UBYTE M_FORMULA_0003 0 0 0 255 ECU_ADDRESS 0x3FDC39 /end MEASUREMENT
/begin MEASUREMENT smg_flags_e2.ekr "EKR-Freigabe [RAM name from V530, voted 10]" UBYTE NO_COMPU_METHOD 0 0 0 255 ECU_ADDRESS 0x3FDC39 FORMAT "%.4g" /end MEASUREMENT
/begin MEASUREMENT smg_flags_e2.zs "ZugSchubschaltung [RAM name from V530, voted 10]" UBYTE NO_COMPU_METHOD 0 0 0 255 ECU_ADDRESS 0x3FDC39 FORMAT "%.4g" /end MEASUREMENT
/begin MEASUREMENT smg_mot_tz_nachl_e2 "Zeit TZ-Nachlauf Ebene 2 [RAM name from V530, voted 2]" UWORD M_FORMULA_0109 0 0 0 327.675 ECU_ADDRESS 0x3FDC3A /end MEASUREMENT
/begin MEASUREMENT tmot_e2 "Motortemperatur-Kuehlwasser Ebene 2 [RAM name from V530, voted 7]" SWORD M_FORMULA_0023 0 0 -3550 3003.5 ECU_ADDRESS 0x3FDC48 /end MEASUREMENT
/begin MEASUREMENT tmot_err_e2 "Anzahl der Vergleichs-Fehler [RAM name from V530, voted 4]" UBYTE M_FORMULA_0003 0 0 0 255 ECU_ADDRESS 0x3FDC4C /end MEASUREMENT
/begin MEASUREMENT toel_e2 "Oeltemperatur Ebene 2 [RAM name from V530, voted 4]" SWORD M_FORMULA_0023 0 0 -3550 3003.5 ECU_ADDRESS 0x3FDC50 /end MEASUREMENT
/begin MEASUREMENT v_e2 "Geschwindigkeit - Ebene 2 [RAM name from V530, voted 4]" SWORD M_FORMULA_0076 0 0 -2048 2047.9375 ECU_ADDRESS 0x3FDC52 /end MEASUREMENT
/begin MEASUREMENT pwg_mode_ign "redundanter Ausgabezustand der Pedalwertgebererfassung [RAM name from V530, voted 1]" UBYTE NO_COMPU_METHOD 0 0 0 255 ECU_ADDRESS 0x3FF025 FORMAT "%.4g" /end MEASUREMENT
/begin MEASUREMENT sk_ursache "Urache fuer SK-Eingriff [RAM name from V530, voted 4]" UWORD NO_COMPU_METHOD 0 0 0 65535 ECU_ADDRESS 0x3FF026 FORMAT "%.4g" /end MEASUREMENT
/begin MEASUREMENT sk_reset_cnt "Resetzaehler seit Kl15 ein [RAM name from V530, voted 5]" UBYTE M_FORMULA_0003 0 0 0 255 ECU_ADDRESS 0x3FF028 /end MEASUREMENT
/begin MEASUREMENT sk_e2_fehler "aktueller Ebene2-Fehler [RAM name from V530, voted 17]" UWORD NO_COMPU_METHOD 0 0 0 65535 ECU_ADDRESS 0x3FF02C FORMAT "%.4g" /end MEASUREMENT
/begin MEASUREMENT sk_reset_cnt_e2 "Resetzaehler Ebene 2 [RAM name from V530, voted 3]" UBYTE M_FORMULA_0003 0 0 0 255 ECU_ADDRESS 0x3FF02E /end MEASUREMENT
/begin MEASUREMENT sys_rsr "Reset Status Register [RAM name from V530, voted 7]" UWORD M_FORMULA_0010 0 0 0 65535 ECU_ADDRESS 0x3FF030 /end MEASUREMENT
/begin MEASUREMENT sys_rsr_csrs "Checkstop reset [RAM name from V530, voted 7]" UWORD NO_COMPU_METHOD 0 0 0 65535 ECU_ADDRESS 0x3FF030 FORMAT "%.4g" /end MEASUREMENT
/begin MEASUREMENT sys_rsr_dbhrs "Debug port hard reset [RAM name from V530, voted 7]" UWORD NO_COMPU_METHOD 0 0 0 65535 ECU_ADDRESS 0x3FF030 FORMAT "%.4g" /end MEASUREMENT
/begin MEASUREMENT sys_rsr_dbsrs "Debug port soft reset [RAM name from V530, voted 7]" UWORD NO_COMPU_METHOD 0 0 0 65535 ECU_ADDRESS 0x3FF030 FORMAT "%.4g" /end MEASUREMENT
/begin MEASUREMENT sys_rsr_ehrs "External Hreset [RAM name from V530, voted 7]" UWORD NO_COMPU_METHOD 0 0 0 65535 ECU_ADDRESS 0x3FF030 FORMAT "%.4g" /end MEASUREMENT
/begin MEASUREMENT sys_rsr_ersr "External Soft reset [RAM name from V530, voted 7]" UWORD NO_COMPU_METHOD 0 0 0 65535 ECU_ADDRESS 0x3FF030 FORMAT "%.4g" /end MEASUREMENT
/begin MEASUREMENT sys_rsr_ghrst "Glitch detected on HRESET PIN [RAM name from V530, voted 7]" UWORD NO_COMPU_METHOD 0 0 0 65535 ECU_ADDRESS 0x3FF030 FORMAT "%.4g" /end MEASUREMENT
/begin MEASUREMENT sys_rsr_gpor "Glitch detected on powern on reset [RAM name from V530, voted 7]" UWORD NO_COMPU_METHOD 0 0 0 65535 ECU_ADDRESS 0x3FF030 FORMAT "%.4g" /end MEASUREMENT
/begin MEASUREMENT sys_rsr_gsrst "Glitch detected on SRESET PIN [RAM name from V530, voted 7]" UWORD NO_COMPU_METHOD 0 0 0 65535 ECU_ADDRESS 0x3FF030 FORMAT "%.4g" /end MEASUREMENT
/begin MEASUREMENT sys_rsr_ilbc "Illegal bit change reset [RAM name from V530, voted 7]" UWORD NO_COMPU_METHOD 0 0 0 65535 ECU_ADDRESS 0x3FF030 FORMAT "%.4g" /end MEASUREMENT
/begin MEASUREMENT sys_rsr_jtrs "Jtag reset [RAM name from V530, voted 7]" UWORD NO_COMPU_METHOD 0 0 0 65535 ECU_ADDRESS 0x3FF030 FORMAT "%.4g" /end MEASUREMENT
/begin MEASUREMENT sys_rsr_llrs "Los of lock reset [RAM name from V530, voted 7]" UWORD NO_COMPU_METHOD 0 0 0 65535 ECU_ADDRESS 0x3FF030 FORMAT "%.4g" /end MEASUREMENT
/begin MEASUREMENT sys_rsr_occs "On chip clock reset [RAM name from V530, voted 7]" UWORD NO_COMPU_METHOD 0 0 0 65535 ECU_ADDRESS 0x3FF030 FORMAT "%.4g" /end MEASUREMENT
/begin MEASUREMENT sys_rsr_swrs "Software watchdog reset [RAM name from V530, voted 7]" UWORD NO_COMPU_METHOD 0 0 0 65535 ECU_ADDRESS 0x3FF030 FORMAT "%.4g" /end MEASUREMENT
/begin MEASUREMENT sys_rsr_cnt_sum "Reset-Summenzaehler [RAM name from V530, voted 3]" UWORD M_FORMULA_0010 0 0 0 65535 ECU_ADDRESS 0x3FF032 /end MEASUREMENT
/begin MEASUREMENT sys_zust_cpu_last "CPU Last [RAM name from V530, voted 1]" UWORD M_FORMULA_0001 0 0 0 6553.5 ECU_ADDRESS 0x3FF034 /end MEASUREMENT
/begin MEASUREMENT sys_zust_bgnd_cnt "Aufruf Bgnd Task pro 100ms [RAM name from V530, voted 3]" UWORD M_FORMULA_0010 0 0 0 65535 ECU_ADDRESS 0x3FF036 /end MEASUREMENT
/begin MEASUREMENT sys_zust_bgnd_net_min "Background Netto time min [RAM name from V530, voted 4]" UWORD M_FORMULA_0404 0 0 0 65.535 ECU_ADDRESS 0x3FF038 /end MEASUREMENT
/begin MEASUREMENT sys_exc_vec "Exception-Vector [RAM name from V530, voted 3]" UWORD NO_COMPU_METHOD 0 0 0 65535 ECU_ADDRESS 0x3FF03A FORMAT "%.4g" /end MEASUREMENT
/begin MEASUREMENT sys_exc_addr "Exception-Adresse [RAM name from V530, voted 2]" ULONG M_FORMULA_0000 0 0 0 4294967295 ECU_ADDRESS 0x3FF03C /end MEASUREMENT
/begin MEASUREMENT sys_sg_fehler "SG internere Fehlernummer [RAM name from V530, voted 18]" UBYTE NO_COMPU_METHOD 0 0 0 255 ECU_ADDRESS 0x3FF040 FORMAT "%.4g" /end MEASUREMENT
/begin MEASUREMENT sys_reset_st "Resetursache [RAM name from V530, voted 6]" UBYTE NO_COMPU_METHOD 0 0 0 255 ECU_ADDRESS 0x3FF041 FORMAT "%.4g" /end MEASUREMENT
/begin MEASUREMENT sys_exc_km_ni "Kilometerstand bei Exception [RAM name from V530, voted 2]" ULONG M_FORMULA_0027 0 0 0 4294967295 ECU_ADDRESS 0x3FF044 /end MEASUREMENT
/begin MEASUREMENT sys_exc_n_ni "Drehzahl bei Exception [RAM name from V530, voted 2]" SWORD M_FORMULA_0006 0 0 -32768 32767 ECU_ADDRESS 0x3FF048 /end MEASUREMENT
/begin MEASUREMENT sys_sync_init_t "Hochlauf Zeitmarken [RAM name from V530, voted 1]" UWORD M_FORMULA_0406 0 0 0 16711.425 ECU_ADDRESS 0x3FF04A /end MEASUREMENT
/begin MEASUREMENT vers_boot "Booterversion [RAM name from V530, interpolated]" UWORD M_FORMULA_0010 0 0 0 65535 ECU_ADDRESS 0x3F8014 /end MEASUREMENT
/begin MEASUREMENT vers_boot_index "Booterversionsindex [RAM name from V530, interpolated]" UWORD M_FORMULA_0010 0 0 0 65535 ECU_ADDRESS 0x3F8016 /end MEASUREMENT
/begin MEASUREMENT tz_grad_b2 "Zuendwinkelgradient pro Bank [RAM name from V530, interpolated]" SWORD M_FORMULA_0231 0 0 -3276.8 3276.7 ECU_ADDRESS 0x3F85AC /end MEASUREMENT
/begin MEASUREMENT auss_erk "Zustandsvariable Aussetzererkennung. [RAM name from V530, interpolated]" UWORD NO_COMPU_METHOD 0 0 0 65535 ECU_ADDRESS 0x3F85BC FORMAT "%.4g" /end MEASUREMENT
/begin MEASUREMENT auss_erk_zyl1 "Aussetzererkennung Zylinder 1. [RAM name from V530, interpolated]" UWORD NO_COMPU_METHOD 0 0 0 65535 ECU_ADDRESS 0x3F85BC FORMAT "%.4g" /end MEASUREMENT
/begin MEASUREMENT auss_erk_zyl10 "Aussetzererkennung Zylinder 10. [RAM name from V530, interpolated]" UWORD NO_COMPU_METHOD 0 0 0 65535 ECU_ADDRESS 0x3F85BC FORMAT "%.4g" /end MEASUREMENT
/begin MEASUREMENT auss_erk_zyl2 "Aussetzererkennung Zylinder 2. [RAM name from V530, interpolated]" UWORD NO_COMPU_METHOD 0 0 0 65535 ECU_ADDRESS 0x3F85BC FORMAT "%.4g" /end MEASUREMENT
/begin MEASUREMENT auss_erk_zyl3 "Aussetzererkennung Zylinder 3. [RAM name from V530, interpolated]" UWORD NO_COMPU_METHOD 0 0 0 65535 ECU_ADDRESS 0x3F85BC FORMAT "%.4g" /end MEASUREMENT
/begin MEASUREMENT auss_erk_zyl4 "Aussetzererkennung Zylinder 4. [RAM name from V530, interpolated]" UWORD NO_COMPU_METHOD 0 0 0 65535 ECU_ADDRESS 0x3F85BC FORMAT "%.4g" /end MEASUREMENT
/begin MEASUREMENT auss_erk_zyl5 "Aussetzererkennung Zylinder 5. [RAM name from V530, interpolated]" UWORD NO_COMPU_METHOD 0 0 0 65535 ECU_ADDRESS 0x3F85BC FORMAT "%.4g" /end MEASUREMENT
/begin MEASUREMENT auss_erk_zyl6 "Aussetzererkennung Zylinder 6. [RAM name from V530, interpolated]" UWORD NO_COMPU_METHOD 0 0 0 65535 ECU_ADDRESS 0x3F85BC FORMAT "%.4g" /end MEASUREMENT
/begin MEASUREMENT auss_erk_zyl7 "Aussetzererkennung Zylinder 7. [RAM name from V530, interpolated]" UWORD NO_COMPU_METHOD 0 0 0 65535 ECU_ADDRESS 0x3F85BC FORMAT "%.4g" /end MEASUREMENT
/begin MEASUREMENT auss_erk_zyl8 "Aussetzererkennung Zylinder 8. [RAM name from V530, interpolated]" UWORD NO_COMPU_METHOD 0 0 0 65535 ECU_ADDRESS 0x3F85BC FORMAT "%.4g" /end MEASUREMENT
/begin MEASUREMENT auss_erk_zyl9 "Aussetzererkennung Zylinder 9. [RAM name from V530, interpolated]" UWORD NO_COMPU_METHOD 0 0 0 65535 ECU_ADDRESS 0x3F85BC FORMAT "%.4g" /end MEASUREMENT
/begin MEASUREMENT kh_lam_soll_b1 "SOLL-Lambda - KAT-Heizen [RAM name from V530, interpolated]" UWORD M_FORMULA_0025 0 0 0 3.999938965 ECU_ADDRESS 0x3F85BE /end MEASUREMENT
/begin MEASUREMENT kh_lam_soll_b2 "SOLL-Lambda - KAT-Heizen [RAM name from V530, interpolated]" UWORD M_FORMULA_0025 0 0 0 3.999938965 ECU_ADDRESS 0x3F85C0 /end MEASUREMENT
/begin MEASUREMENT tz_diag_tpu_err "Tigger fuer Fehleranfilterung bei TPU Dauerbestromung. [RAM name from V530, interpolated]" UWORD M_FORMULA_0010 0 0 0 65535 ECU_ADDRESS 0x3F85C2 /end MEASUREMENT
/begin MEASUREMENT uext_pin_124_512 "Versorgungsspannung [RAM name from V530, interpolated]" UWORD M_FORMULA_0247 0 0 0 6.666564941 ECU_ADDRESS 0x3F85F6 /end MEASUREMENT
/begin MEASUREMENT egas_soll_dk_b2 "DK-Sollwert [RAM name from V530, interpolated]" SWORD M_FORMULA_0001 0 0 -3276.8 3276.7 ECU_ADDRESS 0x3F8626 /end MEASUREMENT
/begin MEASUREMENT smg_ax_mess_filter "ax_mess gefiltert [RAM name from V530, interpolated]" SWORD M_FORMULA_0123 0 0 -819.2 819.175 ECU_ADDRESS 0x3F8660 /end MEASUREMENT
/begin MEASUREMENT u_wakeup "Spannungswert Wakeup [RAM name from V530, interpolated]" SWORD M_FORMULA_0008 0 0 -3276.8 3276.7 ECU_ADDRESS 0x3F865E /end MEASUREMENT
/begin MEASUREMENT ub_roh "Rohwert der U_KL87-Erfassung [RAM name from V530, interpolated]" SWORD M_FORMULA_0261 0 0 -51.08269056 51.08113164 ECU_ADDRESS 0x3F865C /end MEASUREMENT
/begin MEASUREMENT egas_ist_wdk_b2 "Istwert (analog) [RAM name from V530, interpolated]" SWORD M_FORMULA_0001 0 0 -3276.8 3276.7 ECU_ADDRESS 0x3F866C /end MEASUREMENT
/begin MEASUREMENT egas_wdk_adapt_b2 "Adaptionsstatus [RAM name from V530, interpolated]" UBYTE NO_COMPU_METHOD 0 0 0 255 ECU_ADDRESS 0x3F866F FORMAT "%.4g" /end MEASUREMENT
/begin MEASUREMENT egas_aq_soll_b1 "AQ-Soll mit Fuellungsadaption und sek. Einfluessen [RAM name from V530, interpolated]" UWORD M_FORMULA_0143 0 0 0 6553.5 ECU_ADDRESS 0x3F8678 /end MEASUREMENT
/begin MEASUREMENT egas_aq_soll_b2 "AQ-Soll mit Fuellungsadaption und sek. Einfluessen [RAM name from V530, interpolated]" UWORD M_FORMULA_0143 0 0 0 6553.5 ECU_ADDRESS 0x3F867A /end MEASUREMENT
/begin MEASUREMENT md_rad_schlepp_ist "min. Radschleppmoment [RAM name from V530, interpolated]" SLONG M_FORMULA_0272 0 0 -214748364.8 214748364.7 ECU_ADDRESS 0x3F8680 /end MEASUREMENT
/begin MEASUREMENT md_ind_ml_st "Status Sollmoment-Luft [RAM name from V530, interpolated]" UBYTE NO_COMPU_METHOD 0 0 0 255 ECU_ADDRESS 0x3F8692 FORMAT "%.4g" /end MEASUREMENT
/begin MEASUREMENT md_ind_tz_st "Status Sollmoment-TZ [RAM name from V530, interpolated]" UBYTE NO_COMPU_METHOD 0 0 0 255 ECU_ADDRESS 0x3F8691 FORMAT "%.4g" /end MEASUREMENT
/begin MEASUREMENT at_sa_sperre "Anti-Trampeln Schubabschaltungssperre [RAM name from V530, interpolated]" UBYTE NO_COMPU_METHOD 0 0 0 255 ECU_ADDRESS 0x3F8698 FORMAT "%.4g" /end MEASUREMENT
/begin MEASUREMENT fgr_anzeige_kombi "FGR Anzeige im Kombi ein-/ausschalten [RAM name from V530, interpolated]" UBYTE NO_COMPU_METHOD 0 0 0 255 ECU_ADDRESS 0x3F8709 FORMAT "%.4g" /end MEASUREMENT
/begin MEASUREMENT servo_stat "Status Servotronic [RAM name from V530, interpolated]" UBYTE NO_COMPU_METHOD 0 0 0 255 ECU_ADDRESS 0x3F8719 FORMAT "%.4g" /end MEASUREMENT
/begin MEASUREMENT tabg_kat_b1 "Abgastemperatur im Kat [RAM name from V530, interpolated]" SWORD M_FORMULA_0023 0 0 -3550 3003.5 ECU_ADDRESS 0x3F874E /end MEASUREMENT
/begin MEASUREMENT tabg_kat_b2 "Abgastemperatur im Kat [RAM name from V530, interpolated]" SWORD M_FORMULA_0023 0 0 -3550 3003.5 ECU_ADDRESS 0x3F8750 /end MEASUREMENT
/begin MEASUREMENT tan_b2 "Ansauglufttemperatur [RAM name from V530, interpolated]" SWORD M_FORMULA_0023 0 0 -3550 3003.5 ECU_ADDRESS 0x3F875E /end MEASUREMENT
/begin MEASUREMENT hdw_ign "hdw_ign [RAM name from V530, interpolated]" ULONG M_FORMULA_0000 0 0 0 4294967295 ECU_ADDRESS 0x3F8780 /end MEASUREMENT
/begin MEASUREMENT hdw_ign_st "hdw_ign_st [RAM name from V530, interpolated]" UBYTE M_FORMULA_0003 0 0 0 255 ECU_ADDRESS 0x3F877E /end MEASUREMENT
/begin MEASUREMENT tabg_nkat_modell_b1 "Abgastemperaturmodell nach dem Kat [RAM name from V530, interpolated]" SWORD M_FORMULA_0023 0 0 -3550 3003.5 ECU_ADDRESS 0x3F8784 /end MEASUREMENT
/begin MEASUREMENT tabg_nkat_modell_b2 "Abgastemperaturmodell nach dem Kat [RAM name from V530, interpolated]" SWORD M_FORMULA_0023 0 0 -3550 3003.5 ECU_ADDRESS 0x3F8786 /end MEASUREMENT
/begin MEASUREMENT md_ind_opt_la_rg_zw_min "Moment mit LA/RG bei min. ZW [RAM name from V530, interpolated]" SWORD M_FORMULA_0009 0 0 -3276.8 3276.7 ECU_ADDRESS 0x3F87A2 /end MEASUREMENT
/begin MEASUREMENT md_rf_soll_pt_roh "Soll-rf mit pt-Korr [RAM name from V530, interpolated]" SWORD M_FORMULA_0007 0 0 -3.2768 3.2767 ECU_ADDRESS 0x3F87AE /end MEASUREMENT
/begin MEASUREMENT diag_ev_tz_st "Bankabschaltung bei EV-/TZ-Fehlern [RAM name from V530, interpolated]" UWORD M_FORMULA_0010 0 0 0 65535 ECU_ADDRESS 0x3F8884 /end MEASUREMENT
/begin MEASUREMENT ti_ev_ed_b1 "EV-Treiberdiag. [RAM name from V530, interpolated]" UWORD M_FORMULA_0010 0 0 0 65535 ECU_ADDRESS 0x3F8886 /end MEASUREMENT
/begin MEASUREMENT ml_ges "Luftmassenstrom Bank 1 und 2 [RAM name from V530, interpolated]" SWORD M_FORMULA_0103 0 0 -3276.8 3276.7 ECU_ADDRESS 0x3F88A2 /end MEASUREMENT
/begin MEASUREMENT rps_auss_st "Status Aussetzer-RPS [RAM name from V530, interpolated]" UWORD M_FORMULA_0010 0 0 0 65535 ECU_ADDRESS 0x3F88AA /end MEASUREMENT
/begin MEASUREMENT rps_ionen_st "Status Ionen-RPS [RAM name from V530, interpolated]" UWORD M_FORMULA_0010 0 0 0 65535 ECU_ADDRESS 0x3F88A6 /end MEASUREMENT
/begin MEASUREMENT rps_ionen_stufe "Stufe Ionen-RPS [RAM name from V530, interpolated]" UWORD M_FORMULA_0010 0 0 0 65535 ECU_ADDRESS 0x3F88A8 /end MEASUREMENT
/begin MEASUREMENT rps_zyl_nr "Zylinder-RPS [RAM name from V530, interpolated]" UBYTE M_FORMULA_0003 0 0 0 255 ECU_ADDRESS 0x3F88A4 /end MEASUREMENT
/begin MEASUREMENT ed_st_filter_inj "ED-Gesamtstatus INJ-Filter [RAM name from V530, interpolated]" ULONG M_FORMULA_0000 0 0 0 4294967295 ECU_ADDRESS 0x3F88F8 /end MEASUREMENT
/begin MEASUREMENT pks_ist "Kraftstoffdruck, absolut, gefiltert [RAM name from V530, interpolated]" SWORD M_FORMULA_0110 0 0 -32.768 32.767 ECU_ADDRESS 0x3F8928 /end MEASUREMENT
/begin MEASUREMENT sa_aktive_time "SA aktive Zeit [RAM name from V530, interpolated]" UWORD M_FORMULA_0109 0 0 0 327.675 ECU_ADDRESS 0x3F8926 /end MEASUREMENT
/begin MEASUREMENT can_st_klst "Empfangsstatus Klemmenstatus [RAM name from V530, interpolated]" UWORD NO_COMPU_METHOD 0 0 0 65535 ECU_ADDRESS 0x3F8954 FORMAT "%.4g" /end MEASUREMENT
/begin MEASUREMENT can_ax_mess "gem .Laengsbeschleunigung (roh) [RAM name from V530, interpolated]" SWORD M_FORMULA_0123 0 0 -819.2 819.175 ECU_ADDRESS 0x3F8970 /end MEASUREMENT
/begin MEASUREMENT can_ax_offs "Offset aLaengs [RAM name from V530, interpolated]" SWORD M_FORMULA_0123 0 0 -819.2 819.175 ECU_ADDRESS 0x3F8972 /end MEASUREMENT
/begin MEASUREMENT can_no_key "Schluesselnummer [RAM name from V530, interpolated]" UBYTE M_FORMULA_0003 0 0 0 255 ECU_ADDRESS 0x3F8989 /end MEASUREMENT
/begin MEASUREMENT mvac_rf_sr_b_b1 "Fuellung MVAC bankspezifisch [RAM name from V530, interpolated]" SWORD M_FORMULA_0007 0 0 -3.2768 3.2767 ECU_ADDRESS 0x3F89B2 /end MEASUREMENT
/begin MEASUREMENT mvac_rf_sr_b_b2 "Fuellung MVAC bankspezifisch [RAM name from V530, interpolated]" SWORD M_FORMULA_0007 0 0 -3.2768 3.2767 ECU_ADDRESS 0x3F89B4 /end MEASUREMENT
/begin MEASUREMENT mvac_p_mess "berechneter Absolutdruck(Sensor) im Mastervac [RAM name from V530, interpolated]" SWORD M_FORMULA_0075 0 0 -2048 2047.9375 ECU_ADDRESS 0x3F89C4 /end MEASUREMENT
/begin MEASUREMENT mvac_p_modell "Absolutdruck(Modell) im Mastervac [RAM name from V530, interpolated]" SWORD M_FORMULA_0075 0 0 -2048 2047.9375 ECU_ADDRESS 0x3F89C0 /end MEASUREMENT
/begin MEASUREMENT mvac_pdiff_um "Differenzdruck(Modell) Mastervac/Umgebung [RAM name from V530, interpolated]" SWORD M_FORMULA_0075 0 0 -2048 2047.9375 ECU_ADDRESS 0x3F89C2 /end MEASUREMENT
/begin MEASUREMENT n_dyn_st "Statusvariable Drehzahldynamik [RAM name from V530, interpolated]" UBYTE NO_COMPU_METHOD 0 0 0 255 ECU_ADDRESS 0x3F8A11 FORMAT "%.4g" /end MEASUREMENT
/begin MEASUREMENT nwm_state "Zustand vom NWM [RAM name from V530, interpolated]" UBYTE NO_COMPU_METHOD 0 0 0 255 ECU_ADDRESS 0x3F8A24 FORMAT "%.4g" /end MEASUREMENT
/begin MEASUREMENT sk_lam_st_inj_b1 "SK-LAM-Eingriff [RAM name from V530, interpolated]" UBYTE NO_COMPU_METHOD 0 0 0 255 ECU_ADDRESS 0x3F8A2D FORMAT "%.4g" /end MEASUREMENT
/begin MEASUREMENT sk_lam_st_inj_b2 "SK-LAM-Eingriff [RAM name from V530, interpolated]" UBYTE NO_COMPU_METHOD 0 0 0 255 ECU_ADDRESS 0x3F8A2D FORMAT "%.4g" /end MEASUREMENT
/begin MEASUREMENT laa_f_ber_nv_b1 "Faktor-Lambdaadaption ohne TE [RAM name from V530, interpolated]" UWORD M_FORMULA_0024 0 0 0 1.999969482 ECU_ADDRESS 0x3F8A72 /end MEASUREMENT
/begin MEASUREMENT laa_f_ber_nv_b2 "Faktor-Lambdaadaption ohne TE [RAM name from V530, interpolated]" UWORD M_FORMULA_0024 0 0 0 1.999969482 ECU_ADDRESS 0x3F8A74 /end MEASUREMENT
/begin MEASUREMENT kat_obd_wert_gesamt_nv "Gesamtsystemdiagnosewert [RAM name from V530, interpolated]" UWORD M_FORMULA_0025 0 0 0 3.999938965 ECU_ADDRESS 0x3F8A7A /end MEASUREMENT
/begin MEASUREMENT rf_fil_b1 "PT1 gefiltertes rf. [RAM name from V530, interpolated]" SWORD M_FORMULA_0007 0 0 -3.2768 3.2767 ECU_ADDRESS 0x3F8AAC /end MEASUREMENT
/begin MEASUREMENT rf_fil_b2 "PT1 gefiltertes rf. [RAM name from V530, interpolated]" SWORD M_FORMULA_0007 0 0 -3.2768 3.2767 ECU_ADDRESS 0x3F8AAE /end MEASUREMENT
/begin MEASUREMENT rf_grad_b1 "Rf Gradient. [RAM name from V530, interpolated]" SWORD M_FORMULA_0187 0 0 -327.68 327.67 ECU_ADDRESS 0x3F8AB0 /end MEASUREMENT
/begin MEASUREMENT rf_grad_b2 "Rf Gradient. [RAM name from V530, interpolated]" SWORD M_FORMULA_0187 0 0 -327.68 327.67 ECU_ADDRESS 0x3F8AB2 /end MEASUREMENT
/begin MEASUREMENT tumg_st "Status Umgebungstemperatur [RAM name from V530, interpolated]" UBYTE NO_COMPU_METHOD 0 0 0 255 ECU_ADDRESS 0x3F8AC2 FORMAT "%.4g" /end MEASUREMENT
/begin MEASUREMENT slv_st "SLV Status [RAM name from V530, interpolated]" UBYTE NO_COMPU_METHOD 0 0 0 255 ECU_ADDRESS 0x3F8AD2 FORMAT "%.4g" /end MEASUREMENT
/begin MEASUREMENT hdw_inj "hdw_inj [RAM name from V530, interpolated]" ULONG M_FORMULA_0000 0 0 0 4294967295 ECU_ADDRESS 0x3F8AF4 /end MEASUREMENT
/begin MEASUREMENT hdw_inj_st "hdw_inj_st [RAM name from V530, interpolated]" UBYTE M_FORMULA_0003 0 0 0 255 ECU_ADDRESS 0x3F8AF2 /end MEASUREMENT
/begin MEASUREMENT lavk_obd_act_exd_n_soll "Prueflauf - angeforderte Drehzahl [RAM name from V530, interpolated]" SWORD M_FORMULA_0006 0 0 -32768 32767 ECU_ADDRESS 0x3F8AEE /end MEASUREMENT
/begin MEASUREMENT lavk_obd_dyn_kat_exd_n_soll "Prueflauf - angeforderte Drehzahl [RAM name from V530, interpolated]" SWORD M_FORMULA_0006 0 0 -32768 32767 ECU_ADDRESS 0x3F8AF0 /end MEASUREMENT
/begin MEASUREMENT lavk_obd_error "Status LAMBDA-FEHLER im System [RAM name from V530, interpolated]" UWORD M_FORMULA_0010 0 0 0 65535 ECU_ADDRESS 0x3F8AEA /end MEASUREMENT
/begin MEASUREMENT rf_pt_korr "Korrektur der relativen Fuellung [RAM name from V530, interpolated]" UWORD M_FORMULA_0073 0 0 0 63.99902344 ECU_ADDRESS 0x3F8B22 /end MEASUREMENT
/begin MEASUREMENT B_VAN_SK "Notprogramm wegen Vanos [RAM name from V530, interpolated]" UBYTE NO_COMPU_METHOD 0 0 0 255 ECU_ADDRESS 0x3F8B29 FORMAT "%.4g" /end MEASUREMENT
/begin MEASUREMENT van_sk_st "Status Notprogramm wegen Vanos [RAM name from V530, interpolated]" UBYTE M_FORMULA_0003 0 0 0 255 ECU_ADDRESS 0x3F8B29 /end MEASUREMENT
/begin MEASUREMENT kwp_fp_st_inj "Status KWP-FP [RAM name from V530, interpolated]" UBYTE M_FORMULA_0003 0 0 0 255 ECU_ADDRESS 0x3F8B2B /end MEASUREMENT
/begin MEASUREMENT hdw_2_nv "HDW [RAM name from V530, interpolated]" ULONG M_FORMULA_0000 0 0 0 4294967295 ECU_ADDRESS 0x3F9594 /end MEASUREMENT
/begin MEASUREMENT hdw_3_nv "HDW [RAM name from V530, interpolated]" ULONG M_FORMULA_0000 0 0 0 4294967295 ECU_ADDRESS 0x3F9598 /end MEASUREMENT
/begin MEASUREMENT spim_chain_error_nv "SPI Chains Fehler [RAM name from V530, interpolated]" UBYTE NO_COMPU_METHOD 0 0 0 255 ECU_ADDRESS 0x3F96D9 FORMAT "%.4g" /end MEASUREMENT
/begin MEASUREMENT sys_rsr_cnt_nv.csrs "ChkstopReset [RAM name from V530, interpolated]" UBYTE M_FORMULA_0003 0 0 0 255 ECU_ADDRESS 0x3F9710 /end MEASUREMENT
/begin MEASUREMENT sys_rsr_cnt_nv.dbhrs "DebugHardReset [RAM name from V530, interpolated]" UBYTE M_FORMULA_0003 0 0 0 255 ECU_ADDRESS 0x3F9711 /end MEASUREMENT
/begin MEASUREMENT sys_rsr_cnt_nv.dbsrs "DebugSoftReset [RAM name from V530, interpolated]" UBYTE M_FORMULA_0003 0 0 0 255 ECU_ADDRESS 0x3F9712 /end MEASUREMENT
/begin MEASUREMENT sys_rsr_cnt_nv.ghrst "GlitchHPinReset [RAM name from V530, interpolated]" UBYTE M_FORMULA_0003 0 0 0 255 ECU_ADDRESS 0x3F9717 /end MEASUREMENT
/begin MEASUREMENT sys_rsr_cnt_nv.gpor "GlitchPowerOnReset [RAM name from V530, interpolated]" UBYTE M_FORMULA_0003 0 0 0 255 ECU_ADDRESS 0x3F9716 /end MEASUREMENT
/begin MEASUREMENT sys_rsr_cnt_nv.gsrst "GlitchSPinReset [RAM name from V530, interpolated]" UBYTE M_FORMULA_0003 0 0 0 255 ECU_ADDRESS 0x3F9718 /end MEASUREMENT
/begin MEASUREMENT sys_rsr_cnt_nv.ilbc "IllegalBitChangeReset [RAM name from V530, interpolated]" UBYTE M_FORMULA_0003 0 0 0 255 ECU_ADDRESS 0x3F9715 /end MEASUREMENT
/begin MEASUREMENT sys_rsr_cnt_nv.jtrs "JTAGReset [RAM name from V530, interpolated]" UBYTE M_FORMULA_0003 0 0 0 255 ECU_ADDRESS 0x3F9713 /end MEASUREMENT
/begin MEASUREMENT sys_rsr_cnt_nv.llrs "LossOfClockReset [RAM name from V530, interpolated]" UBYTE M_FORMULA_0003 0 0 0 255 ECU_ADDRESS 0x3F970E /end MEASUREMENT
/begin MEASUREMENT sys_rsr_cnt_nv.ocrs "OnChipReset [RAM name from V530, interpolated]" UBYTE M_FORMULA_0003 0 0 0 255 ECU_ADDRESS 0x3F9714 /end MEASUREMENT
/begin MEASUREMENT sys_rsr_cnt_nv.swrs "WatchdogReset [RAM name from V530, interpolated]" UBYTE M_FORMULA_0003 0 0 0 255 ECU_ADDRESS 0x3F970F /end MEASUREMENT
/begin MEASUREMENT ed_fil_sk_tr_ign.zyklus_filter_nv "Vorwaertsfilter zur Fehlerzustandsbestaetigung [RAM name from V530, interpolated]" UBYTE M_FORMULA_0003 0 0 0 255 ECU_ADDRESS 0x3F97B5 /end MEASUREMENT
/begin MEASUREMENT ed_fil_sk_tr_ign.fehler_aufrufe_nv "Gesamtzahl der Fehleraufrufe [RAM name from V530, interpolated]" UBYTE M_FORMULA_0003 0 0 0 255 ECU_ADDRESS 0x3F97B9 /end MEASUREMENT
/begin MEASUREMENT ed_fil_sk_tr_ign.filter_max_nv "Maximaler Fehlerfilterwert [RAM name from V530, interpolated]" UBYTE M_FORMULA_0003 0 0 0 255 ECU_ADDRESS 0x3F97B8 /end MEASUREMENT
/begin MEASUREMENT ed_fil_tmot.filter_nv "Filterwert vor und nach Eintrag [RAM name from V530, interpolated]" UBYTE M_FORMULA_0003 0 0 0 255 ECU_ADDRESS 0x3F97BA /end MEASUREMENT
/begin MEASUREMENT ed_fil_tmot.zyklus_filter_nv "Vorwaertsfilter zur Fehlerzustandsbestaetigung [RAM name from V530, interpolated]" UBYTE M_FORMULA_0003 0 0 0 255 ECU_ADDRESS 0x3F97BB /end MEASUREMENT
/begin MEASUREMENT ed_fil_tmot.fehler_aufrufe_nv "Gesamtzahl der Fehleraufrufe [RAM name from V530, interpolated]" UBYTE M_FORMULA_0003 0 0 0 255 ECU_ADDRESS 0x3F97BF /end MEASUREMENT
/begin MEASUREMENT ed_fil_tmot.filter_max_nv "Maximaler Fehlerfilterwert [RAM name from V530, interpolated]" UBYTE M_FORMULA_0003 0 0 0 255 ECU_ADDRESS 0x3F97BE /end MEASUREMENT
/begin MEASUREMENT ed_fil_tmot_obd.filter_nv "Filterwert vor und nach Eintrag [RAM name from V530, interpolated]" UBYTE M_FORMULA_0003 0 0 0 255 ECU_ADDRESS 0x3F97C0 /end MEASUREMENT
/begin MEASUREMENT ed_fil_tmot_obd.zyklus_filter_nv "Vorwaertsfilter zur Fehlerzustandsbestaetigung [RAM name from V530, interpolated]" UBYTE M_FORMULA_0003 0 0 0 255 ECU_ADDRESS 0x3F97C1 /end MEASUREMENT
/begin MEASUREMENT ed_fil_tan1.filter_nv "Filterwert vor und nach Eintrag [RAM name from V530, interpolated]" UBYTE M_FORMULA_0003 0 0 0 255 ECU_ADDRESS 0x3F97C6 /end MEASUREMENT
/begin MEASUREMENT ed_fil_tan1.zyklus_filter_nv "Vorwaertsfilter zur Fehlerzustandsbestaetigung [RAM name from V530, interpolated]" UBYTE M_FORMULA_0003 0 0 0 255 ECU_ADDRESS 0x3F97C7 /end MEASUREMENT
/begin MEASUREMENT ed_fil_tmot_obd.fehler_aufrufe_nv "Gesamtzahl der Fehleraufrufe [RAM name from V530, interpolated]" UBYTE M_FORMULA_0003 0 0 0 255 ECU_ADDRESS 0x3F97C5 /end MEASUREMENT
/begin MEASUREMENT ed_fil_tmot_obd.filter_max_nv "Maximaler Fehlerfilterwert [RAM name from V530, interpolated]" UBYTE M_FORMULA_0003 0 0 0 255 ECU_ADDRESS 0x3F97C4 /end MEASUREMENT
/begin MEASUREMENT ed_fil_tan1.fehler_aufrufe_nv "Gesamtzahl der Fehleraufrufe [RAM name from V530, interpolated]" UBYTE M_FORMULA_0003 0 0 0 255 ECU_ADDRESS 0x3F97CB /end MEASUREMENT
/begin MEASUREMENT ed_fil_tan1.filter_max_nv "Maximaler Fehlerfilterwert [RAM name from V530, interpolated]" UBYTE M_FORMULA_0003 0 0 0 255 ECU_ADDRESS 0x3F97CA /end MEASUREMENT
/begin MEASUREMENT ed_fil_tan2.art_aktuell_nv "Fehlerart und Statusbits [RAM name from V530, interpolated]" UWORD NO_COMPU_METHOD 0 0 0 65535 ECU_ADDRESS 0x3F97CE FORMAT "%.4g" /end MEASUREMENT
/begin MEASUREMENT ed_fil_tan2.fehler_aufrufe_nv "Gesamtzahl der Fehleraufrufe [RAM name from V530, interpolated]" UBYTE M_FORMULA_0003 0 0 0 255 ECU_ADDRESS 0x3F97D1 /end MEASUREMENT
/begin MEASUREMENT ed_fil_tan2.filter_max_nv "Maximaler Fehlerfilterwert [RAM name from V530, interpolated]" UBYTE M_FORMULA_0003 0 0 0 255 ECU_ADDRESS 0x3F97D0 /end MEASUREMENT
/begin MEASUREMENT ed_fil_tan2.filter_nv "Filterwert vor und nach Eintrag [RAM name from V530, interpolated]" UBYTE M_FORMULA_0003 0 0 0 255 ECU_ADDRESS 0x3F97CC /end MEASUREMENT
/begin MEASUREMENT ed_fil_tan2.zyklus_filter_nv "Vorwaertsfilter zur Fehlerzustandsbestaetigung [RAM name from V530, interpolated]" UBYTE M_FORMULA_0003 0 0 0 255 ECU_ADDRESS 0x3F97CD /end MEASUREMENT
/begin MEASUREMENT ed_fil_time_rel_obd.filter_nv "Filterwert vor und nach Eintrag [RAM name from V530, interpolated]" UBYTE M_FORMULA_0003 0 0 0 255 ECU_ADDRESS 0x3F97D2 /end MEASUREMENT
/begin MEASUREMENT ed_fil_time_rel_obd.zyklus_filter_nv "Vorwaertsfilter zur Fehlerzustandsbestaetigung [RAM name from V530, interpolated]" UBYTE M_FORMULA_0003 0 0 0 255 ECU_ADDRESS 0x3F97D3 /end MEASUREMENT
/begin MEASUREMENT ed_fil_time_rel_obd.fehler_aufrufe_nv "Gesamtzahl der Fehleraufrufe [RAM name from V530, interpolated]" UBYTE M_FORMULA_0003 0 0 0 255 ECU_ADDRESS 0x3F97D7 /end MEASUREMENT
/begin MEASUREMENT ed_fil_time_rel_obd.filter_max_nv "Maximaler Fehlerfilterwert [RAM name from V530, interpolated]" UBYTE M_FORMULA_0003 0 0 0 255 ECU_ADDRESS 0x3F97D6 /end MEASUREMENT
/begin MEASUREMENT ed_fil_ub.filter_nv "Filterwert vor und nach Eintrag [RAM name from V530, interpolated]" UBYTE M_FORMULA_0003 0 0 0 255 ECU_ADDRESS 0x3F97D8 /end MEASUREMENT
/begin MEASUREMENT ed_fil_ub.zyklus_filter_nv "Vorwaertsfilter zur Fehlerzustandsbestaetigung [RAM name from V530, interpolated]" UBYTE M_FORMULA_0003 0 0 0 255 ECU_ADDRESS 0x3F97D9 /end MEASUREMENT
/begin MEASUREMENT ed_fil_tdme.filter_nv "Filterwert vor und nach Eintrag [RAM name from V530, interpolated]" UBYTE M_FORMULA_0003 0 0 0 255 ECU_ADDRESS 0x3F97E4 /end MEASUREMENT
/begin MEASUREMENT ed_fil_tdme.zyklus_filter_nv "Vorwaertsfilter zur Fehlerzustandsbestaetigung [RAM name from V530, interpolated]" UBYTE M_FORMULA_0003 0 0 0 255 ECU_ADDRESS 0x3F97E5 /end MEASUREMENT
/begin MEASUREMENT ed_fil_tka.art_aktuell_nv "Fehlerart und Statusbits [RAM name from V530, interpolated]" UWORD NO_COMPU_METHOD 0 0 0 65535 ECU_ADDRESS 0x3F97E0 FORMAT "%.4g" /end MEASUREMENT
/begin MEASUREMENT ed_fil_tka.fehler_aufrufe_nv "Gesamtzahl der Fehleraufrufe [RAM name from V530, interpolated]" UBYTE M_FORMULA_0003 0 0 0 255 ECU_ADDRESS 0x3F97E3 /end MEASUREMENT
/begin MEASUREMENT ed_fil_tka.filter_max_nv "Maximaler Fehlerfilterwert [RAM name from V530, interpolated]" UBYTE M_FORMULA_0003 0 0 0 255 ECU_ADDRESS 0x3F97E2 /end MEASUREMENT
/begin MEASUREMENT ed_fil_tka.filter_nv "Filterwert vor und nach Eintrag [RAM name from V530, interpolated]" UBYTE M_FORMULA_0003 0 0 0 255 ECU_ADDRESS 0x3F97DE /end MEASUREMENT
/begin MEASUREMENT ed_fil_tka.zyklus_filter_nv "Vorwaertsfilter zur Fehlerzustandsbestaetigung [RAM name from V530, interpolated]" UBYTE M_FORMULA_0003 0 0 0 255 ECU_ADDRESS 0x3F97DF /end MEASUREMENT
/begin MEASUREMENT ed_fil_ub.fehler_aufrufe_nv "Gesamtzahl der Fehleraufrufe [RAM name from V530, interpolated]" UBYTE M_FORMULA_0003 0 0 0 255 ECU_ADDRESS 0x3F97DD /end MEASUREMENT
/begin MEASUREMENT ed_fil_ub.filter_max_nv "Maximaler Fehlerfilterwert [RAM name from V530, interpolated]" UBYTE M_FORMULA_0003 0 0 0 255 ECU_ADDRESS 0x3F97DC /end MEASUREMENT
/begin MEASUREMENT ed_fil_appl_data_ign.filter_nv "Filterwert vor und nach Eintrag [RAM name from V530, interpolated]" UBYTE M_FORMULA_0003 0 0 0 255 ECU_ADDRESS 0x3F97F6 /end MEASUREMENT
/begin MEASUREMENT ed_fil_appl_data_ign.zyklus_filter_nv "Vorwaertsfilter zur Fehlerzustandsbestaetigung [RAM name from V530, interpolated]" UBYTE M_FORMULA_0003 0 0 0 255 ECU_ADDRESS 0x3F97F7 /end MEASUREMENT
/begin MEASUREMENT ed_fil_tdme.fehler_aufrufe_nv "Gesamtzahl der Fehleraufrufe [RAM name from V530, interpolated]" UBYTE M_FORMULA_0003 0 0 0 255 ECU_ADDRESS 0x3F97E9 /end MEASUREMENT
/begin MEASUREMENT ed_fil_tdme.filter_max_nv "Maximaler Fehlerfilterwert [RAM name from V530, interpolated]" UBYTE M_FORMULA_0003 0 0 0 255 ECU_ADDRESS 0x3F97E8 /end MEASUREMENT
/begin MEASUREMENT ed_fil_uext_111219514.art_aktuell_nv "Fehlerart und Statusbits [RAM name from V530, interpolated]" UWORD NO_COMPU_METHOD 0 0 0 65535 ECU_ADDRESS 0x3F97EC FORMAT "%.4g" /end MEASUREMENT
/begin MEASUREMENT ed_fil_uext_111219514.fehler_aufrufe_nv "Gesamtzahl der Fehleraufrufe [RAM name from V530, interpolated]" UBYTE M_FORMULA_0003 0 0 0 255 ECU_ADDRESS 0x3F97EF /end MEASUREMENT
/begin MEASUREMENT ed_fil_uext_111219514.filter_max_nv "Maximaler Fehlerfilterwert [RAM name from V530, interpolated]" UBYTE M_FORMULA_0003 0 0 0 255 ECU_ADDRESS 0x3F97EE /end MEASUREMENT
/begin MEASUREMENT ed_fil_uext_111219514.filter_nv "Filterwert vor und nach Eintrag [RAM name from V530, interpolated]" UBYTE M_FORMULA_0003 0 0 0 255 ECU_ADDRESS 0x3F97EA /end MEASUREMENT
/begin MEASUREMENT ed_fil_uext_111219514.zyklus_filter_nv "Vorwaertsfilter zur Fehlerzustandsbestaetigung [RAM name from V530, interpolated]" UBYTE M_FORMULA_0003 0 0 0 255 ECU_ADDRESS 0x3F97EB /end MEASUREMENT
/begin MEASUREMENT ed_fil_uext_124_512.art_aktuell_nv "Fehlerart und Statusbits [RAM name from V530, interpolated]" UWORD NO_COMPU_METHOD 0 0 0 65535 ECU_ADDRESS 0x3F97F2 FORMAT "%.4g" /end MEASUREMENT
/begin MEASUREMENT ed_fil_uext_124_512.fehler_aufrufe_nv "Gesamtzahl der Fehleraufrufe [RAM name from V530, interpolated]" UBYTE M_FORMULA_0003 0 0 0 255 ECU_ADDRESS 0x3F97F5 /end MEASUREMENT
/begin MEASUREMENT ed_fil_uext_124_512.filter_max_nv "Maximaler Fehlerfilterwert [RAM name from V530, interpolated]" UBYTE M_FORMULA_0003 0 0 0 255 ECU_ADDRESS 0x3F97F4 /end MEASUREMENT
/begin MEASUREMENT ed_fil_uext_124_512.filter_nv "Filterwert vor und nach Eintrag [RAM name from V530, interpolated]" UBYTE M_FORMULA_0003 0 0 0 255 ECU_ADDRESS 0x3F97F0 /end MEASUREMENT
/begin MEASUREMENT ed_fil_uext_124_512.zyklus_filter_nv "Vorwaertsfilter zur Fehlerzustandsbestaetigung [RAM name from V530, interpolated]" UBYTE M_FORMULA_0003 0 0 0 255 ECU_ADDRESS 0x3F97F1 /end MEASUREMENT
/begin MEASUREMENT ed_fil_appl_data_ign.fehler_aufrufe_nv "Gesamtzahl der Fehleraufrufe [RAM name from V530, interpolated]" UBYTE M_FORMULA_0003 0 0 0 255 ECU_ADDRESS 0x3F97FB /end MEASUREMENT
/begin MEASUREMENT ed_fil_appl_data_ign.filter_max_nv "Maximaler Fehlerfilterwert [RAM name from V530, interpolated]" UBYTE M_FORMULA_0003 0 0 0 255 ECU_ADDRESS 0x3F97FA /end MEASUREMENT
/begin MEASUREMENT ed_fil_pwg1.filter_nv "Filterwert vor und nach Eintrag [RAM name from V530, interpolated]" UBYTE M_FORMULA_0003 0 0 0 255 ECU_ADDRESS 0x3F9802 /end MEASUREMENT
/begin MEASUREMENT ed_fil_pwg1.zyklus_filter_nv "Vorwaertsfilter zur Fehlerzustandsbestaetigung [RAM name from V530, interpolated]" UBYTE M_FORMULA_0003 0 0 0 255 ECU_ADDRESS 0x3F9803 /end MEASUREMENT
/begin MEASUREMENT ed_fil_tka_obd.art_aktuell_nv "Fehlerart und Statusbits [RAM name from V530, interpolated]" UWORD NO_COMPU_METHOD 0 0 0 65535 ECU_ADDRESS 0x3F97FE FORMAT "%.4g" /end MEASUREMENT
/begin MEASUREMENT ed_fil_tka_obd.fehler_aufrufe_nv "Gesamtzahl der Fehleraufrufe [RAM name from V530, interpolated]" UBYTE M_FORMULA_0003 0 0 0 255 ECU_ADDRESS 0x3F9801 /end MEASUREMENT
/begin MEASUREMENT ed_fil_tka_obd.filter_max_nv "Maximaler Fehlerfilterwert [RAM name from V530, interpolated]" UBYTE M_FORMULA_0003 0 0 0 255 ECU_ADDRESS 0x3F9800 /end MEASUREMENT
/begin MEASUREMENT ed_fil_tka_obd.filter_nv "Filterwert vor und nach Eintrag [RAM name from V530, interpolated]" UBYTE M_FORMULA_0003 0 0 0 255 ECU_ADDRESS 0x3F97FC /end MEASUREMENT
/begin MEASUREMENT ed_fil_tka_obd.zyklus_filter_nv "Vorwaertsfilter zur Fehlerzustandsbestaetigung [RAM name from V530, interpolated]" UBYTE M_FORMULA_0003 0 0 0 255 ECU_ADDRESS 0x3F97FD /end MEASUREMENT
/begin MEASUREMENT ed_fil_pwg1.fehler_aufrufe_nv "Gesamtzahl der Fehleraufrufe [RAM name from V530, interpolated]" UBYTE M_FORMULA_0003 0 0 0 255 ECU_ADDRESS 0x3F9807 /end MEASUREMENT
/begin MEASUREMENT ed_fil_pwg1.filter_max_nv "Maximaler Fehlerfilterwert [RAM name from V530, interpolated]" UBYTE M_FORMULA_0003 0 0 0 255 ECU_ADDRESS 0x3F9806 /end MEASUREMENT
/begin MEASUREMENT ed_fil_pwg2.filter_nv "Filterwert vor und nach Eintrag [RAM name from V530, interpolated]" UBYTE M_FORMULA_0003 0 0 0 255 ECU_ADDRESS 0x3F9808 /end MEASUREMENT
/begin MEASUREMENT ed_fil_pwg2.zyklus_filter_nv "Vorwaertsfilter zur Fehlerzustandsbestaetigung [RAM name from V530, interpolated]" UBYTE M_FORMULA_0003 0 0 0 255 ECU_ADDRESS 0x3F9809 /end MEASUREMENT
/begin MEASUREMENT ed_fil_pwg_vgl.filter_nv "Filterwert vor und nach Eintrag [RAM name from V530, interpolated]" UBYTE M_FORMULA_0003 0 0 0 255 ECU_ADDRESS 0x3F980E /end MEASUREMENT
/begin MEASUREMENT ed_fil_pwg_vgl.zyklus_filter_nv "Vorwaertsfilter zur Fehlerzustandsbestaetigung [RAM name from V530, interpolated]" UBYTE M_FORMULA_0003 0 0 0 255 ECU_ADDRESS 0x3F980F /end MEASUREMENT
/begin MEASUREMENT ed_fil_pwg2.fehler_aufrufe_nv "Gesamtzahl der Fehleraufrufe [RAM name from V530, interpolated]" UBYTE M_FORMULA_0003 0 0 0 255 ECU_ADDRESS 0x3F980D /end MEASUREMENT
/begin MEASUREMENT ed_fil_pwg2.filter_max_nv "Maximaler Fehlerfilterwert [RAM name from V530, interpolated]" UBYTE M_FORMULA_0003 0 0 0 255 ECU_ADDRESS 0x3F980C /end MEASUREMENT
/begin MEASUREMENT ed_fil_pctrl_ign.filter_nv "Filterwert vor und nach Eintrag [RAM name from V530, interpolated]" UBYTE M_FORMULA_0003 0 0 0 255 ECU_ADDRESS 0x3F9814 /end MEASUREMENT
/begin MEASUREMENT ed_fil_pctrl_ign.zyklus_filter_nv "Vorwaertsfilter zur Fehlerzustandsbestaetigung [RAM name from V530, interpolated]" UBYTE M_FORMULA_0003 0 0 0 255 ECU_ADDRESS 0x3F9815 /end MEASUREMENT
/begin MEASUREMENT ed_fil_pwg_vgl.fehler_aufrufe_nv "Gesamtzahl der Fehleraufrufe [RAM name from V530, interpolated]" UBYTE M_FORMULA_0003 0 0 0 255 ECU_ADDRESS 0x3F9813 /end MEASUREMENT
/begin MEASUREMENT ed_fil_pwg_vgl.filter_max_nv "Maximaler Fehlerfilterwert [RAM name from V530, interpolated]" UBYTE M_FORMULA_0003 0 0 0 255 ECU_ADDRESS 0x3F9812 /end MEASUREMENT
/begin MEASUREMENT ed_fil_dk1_can.art_aktuell_nv "Fehlerart und Statusbits [RAM name from V530, interpolated]" UWORD NO_COMPU_METHOD 0 0 0 65535 ECU_ADDRESS 0x3F9828 FORMAT "%.4g" /end MEASUREMENT
/begin MEASUREMENT ed_fil_dk1_can.fehler_aufrufe_nv "Gesamtzahl der Fehleraufrufe [RAM name from V530, interpolated]" UBYTE M_FORMULA_0003 0 0 0 255 ECU_ADDRESS 0x3F982B /end MEASUREMENT
/begin MEASUREMENT ed_fil_dk1_can.filter_max_nv "Maximaler Fehlerfilterwert [RAM name from V530, interpolated]" UBYTE M_FORMULA_0003 0 0 0 255 ECU_ADDRESS 0x3F982A /end MEASUREMENT
/begin MEASUREMENT ed_fil_dk1_can.filter_nv "Filterwert vor und nach Eintrag [RAM name from V530, interpolated]" UBYTE M_FORMULA_0003 0 0 0 255 ECU_ADDRESS 0x3F9826 /end MEASUREMENT
/begin MEASUREMENT ed_fil_dk1_can.zyklus_filter_nv "Vorwaertsfilter zur Fehlerzustandsbestaetigung [RAM name from V530, interpolated]" UBYTE M_FORMULA_0003 0 0 0 255 ECU_ADDRESS 0x3F9827 /end MEASUREMENT
/begin MEASUREMENT ed_fil_dk2_can.art_aktuell_nv "Fehlerart und Statusbits [RAM name from V530, interpolated]" UWORD NO_COMPU_METHOD 0 0 0 65535 ECU_ADDRESS 0x3F982E FORMAT "%.4g" /end MEASUREMENT
/begin MEASUREMENT ed_fil_dk2_can.fehler_aufrufe_nv "Gesamtzahl der Fehleraufrufe [RAM name from V530, interpolated]" UBYTE M_FORMULA_0003 0 0 0 255 ECU_ADDRESS 0x3F9831 /end MEASUREMENT
/begin MEASUREMENT ed_fil_dk2_can.filter_max_nv "Maximaler Fehlerfilterwert [RAM name from V530, interpolated]" UBYTE M_FORMULA_0003 0 0 0 255 ECU_ADDRESS 0x3F9830 /end MEASUREMENT
/begin MEASUREMENT ed_fil_dk2_can.filter_nv "Filterwert vor und nach Eintrag [RAM name from V530, interpolated]" UBYTE M_FORMULA_0003 0 0 0 255 ECU_ADDRESS 0x3F982C /end MEASUREMENT
/begin MEASUREMENT ed_fil_dk2_can.zyklus_filter_nv "Vorwaertsfilter zur Fehlerzustandsbestaetigung [RAM name from V530, interpolated]" UBYTE M_FORMULA_0003 0 0 0 255 ECU_ADDRESS 0x3F982D /end MEASUREMENT
/begin MEASUREMENT ed_fil_lls1_can.art_aktuell_nv "Fehlerart und Statusbits [RAM name from V530, interpolated]" UWORD NO_COMPU_METHOD 0 0 0 65535 ECU_ADDRESS 0x3F981C FORMAT "%.4g" /end MEASUREMENT
/begin MEASUREMENT ed_fil_lls1_can.fehler_aufrufe_nv "Gesamtzahl der Fehleraufrufe [RAM name from V530, interpolated]" UBYTE M_FORMULA_0003 0 0 0 255 ECU_ADDRESS 0x3F981F /end MEASUREMENT
/begin MEASUREMENT ed_fil_lls1_can.filter_max_nv "Maximaler Fehlerfilterwert [RAM name from V530, interpolated]" UBYTE M_FORMULA_0003 0 0 0 255 ECU_ADDRESS 0x3F981E /end MEASUREMENT
/begin MEASUREMENT ed_fil_lls1_can.filter_nv "Filterwert vor und nach Eintrag [RAM name from V530, interpolated]" UBYTE M_FORMULA_0003 0 0 0 255 ECU_ADDRESS 0x3F981A /end MEASUREMENT
/begin MEASUREMENT ed_fil_lls1_can.zyklus_filter_nv "Vorwaertsfilter zur Fehlerzustandsbestaetigung [RAM name from V530, interpolated]" UBYTE M_FORMULA_0003 0 0 0 255 ECU_ADDRESS 0x3F981B /end MEASUREMENT
/begin MEASUREMENT ed_fil_lls1_sk.art_aktuell_nv "Fehlerart und Statusbits [RAM name from V530, interpolated]" UWORD NO_COMPU_METHOD 0 0 0 65535 ECU_ADDRESS 0x3F9834 FORMAT "%.4g" /end MEASUREMENT
/begin MEASUREMENT ed_fil_lls1_sk.fehler_aufrufe_nv "Gesamtzahl der Fehleraufrufe [RAM name from V530, interpolated]" UBYTE M_FORMULA_0003 0 0 0 255 ECU_ADDRESS 0x3F9837 /end MEASUREMENT
/begin MEASUREMENT ed_fil_lls1_sk.filter_max_nv "Maximaler Fehlerfilterwert [RAM name from V530, interpolated]" UBYTE M_FORMULA_0003 0 0 0 255 ECU_ADDRESS 0x3F9836 /end MEASUREMENT
/begin MEASUREMENT ed_fil_lls1_sk.filter_nv "Filterwert vor und nach Eintrag [RAM name from V530, interpolated]" UBYTE M_FORMULA_0003 0 0 0 255 ECU_ADDRESS 0x3F9832 /end MEASUREMENT
/begin MEASUREMENT ed_fil_lls1_sk.zyklus_filter_nv "Vorwaertsfilter zur Fehlerzustandsbestaetigung [RAM name from V530, interpolated]" UBYTE M_FORMULA_0003 0 0 0 255 ECU_ADDRESS 0x3F9833 /end MEASUREMENT
/begin MEASUREMENT ed_fil_lls2_can.art_aktuell_nv "Fehlerart und Statusbits [RAM name from V530, interpolated]" UWORD NO_COMPU_METHOD 0 0 0 65535 ECU_ADDRESS 0x3F9822 FORMAT "%.4g" /end MEASUREMENT
/begin MEASUREMENT ed_fil_lls2_can.fehler_aufrufe_nv "Gesamtzahl der Fehleraufrufe [RAM name from V530, interpolated]" UBYTE M_FORMULA_0003 0 0 0 255 ECU_ADDRESS 0x3F9825 /end MEASUREMENT
/begin MEASUREMENT ed_fil_lls2_can.filter_max_nv "Maximaler Fehlerfilterwert [RAM name from V530, interpolated]" UBYTE M_FORMULA_0003 0 0 0 255 ECU_ADDRESS 0x3F9824 /end MEASUREMENT
/begin MEASUREMENT ed_fil_lls2_can.filter_nv "Filterwert vor und nach Eintrag [RAM name from V530, interpolated]" UBYTE M_FORMULA_0003 0 0 0 255 ECU_ADDRESS 0x3F9820 /end MEASUREMENT
/begin MEASUREMENT ed_fil_lls2_can.zyklus_filter_nv "Vorwaertsfilter zur Fehlerzustandsbestaetigung [RAM name from V530, interpolated]" UBYTE M_FORMULA_0003 0 0 0 255 ECU_ADDRESS 0x3F9821 /end MEASUREMENT
/begin MEASUREMENT ed_fil_lls2_sk.art_aktuell_nv "Fehlerart und Statusbits [RAM name from V530, interpolated]" UWORD NO_COMPU_METHOD 0 0 0 65535 ECU_ADDRESS 0x3F983A FORMAT "%.4g" /end MEASUREMENT
/begin MEASUREMENT ed_fil_lls2_sk.fehler_aufrufe_nv "Gesamtzahl der Fehleraufrufe [RAM name from V530, interpolated]" UBYTE M_FORMULA_0003 0 0 0 255 ECU_ADDRESS 0x3F983D /end MEASUREMENT
/begin MEASUREMENT ed_fil_lls2_sk.filter_max_nv "Maximaler Fehlerfilterwert [RAM name from V530, interpolated]" UBYTE M_FORMULA_0003 0 0 0 255 ECU_ADDRESS 0x3F983C /end MEASUREMENT
/begin MEASUREMENT ed_fil_lls2_sk.filter_nv "Filterwert vor und nach Eintrag [RAM name from V530, interpolated]" UBYTE M_FORMULA_0003 0 0 0 255 ECU_ADDRESS 0x3F9838 /end MEASUREMENT
/begin MEASUREMENT ed_fil_lls2_sk.zyklus_filter_nv "Vorwaertsfilter zur Fehlerzustandsbestaetigung [RAM name from V530, interpolated]" UBYTE M_FORMULA_0003 0 0 0 255 ECU_ADDRESS 0x3F9839 /end MEASUREMENT
/begin MEASUREMENT ed_fil_pctrl_ign.fehler_aufrufe_nv "Gesamtzahl der Fehleraufrufe [RAM name from V530, interpolated]" UBYTE M_FORMULA_0003 0 0 0 255 ECU_ADDRESS 0x3F9819 /end MEASUREMENT
/begin MEASUREMENT ed_fil_pctrl_ign.filter_max_nv "Maximaler Fehlerfilterwert [RAM name from V530, interpolated]" UBYTE M_FORMULA_0003 0 0 0 255 ECU_ADDRESS 0x3F9818 /end MEASUREMENT
/begin MEASUREMENT ed_fil_smg_schaltab.filter_nv "Filterwert vor und nach Eintrag [RAM name from V530, interpolated]" UBYTE M_FORMULA_0003 0 0 0 255 ECU_ADDRESS 0x3F983E /end MEASUREMENT
/begin MEASUREMENT ed_fil_smg_schaltab.zyklus_filter_nv "Vorwaertsfilter zur Fehlerzustandsbestaetigung [RAM name from V530, interpolated]" UBYTE M_FORMULA_0003 0 0 0 255 ECU_ADDRESS 0x3F983F /end MEASUREMENT
/begin MEASUREMENT ed_fil_smg_schaltab.fehler_aufrufe_nv "Gesamtzahl der Fehleraufrufe [RAM name from V530, interpolated]" UBYTE M_FORMULA_0003 0 0 0 255 ECU_ADDRESS 0x3F9843 /end MEASUREMENT
/begin MEASUREMENT ed_fil_smg_schaltab.filter_max_nv "Maximaler Fehlerfilterwert [RAM name from V530, interpolated]" UBYTE M_FORMULA_0003 0 0 0 255 ECU_ADDRESS 0x3F9842 /end MEASUREMENT
/begin MEASUREMENT ed_fil_smg_sk.filter_nv "Filterwert vor und nach Eintrag [RAM name from V530, interpolated]" UBYTE M_FORMULA_0003 0 0 0 255 ECU_ADDRESS 0x3F9844 /end MEASUREMENT
/begin MEASUREMENT ed_fil_smg_sk.zyklus_filter_nv "Vorwaertsfilter zur Fehlerzustandsbestaetigung [RAM name from V530, interpolated]" UBYTE M_FORMULA_0003 0 0 0 255 ECU_ADDRESS 0x3F9845 /end MEASUREMENT
/begin MEASUREMENT ed_fil_smg_sk.fehler_aufrufe_nv "Gesamtzahl der Fehleraufrufe [RAM name from V530, interpolated]" UBYTE M_FORMULA_0003 0 0 0 255 ECU_ADDRESS 0x3F9849 /end MEASUREMENT
/begin MEASUREMENT ed_fil_smg_sk.filter_max_nv "Maximaler Fehlerfilterwert [RAM name from V530, interpolated]" UBYTE M_FORMULA_0003 0 0 0 255 ECU_ADDRESS 0x3F9848 /end MEASUREMENT
/begin MEASUREMENT ed_fil_smg_sk_n.filter_nv "Filterwert vor und nach Eintrag [RAM name from V530, interpolated]" UBYTE M_FORMULA_0003 0 0 0 255 ECU_ADDRESS 0x3F984A /end MEASUREMENT
/begin MEASUREMENT ed_fil_smg_sk_n.zyklus_filter_nv "Vorwaertsfilter zur Fehlerzustandsbestaetigung [RAM name from V530, interpolated]" UBYTE M_FORMULA_0003 0 0 0 255 ECU_ADDRESS 0x3F984B /end MEASUREMENT
/begin MEASUREMENT ed_fil_dk_init.filter_nv "Filterwert vor und nach Eintrag [RAM name from V530, interpolated]" UBYTE M_FORMULA_0003 0 0 0 255 ECU_ADDRESS 0x3F985C /end MEASUREMENT
/begin MEASUREMENT ed_fil_dk_init.zyklus_filter_nv "Vorwaertsfilter zur Fehlerzustandsbestaetigung [RAM name from V530, interpolated]" UBYTE M_FORMULA_0003 0 0 0 255 ECU_ADDRESS 0x3F985D /end MEASUREMENT
/begin MEASUREMENT ed_fil_smg_sk_n.fehler_aufrufe_nv "Gesamtzahl der Fehleraufrufe [RAM name from V530, interpolated]" UBYTE M_FORMULA_0003 0 0 0 255 ECU_ADDRESS 0x3F984F /end MEASUREMENT
/begin MEASUREMENT ed_fil_smg_sk_n.filter_max_nv "Maximaler Fehlerfilterwert [RAM name from V530, interpolated]" UBYTE M_FORMULA_0003 0 0 0 255 ECU_ADDRESS 0x3F984E /end MEASUREMENT
/begin MEASUREMENT ed_fil_tumg_obd.art_aktuell_nv "Fehlerart und Statusbits [RAM name from V530, interpolated]" UWORD NO_COMPU_METHOD 0 0 0 65535 ECU_ADDRESS 0x3F9852 FORMAT "%.4g" /end MEASUREMENT
/begin MEASUREMENT ed_fil_tumg_obd.fehler_aufrufe_nv "Gesamtzahl der Fehleraufrufe [RAM name from V530, interpolated]" UBYTE M_FORMULA_0003 0 0 0 255 ECU_ADDRESS 0x3F9855 /end MEASUREMENT
/begin MEASUREMENT ed_fil_tumg_obd.filter_max_nv "Maximaler Fehlerfilterwert [RAM name from V530, interpolated]" UBYTE M_FORMULA_0003 0 0 0 255 ECU_ADDRESS 0x3F9854 /end MEASUREMENT
/begin MEASUREMENT ed_fil_tumg_obd.filter_nv "Filterwert vor und nach Eintrag [RAM name from V530, interpolated]" UBYTE M_FORMULA_0003 0 0 0 255 ECU_ADDRESS 0x3F9850 /end MEASUREMENT
/begin MEASUREMENT ed_fil_tumg_obd.zyklus_filter_nv "Vorwaertsfilter zur Fehlerzustandsbestaetigung [RAM name from V530, interpolated]" UBYTE M_FORMULA_0003 0 0 0 255 ECU_ADDRESS 0x3F9851 /end MEASUREMENT
/begin MEASUREMENT ed_fil_v_direkt.art_aktuell_nv "Fehlerart und Statusbits [RAM name from V530, interpolated]" UWORD NO_COMPU_METHOD 0 0 0 65535 ECU_ADDRESS 0x3F9858 FORMAT "%.4g" /end MEASUREMENT
/begin MEASUREMENT ed_fil_v_direkt.fehler_aufrufe_nv "Gesamtzahl der Fehleraufrufe [RAM name from V530, interpolated]" UBYTE M_FORMULA_0003 0 0 0 255 ECU_ADDRESS 0x3F985B /end MEASUREMENT
/begin MEASUREMENT ed_fil_v_direkt.filter_max_nv "Maximaler Fehlerfilterwert [RAM name from V530, interpolated]" UBYTE M_FORMULA_0003 0 0 0 255 ECU_ADDRESS 0x3F985A /end MEASUREMENT
/begin MEASUREMENT ed_fil_v_direkt.filter_nv "Filterwert vor und nach Eintrag [RAM name from V530, interpolated]" UBYTE M_FORMULA_0003 0 0 0 255 ECU_ADDRESS 0x3F9856 /end MEASUREMENT
/begin MEASUREMENT ed_fil_v_direkt.zyklus_filter_nv "Vorwaertsfilter zur Fehlerzustandsbestaetigung [RAM name from V530, interpolated]" UBYTE M_FORMULA_0003 0 0 0 255 ECU_ADDRESS 0x3F9857 /end MEASUREMENT
/begin MEASUREMENT ed_fil_dk_init.fehler_aufrufe_nv "Gesamtzahl der Fehleraufrufe [RAM name from V530, interpolated]" UBYTE M_FORMULA_0003 0 0 0 255 ECU_ADDRESS 0x3F9861 /end MEASUREMENT
/begin MEASUREMENT ed_fil_dk_init.filter_max_nv "Maximaler Fehlerfilterwert [RAM name from V530, interpolated]" UBYTE M_FORMULA_0003 0 0 0 255 ECU_ADDRESS 0x3F9860 /end MEASUREMENT
/begin MEASUREMENT ed_fil_dk1_regler.filter_nv "Filterwert vor und nach Eintrag [RAM name from V530, interpolated]" UBYTE M_FORMULA_0003 0 0 0 255 ECU_ADDRESS 0x3F9862 /end MEASUREMENT
/begin MEASUREMENT ed_fil_dk1_regler.zyklus_filter_nv "Vorwaertsfilter zur Fehlerzustandsbestaetigung [RAM name from V530, interpolated]" UBYTE M_FORMULA_0003 0 0 0 255 ECU_ADDRESS 0x3F9863 /end MEASUREMENT
/begin MEASUREMENT ed_fil_dk1_regler.fehler_aufrufe_nv "Gesamtzahl der Fehleraufrufe [RAM name from V530, interpolated]" UBYTE M_FORMULA_0003 0 0 0 255 ECU_ADDRESS 0x3F9867 /end MEASUREMENT
/begin MEASUREMENT ed_fil_dk1_regler.filter_max_nv "Maximaler Fehlerfilterwert [RAM name from V530, interpolated]" UBYTE M_FORMULA_0003 0 0 0 255 ECU_ADDRESS 0x3F9866 /end MEASUREMENT
/begin MEASUREMENT ed_fil_dk2_regler.filter_nv "Filterwert vor und nach Eintrag [RAM name from V530, interpolated]" UBYTE M_FORMULA_0003 0 0 0 255 ECU_ADDRESS 0x3F9868 /end MEASUREMENT
/begin MEASUREMENT ed_fil_dk2_regler.zyklus_filter_nv "Vorwaertsfilter zur Fehlerzustandsbestaetigung [RAM name from V530, interpolated]" UBYTE M_FORMULA_0003 0 0 0 255 ECU_ADDRESS 0x3F9869 /end MEASUREMENT
/begin MEASUREMENT ed_fil_dk1_adapt.art_aktuell_nv "Fehlerart und Statusbits [RAM name from V530, interpolated]" UWORD NO_COMPU_METHOD 0 0 0 65535 ECU_ADDRESS 0x3F9870 FORMAT "%.4g" /end MEASUREMENT
/begin MEASUREMENT ed_fil_dk1_adapt.fehler_aufrufe_nv "Gesamtzahl der Fehleraufrufe [RAM name from V530, interpolated]" UBYTE M_FORMULA_0003 0 0 0 255 ECU_ADDRESS 0x3F9873 /end MEASUREMENT
/begin MEASUREMENT ed_fil_dk1_adapt.filter_max_nv "Maximaler Fehlerfilterwert [RAM name from V530, interpolated]" UBYTE M_FORMULA_0003 0 0 0 255 ECU_ADDRESS 0x3F9872 /end MEASUREMENT
/begin MEASUREMENT ed_fil_dk1_adapt.filter_nv "Filterwert vor und nach Eintrag [RAM name from V530, interpolated]" UBYTE M_FORMULA_0003 0 0 0 255 ECU_ADDRESS 0x3F986E /end MEASUREMENT
/begin MEASUREMENT ed_fil_dk1_adapt.zyklus_filter_nv "Vorwaertsfilter zur Fehlerzustandsbestaetigung [RAM name from V530, interpolated]" UBYTE M_FORMULA_0003 0 0 0 255 ECU_ADDRESS 0x3F986F /end MEASUREMENT
/begin MEASUREMENT ed_fil_dk1_wdk.filter_nv "Filterwert vor und nach Eintrag [RAM name from V530, interpolated]" UBYTE M_FORMULA_0003 0 0 0 255 ECU_ADDRESS 0x3F989E /end MEASUREMENT
/begin MEASUREMENT ed_fil_dk1_wdk.zyklus_filter_nv "Vorwaertsfilter zur Fehlerzustandsbestaetigung [RAM name from V530, interpolated]" UBYTE M_FORMULA_0003 0 0 0 255 ECU_ADDRESS 0x3F989F /end MEASUREMENT
/begin MEASUREMENT ed_fil_dk2_adapt.art_aktuell_nv "Fehlerart und Statusbits [RAM name from V530, interpolated]" UWORD NO_COMPU_METHOD 0 0 0 65535 ECU_ADDRESS 0x3F9876 FORMAT "%.4g" /end MEASUREMENT
/begin MEASUREMENT ed_fil_dk2_adapt.fehler_aufrufe_nv "Gesamtzahl der Fehleraufrufe [RAM name from V530, interpolated]" UBYTE M_FORMULA_0003 0 0 0 255 ECU_ADDRESS 0x3F9879 /end MEASUREMENT
/begin MEASUREMENT ed_fil_dk2_adapt.filter_max_nv "Maximaler Fehlerfilterwert [RAM name from V530, interpolated]" UBYTE M_FORMULA_0003 0 0 0 255 ECU_ADDRESS 0x3F9878 /end MEASUREMENT
/begin MEASUREMENT ed_fil_dk2_adapt.filter_nv "Filterwert vor und nach Eintrag [RAM name from V530, interpolated]" UBYTE M_FORMULA_0003 0 0 0 255 ECU_ADDRESS 0x3F9874 /end MEASUREMENT
/begin MEASUREMENT ed_fil_dk2_adapt.zyklus_filter_nv "Vorwaertsfilter zur Fehlerzustandsbestaetigung [RAM name from V530, interpolated]" UBYTE M_FORMULA_0003 0 0 0 255 ECU_ADDRESS 0x3F9875 /end MEASUREMENT
/begin MEASUREMENT ed_fil_dk2_regler.fehler_aufrufe_nv "Gesamtzahl der Fehleraufrufe [RAM name from V530, interpolated]" UBYTE M_FORMULA_0003 0 0 0 255 ECU_ADDRESS 0x3F986D /end MEASUREMENT
/begin MEASUREMENT ed_fil_dk2_regler.filter_max_nv "Maximaler Fehlerfilterwert [RAM name from V530, interpolated]" UBYTE M_FORMULA_0003 0 0 0 255 ECU_ADDRESS 0x3F986C /end MEASUREMENT
/begin MEASUREMENT ed_fil_index_33_ign.art_aktuell_nv "Fehlerart und Statusbits [RAM name from V530, interpolated]" UWORD NO_COMPU_METHOD 0 0 0 65535 ECU_ADDRESS 0x3F987C FORMAT "%.4g" /end MEASUREMENT
/begin MEASUREMENT ed_fil_index_33_ign.fehler_aufrufe_nv "Gesamtzahl der Fehleraufrufe [RAM name from V530, interpolated]" UBYTE M_FORMULA_0003 0 0 0 255 ECU_ADDRESS 0x3F987F /end MEASUREMENT
/begin MEASUREMENT ed_fil_index_33_ign.filter_max_nv "Maximaler Fehlerfilterwert [RAM name from V530, interpolated]" UBYTE M_FORMULA_0003 0 0 0 255 ECU_ADDRESS 0x3F987E /end MEASUREMENT
/begin MEASUREMENT ed_fil_index_33_ign.filter_nv "Filterwert vor und nach Eintrag [RAM name from V530, interpolated]" UBYTE M_FORMULA_0003 0 0 0 255 ECU_ADDRESS 0x3F987A /end MEASUREMENT
/begin MEASUREMENT ed_fil_index_33_ign.zyklus_filter_nv "Vorwaertsfilter zur Fehlerzustandsbestaetigung [RAM name from V530, interpolated]" UBYTE M_FORMULA_0003 0 0 0 255 ECU_ADDRESS 0x3F987B /end MEASUREMENT
/begin MEASUREMENT ed_fil_index_34_ign.art_aktuell_nv "Fehlerart und Statusbits [RAM name from V530, interpolated]" UWORD NO_COMPU_METHOD 0 0 0 65535 ECU_ADDRESS 0x3F9882 FORMAT "%.4g" /end MEASUREMENT
/begin MEASUREMENT ed_fil_index_34_ign.fehler_aufrufe_nv "Gesamtzahl der Fehleraufrufe [RAM name from V530, interpolated]" UBYTE M_FORMULA_0003 0 0 0 255 ECU_ADDRESS 0x3F9885 /end MEASUREMENT
/begin MEASUREMENT ed_fil_index_34_ign.filter_max_nv "Maximaler Fehlerfilterwert [RAM name from V530, interpolated]" UBYTE M_FORMULA_0003 0 0 0 255 ECU_ADDRESS 0x3F9884 /end MEASUREMENT
/begin MEASUREMENT ed_fil_index_34_ign.filter_nv "Filterwert vor und nach Eintrag [RAM name from V530, interpolated]" UBYTE M_FORMULA_0003 0 0 0 255 ECU_ADDRESS 0x3F9880 /end MEASUREMENT
/begin MEASUREMENT ed_fil_index_34_ign.zyklus_filter_nv "Vorwaertsfilter zur Fehlerzustandsbestaetigung [RAM name from V530, interpolated]" UBYTE M_FORMULA_0003 0 0 0 255 ECU_ADDRESS 0x3F9881 /end MEASUREMENT
/begin MEASUREMENT ed_fil_index_35_ign.art_aktuell_nv "Fehlerart und Statusbits [RAM name from V530, interpolated]" UWORD NO_COMPU_METHOD 0 0 0 65535 ECU_ADDRESS 0x3F9888 FORMAT "%.4g" /end MEASUREMENT
/begin MEASUREMENT ed_fil_index_35_ign.fehler_aufrufe_nv "Gesamtzahl der Fehleraufrufe [RAM name from V530, interpolated]" UBYTE M_FORMULA_0003 0 0 0 255 ECU_ADDRESS 0x3F988B /end MEASUREMENT
/begin MEASUREMENT ed_fil_index_35_ign.filter_max_nv "Maximaler Fehlerfilterwert [RAM name from V530, interpolated]" UBYTE M_FORMULA_0003 0 0 0 255 ECU_ADDRESS 0x3F988A /end MEASUREMENT
/begin MEASUREMENT ed_fil_index_35_ign.filter_nv "Filterwert vor und nach Eintrag [RAM name from V530, interpolated]" UBYTE M_FORMULA_0003 0 0 0 255 ECU_ADDRESS 0x3F9886 /end MEASUREMENT
/begin MEASUREMENT ed_fil_index_35_ign.zyklus_filter_nv "Vorwaertsfilter zur Fehlerzustandsbestaetigung [RAM name from V530, interpolated]" UBYTE M_FORMULA_0003 0 0 0 255 ECU_ADDRESS 0x3F9887 /end MEASUREMENT
/begin MEASUREMENT ed_fil_index_36_ign.art_aktuell_nv "Fehlerart und Statusbits [RAM name from V530, interpolated]" UWORD NO_COMPU_METHOD 0 0 0 65535 ECU_ADDRESS 0x3F988E FORMAT "%.4g" /end MEASUREMENT
/begin MEASUREMENT ed_fil_index_36_ign.fehler_aufrufe_nv "Gesamtzahl der Fehleraufrufe [RAM name from V530, interpolated]" UBYTE M_FORMULA_0003 0 0 0 255 ECU_ADDRESS 0x3F9891 /end MEASUREMENT
/begin MEASUREMENT ed_fil_index_36_ign.filter_max_nv "Maximaler Fehlerfilterwert [RAM name from V530, interpolated]" UBYTE M_FORMULA_0003 0 0 0 255 ECU_ADDRESS 0x3F9890 /end MEASUREMENT
/begin MEASUREMENT ed_fil_index_36_ign.filter_nv "Filterwert vor und nach Eintrag [RAM name from V530, interpolated]" UBYTE M_FORMULA_0003 0 0 0 255 ECU_ADDRESS 0x3F988C /end MEASUREMENT
/begin MEASUREMENT ed_fil_index_36_ign.zyklus_filter_nv "Vorwaertsfilter zur Fehlerzustandsbestaetigung [RAM name from V530, interpolated]" UBYTE M_FORMULA_0003 0 0 0 255 ECU_ADDRESS 0x3F988D /end MEASUREMENT
/begin MEASUREMENT ed_fil_tabg1.art_aktuell_nv "Fehlerart und Statusbits [RAM name from V530, interpolated]" UWORD NO_COMPU_METHOD 0 0 0 65535 ECU_ADDRESS 0x3F9894 FORMAT "%.4g" /end MEASUREMENT
/begin MEASUREMENT ed_fil_tabg1.fehler_aufrufe_nv "Gesamtzahl der Fehleraufrufe [RAM name from V530, interpolated]" UBYTE M_FORMULA_0003 0 0 0 255 ECU_ADDRESS 0x3F9897 /end MEASUREMENT
/begin MEASUREMENT ed_fil_tabg1.filter_max_nv "Maximaler Fehlerfilterwert [RAM name from V530, interpolated]" UBYTE M_FORMULA_0003 0 0 0 255 ECU_ADDRESS 0x3F9896 /end MEASUREMENT
/begin MEASUREMENT ed_fil_tabg1.filter_nv "Filterwert vor und nach Eintrag [RAM name from V530, interpolated]" UBYTE M_FORMULA_0003 0 0 0 255 ECU_ADDRESS 0x3F9892 /end MEASUREMENT
/begin MEASUREMENT ed_fil_tabg1.zyklus_filter_nv "Vorwaertsfilter zur Fehlerzustandsbestaetigung [RAM name from V530, interpolated]" UBYTE M_FORMULA_0003 0 0 0 255 ECU_ADDRESS 0x3F9893 /end MEASUREMENT
/begin MEASUREMENT ed_fil_tabg2.art_aktuell_nv "Fehlerart und Statusbits [RAM name from V530, interpolated]" UWORD NO_COMPU_METHOD 0 0 0 65535 ECU_ADDRESS 0x3F989A FORMAT "%.4g" /end MEASUREMENT
/begin MEASUREMENT ed_fil_tabg2.fehler_aufrufe_nv "Gesamtzahl der Fehleraufrufe [RAM name from V530, interpolated]" UBYTE M_FORMULA_0003 0 0 0 255 ECU_ADDRESS 0x3F989D /end MEASUREMENT
/begin MEASUREMENT ed_fil_tabg2.filter_max_nv "Maximaler Fehlerfilterwert [RAM name from V530, interpolated]" UBYTE M_FORMULA_0003 0 0 0 255 ECU_ADDRESS 0x3F989C /end MEASUREMENT
/begin MEASUREMENT ed_fil_tabg2.filter_nv "Filterwert vor und nach Eintrag [RAM name from V530, interpolated]" UBYTE M_FORMULA_0003 0 0 0 255 ECU_ADDRESS 0x3F9898 /end MEASUREMENT
/begin MEASUREMENT ed_fil_tabg2.zyklus_filter_nv "Vorwaertsfilter zur Fehlerzustandsbestaetigung [RAM name from V530, interpolated]" UBYTE M_FORMULA_0003 0 0 0 255 ECU_ADDRESS 0x3F9899 /end MEASUREMENT
/begin MEASUREMENT ed_fil_dk1_pdr.filter_nv "Filterwert vor und nach Eintrag [RAM name from V530, interpolated]" UBYTE M_FORMULA_0003 0 0 0 255 ECU_ADDRESS 0x3F98AA /end MEASUREMENT
/begin MEASUREMENT ed_fil_dk1_pdr.zyklus_filter_nv "Vorwaertsfilter zur Fehlerzustandsbestaetigung [RAM name from V530, interpolated]" UBYTE M_FORMULA_0003 0 0 0 255 ECU_ADDRESS 0x3F98AB /end MEASUREMENT
/begin MEASUREMENT ed_fil_dk1_wdk.fehler_aufrufe_nv "Gesamtzahl der Fehleraufrufe [RAM name from V530, interpolated]" UBYTE M_FORMULA_0003 0 0 0 255 ECU_ADDRESS 0x3F98A3 /end MEASUREMENT
/begin MEASUREMENT ed_fil_dk1_wdk.filter_max_nv "Maximaler Fehlerfilterwert [RAM name from V530, interpolated]" UBYTE M_FORMULA_0003 0 0 0 255 ECU_ADDRESS 0x3F98A2 /end MEASUREMENT
/begin MEASUREMENT ed_fil_dk2_wdk.art_aktuell_nv "Fehlerart und Statusbits [RAM name from V530, interpolated]" UWORD NO_COMPU_METHOD 0 0 0 65535 ECU_ADDRESS 0x3F98A6 FORMAT "%.4g" /end MEASUREMENT
/begin MEASUREMENT ed_fil_dk2_wdk.fehler_aufrufe_nv "Gesamtzahl der Fehleraufrufe [RAM name from V530, interpolated]" UBYTE M_FORMULA_0003 0 0 0 255 ECU_ADDRESS 0x3F98A9 /end MEASUREMENT
/begin MEASUREMENT ed_fil_dk2_wdk.filter_max_nv "Maximaler Fehlerfilterwert [RAM name from V530, interpolated]" UBYTE M_FORMULA_0003 0 0 0 255 ECU_ADDRESS 0x3F98A8 /end MEASUREMENT
/begin MEASUREMENT ed_fil_dk2_wdk.filter_nv "Filterwert vor und nach Eintrag [RAM name from V530, interpolated]" UBYTE M_FORMULA_0003 0 0 0 255 ECU_ADDRESS 0x3F98A4 /end MEASUREMENT
/begin MEASUREMENT ed_fil_dk2_wdk.zyklus_filter_nv "Vorwaertsfilter zur Fehlerzustandsbestaetigung [RAM name from V530, interpolated]" UBYTE M_FORMULA_0003 0 0 0 255 ECU_ADDRESS 0x3F98A5 /end MEASUREMENT
/begin MEASUREMENT ed_fil_dk1_pdr.fehler_aufrufe_nv "Gesamtzahl der Fehleraufrufe [RAM name from V530, interpolated]" UBYTE M_FORMULA_0003 0 0 0 255 ECU_ADDRESS 0x3F98AF /end MEASUREMENT
/begin MEASUREMENT ed_fil_dk1_pdr.filter_max_nv "Maximaler Fehlerfilterwert [RAM name from V530, interpolated]" UBYTE M_FORMULA_0003 0 0 0 255 ECU_ADDRESS 0x3F98AE /end MEASUREMENT
/begin MEASUREMENT ed_fil_dk2_pdr.filter_nv "Filterwert vor und nach Eintrag [RAM name from V530, interpolated]" UBYTE M_FORMULA_0003 0 0 0 255 ECU_ADDRESS 0x3F98B0 /end MEASUREMENT
/begin MEASUREMENT ed_fil_dk2_pdr.zyklus_filter_nv "Vorwaertsfilter zur Fehlerzustandsbestaetigung [RAM name from V530, interpolated]" UBYTE M_FORMULA_0003 0 0 0 255 ECU_ADDRESS 0x3F98B1 /end MEASUREMENT
/begin MEASUREMENT ed_fil_dk1_sk_err.filter_nv "Filterwert vor und nach Eintrag [RAM name from V530, interpolated]" UBYTE M_FORMULA_0003 0 0 0 255 ECU_ADDRESS 0x3F98C2 /end MEASUREMENT
/begin MEASUREMENT ed_fil_dk1_sk_err.zyklus_filter_nv "Vorwaertsfilter zur Fehlerzustandsbestaetigung [RAM name from V530, interpolated]" UBYTE M_FORMULA_0003 0 0 0 255 ECU_ADDRESS 0x3F98C3 /end MEASUREMENT
/begin MEASUREMENT ed_fil_dk2_pdr.fehler_aufrufe_nv "Gesamtzahl der Fehleraufrufe [RAM name from V530, interpolated]" UBYTE M_FORMULA_0003 0 0 0 255 ECU_ADDRESS 0x3F98B5 /end MEASUREMENT
/begin MEASUREMENT ed_fil_dk2_pdr.filter_max_nv "Maximaler Fehlerfilterwert [RAM name from V530, interpolated]" UBYTE M_FORMULA_0003 0 0 0 255 ECU_ADDRESS 0x3F98B4 /end MEASUREMENT
/begin MEASUREMENT ed_fil_lls1_regler.art_aktuell_nv "Fehlerart und Statusbits [RAM name from V530, interpolated]" UWORD NO_COMPU_METHOD 0 0 0 65535 ECU_ADDRESS 0x3F98B8 FORMAT "%.4g" /end MEASUREMENT
/begin MEASUREMENT ed_fil_lls1_regler.fehler_aufrufe_nv "Gesamtzahl der Fehleraufrufe [RAM name from V530, interpolated]" UBYTE M_FORMULA_0003 0 0 0 255 ECU_ADDRESS 0x3F98BB /end MEASUREMENT
/begin MEASUREMENT ed_fil_lls1_regler.filter_max_nv "Maximaler Fehlerfilterwert [RAM name from V530, interpolated]" UBYTE M_FORMULA_0003 0 0 0 255 ECU_ADDRESS 0x3F98BA /end MEASUREMENT
/begin MEASUREMENT ed_fil_lls1_regler.filter_nv "Filterwert vor und nach Eintrag [RAM name from V530, interpolated]" UBYTE M_FORMULA_0003 0 0 0 255 ECU_ADDRESS 0x3F98B6 /end MEASUREMENT
/begin MEASUREMENT ed_fil_lls1_regler.zyklus_filter_nv "Vorwaertsfilter zur Fehlerzustandsbestaetigung [RAM name from V530, interpolated]" UBYTE M_FORMULA_0003 0 0 0 255 ECU_ADDRESS 0x3F98B7 /end MEASUREMENT
/begin MEASUREMENT ed_fil_lls2_regler.art_aktuell_nv "Fehlerart und Statusbits [RAM name from V530, interpolated]" UWORD NO_COMPU_METHOD 0 0 0 65535 ECU_ADDRESS 0x3F98BE FORMAT "%.4g" /end MEASUREMENT
/begin MEASUREMENT ed_fil_lls2_regler.fehler_aufrufe_nv "Gesamtzahl der Fehleraufrufe [RAM name from V530, interpolated]" UBYTE M_FORMULA_0003 0 0 0 255 ECU_ADDRESS 0x3F98C1 /end MEASUREMENT
/begin MEASUREMENT ed_fil_lls2_regler.filter_max_nv "Maximaler Fehlerfilterwert [RAM name from V530, interpolated]" UBYTE M_FORMULA_0003 0 0 0 255 ECU_ADDRESS 0x3F98C0 /end MEASUREMENT
/begin MEASUREMENT ed_fil_lls2_regler.filter_nv "Filterwert vor und nach Eintrag [RAM name from V530, interpolated]" UBYTE M_FORMULA_0003 0 0 0 255 ECU_ADDRESS 0x3F98BC /end MEASUREMENT
/begin MEASUREMENT ed_fil_lls2_regler.zyklus_filter_nv "Vorwaertsfilter zur Fehlerzustandsbestaetigung [RAM name from V530, interpolated]" UBYTE M_FORMULA_0003 0 0 0 255 ECU_ADDRESS 0x3F98BD /end MEASUREMENT
/begin MEASUREMENT ed_fil_dk1_sk_err.fehler_aufrufe_nv "Gesamtzahl der Fehleraufrufe [RAM name from V530, interpolated]" UBYTE M_FORMULA_0003 0 0 0 255 ECU_ADDRESS 0x3F98C7 /end MEASUREMENT
/begin MEASUREMENT ed_fil_dk1_sk_err.filter_max_nv "Maximaler Fehlerfilterwert [RAM name from V530, interpolated]" UBYTE M_FORMULA_0003 0 0 0 255 ECU_ADDRESS 0x3F98C6 /end MEASUREMENT
/begin MEASUREMENT ed_fil_dk2_sk_err.filter_nv "Filterwert vor und nach Eintrag [RAM name from V530, interpolated]" UBYTE M_FORMULA_0003 0 0 0 255 ECU_ADDRESS 0x3F98C8 /end MEASUREMENT
/begin MEASUREMENT ed_fil_dk2_sk_err.zyklus_filter_nv "Vorwaertsfilter zur Fehlerzustandsbestaetigung [RAM name from V530, interpolated]" UBYTE M_FORMULA_0003 0 0 0 255 ECU_ADDRESS 0x3F98C9 /end MEASUREMENT
/begin MEASUREMENT ed_fil_dk1_federn.filter_nv "Filterwert vor und nach Eintrag [RAM name from V530, interpolated]" UBYTE M_FORMULA_0003 0 0 0 255 ECU_ADDRESS 0x3F98CE /end MEASUREMENT
/begin MEASUREMENT ed_fil_dk1_federn.zyklus_filter_nv "Vorwaertsfilter zur Fehlerzustandsbestaetigung [RAM name from V530, interpolated]" UBYTE M_FORMULA_0003 0 0 0 255 ECU_ADDRESS 0x3F98CF /end MEASUREMENT
/begin MEASUREMENT ed_fil_dk2_sk_err.fehler_aufrufe_nv "Gesamtzahl der Fehleraufrufe [RAM name from V530, interpolated]" UBYTE M_FORMULA_0003 0 0 0 255 ECU_ADDRESS 0x3F98CD /end MEASUREMENT
/begin MEASUREMENT ed_fil_dk2_sk_err.filter_max_nv "Maximaler Fehlerfilterwert [RAM name from V530, interpolated]" UBYTE M_FORMULA_0003 0 0 0 255 ECU_ADDRESS 0x3F98CC /end MEASUREMENT
/begin MEASUREMENT ed_fil_dk1_federn.fehler_aufrufe_nv "Gesamtzahl der Fehleraufrufe [RAM name from V530, interpolated]" UBYTE M_FORMULA_0003 0 0 0 255 ECU_ADDRESS 0x3F98D3 /end MEASUREMENT
/begin MEASUREMENT ed_fil_dk1_federn.filter_max_nv "Maximaler Fehlerfilterwert [RAM name from V530, interpolated]" UBYTE M_FORMULA_0003 0 0 0 255 ECU_ADDRESS 0x3F98D2 /end MEASUREMENT
/begin MEASUREMENT ed_fil_dk2_federn.filter_nv "Filterwert vor und nach Eintrag [RAM name from V530, interpolated]" UBYTE M_FORMULA_0003 0 0 0 255 ECU_ADDRESS 0x3F98D4 /end MEASUREMENT
/begin MEASUREMENT ed_fil_dk2_federn.zyklus_filter_nv "Vorwaertsfilter zur Fehlerzustandsbestaetigung [RAM name from V530, interpolated]" UBYTE M_FORMULA_0003 0 0 0 255 ECU_ADDRESS 0x3F98D5 /end MEASUREMENT
/begin MEASUREMENT ed_fil_dk2_federn.fehler_aufrufe_nv "Gesamtzahl der Fehleraufrufe [RAM name from V530, interpolated]" UBYTE M_FORMULA_0003 0 0 0 255 ECU_ADDRESS 0x3F98D9 /end MEASUREMENT
/begin MEASUREMENT ed_fil_dk2_federn.filter_max_nv "Maximaler Fehlerfilterwert [RAM name from V530, interpolated]" UBYTE M_FORMULA_0003 0 0 0 255 ECU_ADDRESS 0x3F98D8 /end MEASUREMENT
/begin MEASUREMENT ed_fil_md_sk_err.filter_nv "Filterwert vor und nach Eintrag [RAM name from V530, interpolated]" UBYTE M_FORMULA_0003 0 0 0 255 ECU_ADDRESS 0x3F98DA /end MEASUREMENT
/begin MEASUREMENT ed_fil_md_sk_err.zyklus_filter_nv "Vorwaertsfilter zur Fehlerzustandsbestaetigung [RAM name from V530, interpolated]" UBYTE M_FORMULA_0003 0 0 0 255 ECU_ADDRESS 0x3F98DB /end MEASUREMENT
/begin MEASUREMENT ed_fil_dk1_cmd.filter_nv "Filterwert vor und nach Eintrag [RAM name from V530, interpolated]" UBYTE M_FORMULA_0003 0 0 0 255 ECU_ADDRESS 0x3F98EC /end MEASUREMENT
/begin MEASUREMENT ed_fil_dk1_cmd.zyklus_filter_nv "Vorwaertsfilter zur Fehlerzustandsbestaetigung [RAM name from V530, interpolated]" UBYTE M_FORMULA_0003 0 0 0 255 ECU_ADDRESS 0x3F98ED /end MEASUREMENT
/begin MEASUREMENT ed_fil_dsc_eingr.art_aktuell_nv "Fehlerart und Statusbits [RAM name from V530, interpolated]" UWORD NO_COMPU_METHOD 0 0 0 65535 ECU_ADDRESS 0x3F98E8 FORMAT "%.4g" /end MEASUREMENT
/begin MEASUREMENT ed_fil_dsc_eingr.fehler_aufrufe_nv "Gesamtzahl der Fehleraufrufe [RAM name from V530, interpolated]" UBYTE M_FORMULA_0003 0 0 0 255 ECU_ADDRESS 0x3F98EB /end MEASUREMENT
/begin MEASUREMENT ed_fil_dsc_eingr.filter_max_nv "Maximaler Fehlerfilterwert [RAM name from V530, interpolated]" UBYTE M_FORMULA_0003 0 0 0 255 ECU_ADDRESS 0x3F98EA /end MEASUREMENT
/begin MEASUREMENT ed_fil_dsc_eingr.filter_nv "Filterwert vor und nach Eintrag [RAM name from V530, interpolated]" UBYTE M_FORMULA_0003 0 0 0 255 ECU_ADDRESS 0x3F98E6 /end MEASUREMENT
/begin MEASUREMENT ed_fil_dsc_eingr.zyklus_filter_nv "Vorwaertsfilter zur Fehlerzustandsbestaetigung [RAM name from V530, interpolated]" UBYTE M_FORMULA_0003 0 0 0 255 ECU_ADDRESS 0x3F98E7 /end MEASUREMENT
/begin MEASUREMENT ed_fil_lls_init.art_aktuell_nv "Fehlerart und Statusbits [RAM name from V530, interpolated]" UWORD NO_COMPU_METHOD 0 0 0 65535 ECU_ADDRESS 0x3F98E2 FORMAT "%.4g" /end MEASUREMENT
/begin MEASUREMENT ed_fil_lls_init.fehler_aufrufe_nv "Gesamtzahl der Fehleraufrufe [RAM name from V530, interpolated]" UBYTE M_FORMULA_0003 0 0 0 255 ECU_ADDRESS 0x3F98E5 /end MEASUREMENT
/begin MEASUREMENT ed_fil_lls_init.filter_max_nv "Maximaler Fehlerfilterwert [RAM name from V530, interpolated]" UBYTE M_FORMULA_0003 0 0 0 255 ECU_ADDRESS 0x3F98E4 /end MEASUREMENT
/begin MEASUREMENT ed_fil_lls_init.filter_nv "Filterwert vor und nach Eintrag [RAM name from V530, interpolated]" UBYTE M_FORMULA_0003 0 0 0 255 ECU_ADDRESS 0x3F98E0 /end MEASUREMENT
/begin MEASUREMENT ed_fil_lls_init.zyklus_filter_nv "Vorwaertsfilter zur Fehlerzustandsbestaetigung [RAM name from V530, interpolated]" UBYTE M_FORMULA_0003 0 0 0 255 ECU_ADDRESS 0x3F98E1 /end MEASUREMENT
/begin MEASUREMENT ed_fil_md_sk_err.fehler_aufrufe_nv "Gesamtzahl der Fehleraufrufe [RAM name from V530, interpolated]" UBYTE M_FORMULA_0003 0 0 0 255 ECU_ADDRESS 0x3F98DF /end MEASUREMENT
/begin MEASUREMENT ed_fil_md_sk_err.filter_max_nv "Maximaler Fehlerfilterwert [RAM name from V530, interpolated]" UBYTE M_FORMULA_0003 0 0 0 255 ECU_ADDRESS 0x3F98DE /end MEASUREMENT
/begin MEASUREMENT ed_fil_dk1_cmd.fehler_aufrufe_nv "Gesamtzahl der Fehleraufrufe [RAM name from V530, interpolated]" UBYTE M_FORMULA_0003 0 0 0 255 ECU_ADDRESS 0x3F98F1 /end MEASUREMENT
/begin MEASUREMENT ed_fil_dk1_cmd.filter_max_nv "Maximaler Fehlerfilterwert [RAM name from V530, interpolated]" UBYTE M_FORMULA_0003 0 0 0 255 ECU_ADDRESS 0x3F98F0 /end MEASUREMENT
/begin MEASUREMENT ed_fil_dk2_cmd.filter_nv "Filterwert vor und nach Eintrag [RAM name from V530, interpolated]" UBYTE M_FORMULA_0003 0 0 0 255 ECU_ADDRESS 0x3F98F2 /end MEASUREMENT
/begin MEASUREMENT ed_fil_dk2_cmd.zyklus_filter_nv "Vorwaertsfilter zur Fehlerzustandsbestaetigung [RAM name from V530, interpolated]" UBYTE M_FORMULA_0003 0 0 0 255 ECU_ADDRESS 0x3F98F3 /end MEASUREMENT
/begin MEASUREMENT ed_fil_dk2_cmd.fehler_aufrufe_nv "Gesamtzahl der Fehleraufrufe [RAM name from V530, interpolated]" UBYTE M_FORMULA_0003 0 0 0 255 ECU_ADDRESS 0x3F98F7 /end MEASUREMENT
/begin MEASUREMENT ed_fil_dk2_cmd.filter_max_nv "Maximaler Fehlerfilterwert [RAM name from V530, interpolated]" UBYTE M_FORMULA_0003 0 0 0 255 ECU_ADDRESS 0x3F98F6 /end MEASUREMENT
/begin MEASUREMENT ed_fil_lls1_cmd.filter_nv "Filterwert vor und nach Eintrag [RAM name from V530, interpolated]" UBYTE M_FORMULA_0003 0 0 0 255 ECU_ADDRESS 0x3F98F8 /end MEASUREMENT
/begin MEASUREMENT ed_fil_lls1_cmd.zyklus_filter_nv "Vorwaertsfilter zur Fehlerzustandsbestaetigung [RAM name from V530, interpolated]" UBYTE M_FORMULA_0003 0 0 0 255 ECU_ADDRESS 0x3F98F9 /end MEASUREMENT
/begin MEASUREMENT ed_fil_lls1_cmd.fehler_aufrufe_nv "Gesamtzahl der Fehleraufrufe [RAM name from V530, interpolated]" UBYTE M_FORMULA_0003 0 0 0 255 ECU_ADDRESS 0x3F98FD /end MEASUREMENT
/begin MEASUREMENT ed_fil_lls1_cmd.filter_max_nv "Maximaler Fehlerfilterwert [RAM name from V530, interpolated]" UBYTE M_FORMULA_0003 0 0 0 255 ECU_ADDRESS 0x3F98FC /end MEASUREMENT
/begin MEASUREMENT ed_fil_lls2_cmd.art_aktuell_nv "Fehlerart und Statusbits [RAM name from V530, interpolated]" UWORD NO_COMPU_METHOD 0 0 0 65535 ECU_ADDRESS 0x3F9900 FORMAT "%.4g" /end MEASUREMENT
/begin MEASUREMENT ed_fil_lls2_cmd.fehler_aufrufe_nv "Gesamtzahl der Fehleraufrufe [RAM name from V530, interpolated]" UBYTE M_FORMULA_0003 0 0 0 255 ECU_ADDRESS 0x3F9903 /end MEASUREMENT
/begin MEASUREMENT ed_fil_lls2_cmd.filter_max_nv "Maximaler Fehlerfilterwert [RAM name from V530, interpolated]" UBYTE M_FORMULA_0003 0 0 0 255 ECU_ADDRESS 0x3F9902 /end MEASUREMENT
/begin MEASUREMENT ed_fil_lls2_cmd.filter_nv "Filterwert vor und nach Eintrag [RAM name from V530, interpolated]" UBYTE M_FORMULA_0003 0 0 0 255 ECU_ADDRESS 0x3F98FE /end MEASUREMENT
/begin MEASUREMENT ed_fil_lls2_cmd.zyklus_filter_nv "Vorwaertsfilter zur Fehlerzustandsbestaetigung [RAM name from V530, interpolated]" UBYTE M_FORMULA_0003 0 0 0 255 ECU_ADDRESS 0x3F98FF /end MEASUREMENT
/begin MEASUREMENT ed_fil_sc_smg1.filter_nv "Filterwert vor und nach Eintrag [RAM name from V530, interpolated]" UBYTE M_FORMULA_0003 0 0 0 255 ECU_ADDRESS 0x3F9904 /end MEASUREMENT
/begin MEASUREMENT ed_fil_sc_smg1.zyklus_filter_nv "Vorwaertsfilter zur Fehlerzustandsbestaetigung [RAM name from V530, interpolated]" UBYTE M_FORMULA_0003 0 0 0 255 ECU_ADDRESS 0x3F9905 /end MEASUREMENT
/begin MEASUREMENT ed_fil_sc_smg1.fehler_aufrufe_nv "Gesamtzahl der Fehleraufrufe [RAM name from V530, interpolated]" UBYTE M_FORMULA_0003 0 0 0 255 ECU_ADDRESS 0x3F9909 /end MEASUREMENT
/begin MEASUREMENT ed_fil_sc_smg1.filter_max_nv "Maximaler Fehlerfilterwert [RAM name from V530, interpolated]" UBYTE M_FORMULA_0003 0 0 0 255 ECU_ADDRESS 0x3F9908 /end MEASUREMENT
/begin MEASUREMENT ed_fil_sc_smg2.filter_nv "Filterwert vor und nach Eintrag [RAM name from V530, interpolated]" UBYTE M_FORMULA_0003 0 0 0 255 ECU_ADDRESS 0x3F990A /end MEASUREMENT
/begin MEASUREMENT ed_fil_sc_smg2.zyklus_filter_nv "Vorwaertsfilter zur Fehlerzustandsbestaetigung [RAM name from V530, interpolated]" UBYTE M_FORMULA_0003 0 0 0 255 ECU_ADDRESS 0x3F990B /end MEASUREMENT
/begin MEASUREMENT ed_fil_sc_busoff.filter_nv "Filterwert vor und nach Eintrag [RAM name from V530, interpolated]" UBYTE M_FORMULA_0003 0 0 0 255 ECU_ADDRESS 0x3F9916 /end MEASUREMENT
/begin MEASUREMENT ed_fil_sc_busoff.zyklus_filter_nv "Vorwaertsfilter zur Fehlerzustandsbestaetigung [RAM name from V530, interpolated]" UBYTE M_FORMULA_0003 0 0 0 255 ECU_ADDRESS 0x3F9917 /end MEASUREMENT
/begin MEASUREMENT ed_fil_sc_smg2.fehler_aufrufe_nv "Gesamtzahl der Fehleraufrufe [RAM name from V530, interpolated]" UBYTE M_FORMULA_0003 0 0 0 255 ECU_ADDRESS 0x3F990F /end MEASUREMENT
/begin MEASUREMENT ed_fil_sc_smg2.filter_max_nv "Maximaler Fehlerfilterwert [RAM name from V530, interpolated]" UBYTE M_FORMULA_0003 0 0 0 255 ECU_ADDRESS 0x3F990E /end MEASUREMENT
/begin MEASUREMENT ed_fil_sc_smg3.art_aktuell_nv "Fehlerart und Statusbits [RAM name from V530, interpolated]" UWORD NO_COMPU_METHOD 0 0 0 65535 ECU_ADDRESS 0x3F9912 FORMAT "%.4g" /end MEASUREMENT
/begin MEASUREMENT ed_fil_sc_smg3.fehler_aufrufe_nv "Gesamtzahl der Fehleraufrufe [RAM name from V530, interpolated]" UBYTE M_FORMULA_0003 0 0 0 255 ECU_ADDRESS 0x3F9915 /end MEASUREMENT
/begin MEASUREMENT ed_fil_sc_smg3.filter_max_nv "Maximaler Fehlerfilterwert [RAM name from V530, interpolated]" UBYTE M_FORMULA_0003 0 0 0 255 ECU_ADDRESS 0x3F9914 /end MEASUREMENT
/begin MEASUREMENT ed_fil_sc_smg3.filter_nv "Filterwert vor und nach Eintrag [RAM name from V530, interpolated]" UBYTE M_FORMULA_0003 0 0 0 255 ECU_ADDRESS 0x3F9910 /end MEASUREMENT
/begin MEASUREMENT ed_fil_sc_smg3.zyklus_filter_nv "Vorwaertsfilter zur Fehlerzustandsbestaetigung [RAM name from V530, interpolated]" UBYTE M_FORMULA_0003 0 0 0 255 ECU_ADDRESS 0x3F9911 /end MEASUREMENT
/begin MEASUREMENT ed_fil_ec_busoff.filter_nv "Filterwert vor und nach Eintrag [RAM name from V530, interpolated]" UBYTE M_FORMULA_0003 0 0 0 255 ECU_ADDRESS 0x3F991C /end MEASUREMENT
/begin MEASUREMENT ed_fil_ec_busoff.zyklus_filter_nv "Vorwaertsfilter zur Fehlerzustandsbestaetigung [RAM name from V530, interpolated]" UBYTE M_FORMULA_0003 0 0 0 255 ECU_ADDRESS 0x3F991D /end MEASUREMENT
/begin MEASUREMENT ed_fil_sc_busoff.fehler_aufrufe_nv "Gesamtzahl der Fehleraufrufe [RAM name from V530, interpolated]" UBYTE M_FORMULA_0003 0 0 0 255 ECU_ADDRESS 0x3F991B /end MEASUREMENT
/begin MEASUREMENT ed_fil_sc_busoff.filter_max_nv "Maximaler Fehlerfilterwert [RAM name from V530, interpolated]" UBYTE M_FORMULA_0003 0 0 0 255 ECU_ADDRESS 0x3F991A /end MEASUREMENT
/begin MEASUREMENT ed_fil_auss_abg_z1.filter_nv "Filterwert vor und nach Eintrag [RAM name from V530, interpolated]" UBYTE M_FORMULA_0003 0 0 0 255 ECU_ADDRESS 0x3F9970 /end MEASUREMENT
/begin MEASUREMENT ed_fil_auss_abg_z1.zyklus_filter_nv "Vorwaertsfilter zur Fehlerzustandsbestaetigung [RAM name from V530, interpolated]" UBYTE M_FORMULA_0003 0 0 0 255 ECU_ADDRESS 0x3F9971 /end MEASUREMENT
/begin MEASUREMENT ed_fil_auss_kat_mult.fehler_aufrufe_nv "Gesamtzahl der Fehleraufrufe [RAM name from V530, interpolated]" UBYTE M_FORMULA_0003 0 0 0 255 ECU_ADDRESS 0x3F996F /end MEASUREMENT
/begin MEASUREMENT ed_fil_auss_kat_mult.filter_max_nv "Maximaler Fehlerfilterwert [RAM name from V530, interpolated]" UBYTE M_FORMULA_0003 0 0 0 255 ECU_ADDRESS 0x3F996E /end MEASUREMENT
/begin MEASUREMENT ed_fil_auss_abg_z1.fehler_aufrufe_nv "Gesamtzahl der Fehleraufrufe [RAM name from V530, interpolated]" UBYTE M_FORMULA_0003 0 0 0 255 ECU_ADDRESS 0x3F9975 /end MEASUREMENT
/begin MEASUREMENT ed_fil_auss_abg_z1.filter_max_nv "Maximaler Fehlerfilterwert [RAM name from V530, interpolated]" UBYTE M_FORMULA_0003 0 0 0 255 ECU_ADDRESS 0x3F9974 /end MEASUREMENT
/begin MEASUREMENT ed_fil_auss_abg_z2.filter_nv "Filterwert vor und nach Eintrag [RAM name from V530, interpolated]" UBYTE M_FORMULA_0003 0 0 0 255 ECU_ADDRESS 0x3F9976 /end MEASUREMENT
/begin MEASUREMENT ed_fil_auss_abg_z2.zyklus_filter_nv "Vorwaertsfilter zur Fehlerzustandsbestaetigung [RAM name from V530, interpolated]" UBYTE M_FORMULA_0003 0 0 0 255 ECU_ADDRESS 0x3F9977 /end MEASUREMENT
/begin MEASUREMENT ed_fil_auss_abg_z2.fehler_aufrufe_nv "Gesamtzahl der Fehleraufrufe [RAM name from V530, interpolated]" UBYTE M_FORMULA_0003 0 0 0 255 ECU_ADDRESS 0x3F997B /end MEASUREMENT
/begin MEASUREMENT ed_fil_auss_abg_z2.filter_max_nv "Maximaler Fehlerfilterwert [RAM name from V530, interpolated]" UBYTE M_FORMULA_0003 0 0 0 255 ECU_ADDRESS 0x3F997A /end MEASUREMENT
/begin MEASUREMENT ed_fil_auss_abg_z3.filter_nv "Filterwert vor und nach Eintrag [RAM name from V530, interpolated]" UBYTE M_FORMULA_0003 0 0 0 255 ECU_ADDRESS 0x3F997C /end MEASUREMENT
/begin MEASUREMENT ed_fil_auss_abg_z3.zyklus_filter_nv "Vorwaertsfilter zur Fehlerzustandsbestaetigung [RAM name from V530, interpolated]" UBYTE M_FORMULA_0003 0 0 0 255 ECU_ADDRESS 0x3F997D /end MEASUREMENT
/begin MEASUREMENT ed_fil_auss_abg_z3.fehler_aufrufe_nv "Gesamtzahl der Fehleraufrufe [RAM name from V530, interpolated]" UBYTE M_FORMULA_0003 0 0 0 255 ECU_ADDRESS 0x3F9981 /end MEASUREMENT
/begin MEASUREMENT ed_fil_auss_abg_z3.filter_max_nv "Maximaler Fehlerfilterwert [RAM name from V530, interpolated]" UBYTE M_FORMULA_0003 0 0 0 255 ECU_ADDRESS 0x3F9980 /end MEASUREMENT
/begin MEASUREMENT ed_fil_auss_abg_z4.filter_nv "Filterwert vor und nach Eintrag [RAM name from V530, interpolated]" UBYTE M_FORMULA_0003 0 0 0 255 ECU_ADDRESS 0x3F9982 /end MEASUREMENT
/begin MEASUREMENT ed_fil_auss_abg_z4.zyklus_filter_nv "Vorwaertsfilter zur Fehlerzustandsbestaetigung [RAM name from V530, interpolated]" UBYTE M_FORMULA_0003 0 0 0 255 ECU_ADDRESS 0x3F9983 /end MEASUREMENT
/begin MEASUREMENT ed_fil_auss_abg_z6.fehler_aufrufe_nv "Gesamtzahl der Fehleraufrufe [RAM name from V530, interpolated]" UBYTE M_FORMULA_0003 0 0 0 255 ECU_ADDRESS 0x3F992D /end MEASUREMENT
/begin MEASUREMENT ed_fil_auss_abg_z6.filter_max_nv "Maximaler Fehlerfilterwert [RAM name from V530, interpolated]" UBYTE M_FORMULA_0003 0 0 0 255 ECU_ADDRESS 0x3F992C /end MEASUREMENT
/begin MEASUREMENT ed_fil_auss_abg_z7.filter_nv "Filterwert vor und nach Eintrag [RAM name from V530, interpolated]" UBYTE M_FORMULA_0003 0 0 0 255 ECU_ADDRESS 0x3F992E /end MEASUREMENT
/begin MEASUREMENT ed_fil_auss_abg_z7.zyklus_filter_nv "Vorwaertsfilter zur Fehlerzustandsbestaetigung [RAM name from V530, interpolated]" UBYTE M_FORMULA_0003 0 0 0 255 ECU_ADDRESS 0x3F992F /end MEASUREMENT
/begin MEASUREMENT ed_fil_auss_abg_z7.fehler_aufrufe_nv "Gesamtzahl der Fehleraufrufe [RAM name from V530, interpolated]" UBYTE M_FORMULA_0003 0 0 0 255 ECU_ADDRESS 0x3F9933 /end MEASUREMENT
/begin MEASUREMENT ed_fil_auss_abg_z7.filter_max_nv "Maximaler Fehlerfilterwert [RAM name from V530, interpolated]" UBYTE M_FORMULA_0003 0 0 0 255 ECU_ADDRESS 0x3F9932 /end MEASUREMENT
/begin MEASUREMENT ed_fil_auss_abg_z8.filter_nv "Filterwert vor und nach Eintrag [RAM name from V530, interpolated]" UBYTE M_FORMULA_0003 0 0 0 255 ECU_ADDRESS 0x3F9934 /end MEASUREMENT
/begin MEASUREMENT ed_fil_auss_abg_z8.zyklus_filter_nv "Vorwaertsfilter zur Fehlerzustandsbestaetigung [RAM name from V530, interpolated]" UBYTE M_FORMULA_0003 0 0 0 255 ECU_ADDRESS 0x3F9935 /end MEASUREMENT
/begin MEASUREMENT ed_fil_auss_abg_z8.fehler_aufrufe_nv "Gesamtzahl der Fehleraufrufe [RAM name from V530, interpolated]" UBYTE M_FORMULA_0003 0 0 0 255 ECU_ADDRESS 0x3F9939 /end MEASUREMENT
/begin MEASUREMENT ed_fil_auss_abg_z8.filter_max_nv "Maximaler Fehlerfilterwert [RAM name from V530, interpolated]" UBYTE M_FORMULA_0003 0 0 0 255 ECU_ADDRESS 0x3F9938 /end MEASUREMENT
/begin MEASUREMENT ed_fil_auss_abg_z9.filter_nv "Filterwert vor und nach Eintrag [RAM name from V530, interpolated]" UBYTE M_FORMULA_0003 0 0 0 255 ECU_ADDRESS 0x3F993A /end MEASUREMENT
/begin MEASUREMENT ed_fil_auss_abg_z9.zyklus_filter_nv "Vorwaertsfilter zur Fehlerzustandsbestaetigung [RAM name from V530, interpolated]" UBYTE M_FORMULA_0003 0 0 0 255 ECU_ADDRESS 0x3F993B /end MEASUREMENT
/begin MEASUREMENT ed_fil_auss_abg_z10.filter_nv "Filterwert vor und nach Eintrag [RAM name from V530, interpolated]" UBYTE M_FORMULA_0003 0 0 0 255 ECU_ADDRESS 0x3F9940 /end MEASUREMENT
/begin MEASUREMENT ed_fil_auss_abg_z10.zyklus_filter_nv "Vorwaertsfilter zur Fehlerzustandsbestaetigung [RAM name from V530, interpolated]" UBYTE M_FORMULA_0003 0 0 0 255 ECU_ADDRESS 0x3F9941 /end MEASUREMENT
/begin MEASUREMENT ed_fil_auss_abg_z9.fehler_aufrufe_nv "Gesamtzahl der Fehleraufrufe [RAM name from V530, interpolated]" UBYTE M_FORMULA_0003 0 0 0 255 ECU_ADDRESS 0x3F993F /end MEASUREMENT
/begin MEASUREMENT ed_fil_auss_abg_z9.filter_max_nv "Maximaler Fehlerfilterwert [RAM name from V530, interpolated]" UBYTE M_FORMULA_0003 0 0 0 255 ECU_ADDRESS 0x3F993E /end MEASUREMENT
/begin COMPU_METHOD M_FORMULA_0000 "V530 FORMULA_0000" RAT_FUNC "%.4g" "-" COEFFS 0 1 0 0 0 1 /end COMPU_METHOD
/begin COMPU_METHOD M_FORMULA_0001 "V530 FORMULA_0001" RAT_FUNC "%.4g" "%" COEFFS 0 10 0 0 0 1 /end COMPU_METHOD
/begin COMPU_METHOD M_FORMULA_0003 "V530 FORMULA_0003" RAT_FUNC "%.4g" "-" COEFFS 0 1 0 0 0 1 /end COMPU_METHOD
/begin COMPU_METHOD M_FORMULA_0006 "V530 FORMULA_0006" RAT_FUNC "%.4g" "Upm" COEFFS 0 1 0 0 0 1 /end COMPU_METHOD
/begin COMPU_METHOD M_FORMULA_0007 "V530 FORMULA_0007" RAT_FUNC "%.4g" "-" COEFFS 0 10000 0 0 0 1 /end COMPU_METHOD
/begin COMPU_METHOD M_FORMULA_0008 "V530 FORMULA_0008" RAT_FUNC "%.4g" "V" COEFFS 0 10 0 0 0 1 /end COMPU_METHOD
/begin COMPU_METHOD M_FORMULA_0009 "V530 FORMULA_0009" RAT_FUNC "%.4g" "Nm" COEFFS 0 10 0 0 0 1 /end COMPU_METHOD
/begin COMPU_METHOD M_FORMULA_0010 "V530 FORMULA_0010" RAT_FUNC "%.4g" "-" COEFFS 0 1 0 0 0 1 /end COMPU_METHOD
/begin COMPU_METHOD M_FORMULA_0017 "V530 FORMULA_0017" RAT_FUNC "%.4g" "ms" COEFFS 0 7000 0 0 0 1 /end COMPU_METHOD
/begin COMPU_METHOD M_FORMULA_0021 "V530 FORMULA_0021" RAT_FUNC "%.4g" "s" COEFFS 0 100 0 0 0 1 /end COMPU_METHOD
/begin COMPU_METHOD M_FORMULA_0023 "V530 FORMULA_0023" RAT_FUNC "%.4g" "???C" COEFFS 0 10 2732 0 0 1 /end COMPU_METHOD
/begin COMPU_METHOD M_FORMULA_0024 "V530 FORMULA_0024" RAT_FUNC "%.4g" "-" COEFFS 0 32768 0 0 0 1 /end COMPU_METHOD
/begin COMPU_METHOD M_FORMULA_0025 "V530 FORMULA_0025" RAT_FUNC "%.4g" "-" COEFFS 0 16384 0 0 0 1 /end COMPU_METHOD
/begin COMPU_METHOD M_FORMULA_0027 "V530 FORMULA_0027" RAT_FUNC "%.4g" "km" COEFFS 0 1 0 0 0 1 /end COMPU_METHOD
/begin COMPU_METHOD M_FORMULA_0037 "V530 FORMULA_0037" RAT_FUNC "%.4g" "-" COEFFS 0 1 0 0 0 1 /end COMPU_METHOD
/begin COMPU_METHOD M_FORMULA_0071 "V530 FORMULA_0071" RAT_FUNC "%.4g" "s" COEFFS 0 10 0 0 0 1 /end COMPU_METHOD
/begin COMPU_METHOD M_FORMULA_0073 "V530 FORMULA_0073" RAT_FUNC "%.4g" "-" COEFFS 0 1024 0 0 0 1 /end COMPU_METHOD
/begin COMPU_METHOD M_FORMULA_0074 "V530 FORMULA_0074" RAT_FUNC "%.4g" "Kelvin" COEFFS 0 10 0 0 0 1 /end COMPU_METHOD
/begin COMPU_METHOD M_FORMULA_0075 "V530 FORMULA_0075" RAT_FUNC "%.4g" "mbar" COEFFS 0 16 0 0 0 1 /end COMPU_METHOD
/begin COMPU_METHOD M_FORMULA_0076 "V530 FORMULA_0076" RAT_FUNC "%.4g" "km/h" COEFFS 0 16 0 0 0 1 /end COMPU_METHOD
/begin COMPU_METHOD M_FORMULA_0102 "V530 FORMULA_0102" RAT_FUNC "%.4g" "???KW" COEFFS 0 10 0 0 0 1 /end COMPU_METHOD
/begin COMPU_METHOD M_FORMULA_0103 "V530 FORMULA_0103" RAT_FUNC "%.4g" "kg/h" COEFFS 0 10 0 0 0 1 /end COMPU_METHOD
/begin COMPU_METHOD M_FORMULA_0104 "V530 FORMULA_0104" RAT_FUNC "%.4g" "mg/asp" COEFFS 0 10 0 0 0 1 /end COMPU_METHOD
/begin COMPU_METHOD M_FORMULA_0105 "V530 FORMULA_0105" RAT_FUNC "%.4g" "Upm/s" COEFFS 0 1 0 0 0 1 /end COMPU_METHOD
/begin COMPU_METHOD M_FORMULA_0109 "V530 FORMULA_0109" RAT_FUNC "%.4g" "s" COEFFS 0 200 0 0 0 1 /end COMPU_METHOD
/begin COMPU_METHOD M_FORMULA_0110 "V530 FORMULA_0110" RAT_FUNC "%.4g" "bar" COEFFS 0 1000 0 0 0 1 /end COMPU_METHOD
/begin COMPU_METHOD M_FORMULA_0114 "V530 FORMULA_0114" RAT_FUNC "%.4g" "digit" COEFFS 0 1 0 0 0 1 /end COMPU_METHOD
/begin COMPU_METHOD M_FORMULA_0123 "V530 FORMULA_0123" RAT_FUNC "%.4g" "m/(s*s)" COEFFS 0 40 0 0 0 1 /end COMPU_METHOD
/begin COMPU_METHOD M_FORMULA_0135 "V530 FORMULA_0135" RAT_FUNC "%.4g" ".Gang" COEFFS 0 1 0 0 0 1 /end COMPU_METHOD
/begin COMPU_METHOD M_FORMULA_0143 "V530 FORMULA_0143" RAT_FUNC "%.4g" "qmm" COEFFS 0 10 0 0 0 1 /end COMPU_METHOD
/begin COMPU_METHOD M_FORMULA_0187 "V530 FORMULA_0187" RAT_FUNC "%.4g" "100/10ms" COEFFS 0 100 0 0 0 1 /end COMPU_METHOD
/begin COMPU_METHOD M_FORMULA_0231 "V530 FORMULA_0231" RAT_FUNC "%.4g" "???KW/Segm" COEFFS 0 10 0 0 0 1 /end COMPU_METHOD
/begin COMPU_METHOD M_FORMULA_0247 "V530 FORMULA_0247" RAT_FUNC "%.4g" "V" COEFFS 0 9830.4 0 0 0 1 /end COMPU_METHOD
/begin COMPU_METHOD M_FORMULA_0261 "V530 FORMULA_0261" RAT_FUNC "%.4g" "V" COEFFS 0 641.4697355 0 0 0 1 /end COMPU_METHOD
/begin COMPU_METHOD M_FORMULA_0263 "V530 FORMULA_0263" RAT_FUNC "%.4g" ".Prog" COEFFS 0 1 0 0 0 1 /end COMPU_METHOD
/begin COMPU_METHOD M_FORMULA_0272 "V530 FORMULA_0272" RAT_FUNC "%.4g" "Nm" COEFFS 0 10 0 0 0 1 /end COMPU_METHOD
/begin COMPU_METHOD M_FORMULA_0306 "V530 FORMULA_0306" RAT_FUNC "%.4g" "s" COEFFS 0 100 0 0 0 1 /end COMPU_METHOD
/begin COMPU_METHOD M_FORMULA_0342 "V530 FORMULA_0342" RAT_FUNC "%.4g" "???C" COEFFS 0 20 5463 0 0 1 /end COMPU_METHOD
/begin COMPU_METHOD M_FORMULA_0343 "V530 FORMULA_0343" RAT_FUNC "%.4g" "???C" COEFFS 0 10240 2797056 0 0 1 /end COMPU_METHOD
/begin COMPU_METHOD M_FORMULA_0354 "V530 FORMULA_0354" RAT_FUNC "%.4g" "ms" COEFFS 0 625 0 0 0 1 /end COMPU_METHOD
/begin COMPU_METHOD M_FORMULA_0357 "V530 FORMULA_0357" RAT_FUNC "%.4g" "s" COEFFS 0 200 0 0 0 1 /end COMPU_METHOD
/begin COMPU_METHOD M_FORMULA_0358 "V530 FORMULA_0358" RAT_FUNC "%.4g" "ms" COEFFS 0 0.1 0 0 0 1 /end COMPU_METHOD
/begin COMPU_METHOD M_FORMULA_0360 "V530 FORMULA_0360" RAT_FUNC "%.4g" "kHz" COEFFS 0 100 0 0 0 1 /end COMPU_METHOD
/begin COMPU_METHOD M_FORMULA_0404 "V530 FORMULA_0404" RAT_FUNC "%.4g" "ms" COEFFS 0 1000 0 0 0 1 /end COMPU_METHOD
/begin COMPU_METHOD M_FORMULA_0406 "V530 FORMULA_0406" RAT_FUNC "%.4g" "ms" COEFFS 0 3.921568627 0 0 0 1 /end COMPU_METHOD
/begin COMPU_METHOD M_FORMULA_0408 "V530 FORMULA_0408" RAT_FUNC "%.4g" "-" COEFFS 0 1 -1 0 0 1 /end COMPU_METHOD
/begin COMPU_METHOD M_FORMULA_0425 "V530 FORMULA_0425" RAT_FUNC "%.4g" "Bit" COEFFS 0 0.25 0 0 0 1 /end COMPU_METHOD
/begin COMPU_METHOD M_FORMULA_0437 "V530 FORMULA_0437" RAT_FUNC "%.4g" "%" COEFFS 0 327.68 0 0 0 1 /end COMPU_METHOD
/begin COMPU_METHOD M_FORMULA_0448 "V530 FORMULA_0448" RAT_FUNC "%.4g" "%" COEFFS 0 640 0 0 0 1 /end COMPU_METHOD
/begin COMPU_METHOD M_FORMULA_0492 "V530 FORMULA_0492" RAT_FUNC "%.4g" "s" COEFFS 0 10 0 0 0 1 /end COMPU_METHOD
/begin COMPU_METHOD M_FORMULA_0562 "V530 FORMULA_0562" RAT_FUNC "%.4g" "Nm/s" COEFFS 0 0.05 0 0 0 1 /end COMPU_METHOD
/begin COMPU_METHOD M_FORMULA_0584 "V530 FORMULA_0584" RAT_FUNC "%.4g" "ms" COEFFS 0 0.2 0 0 0 1 /end COMPU_METHOD
/begin COMPU_METHOD M_FORMULA_0590 "V530 FORMULA_0590" RAT_FUNC "%.4g" "sec" COEFFS 0 200 0 0 0 1 /end COMPU_METHOD
/begin COMPU_METHOD M_FORMULA_0742 "V530 FORMULA_0742" RAT_FUNC "%.4g" "Nm" COEFFS 0 2000 0 0 0 1 /end COMPU_METHOD
/begin COMPU_METHOD M_FORMULA_0757 "V530 FORMULA_0757" RAT_FUNC "%.4g" "-" COEFFS 0 128 0 0 0 1 /end COMPU_METHOD
/begin COMPU_METHOD M_FORMULA_0758 "V530 FORMULA_0758" RAT_FUNC "%.4g" "Nm" COEFFS 0 100 0 0 0 1 /end COMPU_METHOD
/begin COMPU_METHOD M_FORMULA_0760 "V530 FORMULA_0760" RAT_FUNC "%.4g" "10E-4" COEFFS 0 100 0 0 0 1 /end COMPU_METHOD
/begin COMPU_METHOD M_FORMULA_0785 "V530 FORMULA_0785" RAT_FUNC "%.4g" "Nm/s" COEFFS 0 1 0 0 0 1 /end COMPU_METHOD
/begin COMPU_METHOD M_FORMULA_0786 "V530 FORMULA_0786" RAT_FUNC "%.4g" "Nm/s" COEFFS 0 1 0 0 0 1 /end COMPU_METHOD
/begin COMPU_METHOD M_FORMULA_0787 "V530 FORMULA_0787" RAT_FUNC "%.4g" "Nm" COEFFS 0 200 0 0 0 1 /end COMPU_METHOD
/begin COMPU_METHOD M_FORMULA_0794 "V530 FORMULA_0794" RAT_FUNC "%.4g" "Nm" COEFFS 0 1 0 0 0 1 /end COMPU_METHOD
/begin COMPU_METHOD M_FORMULA_0795 "V530 FORMULA_0795" RAT_FUNC "%.4g" "Nm/Upm" COEFFS 0 1000 0 0 0 1 /end COMPU_METHOD
/begin COMPU_METHOD M_FORMULA_0799 "V530 FORMULA_0799" RAT_FUNC "%.4g" "Nm/Upm" COEFFS 0 -1000 0 0 0 1 /end COMPU_METHOD
/begin COMPU_METHOD M_FORMULA_0800 "V530 FORMULA_0800" RAT_FUNC "%.4g" "Nm/kmh" COEFFS 0 1000 0 0 0 1 /end COMPU_METHOD
/begin COMPU_METHOD M_FORMULA_0801 "V530 FORMULA_0801" RAT_FUNC "%.4g" "Nm/kmh" COEFFS 0 -1000 0 0 0 1 /end COMPU_METHOD
/begin COMPU_METHOD M_FORMULA_0878 "V530 FORMULA_0878" RAT_FUNC "%.4g" "-" COEFFS 0 65536 0 0 0 1 /end COMPU_METHOD
/begin COMPU_METHOD M_FORMULA_0896 "V530 FORMULA_0896" RAT_FUNC "%.4g" "%" COEFFS 0 1.28 0 0 0 1 /end COMPU_METHOD
/begin COMPU_METHOD M_FORMULA_0904 "V530 FORMULA_0904" RAT_FUNC "%.4g" "%" COEFFS 0 10.24 0 0 0 1 /end COMPU_METHOD
/begin COMPU_METHOD M_FORMULA_0913 "V530 FORMULA_0913" RAT_FUNC "%.4g" "%" COEFFS 0 1.28 0 0 0 1 /end COMPU_METHOD
/begin COMPU_METHOD M_FORMULA_0914 "V530 FORMULA_0914" RAT_FUNC "%.4g" "%" COEFFS 0 2.56 0 0 0 1 /end COMPU_METHOD
/begin COMPU_METHOD M_FORMULA_0915 "V530 FORMULA_0915" RAT_FUNC "%.4g" "Nm" COEFFS 0 10000 0 0 0 1 /end COMPU_METHOD
/begin COMPU_METHOD M_FORMULA_0916 "V530 FORMULA_0916" RAT_FUNC "%.4g" "Nm" COEFFS 0 1000 0 0 0 1 /end COMPU_METHOD
/begin COMPU_METHOD M_FORMULA_0921 "V530 FORMULA_0921" RAT_FUNC "%.4g" "Nm" COEFFS 0 1000 0 0 0 1 /end COMPU_METHOD
/begin COMPU_METHOD M_FORMULA_0923 "V530 FORMULA_0923" RAT_FUNC "%.4g" "%" COEFFS 0 1.28 0 0 0 1 /end COMPU_METHOD
/begin COMPU_METHOD M_FORMULA_0924 "V530 FORMULA_0924" RAT_FUNC "%.4g" "ms" COEFFS 0 1.6 0 0 0 1 /end COMPU_METHOD
/begin COMPU_METHOD M_FORMULA_0926 "V530 FORMULA_0926" RAT_FUNC "%.4g" "Nms2" COEFFS 0 128 0 0 0 1 /end COMPU_METHOD
/begin COMPU_METHOD M_FORMULA_0954 "V530 FORMULA_0954" RAT_FUNC "%.4g" "km/h" COEFFS 0 16 0 0 0 1 /end COMPU_METHOD
/begin COMPU_METHOD M_FORMULA_0975 "V530 FORMULA_0975" RAT_FUNC "%.4g" "???C" COEFFS 0 40 10926 0 0 1 /end COMPU_METHOD
/begin COMPU_METHOD M_FORMULA_0980 "V530 FORMULA_0980" RAT_FUNC "%.4g" "s" COEFFS 0 10 0 0 0 1 /end COMPU_METHOD
/begin COMPU_METHOD M_FORMULA_0988 "V530 FORMULA_0988" RAT_FUNC "%.4g" "s" COEFFS 0 1 0 0 0 1 /end COMPU_METHOD
/begin COMPU_METHOD M_FORMULA_1002 "V530 FORMULA_1002" RAT_FUNC "%.4g" "Kelvin" COEFFS 0 10240 0 0 0 1 /end COMPU_METHOD
/begin COMPU_METHOD M_FORMULA_1010 "V530 FORMULA_1010" RAT_FUNC "%.4g" "???C" COEFFS 0 10000 2732000 0 0 1 /end COMPU_METHOD
/begin COMPU_METHOD M_FORMULA_1011 "V530 FORMULA_1011" RAT_FUNC "%.4g" "Kelvin" COEFFS 0 10000 0 0 0 1 /end COMPU_METHOD
/begin COMPU_METHOD CM_0221 "X*0.5" RAT_FUNC "%.4g" "Nm" COEFFS 0 1 0 0 0 0.5 /end COMPU_METHOD
/begin COMPU_METHOD CM_0222 "X*0.625" RAT_FUNC "%.4g" "mbar/s" COEFFS 0 1 0 0 0 0.625 /end COMPU_METHOD
/begin COMPU_METHOD CM_0223 "X*0.1" RAT_FUNC "%.4g" "?KW/10ms" COEFFS 0 1 0 0 0 0.1 /end COMPU_METHOD
/begin COMPU_METHOD CM_0224 "X*0.006" RAT_FUNC "%.4g" "l/min" COEFFS 0 1 0 0 0 0.006 /end COMPU_METHOD
/begin COMPU_METHOD CM_0225 "X" RAT_FUNC "%.4g" "Hz" COEFFS 0 1 0 0 0 1 /end COMPU_METHOD
/begin COMPU_METHOD CM_0226 "X*0.0122070312" RAT_FUNC "%.4g" "mA/s" COEFFS 0 1 0 0 0 0.0122070312 /end COMPU_METHOD
/begin COMPU_METHOD CM_0227 "X*0.0390625" RAT_FUNC "%.4g" "mA/?KW" COEFFS 0 1 0 0 0 0.0390625 /end COMPU_METHOD
/begin COMPU_METHOD CM_0228 "X" RAT_FUNC "%.4g" "mA" COEFFS 0 1 0 0 0 1 /end COMPU_METHOD
/begin COMPU_METHOD CM_0229 "X*0.001" RAT_FUNC "%.4g" "Ohm" COEFFS 0 1 0 0 0 0.001 /end COMPU_METHOD
/begin COMPU_METHOD CM_0230 "X*0.01" RAT_FUNC "%.4g" "10exp-3" COEFFS 0 1 0 0 0 0.01 /end COMPU_METHOD
/begin COMPU_METHOD CM_0231 "X" RAT_FUNC "%.4g" "ASP" COEFFS 0 1 0 0 0 1 /end COMPU_METHOD
/begin COMPU_METHOD CM_0232 "X*0.03125" RAT_FUNC "%.4g" "mg" COEFFS 0 1 0 0 0 0.03125 /end COMPU_METHOD
/begin COMPU_METHOD CM_0234 "X" RAT_FUNC "%.4g" "segm" COEFFS 0 1 0 0 0 1 /end COMPU_METHOD
/begin COMPU_METHOD CM_0237 "X*0.000030517578125" RAT_FUNC "%.4g" "-" COEFFS 0 1 0 0 0 3.051757812e-05 /end COMPU_METHOD
/begin COMPU_METHOD CM_0239 "X*0.0000152587890625" RAT_FUNC "%.4g" "-" COEFFS 0 1 0 0 0 1.525878906e-05 /end COMPU_METHOD
/begin COMPU_METHOD CM_0240 "X/1000" RAT_FUNC "%.4g" "bar" COEFFS 0 1000 0 0 0 1 /end COMPU_METHOD
/begin COMPU_METHOD CM_0241 "X*75/256" RAT_FUNC "%.4g" "mm" COEFFS 0 256 0 0 0 75 /end COMPU_METHOD
/begin COMPU_METHOD CM_0242 "X*128/65536" RAT_FUNC "%.4g" "-" COEFFS 0 512 0 0 0 1 /end COMPU_METHOD
/begin COMPU_METHOD CM_0243 "X/10" RAT_FUNC "%.4g" "?C" COEFFS 0 10 0 0 0 1 /end COMPU_METHOD
/begin COMPU_METHOD CM_0244 "X/100" RAT_FUNC "%.4g" "?C" COEFFS 0 100 0 0 0 1 /end COMPU_METHOD
/begin COMPU_METHOD CM_0246 "X" RAT_FUNC "%.4g" "hPa" COEFFS 0 1 0 0 0 1 /end COMPU_METHOD
/begin COMPU_METHOD CM_0248 "X*10/65536" RAT_FUNC "%.4g" "%" COEFFS 0 32768 0 0 0 5 /end COMPU_METHOD
/begin COMPU_METHOD CM_0249 "X/4" RAT_FUNC "%.4g" "-" COEFFS 0 4 0 0 0 1 /end COMPU_METHOD
/begin COMPU_METHOD CM_0250 "X/256" RAT_FUNC "%.4g" "-" COEFFS 0 256 0 0 0 1 /end COMPU_METHOD
/begin COMPU_METHOD CM_0251 "X/20.97152" RAT_FUNC "%.4g" "%/bar" COEFFS 0 1 0 0 0 0.04768371582 /end COMPU_METHOD
/begin COMPU_METHOD CM_0252 "X/8" RAT_FUNC "%.4g" "l/h" COEFFS 0 8 0 0 0 1 /end COMPU_METHOD
/begin COMPU_METHOD CM_0254 "(X*100)/1024" RAT_FUNC "%.4g" "%" COEFFS 0 256 0 0 0 25 /end COMPU_METHOD
/begin COMPU_METHOD CM_0257 "X/2" RAT_FUNC "%.4g" "l" COEFFS 0 2 0 0 0 1 /end COMPU_METHOD
/begin COMPU_METHOD CM_0261 "X*5000/1024" RAT_FUNC "%.4g" "mV/10ms" COEFFS 0 128 0 0 0 625 /end COMPU_METHOD
/begin COMPU_METHOD CM_0262 "X*5000/1024" RAT_FUNC "%.4g" "mV" COEFFS 0 128 0 0 0 625 /end COMPU_METHOD
/begin COMPU_METHOD CM_0263 "X/3600" RAT_FUNC "%.4g" "g" COEFFS 0 3600 0 0 0 1 /end COMPU_METHOD
/begin COMPU_METHOD CM_0264 "X/16384" RAT_FUNC "%.4g" "-/10ms" COEFFS 0 16384 0 0 0 1 /end COMPU_METHOD
/begin COMPU_METHOD CM_0266 "X/1000" RAT_FUNC "%.4g" "Wok/s" COEFFS 0 1000 0 0 0 1 /end COMPU_METHOD
/begin COMPU_METHOD CM_0267 "X/10000" RAT_FUNC "%.4g" "Wok" COEFFS 0 10000 0 0 0 1 /end COMPU_METHOD
/begin COMPU_METHOD CM_0268 "X*10" RAT_FUNC "%.4g" "rpm/s" COEFFS 0 1 0 0 0 10 /end COMPU_METHOD
/begin COMPU_METHOD CM_0273 "X*10/16384" RAT_FUNC "%.4g" "1/s" COEFFS 0 8192 0 0 0 5 /end COMPU_METHOD
/begin COMPU_METHOD CM_0274 "X*6/10" RAT_FUNC "%.4g" "ms" COEFFS 0 5 0 0 0 3 /end COMPU_METHOD
/begin COMPU_METHOD CM_0275 "X/512" RAT_FUNC "%.4g" "%/100ms" COEFFS 0 512 0 0 0 1 /end COMPU_METHOD
/begin COMPU_METHOD CM_0292 "X" RAT_FUNC "%.4g" "KW tooth" COEFFS 0 1 0 0 0 1 /end COMPU_METHOD
/begin COMPU_METHOD CM_0293 "X" RAT_FUNC "%.4g" "Zaehne/Asp" COEFFS 0 1 0 0 0 1 /end COMPU_METHOD
/begin COMPU_METHOD CM_0294 "1000000/X" RAT_FUNC "%.4g" "Hz" COEFFS 0 0 -1000000 0 -1 0 /end COMPU_METHOD
/begin COMPU_METHOD CM_0295 "X" RAT_FUNC "%.4g" "mA/10ms" COEFFS 0 1 0 0 0 1 /end COMPU_METHOD
/begin COMPU_METHOD CM_0300 "X" RAT_FUNC "%.4g" "Diags" COEFFS 0 1 0 0 0 1 /end COMPU_METHOD
/begin COMPU_METHOD CM_0302 "X/1024" RAT_FUNC "%.4g" "NT_F" COEFFS 0 1024 0 0 0 1 /end COMPU_METHOD
/begin COMPU_METHOD CM_0308 "X/4000+6" RAT_FUNC "%.4g" "V" COEFFS 0 4000 -24000 0 0 1 /end COMPU_METHOD
/begin COMPU_METHOD CM_0309 "X/8000" RAT_FUNC "%.4g" "V" COEFFS 0 8000 0 0 0 1 /end COMPU_METHOD
/begin COMPU_METHOD CM_0310 "X*30/103" RAT_FUNC "%.4g" "Ah" COEFFS 0 103 0 0 0 30 /end COMPU_METHOD
/begin COMPU_METHOD CM_0311 "X/100" RAT_FUNC "%.4g" "%" COEFFS 0 100 0 0 0 1 /end COMPU_METHOD
/begin COMPU_METHOD CM_0313 "X" RAT_FUNC "%.4g" "J/kgK" COEFFS 0 1 0 0 0 1 /end COMPU_METHOD
/begin COMPU_METHOD CM_0314 "X/10" RAT_FUNC "%.4g" "Hz" COEFFS 0 10 0 0 0 1 /end COMPU_METHOD
/begin COMPU_METHOD CM_0315 "X/1000" RAT_FUNC "%.4g" "-" COEFFS 0 1000 0 0 0 1 /end COMPU_METHOD
/begin COMPU_METHOD CM_0316 "X" RAT_FUNC "%.4g" "pksr_cfg.equ" COEFFS 0 1 0 0 0 1 /end COMPU_METHOD
/begin COMPU_METHOD CM_0317 "X/10" RAT_FUNC "%.4g" "bar/s" COEFFS 0 10 0 0 0 1 /end COMPU_METHOD
/begin COMPU_METHOD CM_0318 "X/500" RAT_FUNC "%.4g" "l/min" COEFFS 0 500 0 0 0 1 /end COMPU_METHOD
/begin COMPU_METHOD CM_0319 "X/64" RAT_FUNC "%.4g" "mOhm" COEFFS 0 64 0 0 0 1 /end COMPU_METHOD
/begin COMPU_METHOD CM_0333 "X/80" RAT_FUNC "%.4g" "[]" COEFFS 0 80 0 0 0 1 /end COMPU_METHOD
/begin COMPU_METHOD CM_0335 "X/40" RAT_FUNC "%.4g" "?C" COEFFS 0 40 0 0 0 1 /end COMPU_METHOD
/begin COMPU_METHOD CM_0336 "X" RAT_FUNC "%.4g" "Ah" COEFFS 0 1 0 0 0 1 /end COMPU_METHOD
/begin COMPU_METHOD CM_0337 "X/10" RAT_FUNC "%.4g" "km/h" COEFFS 0 10 0 0 0 1 /end COMPU_METHOD
/begin COMPU_METHOD CM_0338 "X/5" RAT_FUNC "%.4g" "s" COEFFS 0 5 0 0 0 1 /end COMPU_METHOD
/begin COMPU_METHOD CM_0339 "X" RAT_FUNC "%.4g" "km/h" COEFFS 0 1 0 0 0 1 /end COMPU_METHOD
/begin COMPU_METHOD CM_0340 "X/8" RAT_FUNC "%.4g" "A" COEFFS 0 8 0 0 0 1 /end COMPU_METHOD
/begin COMPU_METHOD CM_0341 "X/32" RAT_FUNC "%.4g" "-" COEFFS 0 32 0 0 0 1 /end COMPU_METHOD
/begin COMPU_METHOD CM_0342 "X/10" RAT_FUNC "%.4g" "degC" COEFFS 0 10 0 0 0 1 /end COMPU_METHOD
/begin COMPU_METHOD CM_0350 "X/1000" RAT_FUNC "%.4g" "qmm" COEFFS 0 1000 0 0 0 1 /end COMPU_METHOD
/begin COMPU_METHOD CM_0351 "(X*65536)/300000" RAT_FUNC "%.4g" "l" COEFFS 0 9375 0 0 0 2048 /end COMPU_METHOD
/begin COMPU_METHOD CM_0352 "X/8192" RAT_FUNC "%.4g" "-" COEFFS 0 8192 0 0 0 1 /end COMPU_METHOD
/begin COMPU_METHOD CM_0353 "X/64" RAT_FUNC "%.4g" "mg" COEFFS 0 64 0 0 0 1 /end COMPU_METHOD
/begin COMPU_METHOD CM_0354 "X" RAT_FUNC "%.4g" "Freigabe" COEFFS 0 1 0 0 0 1 /end COMPU_METHOD
/begin COMPU_METHOD CM_0355 "(X*100)/8192" RAT_FUNC "%.4g" "%lam/s" COEFFS 0 2048 0 0 0 25 /end COMPU_METHOD
/begin COMPU_METHOD CM_0356 "X/64" RAT_FUNC "%.4g" "-" COEFFS 0 64 0 0 0 1 /end COMPU_METHOD
/begin COMPU_METHOD CM_0357 "X/100" RAT_FUNC "%.4g" "_LL" COEFFS 0 100 0 0 0 1 /end COMPU_METHOD
/begin COMPU_METHOD CM_0358 "X/10" RAT_FUNC "%.4g" "Liter" COEFFS 0 10 0 0 0 1 /end COMPU_METHOD
/begin COMPU_METHOD CM_0359 "(X/10)-10" RAT_FUNC "%.4g" "Liter" COEFFS 0 10 100 0 0 1 /end COMPU_METHOD
/begin COMPU_METHOD CM_0360 "(X/10)-10" RAT_FUNC "%.4g" "H" COEFFS 0 10 100 0 0 1 /end COMPU_METHOD
/begin COMPU_METHOD CM_0361 "(X/10)-10" RAT_FUNC "%.4g" "_OK" COEFFS 0 10 100 0 0 1 /end COMPU_METHOD
/begin COMPU_METHOD CM_0362 "(X/10)-10" RAT_FUNC "%.4g" "-" COEFFS 0 10 100 0 0 1 /end COMPU_METHOD
/begin COMPU_METHOD CM_0363 "X/1000" RAT_FUNC "%.4g" "Liter" COEFFS 0 1000 0 0 0 1 /end COMPU_METHOD
/begin COMPU_METHOD CM_0364 "X" RAT_FUNC "%.4g" "DE" COEFFS 0 1 0 0 0 1 /end COMPU_METHOD
/begin COMPU_METHOD CM_0365 "X/10" RAT_FUNC "%.4g" "-" COEFFS 0 10 0 0 0 1 /end COMPU_METHOD
/begin COMPU_METHOD CM_0366 "X" RAT_FUNC "%.4g" "WERTE" COEFFS 0 1 0 0 0 1 /end COMPU_METHOD
/begin COMPU_METHOD CM_0367 "X/100" RAT_FUNC "%.4g" "SBLEND" COEFFS 0 100 0 0 0 1 /end COMPU_METHOD
/begin COMPU_METHOD CM_0368 "X/4" RAT_FUNC "%.4g" "CHS" COEFFS 0 4 0 0 0 1 /end COMPU_METHOD
/begin COMPU_METHOD CM_0369 "X*6/65536" RAT_FUNC "%.4g" "-" COEFFS 0 32768 0 0 0 3 /end COMPU_METHOD
/begin COMPU_METHOD CM_0370 "(X-2732)/10" RAT_FUNC "%.4g" "N" COEFFS 0 10 2732 0 0 1 /end COMPU_METHOD
/begin COMPU_METHOD CM_0392 "X*10" RAT_FUNC "%.4g" "A" COEFFS 0 1 0 0 0 10 /end COMPU_METHOD
/begin COMPU_METHOD CM_0393 "X*0.5-40" RAT_FUNC "%.4g" "?C" COEFFS 0 1 40 0 0 0.5 /end COMPU_METHOD
/begin COMPU_METHOD CM_0394 "X*0.03125" RAT_FUNC "%.4g" "-" COEFFS 0 1 0 0 0 0.03125 /end COMPU_METHOD
/begin COMPU_METHOD CM_0395 "X*0.003051757812" RAT_FUNC "%.4g" "-" COEFFS 0 1 0 0 0 0.003051757812 /end COMPU_METHOD
/begin COMPU_METHOD CM_0396 "X*50" RAT_FUNC "%.4g" "Upm" COEFFS 0 1 0 0 0 50 /end COMPU_METHOD
/begin COMPU_METHOD CM_0397 "X*0.25" RAT_FUNC "%.4g" "" COEFFS 0 1 0 0 0 0.25 /end COMPU_METHOD
/begin COMPU_METHOD CM_0398 "X*0.00125" RAT_FUNC "%.4g" "0.0p" COEFFS 0 1 0 0 0 0.00125 /end COMPU_METHOD
/end MODULE
/end PROJECT
